
;============================================================================
;
; *************** THIS SCRIPT WAS AUTOGENERATED - 9/25/2013 *****************
;
; TARGET
;   APQ8084
;
; SCRIPT
;   ..\..\..\SCRIPTS\APQ8084\LPASS\TESTCLOCK.CMM
;
; GENERAL DESCRIPTION
;   This script can be used to route specific clocks to the clock test output
;   on GPIO 0
;
; FUNCTIONS
;   N/A
;
; INITIALIZATION AND SEQUENCING REQUIREMENTS
;   Invoke this script, and choose the clock to test.  The script will program
;   the necessary registers accordingly.
;
;      Copyright (c) 2013 by QUALCOMM Technologies Inc.  All Rights Reserved.
;============================================================================

;-----------------------------------------------------------------------------
; Local variables
;-----------------------------------------------------------------------------

local &clk
local &choice
local &clk_name
local &clk_state
local &clk_freq
local &clk_freq_str
local &header_printed
local &choice_handled
local &old_choice
local &clk_test
local &clk_reg
local &clk_reg_str
local &clk_reg_name
local &print_if_off
local &clk_reg_val
local &clk_reg_val_str
local &clk_reg_cbcr_type
local &state_change
local &print_menu
local &input_file
local &input_line
local &input_file_prompt
local &clock_count
local &multiplier
local &tcxo_count
local &match
local &clk_access_mod
local &testclock_cmd_arg0
local &testclock_cmd_arg1
local &testclock_cmd_arg2
local &testclock_cmd_arg3
local &testclock_cmd_arg4
local &clk_cmd_rcgr_addr
local &clk_cfg_rcgr_addr
local &clk_cmd_rcgr_val
local &clk_cfg_rcgr_val
local &clk_src_name
local &clk_src_sel
local &clk_src_div
local &clk_m_addr
local &clk_n_addr
local &clk_d_addr
local &clk_m_val
local &clk_n_val
local &clk_2d_val

; Constants required for setting clock frequencies
&HAL_CLK_CMD_CFG_UPDATE_FMSK=0x1
&HAL_CLK_CFG_CGR_SRC_SEL_SHFT=0x8
&HAL_CLK_CFG_CGR_SRC_DIV_SHFT=0x0
&HAL_CLK_CFG_CGR_SRC_SEL_FMSK=0x700
&HAL_CLK_CFG_CGR_SRC_DIV_FMSK=0x1f
&HAL_CLK_CFG_CGR_MODE_FMSK=0x3000
&HAL_CLK_CFG_CFG_DUAL_EDGE_MODE_VAL=0x2
&HAL_CLK_CFG_CGR_MODE_SHFT=0xc
&HAL_CLK_M_REG_OFFSET=0x8
&HAL_CLK_N_REG_OFFSET=0xc
&HAL_CLK_D_REG_OFFSET=0x10


;-----------------------------------------------------------------------------
; Define the window
;-----------------------------------------------------------------------------
&testclock_cmd_arg0=""
&testclock_cmd_arg1=""
&testclock_cmd_arg2=""
&testclock_cmd_arg3=""
&testclock_cmd_arg4=""

ENTRY &testclock_cmd_arg0 &testclock_cmd_arg1 &testclock_cmd_arg2 &testclock_cmd_arg3 &testclock_cmd_arg4

; Create a new area window if the script was not invoked in menu mode.
if ("&testclock_cmd_arg0"!="menu")
(
  AREA.RESet
  WINPOS 0. 0. 50% 100%
  AREA.Create CLOCK 120. 1000.
  AREA.view CLOCK
)

AREA.Select CLOCK
AREA.Clear CLOCK

;-----------------------------------------------------------------------------
; Initialize autogenerated constants
;-----------------------------------------------------------------------------

goto Init_Constants
Init_Constants_Done:

;-----------------------------------------------------------------------------
; Print banner and go to main menu
;-----------------------------------------------------------------------------

print " "
print "[----------------------------------------------- APQ8084 Clock Test ----------------------------------------------]"
print " "

;-----------------------------------------------------------------------------
; Read input
;-----------------------------------------------------------------------------

ON ERROR gosub
(
  print "Error occurred processing &clk"
  return
)

&print_if_off=1
&print_menu=1

Main_Menu:
; Only print main menu when it isn't disabled
if (&print_menu!=0)
(
  print " "
  print "Version: 1.0 <2013-09-25>"
  print "Clock (? for list): "
)
else
(
  ; re-enable the main menu after this choice is handled
  &print_menu=1
)

CMD_ARG0:
  if ("&testclock_cmd_arg0"!="")&&(("&testclock_cmd_arg0"!="menu"))
  (
    &choice="&testclock_cmd_arg0"
    &testclock_cmd_arg0=""
    goto Handle_Choice
  )
  else if ("&testclock_cmd_arg0"=="menu")
  (
    goto Handle_Choice
  )
CMD_ARG1:
  if ("&testclock_cmd_arg1"!="")
  (
    &choice="&testclock_cmd_arg1"
    &testclock_cmd_arg1=""
    goto Handle_Choice
  )
CMD_ARG2:
  if ("&testclock_cmd_arg2"!="")
  (
    &choice="&testclock_cmd_arg2"
    &testclock_cmd_arg2=""
    goto Handle_Choice
  )
CMD_ARG3:
  if ("&testclock_cmd_arg3"!="")
  (
    &choice="&testclock_cmd_arg3"
    &testclock_cmd_arg3=""
    goto Handle_Choice
  )
CMD_ARG4:
  if ("&testclock_cmd_arg4"!="")
  (
    &choice="&testclock_cmd_arg4"
    &testclock_cmd_arg4=""
    goto Handle_Choice
  )

Handle_Choice:

&t32_cmm_stopped=1

if ("&choice"=="")
(
  enter &choice
)
&t32_cmm_stopped=0

&header_printed=0
&choice_handled=0
&state_change=""
&input_file_prompt=1

; Exit
if "&choice"=="?"
(
  gosub Help
  &choice_handled=1
  
  ; disable the main menu when displaying the help window
  &print_menu=0
)
else if "&choice"=="x"
(
  ; Close the window if the script was not invoked in menu mode.
  if "&testclock_cmd_arg0"=="menu"
  (
    enddo (0==0)
  )
  else
  (
    WINCLEAR TOP
    enddo (0==0)
  )
)
else if ("&choice"==".")||("&choice"=="")
(
  if "&old_choice"==""
  (
    &old_choice="?"
    
    ; disable the main menu when displaying the help window
    &print_menu=0
  )
  &choice="&old_choice"
  gosub Handle_Choice
)

;-----------------------------------------------------------------------------
; Check for enabling the clock test output on GPIOs
;-----------------------------------------------------------------------------

if "&choice"=="gpio"
(
  ; Configure HS GPIO
  ; data.set eahb:&HWIO_TLMM_GPIO_CFG0_ADDR %LONG 0x1D0
  ; print "GPIO 0 configured and output enabled"

  ; Enable the gcc_dbg_clk on PLLTEST.
  data.set eahb:&HWIO_GCC_PLLTEST_PAD_CFG_ADDR %LONG 0x1200
  print "PLLTEST_PAD configured for GCC debug clock output"

  &choice_handled=1
)

if ("&choice"=="on")||("&choice"=="off")||("&choice"=="set")
(
  &state_change="&choice"
  &choice="&old_choice"
  
  ; do not prompt user for input file again for on/off choice
  if ("&choice"=="file")
  (
    &input_file_prompt=0
  )
)

;-----------------------------------------------------------------------------
; Check for file input with a list of clocks
;-----------------------------------------------------------------------------

if ("&choice"=="file")
(
  if (&input_file_prompt==1)
  (
    print "Enter input file [c:\temp\testclock.txt]: "
    enter &input_file
    if "&input_file"==""
    (
      &input_file="c:\temp\testclock.txt"
    )
  )
  print "Operating on list of clocks from &input_file"
  OPEN #1 &input_file /Read
  READ #1 %line &input_line
  WHILE !EOF()
  (
    gosub Find_Print_Clock &input_line
    
    READ #1 %line &input_line
  )
  CLOSE #1
  
  &choice_handled=1
)


;-----------------------------------------------------------------------------
; Check for dumping all or all/on clocks
;-----------------------------------------------------------------------------

if ("&choice"=="all")||("&choice"=="all_on")
(
  if ("&choice"=="all_on")
  (
    &print_if_off=0
  )
  else
  (
    &print_if_off=1
  )

  gosub Print_All

  &print_if_off=1
  &choice_handled=1
)

if (&choice_handled!=1)
(
  gosub Print_All_SS
)

;-----------------------------------------------------------------------------
; If nothing else, then assume it was a clock name
;-----------------------------------------------------------------------------

if (&choice_handled!=1)
(
  gosub Find_Print_Clock &choice
)

&old_choice="&choice"
&choice=""
goto Main_Menu


;-----------------------------------------------------------------------------
; Display header
;-----------------------------------------------------------------------------

Print_Header:

  if &header_printed==0
  (
    print ""
    print "Clock                                      State      Frequency (MHz)         CBCR Addr : Value        CBCR Type "
    print "---------------------------------------------------------------------------------------------------------------- "

    &header_printed=1
  )

  return


;-----------------------------------------------------------------------------
; Display help
;-----------------------------------------------------------------------------

Help:

  ;-----------------------------------------------------------------------------
  ; Display available clock sources that can be output to the clock test output
  ; and prompt for selection.
  ;-----------------------------------------------------------------------------

  AREA.Create HELP 130. 1000.
  AREA.View HELP
  AREA.Select HELP
  winresize 130. 24.

  print " "
  print " "
  gosub Print_Clock_Help
  print ""
  print "*** Clock groups***   "
  print "  all        - all clocks"
  print "  all_on     - all clocks that are on"
  print "  <ss>_all   - all subsystem clocks"
  print "  <wildcard> - search query"
  print "  file       - file specifying enumerated clocks (separated by newlines)"
  print "  on/off     - modifies on/off state of previously selected clock(s)"
  print "  set        - sets the clock to one of supported frequencies"
  print "  buses      - show all bus clocks"
  print "  cpus       - show all cpu clocks"
  
  print "*** Other options ***"
  print "  x   - exit"
  print "  ?   - help"
  print "  .   - repeat (also carriage return without any arguments)" 
  print "*** Debug options ***"
  print "   gpio       - enable GPIO's for clock output"
  print ""

  AREA.Select CLOCK

  return


;-----------------------------------------------------------------------------
; Display clock info line
;-----------------------------------------------------------------------------

Print_Clk_Info_Line:

  &is_on=0
  &clk_freq=0
  &clk_reg_val=0

  ; Set the default name
  &clk_name=string.cut("&clk_name                                           ", -string.len("&clk_name"))
  
  ;-----------------------------------------------------------------------------
  ; Toggle clock state if requested
  ;-----------------------------------------------------------------------------
  if (&clk_reg!=0)
  (
    if "&state_change"=="on"
    (
      data.set &clk_access_mod&clk_reg %LONG (data.long(&clk_access_mod&clk_reg)|0x00000001)
    )
    else if "&state_change"=="off"
    (
      data.set &clk_access_mod&clk_reg %LONG (data.long(&clk_access_mod&clk_reg)&~(0x00000001))
    )
  )

  if "&state_change"=="set"
  (
    gosub Set_Clock_Freq_Enter
  )

  ;-----------------------------------------------------------------------------
  ; Print the clock header
  ;-----------------------------------------------------------------------------
  gosub Print_Header

  ;-----------------------------------------------------------------------------
  ; Test if clock is on
  ;-----------------------------------------------------------------------------
  
  if (&clk_reg!=0)
  (
    if (data.long(&clk_access_mod&clk_reg)&(0x80000000))==0x0
    (
      &clk_state="ON "
      &is_on=1
    )
    else
    (
      &clk_state="OFF"
      &is_on=0
    )
  )
  else
  (
    &clk_state=" ? " 
    &is_on=1
  )
  
  ;-----------------------------------------------------------------------------
  ; Calculate the clock frequency based on the TCXO counter
  ;-----------------------------------------------------------------------------

  if (&clk_test!=0)&&(&is_on==1)
  (
    gosub Program_Clk_Test

    gosub Calc_Clock_Freq

    if (&clk_freq==0)
    (
      &clk_freq_str=FORMAT.DECIMAL(14., 0x0)
    )
    else
    (
      &clk_freq_str=FORMAT.FLOAT(12., 0x6, &clk_freq) 
    )
  )
  else if (&is_on==0)
  (
    &clk_freq_str=FORMAT.DECIMAL(14., 0x0)
  )
  else
  (
    &clk_freq_str="  Not Testable"
  )
  
  if (&print_if_off==1)||(&is_on==0x1)
  (
    if (&clk_reg!=0)
    (
      &clk_reg_val=FORMAT.HEX(0x8, data.long(&clk_access_mod&clk_reg))
      &clk_reg_val_str="0x&clk_reg_val"
      
      &clk_reg=FORMAT.HEX(0x8, &clk_reg)
      &clk_reg_str="0x&clk_reg"
    )
    else
    (
      &clk_reg_str="----------" 
      &clk_reg_val_str="----------"
    )

    print "&clk_name &clk_state       &clk_freq_str         &clk_reg_str : &clk_reg_val_str   &clk_reg_cbcr_type"
  )

  return


;-----------------------------------------------------------------------------
; Determine clock frequency.
;-----------------------------------------------------------------------------

Calc_Clock_Freq:

  local &l2cpucpselr_val
  local &l2cpucpcpdr_val

  ; Disable auto-gating on L2 clock to get accurate frequency.
  if (cpu()=="KRAIT")&&(&clk_test==&CLK_TEST_APCS_L2_CLK)
  (
    &l2cpucpselr_val=data.long(c15:0x360f)
    data.set c15:0x360f %LONG 0x500
    &l2cpucpcpdr_val=data.long(c15:0x370f)
    data.set c15:0x370f %LONG (&l2cpucpcpdr_val|0xc00)
  )

  ; Save current values
  &xo_div4_cbcr=data.long(eahb:&HWIO_GCC_XO_DIV4_CBCR_ADDR)
  
  ; Measure a short run
  &multiplier=4
  &tcxo_count=0x800
  
  ; Config XO DIV4 comparator clock
  data.set eahb:&HWIO_GCC_XO_DIV4_CBCR_ADDR %LONG data.long(eahb:&HWIO_GCC_XO_DIV4_CBCR_ADDR)|0x1
  
  ; Start with the counter disabled 
  &measure_ctl=data.long(eahb:&HWIO_GCC_CLOCK_FRQ_MEASURE_CTL_ADDR)
  &measure_ctl=&measure_ctl&~0x1FFFFF
  data.set eahb:&HWIO_GCC_CLOCK_FRQ_MEASURE_CTL_ADDR %LONG &measure_ctl
  
  ; Program the starting counter value, high enough to get good accuracy
  &measure_ctl=&measure_ctl|&tcxo_count
  
  ; Start the counting
  &measure_ctl=&measure_ctl|0x100000
  data.set eahb:&HWIO_GCC_CLOCK_FRQ_MEASURE_CTL_ADDR %LONG &measure_ctl
  
  ; Wait for the counters to finish
  wait 1.ms
  while (data.long(eahb:&HWIO_GCC_CLOCK_FRQ_MEASURE_STATUS_ADDR)&0x2000000)==0
  (
  )
  
  ; Turn off the test clock and read the clock count
  &measure_ctl=data.long(eahb:&HWIO_GCC_CLOCK_FRQ_MEASURE_CTL_ADDR)
  data.set eahb:&HWIO_GCC_CLOCK_FRQ_MEASURE_CTL_ADDR %LONG (&measure_ctl&~0x100000)
  
  &short_clock_count=data.long(eahb:&HWIO_GCC_CLOCK_FRQ_MEASURE_STATUS_ADDR)&0x1FFFFFF
  
  ; Restore the registers
  data.set eahb:&HWIO_GCC_XO_DIV4_CBCR_ADDR %LONG &xo_div4_cbcr
 
  ; Now do a longer count and compare
  ; Save current values
  &xo_div4_cbcr=data.long(eahb:&HWIO_GCC_XO_DIV4_CBCR_ADDR)
  
  &multiplier=4
  &tcxo_count=0x8000
  
  ; Config XO DIV4 comparator clock
  data.set eahb:&HWIO_GCC_XO_DIV4_CBCR_ADDR %LONG data.long(eahb:&HWIO_GCC_XO_DIV4_CBCR_ADDR)|0x1
  
  ; Start with the counter disabled 
  &measure_ctl=data.long(eahb:&HWIO_GCC_CLOCK_FRQ_MEASURE_CTL_ADDR)
  &measure_ctl=&measure_ctl&~0x1FFFFF
  data.set eahb:&HWIO_GCC_CLOCK_FRQ_MEASURE_CTL_ADDR %LONG &measure_ctl
  
  ; Program the starting counter value, high enough to get good accuracy
  &measure_ctl=&measure_ctl|&tcxo_count
  
  ; Start the counting
  &measure_ctl=&measure_ctl|0x100000
  data.set eahb:&HWIO_GCC_CLOCK_FRQ_MEASURE_CTL_ADDR %LONG &measure_ctl
  
  ; Wait for the counters to finish
  wait 1.ms
  while (data.long(eahb:&HWIO_GCC_CLOCK_FRQ_MEASURE_STATUS_ADDR)&0x2000000)==0
  (
  )
  
  ; Turn off the test clock and read the clock count
  &measure_ctl=data.long(eahb:&HWIO_GCC_CLOCK_FRQ_MEASURE_CTL_ADDR)
  data.set eahb:&HWIO_GCC_CLOCK_FRQ_MEASURE_CTL_ADDR %LONG (&measure_ctl&~0x100000)
  
  &clock_count=data.long(eahb:&HWIO_GCC_CLOCK_FRQ_MEASURE_STATUS_ADDR)&0x1FFFFFF
  
  ; Calculate the frequency.  Function is provided by
  ; Power Control 42.8.1.2 Measurement technique
  ; f ring = f tcxo/4 * (Nring + 1.5) / (TCtcxo + 3.5)
  ;
  ; The formula below is the equivalent one converted
  ; to integer arithmetic.
  ; 
  ; We add half of the denominator value to the dividend
  ; to guard against rounding errors inherent to
  ; integer arithmetic.
  ;
  
  if &clock_count==&short_clock_count
  (
    &clk_freq=0
  )
  else
  (
    &clk_freq=4.800*(&multiplier)*(&clock_count+1.5)/(&tcxo_count+3.5)
  )
  
  ; Restore the registers
  data.set eahb:&HWIO_GCC_XO_DIV4_CBCR_ADDR %LONG &xo_div4_cbcr
  
  ; Clear the divide by 4 in DEBUG_CLK_CTL to make the scope view of the clock
  ; the correct frequency
  &dbg_clk_ctl=data.long(eahb:&HWIO_GCC_DEBUG_CLK_CTL_ADDR)
  &dbg_clk_ctl=&dbg_clk_ctl&~0x00003000
  data.set eahb:&HWIO_GCC_DEBUG_CLK_CTL_ADDR %LONG &dbg_clk_ctl

  ; Restore the original auto-gating behavior.
  if (cpu()=="KRAIT")&&(&clk_test==&CLK_TEST_APCS_L2_CLK)
  (
    data.set c15:0x370f %LONG &l2cpucpcpdr_val
    data.set c15:0x360f %LONG &l2cpucpselr_val
  )
  
  return


;-----------------------------------------------------------------------------
; Set clock frequency.
;-----------------------------------------------------------------------------

Set_Clock_Freq:

  ; Use testpll.cmm to turn on required source
  do testpll.cmm on &clk_src_name

  ; Convert src divider to appropriate register value
  if (&clk_src_div!=0)
  (
    &clk_src_div=&clk_src_div-1
  )

  ; Read current cmd_rcgr and cfg_rcgr values
  &clk_cmd_rcgr_val=data.long(&clk_access_mod&clk_cmd_rcgr_addr)
  &clk_cfg_rcgr_val=data.long(&clk_access_mod&clk_cfg_rcgr_addr)

  ; Clear src_sel, src_div, and mode fields
  &clk_cfg_rcgr_val=&clk_cfg_rcgr_val&~(&HAL_CLK_CFG_CGR_SRC_SEL_FMSK|&HAL_CLK_CFG_CGR_SRC_DIV_FMSK|&HAL_CLK_CFG_CGR_MODE_FMSK)

  ; Program src_sel and src_div
  &clk_cfg_rcgr_val=&clk_cfg_rcgr_val|((&clk_src_sel<<&HAL_CLK_CFG_CGR_SRC_SEL_SHFT)&(&HAL_CLK_CFG_CGR_SRC_SEL_FMSK))
  &clk_cfg_rcgr_val=&clk_cfg_rcgr_val|((&clk_src_div<<&HAL_CLK_CFG_CGR_SRC_DIV_SHFT)&(&HAL_CLK_CFG_CGR_SRC_DIV_FMSK))

  ; Program M, N, D registers if necessary
  if (&clk_m_val!=0.)&&(&clk_m_val<&clk_n_val)
  (
    &clk_m_addr=&clk_cmd_rcgr_addr+&HAL_CLK_M_REG_OFFSET
    &clk_n_addr=&clk_cmd_rcgr_addr+&HAL_CLK_N_REG_OFFSET
    &clk_2d_addr=&clk_cmd_rcgr_addr+&HAL_CLK_D_REG_OFFSET

    ; Write to M register
    data.set &clk_access_mod&clk_m_addr %long &clk_m_val
    
    ; Write to N register
    data.set &clk_access_mod&clk_n_addr %long ~(&clk_n_val-&clk_m_val)
    
    ; Write to D register
    data.set &clk_access_mod&clk_2d_addr %long ~&clk_2d_val
    
    ; Dual edge mode
    &clk_cfg_rcgr_val=&clk_cfg_rcgr_val|((&HAL_CLK_CFG_CFG_DUAL_EDGE_MODE_VAL<<&HAL_CLK_CFG_CGR_MODE_SHFT)&(&HAL_CLK_CFG_CGR_MODE_FMSK))
  )
  
  ; Write to cfg_rcgr
  data.set &clk_access_mod&clk_cfg_rcgr_addr %long &clk_cfg_rcgr_val

  ; Write to cmd_rcgr to trigger update
  data.set &clk_access_mod&clk_cmd_rcgr_addr %long (&clk_cmd_rcgr_val|&HAL_CLK_CMD_CFG_UPDATE_FMSK)

  ; Wait for update to finish
  wait 1.ms
  while (data.long(&clk_access_mod&clk_cmd_rcgr_addr)&(&HAL_CLK_CMD_CFG_UPDATE_FMSK))!=0
  (
  )

  return


;-----------------------------------------------------------------------------
; Program the clk_test register
;-----------------------------------------------------------------------------

Program_Clk_Test:

  &testval=&clk_test&(&CLK_TEST_TYPE_MASK)
  &selval=&clk_test&(&CLK_TEST_SEL_MASK)
  &submuxval=&clk_test&(&CLK_TEST_SUB_MUX_MASK)

  ; GCC
  if &selval==&CLK_GCC_TEST
  (
    data.set eahb:&HWIO_GCC_DEBUG_CLK_CTL_ADDR %LONG 0x00013000|(&testval&0x000003FF)
    ; No sub-system config
  )
  ; LPASS
  if &selval==&CLK_LPASS_TEST
  (
    data.set eahb:&HWIO_GCC_DEBUG_CLK_CTL_ADDR %LONG 0x00013000|(0x161&0x000003FF)
    data.set eahb:&HWIO_LPASS_DBG_CLK_ADDR %LONG 0x00100000|(&testval&0x0000FFFF)
  )
  ; MMSS
  if &selval==&CLK_MMSS_TEST
  (
    data.set eahb:&HWIO_GCC_DEBUG_CLK_CTL_ADDR %LONG 0x00013000|(0x2c&0x000003FF)
    data.set eahb:&HWIO_MMSS_DEBUG_CLK_CTL_ADDR %LONG 0x00010000|(&testval&0x00000FFF)
  )
  ; APCS
  if &selval==&CLK_APCS_TEST
  (
    local &mult
    &mult=0x3000
    ; APCS cores and L2 are implicitly divided by 4, the others are not.
    if (&clk_test==&CLK_TEST_APCS_C0_CLK)||(&clk_test==&CLK_TEST_APCS_C1_CLK)||(&clk_test==&CLK_TEST_APCS_C2_CLK)||(&clk_test==&CLK_TEST_APCS_C3_CLK)||(&clk_test==&CLK_TEST_APCS_L2_CLK)
    (
      &mult=0x0000
    )
    data.set eahb:&HWIO_GCC_DEBUG_CLK_CTL_ADDR %LONG &mult|0x00010000|(0x16A&0x000003FF)
    data.set eahb:&HWIO_APCS_L2_CBCR_ADDR %LONG 0x1
    data.set eahb:&HWIO_APCS_GLB_CLK_DIAG_ADDR %LONG &testval
  )
  
  return
  



Init_Constants:

; CBCR addresses for clocks

&HWIO_GCC_BAM_DMA_AHB_CBCR_ADDR=0xfc400d44
&HWIO_GCC_BAM_DMA_INACTIVITY_TIMERS_CBCR_ADDR=0xfc400d48
&HWIO_GCC_BIMC_CFG_AHB_CBCR_ADDR=0xfc40110c
&HWIO_GCC_BIMC_CBCR_ADDR=0xfc401118
&HWIO_GCC_BIMC_KPSS_AXI_CBCR_ADDR=0xfc40111c
&HWIO_GCC_BIMC_SLEEP_CBCR_ADDR=0xfc401110
&HWIO_GCC_BIMC_SYSNOC_AXI_CBCR_ADDR=0xfc401114
&HWIO_GCC_BIMC_XO_CBCR_ADDR=0xfc401108
&HWIO_GCC_BLSP1_AHB_CBCR_ADDR=0xfc4005c4
&HWIO_GCC_BLSP1_SLEEP_CBCR_ADDR=0xfc4005c8
&HWIO_GCC_BLSP1_QUP1_I2C_APPS_CBCR_ADDR=0xfc400648
&HWIO_GCC_BLSP1_QUP1_SPI_APPS_CBCR_ADDR=0xfc400644
&HWIO_GCC_BLSP1_QUP2_I2C_APPS_CBCR_ADDR=0xfc4006c8
&HWIO_GCC_BLSP1_QUP2_SPI_APPS_CBCR_ADDR=0xfc4006c4
&HWIO_GCC_BLSP1_QUP3_I2C_APPS_CBCR_ADDR=0xfc400748
&HWIO_GCC_BLSP1_QUP3_SPI_APPS_CBCR_ADDR=0xfc400744
&HWIO_GCC_BLSP1_QUP4_I2C_APPS_CBCR_ADDR=0xfc4007c8
&HWIO_GCC_BLSP1_QUP4_SPI_APPS_CBCR_ADDR=0xfc4007c4
&HWIO_GCC_BLSP1_QUP5_I2C_APPS_CBCR_ADDR=0xfc400848
&HWIO_GCC_BLSP1_QUP5_SPI_APPS_CBCR_ADDR=0xfc400844
&HWIO_GCC_BLSP1_QUP6_I2C_APPS_CBCR_ADDR=0xfc4008c8
&HWIO_GCC_BLSP1_QUP6_SPI_APPS_CBCR_ADDR=0xfc4008c4
&HWIO_GCC_BLSP1_UART1_APPS_CBCR_ADDR=0xfc400684
&HWIO_GCC_BLSP1_UART1_SIM_CBCR_ADDR=0xfc400688
&HWIO_GCC_BLSP1_UART2_APPS_CBCR_ADDR=0xfc400704
&HWIO_GCC_BLSP1_UART2_SIM_CBCR_ADDR=0xfc400708
&HWIO_GCC_BLSP1_UART3_APPS_CBCR_ADDR=0xfc400784
&HWIO_GCC_BLSP1_UART3_SIM_CBCR_ADDR=0xfc400788
&HWIO_GCC_BLSP1_UART4_APPS_CBCR_ADDR=0xfc400804
&HWIO_GCC_BLSP1_UART4_SIM_CBCR_ADDR=0xfc400808
&HWIO_GCC_BLSP1_UART5_APPS_CBCR_ADDR=0xfc400884
&HWIO_GCC_BLSP1_UART5_SIM_CBCR_ADDR=0xfc400888
&HWIO_GCC_BLSP1_UART6_APPS_CBCR_ADDR=0xfc400904
&HWIO_GCC_BLSP1_UART6_SIM_CBCR_ADDR=0xfc400908
&HWIO_GCC_BLSP2_AHB_CBCR_ADDR=0xfc400944
&HWIO_GCC_BLSP2_SLEEP_CBCR_ADDR=0xfc400948
&HWIO_GCC_BLSP2_QUP1_I2C_APPS_CBCR_ADDR=0xfc400988
&HWIO_GCC_BLSP2_QUP1_SPI_APPS_CBCR_ADDR=0xfc400984
&HWIO_GCC_BLSP2_QUP2_I2C_APPS_CBCR_ADDR=0xfc400a08
&HWIO_GCC_BLSP2_QUP2_SPI_APPS_CBCR_ADDR=0xfc400a04
&HWIO_GCC_BLSP2_QUP3_I2C_APPS_CBCR_ADDR=0xfc400a88
&HWIO_GCC_BLSP2_QUP3_SPI_APPS_CBCR_ADDR=0xfc400a84
&HWIO_GCC_BLSP2_QUP4_I2C_APPS_CBCR_ADDR=0xfc400b08
&HWIO_GCC_BLSP2_QUP4_SPI_APPS_CBCR_ADDR=0xfc400b04
&HWIO_GCC_BLSP2_QUP5_I2C_APPS_CBCR_ADDR=0xfc400b88
&HWIO_GCC_BLSP2_QUP5_SPI_APPS_CBCR_ADDR=0xfc400b84
&HWIO_GCC_BLSP2_QUP6_I2C_APPS_CBCR_ADDR=0xfc400c08
&HWIO_GCC_BLSP2_QUP6_SPI_APPS_CBCR_ADDR=0xfc400c04
&HWIO_GCC_BLSP2_UART1_APPS_CBCR_ADDR=0xfc4009c4
&HWIO_GCC_BLSP2_UART1_SIM_CBCR_ADDR=0xfc4009c8
&HWIO_GCC_BLSP2_UART2_APPS_CBCR_ADDR=0xfc400a44
&HWIO_GCC_BLSP2_UART2_SIM_CBCR_ADDR=0xfc400a48
&HWIO_GCC_BLSP2_UART3_APPS_CBCR_ADDR=0xfc400ac4
&HWIO_GCC_BLSP2_UART3_SIM_CBCR_ADDR=0xfc400ac8
&HWIO_GCC_BLSP2_UART4_APPS_CBCR_ADDR=0xfc400b44
&HWIO_GCC_BLSP2_UART4_SIM_CBCR_ADDR=0xfc400b48
&HWIO_GCC_BLSP2_UART5_APPS_CBCR_ADDR=0xfc400bc4
&HWIO_GCC_BLSP2_UART5_SIM_CBCR_ADDR=0xfc400bc8
&HWIO_GCC_BLSP2_UART6_APPS_CBCR_ADDR=0xfc400c44
&HWIO_GCC_BLSP2_UART6_SIM_CBCR_ADDR=0xfc400c48
&HWIO_GCC_BOOT_ROM_AHB_CBCR_ADDR=0xfc400e04
&HWIO_GCC_CE1_AHB_CBCR_ADDR=0xfc40104c
&HWIO_GCC_CE1_AXI_CBCR_ADDR=0xfc401048
&HWIO_GCC_CE1_CBCR_ADDR=0xfc401044
&HWIO_GCC_CE2_AHB_CBCR_ADDR=0xfc40108c
&HWIO_GCC_CE2_AXI_CBCR_ADDR=0xfc401088
&HWIO_GCC_CE2_CBCR_ADDR=0xfc401084
&HWIO_GCC_CE3_AHB_CBCR_ADDR=0xfc401d0c
&HWIO_GCC_CE3_AXI_CBCR_ADDR=0xfc401d08
&HWIO_GCC_CE3_CBCR_ADDR=0xfc401d04
&HWIO_GCC_CNOC_BUS_TIMEOUT0_AHB_CBCR_ADDR=0xfc4012c4
&HWIO_GCC_CNOC_BUS_TIMEOUT1_AHB_CBCR_ADDR=0xfc4012cc
&HWIO_GCC_CNOC_BUS_TIMEOUT2_AHB_CBCR_ADDR=0xfc4012d4
&HWIO_GCC_CNOC_BUS_TIMEOUT3_AHB_CBCR_ADDR=0xfc4012dc
&HWIO_GCC_CNOC_BUS_TIMEOUT4_AHB_CBCR_ADDR=0xfc4012e4
&HWIO_GCC_CNOC_BUS_TIMEOUT5_AHB_CBCR_ADDR=0xfc4012ec
&HWIO_GCC_CNOC_BUS_TIMEOUT6_AHB_CBCR_ADDR=0xfc4012f4
&HWIO_GCC_CNOC_BUS_TIMEOUT7_AHB_CBCR_ADDR=0xfc4012fc
&HWIO_GCC_COPSS_SMMU_AHB_CBCR_ADDR=0xfc401a48
&HWIO_GCC_COPSS_SMMU_AXI_CBCR_ADDR=0xfc401a44
&HWIO_GCC_CFG_NOC_AHB_CBCR_ADDR=0xfc400144
&HWIO_GCC_CFG_NOC_DDR_CFG_CBCR_ADDR=0xfc400148
&HWIO_GCC_CFG_NOC_RPM_AHB_CBCR_ADDR=0xfc40014c
&HWIO_GCC_DCD_XO_CBCR_ADDR=0xfc401c04
&HWIO_GCC_BIMC_DDR_CH0_CBCR_ADDR=0xfc4011a8
&HWIO_GCC_BIMC_DDR_CH1_CBCR_ADDR=0xfc4011ac
&HWIO_GCC_BIMC_DDR_CPLL0_CBCR_ADDR=0xfc401184
&HWIO_GCC_BIMC_DDR_CPLL1_CBCR_ADDR=0xfc401188
&HWIO_GCC_BIMC_GFX_CBCR_ADDR=0xfc4011b0
&HWIO_GCC_DDR_DIM_CFG_CBCR_ADDR=0xfc401180
&HWIO_GCC_DDR_DIM_SLEEP_CBCR_ADDR=0xfc40118c
&HWIO_GCC_DEHR_CBCR_ADDR=0xfc401304
&HWIO_GCC_AHB_CBCR_ADDR=0xfc4010c0
&HWIO_GCC_IM_SLEEP_CBCR_ADDR=0xfc4010cc
&HWIO_GCC_XO_CBCR_ADDR=0xfc4010c4
&HWIO_GCC_XO_DIV4_CBCR_ADDR=0xfc4010c8
&HWIO_GCC_GP1_CBCR_ADDR=0xfc401900
&HWIO_GCC_GP2_CBCR_ADDR=0xfc401940
&HWIO_GCC_GP3_CBCR_ADDR=0xfc401980
&HWIO_GCC_IMEM_AXI_CBCR_ADDR=0xfc400204
&HWIO_GCC_IMEM_CFG_AHB_CBCR_ADDR=0xfc400208
&HWIO_GCC_KPSS_AHB_CBCR_ADDR=0xfc401204
&HWIO_GCC_KPSS_AXI_CBCR_ADDR=0xfc401208
&HWIO_GCC_LPASS_MPORT_AXI_CBCR_ADDR=0xfc4011c4
&HWIO_GCC_LPASS_Q6_AXI_CBCR_ADDR=0xfc4011c0
&HWIO_GCC_LPASS_SWAY_CBCR_ADDR=0xfc4011c8
&HWIO_GCC_MMSS_BIMC_GFX_CBCR_ADDR=0xfc400254
&HWIO_GCC_MMSS_NOC_AT_CBCR_ADDR=0xfc400250
&HWIO_GCC_MMSS_NOC_CFG_AHB_CBCR_ADDR=0xfc40024c
&HWIO_GCC_MMSS_VPU_MAPLE_SYS_NOC_AXI_CBCR_ADDR=0xfc40026c
&HWIO_GCC_OCMEM_NOC_CFG_AHB_CBCR_ADDR=0xfc400248
&HWIO_GCC_OCMEM_SYS_NOC_AXI_CBCR_ADDR=0xfc400244
&HWIO_GCC_MPM_AHB_CBCR_ADDR=0xfc400ec8
&HWIO_GCC_MSG_RAM_AHB_CBCR_ADDR=0xfc400e44
&HWIO_GCC_NOC_CONF_XPU_AHB_CBCR_ADDR=0xfc4001c0
&HWIO_GCC_OBT_ODT_CBCR_ADDR=0xfc401cd8
&HWIO_GCC_PCIE_0_AUX_CBCR_ADDR=0xfc401b10
&HWIO_GCC_PCIE_0_CFG_AHB_CBCR_ADDR=0xfc401b0c
&HWIO_GCC_PCIE_0_MSTR_AXI_CBCR_ADDR=0xfc401b08
&HWIO_GCC_PCIE_0_PIPE_CBCR_ADDR=0xfc401b14
&HWIO_GCC_PCIE_0_SLV_AXI_CBCR_ADDR=0xfc401b04
&HWIO_GCC_PCIE_0_PIPE_CBCR_ADDR=0xfc401b14
&HWIO_GCC_PCIE_1_AUX_CBCR_ADDR=0xfc401b90
&HWIO_GCC_PCIE_1_CFG_AHB_CBCR_ADDR=0xfc401b8c
&HWIO_GCC_PCIE_1_MSTR_AXI_CBCR_ADDR=0xfc401b88
&HWIO_GCC_PCIE_1_PIPE_CBCR_ADDR=0xfc401b94
&HWIO_GCC_PCIE_1_SLV_AXI_CBCR_ADDR=0xfc401b84
&HWIO_GCC_PCIE_1_PIPE_CBCR_ADDR=0xfc401b94
&HWIO_GCC_PDM2_CBCR_ADDR=0xfc400ccc
&HWIO_GCC_PDM_AHB_CBCR_ADDR=0xfc400cc4
&HWIO_GCC_PDM_XO4_CBCR_ADDR=0xfc400cc8
&HWIO_GCC_PNOC_BUS_TIMEOUT0_AHB_CBCR_ADDR=0xfc401284
&HWIO_GCC_PNOC_BUS_TIMEOUT1_AHB_CBCR_ADDR=0xfc40128c
&HWIO_GCC_PNOC_BUS_TIMEOUT2_AHB_CBCR_ADDR=0xfc401294
&HWIO_GCC_PNOC_BUS_TIMEOUT3_AHB_CBCR_ADDR=0xfc40129c
&HWIO_GCC_PNOC_BUS_TIMEOUT4_AHB_CBCR_ADDR=0xfc4012a4
&HWIO_GCC_PRNG_AHB_CBCR_ADDR=0xfc400d04
&HWIO_GCC_PERIPH_NOC_AHB_CBCR_ADDR=0xfc400184
&HWIO_GCC_PERIPH_NOC_AT_CBCR_ADDR=0xfc40018c
&HWIO_GCC_PERIPH_NOC_CFG_AHB_CBCR_ADDR=0xfc400188
&HWIO_GCC_PERIPH_NOC_USB_HSIC_AHB_CBCR_ADDR=0xfc4001a4
&HWIO_GCC_QDSS_AT_CBCR_ADDR=0xfc40030c
&HWIO_GCC_QDSS_CFG_AHB_CBCR_ADDR=0xfc400308
&HWIO_GCC_QDSS_DAP_AHB_CBCR_ADDR=0xfc400304
&HWIO_GCC_QDSS_DAP_CBCR_ADDR=0xfc400324
&HWIO_GCC_QDSS_ETR_USB_CBCR_ADDR=0xfc400310
&HWIO_GCC_QDSS_STM_CBCR_ADDR=0xfc400314
&HWIO_GCC_QDSS_TRACECLKIN_CBCR_ADDR=0xfc400318
&HWIO_GCC_QDSS_TSCTR_DIV16_CBCR_ADDR=0xfc400330
&HWIO_GCC_QDSS_TSCTR_DIV2_CBCR_ADDR=0xfc40031c
&HWIO_GCC_QDSS_TSCTR_DIV3_CBCR_ADDR=0xfc400320
&HWIO_GCC_QDSS_TSCTR_DIV4_CBCR_ADDR=0xfc400328
&HWIO_GCC_QDSS_TSCTR_DIV8_CBCR_ADDR=0xfc40032c
&HWIO_GCC_QDSS_RBCPR_XPU_AHB_CBCR_ADDR=0xfc4002c0
&HWIO_GCC_RBCPR_AHB_CBCR_ADDR=0xfc401388
&HWIO_GCC_RBCPR_CBCR_ADDR=0xfc401384
&HWIO_GCC_RPM_BUS_AHB_CBCR_ADDR=0xfc400f04
&HWIO_GCC_RPM_PROC_HCLK_CBCR_ADDR=0xfc400f00
&HWIO_GCC_RPM_SLEEP_CBCR_ADDR=0xfc400f08
&HWIO_GCC_RPM_TIMER_CBCR_ADDR=0xfc400f0c
&HWIO_GCC_SATA_ASIC0_CBCR_ADDR=0xfc401c54
&HWIO_GCC_SATA_AXI_CBCR_ADDR=0xfc401c44
&HWIO_GCC_SATA_CFG_AHB_CBCR_ADDR=0xfc401c48
&HWIO_GCC_SATA_PMALIVE_CBCR_ADDR=0xfc401c50
&HWIO_GCC_SATA_RX_CBCR_ADDR=0xfc401c58
&HWIO_GCC_SATA_RX_OOB_CBCR_ADDR=0xfc401c4c
&HWIO_GCC_SDCC1_AHB_CBCR_ADDR=0xfc4004c8
&HWIO_GCC_SDCC1_APPS_CBCR_ADDR=0xfc4004c4
&HWIO_GCC_SDCC1_CDCCAL_FF_CBCR_ADDR=0xfc4004e8
&HWIO_GCC_SDCC1_CDCCAL_SLEEP_CBCR_ADDR=0xfc4004e4
&HWIO_GCC_SDCC2_AHB_CBCR_ADDR=0xfc400508
&HWIO_GCC_SDCC2_APPS_CBCR_ADDR=0xfc400504
&HWIO_GCC_SDCC2_INACTIVITY_TIMERS_CBCR_ADDR=0xfc40050c
&HWIO_GCC_SDCC3_AHB_CBCR_ADDR=0xfc400548
&HWIO_GCC_SDCC3_APPS_CBCR_ADDR=0xfc400544
&HWIO_GCC_SDCC3_INACTIVITY_TIMERS_CBCR_ADDR=0xfc40054c
&HWIO_GCC_SDCC4_AHB_CBCR_ADDR=0xfc400588
&HWIO_GCC_SDCC4_APPS_CBCR_ADDR=0xfc400584
&HWIO_GCC_SDCC4_INACTIVITY_TIMERS_CBCR_ADDR=0xfc40058c
&HWIO_GCC_SNOC_BUS_TIMEOUT0_AHB_CBCR_ADDR=0xfc401244
&HWIO_GCC_SNOC_BUS_TIMEOUT2_AHB_CBCR_ADDR=0xfc40124c
&HWIO_GCC_SNOC_BUS_TIMEOUT3_AHB_CBCR_ADDR=0xfc401254
&HWIO_GCC_SPDM_BIMC_CY_CBCR_ADDR=0xfc401010
&HWIO_GCC_SPDM_CFG_AHB_CBCR_ADDR=0xfc401004
&HWIO_GCC_SPDM_FF_CBCR_ADDR=0xfc40100c
&HWIO_GCC_SPDM_MSTR_AHB_CBCR_ADDR=0xfc401008
&HWIO_GCC_SPDM_PNOC_CY_CBCR_ADDR=0xfc40101c
&HWIO_GCC_SPDM_RPM_CY_CBCR_ADDR=0xfc401020
&HWIO_GCC_SPDM_SNOC_CY_CBCR_ADDR=0xfc401014
&HWIO_GCC_SPMI_AHB_CBCR_ADDR=0xfc400fcc
&HWIO_GCC_SPMI_CNOC_AHB_CBCR_ADDR=0xfc400fc8
&HWIO_GCC_SPMI_SER_CBCR_ADDR=0xfc400fc4
&HWIO_GCC_SPSS_AHB_CBCR_ADDR=0xfc401a84
&HWIO_GCC_SEC_CTRL_ACC_CBCR_ADDR=0xfc400f44
&HWIO_GCC_SEC_CTRL_AHB_CBCR_ADDR=0xfc400f48
&HWIO_GCC_SEC_CTRL_BOOT_ROM_PATCH_CBCR_ADDR=0xfc400f54
&HWIO_GCC_SEC_CTRL_CBCR_ADDR=0xfc400f4c
&HWIO_GCC_SEC_CTRL_SENSE_CBCR_ADDR=0xfc400f50
&HWIO_GCC_SNOC_CNOC_AHB_CBCR_ADDR=0xfc400114
&HWIO_GCC_SNOC_PNOC_AHB_CBCR_ADDR=0xfc400118
&HWIO_GCC_SYS_NOC_AT_CBCR_ADDR=0xfc40011c
&HWIO_GCC_SYS_NOC_AXI_CBCR_ADDR=0xfc400104
&HWIO_GCC_SYS_NOC_KPSS_AHB_CBCR_ADDR=0xfc400110
&HWIO_GCC_SYS_NOC_QDSS_STM_AXI_CBCR_ADDR=0xfc40010c
&HWIO_GCC_SYS_NOC_UFS_AXI_CBCR_ADDR=0xfc40013c
&HWIO_GCC_SYS_NOC_USB3_AXI_CBCR_ADDR=0xfc400108
&HWIO_GCC_SYS_NOC_USB3_SEC_AXI_CBCR_ADDR=0xfc400138
&HWIO_GCC_TCSR_AHB_CBCR_ADDR=0xfc400dc4
&HWIO_GCC_TLMM_AHB_CBCR_ADDR=0xfc400e84
&HWIO_GCC_TLMM_CBCR_ADDR=0xfc400e88
&HWIO_GCC_TSIF_AHB_CBCR_ADDR=0xfc400d84
&HWIO_GCC_TSIF_INACTIVITY_TIMERS_CBCR_ADDR=0xfc400d8c
&HWIO_GCC_TSIF_REF_CBCR_ADDR=0xfc400d88
&HWIO_GCC_UFS_AHB_CBCR_ADDR=0xfc401d48
&HWIO_GCC_UFS_AXI_CBCR_ADDR=0xfc401d44
&HWIO_GCC_UFS_RX_CFG_CBCR_ADDR=0xfc401d50
&HWIO_GCC_UFS_RX_SYMBOL_0_CBCR_ADDR=0xfc401d5c
&HWIO_GCC_UFS_RX_SYMBOL_1_CBCR_ADDR=0xfc401d60
&HWIO_GCC_UFS_TX_CFG_CBCR_ADDR=0xfc401d4c
&HWIO_GCC_UFS_TX_SYMBOL_0_CBCR_ADDR=0xfc401d54
&HWIO_GCC_UFS_TX_SYMBOL_1_CBCR_ADDR=0xfc401d58
&HWIO_GCC_USB2A_PHY_SLEEP_CBCR_ADDR=0xfc4004ac
&HWIO_GCC_USB2B_PHY_SLEEP_CBCR_ADDR=0xfc4004b4
&HWIO_GCC_USB30_MASTER_CBCR_ADDR=0xfc4003c8
&HWIO_GCC_USB30_MOCK_UTMI_CBCR_ADDR=0xfc4003d0
&HWIO_GCC_USB30_SLEEP_CBCR_ADDR=0xfc4003cc
&HWIO_GCC_USB30_SEC_MASTER_CBCR_ADDR=0xfc401bc8
&HWIO_GCC_USB30_SEC_MOCK_UTMI_CBCR_ADDR=0xfc401bd0
&HWIO_GCC_USB30_SEC_SLEEP_CBCR_ADDR=0xfc401bcc
&HWIO_GCC_USB_HS_AHB_CBCR_ADDR=0xfc400488
&HWIO_GCC_USB_HS_INACTIVITY_TIMERS_CBCR_ADDR=0xfc40048c
&HWIO_GCC_USB_HS_SYSTEM_CBCR_ADDR=0xfc400484
&HWIO_GCC_USB_HSIC_AHB_CBCR_ADDR=0xfc400408
&HWIO_GCC_USB_HSIC_CBCR_ADDR=0xfc400410
&HWIO_GCC_USB_HSIC_IO_CAL_CBCR_ADDR=0xfc400414
&HWIO_GCC_USB_HSIC_IO_CAL_SLEEP_CBCR_ADDR=0xfc400418
&HWIO_GCC_USB_HSIC_MOCK_UTMI_CBCR_ADDR=0xfc401f14
&HWIO_GCC_USB_HSIC_SYSTEM_CBCR_ADDR=0xfc40040c
&HWIO_GCC_PERIPH_NOC_MPU_CFG_AHB_CBCR_ADDR=0xfc401340
&HWIO_GCC_PERIPH_XPU_AHB_CBCR_ADDR=0xfc400c80
&HWIO_GCC_DEBUG_CLK_CTL_ADDR=0xfc401880
&HWIO_LPASS_AUDIO_CORE_AVSYNC_CSR_CBCR_ADDR=0xfe01a000
&HWIO_LPASS_AUDIO_CORE_BSTC_CBCR_ADDR=0xfe01a004
&HWIO_LPASS_AUDIO_CORE_CSR_CBCR_ADDR=0xfe01d000
&HWIO_LPASS_AUDIO_CORE_DML_CBCR_ADDR=0xfe01e000
&HWIO_LPASS_AUDIO_CORE_IXFABRIC_CBCR_ADDR=0xfe01b000
&HWIO_LPASS_AUDIO_CORE_IXFABRIC_SPDMTM_CSR_CBCR_ADDR=0xfe028000
&HWIO_LPASS_AUDIO_CORE_LPAIF_CSR_CBCR_ADDR=0xfe009004
&HWIO_LPASS_AUDIO_CORE_LPAIF_DMA_CBCR_ADDR=0xfe009000
&HWIO_LPASS_AUDIO_CORE_LPM_CBCR_ADDR=0xfe019000
&HWIO_LPASS_AUDIO_CORE_MIDI_LFABIF_CBCR_ADDR=0xfe008018
&HWIO_LPASS_AUDIO_CORE_RESAMPLER_LFABIF_CBCR_ADDR=0xfe011018
&HWIO_LPASS_AUDIO_CORE_SECURITY_CBCR_ADDR=0xfe021000
&HWIO_LPASS_AUDIO_CORE_SLIMBUS_LFABIF_CBCR_ADDR=0xfe012018
&HWIO_LPASS_AUDIO_CORE_TIMEOUT_CBCR_ADDR=0xfe020000
&HWIO_LPASS_AUDIO_WRAPPER_BR_CBCR_ADDR=0xfe024000
&HWIO_LPASS_AUDIO_WRAPPER_EFABRIC_CBCR_ADDR=0xfe01b004
&HWIO_LPASS_AUDIO_WRAPPER_EFABRIC_SPDMTM_CSR_CBCR_ADDR=0xfe028004
&HWIO_LPASS_AUDIO_WRAPPER_LCC_CSR_CBCR_ADDR=0xfe023000
&HWIO_LPASS_AUDIO_WRAPPER_SECURITY_CBCR_ADDR=0xfe021004
&HWIO_LPASS_AUDIO_WRAPPER_SMEM_CBCR_ADDR=0xfe025000
&HWIO_LPASS_AUDIO_WRAPPER_SYSNOC_SWAY_CBCR_ADDR=0xfe01f004
&HWIO_LPASS_AUDIO_WRAPPER_TIMEOUT_CBCR_ADDR=0xfe020004
&HWIO_LPASS_DIGCODEC_AHB_CBCR_ADDR=0xfe02c018
&HWIO_LPASS_HDMIRX_AHB_CBCR_ADDR=0xfe02b000
&HWIO_LPASS_Q6SS_AHB_LFABIF_CBCR_ADDR=0xfe022000
&HWIO_LPASS_Q6SS_AHBM_CBCR_ADDR=0xfe022004
&HWIO_LPASS_SIF_AHB_CBCR_ADDR=0xfe02a004
&HWIO_LPASS_SPDIFTX_AHBM_CBCR_ADDR=0xfe02901c
&HWIO_LPASS_SPDIFTX_AHBS_CBCR_ADDR=0xfe029018
&HWIO_LPASS_AUDIO_CORE_AVSYNC_BT_XO_CBCR_ADDR=0xfe01a00c
&HWIO_LPASS_AUDIO_CORE_AVSYNC_FM_XO_CBCR_ADDR=0xfe01a010
&HWIO_LPASS_AUDIO_CORE_AVSYNC_XO_CBCR_ADDR=0xfe01a008
&HWIO_LPASS_AUDIO_CORE_GDSC_XO_CBCR_ADDR=0xfe007004
&HWIO_LPASS_AUDIO_WRAPPER_STM_XO_CBCR_ADDR=0xfe027000
&HWIO_LPASS_Q6SS_XO_CBCR_ADDR=0xfe026000
&HWIO_LPASS_DIGCODEC_CBCR_ADDR=0xfe02c014
&HWIO_LPASS_AUDIO_CORE_LPAIF_PCM_DATA_OE_CBCR_ADDR=0xfe013014
&HWIO_LPASS_AUDIO_CORE_LPAIF_PRI_EBIT_CBCR_ADDR=0xfe00b01c
&HWIO_LPASS_AUDIO_CORE_LPAIF_PRI_IBIT_CBCR_ADDR=0xfe00b018
&HWIO_LPASS_AUDIO_CORE_LPAIF_PRI_OSR_CBCR_ADDR=0xfe00b014
&HWIO_LPASS_AUDIO_CORE_LPAIF_PCM0_EBIT_CBCR_ADDR=0xfe00f018
&HWIO_LPASS_AUDIO_CORE_LPAIF_PCM0_IBIT_CBCR_ADDR=0xfe00f014
&HWIO_LPASS_AUDIO_CORE_LPAIF_QUAD_EBIT_CBCR_ADDR=0xfe00e01c
&HWIO_LPASS_AUDIO_CORE_LPAIF_QUAD_IBIT_CBCR_ADDR=0xfe00e018
&HWIO_LPASS_AUDIO_CORE_LPAIF_QUAD_OSR_CBCR_ADDR=0xfe00e014
&HWIO_LPASS_AUDIO_CORE_RESAMPLER_CORE_CBCR_ADDR=0xfe011014
&HWIO_LPASS_SIF_CBCR_ADDR=0xfe02a000
&HWIO_LPASS_AUDIO_CORE_SLIMBUS_CORE_CBCR_ADDR=0xfe012014
&HWIO_LPASS_AUDIO_CORE_SLIMBUS_CORE_CBCR_ADDR=0xfe012014
&HWIO_LPASS_SPDIFTX_BMC_CBCR_ADDR=0xfe029014
&HWIO_LPASS_AUDIO_CORE_LPAIF_SEC_EBIT_CBCR_ADDR=0xfe00c01c
&HWIO_LPASS_AUDIO_CORE_LPAIF_SEC_IBIT_CBCR_ADDR=0xfe00c018
&HWIO_LPASS_AUDIO_CORE_LPAIF_SEC_OSR_CBCR_ADDR=0xfe00c014
&HWIO_LPASS_AUDIO_CORE_LPAIF_PCM1_EBIT_CBCR_ADDR=0xfe010018
&HWIO_LPASS_AUDIO_CORE_LPAIF_PCM1_IBIT_CBCR_ADDR=0xfe010014
&HWIO_LPASS_AUDIO_CORE_BCR_SLP_CBCR_ADDR=0xfe004004
&HWIO_LPASS_Q6SS_BCR_SLP_CBCR_ADDR=0xfe006004
&HWIO_LPASS_Q6SS_SLP_CBCR_ADDR=0xfe026004
&HWIO_LPASS_AUDIO_CORE_LPAIF_CODEC_SPKR_EBIT_CBCR_ADDR=0xfe00a01c
&HWIO_LPASS_AUDIO_CORE_LPAIF_CODEC_SPKR_IBIT_CBCR_ADDR=0xfe00a018
&HWIO_LPASS_AUDIO_CORE_LPAIF_CODEC_SPKR_OSR_CBCR_ADDR=0xfe00a014
&HWIO_LPASS_AUDIO_CORE_LPAIF_TER_EBIT_CBCR_ADDR=0xfe00d01c
&HWIO_LPASS_AUDIO_CORE_LPAIF_TER_IBIT_CBCR_ADDR=0xfe00d018
&HWIO_LPASS_AUDIO_CORE_LPAIF_TER_OSR_CBCR_ADDR=0xfe00d014
&HWIO_LPASS_DBG_CLK_ADDR=0xfe032000
&HWIO_MMSS_AVSYNC_AHB_CBCR_ADDR=0xfd8c2414
&HWIO_MMSS_AVSYNC_EDPPIXEL_CBCR_ADDR=0xfd8c2418
&HWIO_MMSS_AVSYNC_EXTPCLK_CBCR_ADDR=0xfd8c2410
&HWIO_MMSS_AVSYNC_PCLK0_CBCR_ADDR=0xfd8c241c
&HWIO_MMSS_AVSYNC_PCLK1_CBCR_ADDR=0xfd8c2420
&HWIO_MMSS_AVSYNC_VP_CBCR_ADDR=0xfd8c2404
&HWIO_MMSS_CAMSS_AHB_CBCR_ADDR=0xfd8c348c
&HWIO_MMSS_CAMSS_CCI_CCI_AHB_CBCR_ADDR=0xfd8c3348
&HWIO_MMSS_CAMSS_CCI_CCI_CBCR_ADDR=0xfd8c3344
&HWIO_MMSS_CAMSS_CSI0_AHB_CBCR_ADDR=0xfd8c30bc
&HWIO_MMSS_CAMSS_CSI0_CBCR_ADDR=0xfd8c30b4
&HWIO_MMSS_CAMSS_CSI0PHY_CBCR_ADDR=0xfd8c30c4
&HWIO_MMSS_CAMSS_CSI0PIX_CBCR_ADDR=0xfd8c30e4
&HWIO_MMSS_CAMSS_CSI0RDI_CBCR_ADDR=0xfd8c30d4
&HWIO_MMSS_CAMSS_CSI1_AHB_CBCR_ADDR=0xfd8c3128
&HWIO_MMSS_CAMSS_CSI1_CBCR_ADDR=0xfd8c3124
&HWIO_MMSS_CAMSS_CSI1PHY_CBCR_ADDR=0xfd8c3134
&HWIO_MMSS_CAMSS_CSI1PIX_CBCR_ADDR=0xfd8c3154
&HWIO_MMSS_CAMSS_CSI1RDI_CBCR_ADDR=0xfd8c3144
&HWIO_MMSS_CAMSS_CSI2_AHB_CBCR_ADDR=0xfd8c3188
&HWIO_MMSS_CAMSS_CSI2_CBCR_ADDR=0xfd8c3184
&HWIO_MMSS_CAMSS_CSI2PHY_CBCR_ADDR=0xfd8c3194
&HWIO_MMSS_CAMSS_CSI2PIX_CBCR_ADDR=0xfd8c31b4
&HWIO_MMSS_CAMSS_CSI2RDI_CBCR_ADDR=0xfd8c31a4
&HWIO_MMSS_CAMSS_CSI3_AHB_CBCR_ADDR=0xfd8c31e8
&HWIO_MMSS_CAMSS_CSI3_CBCR_ADDR=0xfd8c31e4
&HWIO_MMSS_CAMSS_CSI3PHY_CBCR_ADDR=0xfd8c31f4
&HWIO_MMSS_CAMSS_CSI3PIX_CBCR_ADDR=0xfd8c3214
&HWIO_MMSS_CAMSS_CSI3RDI_CBCR_ADDR=0xfd8c3204
&HWIO_MMSS_CAMSS_CSI_VFE0_CBCR_ADDR=0xfd8c3704
&HWIO_MMSS_CAMSS_CSI_VFE1_CBCR_ADDR=0xfd8c3714
&HWIO_MMSS_CAMSS_GP0_CBCR_ADDR=0xfd8c3444
&HWIO_MMSS_CAMSS_GP1_CBCR_ADDR=0xfd8c3474
&HWIO_MMSS_CAMSS_ISPIF_AHB_CBCR_ADDR=0xfd8c3224
&HWIO_MMSS_CAMSS_JPEG_JPEG0_CBCR_ADDR=0xfd8c35a8
&HWIO_MMSS_CAMSS_JPEG_JPEG1_CBCR_ADDR=0xfd8c35ac
&HWIO_MMSS_CAMSS_JPEG_JPEG2_CBCR_ADDR=0xfd8c35b0
&HWIO_MMSS_CAMSS_JPEG_JPEG_AHB_CBCR_ADDR=0xfd8c35b4
&HWIO_MMSS_CAMSS_JPEG_JPEG_AXI_CBCR_ADDR=0xfd8c35b8
&HWIO_MMSS_CAMSS_MCLK0_CBCR_ADDR=0xfd8c3384
&HWIO_MMSS_CAMSS_MCLK1_CBCR_ADDR=0xfd8c33b4
&HWIO_MMSS_CAMSS_MCLK2_CBCR_ADDR=0xfd8c33e4
&HWIO_MMSS_CAMSS_MCLK3_CBCR_ADDR=0xfd8c3414
&HWIO_MMSS_CAMSS_MICRO_AHB_CBCR_ADDR=0xfd8c3494
&HWIO_MMSS_CAMSS_PHY0_CSI0PHYTIMER_CBCR_ADDR=0xfd8c3024
&HWIO_MMSS_CAMSS_PHY1_CSI1PHYTIMER_CBCR_ADDR=0xfd8c3054
&HWIO_MMSS_CAMSS_PHY2_CSI2PHYTIMER_CBCR_ADDR=0xfd8c3084
&HWIO_MMSS_CAMSS_TOP_AHB_CBCR_ADDR=0xfd8c3484
&HWIO_MMSS_CAMSS_VFE_CPP_AHB_CBCR_ADDR=0xfd8c36b4
&HWIO_MMSS_CAMSS_VFE_CPP_CBCR_ADDR=0xfd8c36b0
&HWIO_MMSS_CAMSS_VFE_VFE0_CBCR_ADDR=0xfd8c36a8
&HWIO_MMSS_CAMSS_VFE_VFE1_CBCR_ADDR=0xfd8c36ac
&HWIO_MMSS_CAMSS_VFE_VFE_AHB_CBCR_ADDR=0xfd8c36b8
&HWIO_MMSS_CAMSS_VFE_VFE_AXI_CBCR_ADDR=0xfd8c36bc
&HWIO_MMSS_MDSS_AHB_CBCR_ADDR=0xfd8c2308
&HWIO_MMSS_MDSS_AXI_CBCR_ADDR=0xfd8c2310
&HWIO_MMSS_MDSS_BYTE0_CBCR_ADDR=0xfd8c233c
&HWIO_MMSS_MDSS_BYTE1_CBCR_ADDR=0xfd8c2340
&HWIO_MMSS_MDSS_EDPAUX_CBCR_ADDR=0xfd8c2334
&HWIO_MMSS_MDSS_EDPLINK_CBCR_ADDR=0xfd8c2330
&HWIO_MMSS_MDSS_EDPPIXEL_CBCR_ADDR=0xfd8c232c
&HWIO_MMSS_MDSS_ESC0_CBCR_ADDR=0xfd8c2344
&HWIO_MMSS_MDSS_ESC1_CBCR_ADDR=0xfd8c2348
&HWIO_MMSS_MDSS_EXTPCLK_CBCR_ADDR=0xfd8c2324
&HWIO_MMSS_MDSS_HDMI_AHB_CBCR_ADDR=0xfd8c230c
&HWIO_MMSS_MDSS_HDMI_CBCR_ADDR=0xfd8c2338
&HWIO_MMSS_MDSS_MDP_CBCR_ADDR=0xfd8c231c
&HWIO_MMSS_MDSS_MDP_LUT_CBCR_ADDR=0xfd8c2320
&HWIO_MMSS_MDSS_PCLK0_CBCR_ADDR=0xfd8c2314
&HWIO_MMSS_MDSS_PCLK1_CBCR_ADDR=0xfd8c2318
&HWIO_MMSS_MDSS_VSYNC_CBCR_ADDR=0xfd8c2328
&HWIO_MMSS_CXO_CBCR_ADDR=0xfd8c5104
&HWIO_MMSS_SLEEPCLK_CBCR_ADDR=0xfd8c5100
&HWIO_MMSS_MISC_AHB_CBCR_ADDR=0xfd8c502c
&HWIO_MMSS_MMSSNOC_AHB_CBCR_ADDR=0xfd8c5024
&HWIO_MMSS_MMSSNOC_BTO_AHB_CBCR_ADDR=0xfd8c5028
&HWIO_MMSS_MMSSNOC_AXI_CBCR_ADDR=0xfd8c506c
&HWIO_MMSS_S0_AXI_CBCR_ADDR=0xfd8c5064
&HWIO_MMSS_RBCPR_AHB_CBCR_ADDR=0xfd8c4088
&HWIO_MMSS_RBCPR_CBCR_ADDR=0xfd8c4084
&HWIO_MMSS_SPDM_AHB_CBCR_ADDR=0xfd8c0230
&HWIO_MMSS_SPDM_AXI_CBCR_ADDR=0xfd8c0210
&HWIO_MMSS_SPDM_CSI0_CBCR_ADDR=0xfd8c023c
&HWIO_MMSS_SPDM_GFX3D_CBCR_ADDR=0xfd8c022c
&HWIO_MMSS_SPDM_JPEG0_CBCR_ADDR=0xfd8c0204
&HWIO_MMSS_SPDM_JPEG1_CBCR_ADDR=0xfd8c0208
&HWIO_MMSS_SPDM_JPEG2_CBCR_ADDR=0xfd8c0224
&HWIO_MMSS_SPDM_MDP_CBCR_ADDR=0xfd8c020c
&HWIO_MMSS_SPDM_PCLK0_CBCR_ADDR=0xfd8c0234
&HWIO_MMSS_SPDM_PCLK1_CBCR_ADDR=0xfd8c0228
&HWIO_MMSS_SPDM_VCODEC0_CBCR_ADDR=0xfd8c0214
&HWIO_MMSS_SPDM_VFE0_CBCR_ADDR=0xfd8c0218
&HWIO_MMSS_SPDM_VFE1_CBCR_ADDR=0xfd8c021c
&HWIO_MMSS_SPDM_RM_AXI_CBCR_ADDR=0xfd8c0304
&HWIO_MMSS_SPDM_RM_OCMEMNOC_CBCR_ADDR=0xfd8c0308
&HWIO_MMSS_OCMEMCX_AHB_CBCR_ADDR=0xfd8c405c
&HWIO_MMSS_OCMEMCX_OCMEMNOC_CBCR_ADDR=0xfd8c4058
&HWIO_MMSS_OXILI_OCMEMGX_CBCR_ADDR=0xfd8c402c
&HWIO_MMSS_OXILI_GFX3D_CBCR_ADDR=0xfd8c4028
&HWIO_MMSS_OXILI_RBBMTIMER_CBCR_ADDR=0xfd8c40b0
&HWIO_MMSS_OXILICX_AHB_CBCR_ADDR=0xfd8c403c
&HWIO_MMSS_VENUS0_AHB_CBCR_ADDR=0xfd8c1030
&HWIO_MMSS_VENUS0_AXI_CBCR_ADDR=0xfd8c1034
&HWIO_MMSS_VENUS0_CORE0_VCODEC_CBCR_ADDR=0xfd8c1048
&HWIO_MMSS_VENUS0_CORE1_VCODEC_CBCR_ADDR=0xfd8c104c
&HWIO_MMSS_VENUS0_OCMEMNOC_CBCR_ADDR=0xfd8c1038
&HWIO_MMSS_VENUS0_VCODEC0_CBCR_ADDR=0xfd8c1028
&HWIO_MMSS_VPU_AHB_CBCR_ADDR=0xfd8c1430
&HWIO_MMSS_VPU_AXI_CBCR_ADDR=0xfd8c143c
&HWIO_MMSS_VPU_BUS_CBCR_ADDR=0xfd8c1440
&HWIO_MMSS_VPU_CXO_CBCR_ADDR=0xfd8c1434
&HWIO_MMSS_VPU_MAPLE_CBCR_ADDR=0xfd8c142c
&HWIO_MMSS_VPU_SLEEP_CBCR_ADDR=0xfd8c1438
&HWIO_MMSS_VPU_VDP_CBCR_ADDR=0xfd8c1428
&HWIO_MMSS_DEBUG_CLK_CTL_ADDR=0xfd8c0900
&HWIO_APCS_L2_CBCR_ADDR=0xf901104c
&HWIO_APCS_GLB_CLK_DIAG_ADDR=0xf901101c

; CMD and CFG RCGR addresses for configurable clocks

&HWIO_GCC_XO_DIV4_CBCR_ADDR=0xfc4010c8
&HWIO_GCC_CLOCK_FRQ_MEASURE_CTL_ADDR=0xfc401884
&HWIO_GCC_CLOCK_FRQ_MEASURE_STATUS_ADDR=0xfc401888
&HWIO_TLMM_GPIO_CFG0_ADDR=0xfd511000
&HWIO_GCC_PLLTEST_PAD_CFG_ADDR=0xfc40188c

; Test Masks
&CLK_TEST_TYPE_MASK=(0x00007FFF)
&CLK_TEST_SEL_MASK=(0x000F0000)
&CLK_TEST_SUB_MUX_MASK=(0xF0000000)

;Sub-system Test Masks
&CLK_GCC_TEST=(0x1<<0x10)
&CLK_LPASS_TEST=(0x2<<0x10)
&CLK_MMSS_TEST=(0x3<<0x10)
&CLK_APCS_TEST=(0x4<<0x10)
      
; GCC Sub Mux List
      
; LPASS Sub Mux List
      
; MMSS Sub Mux List
      
; APCS Sub Mux List

; GCC Test Clocks
&CLK_TEST_GCC_BAM_DMA_AHB_CLK=(&CLK_GCC_TEST|0x0E0)
&CLK_TEST_GCC_BAM_DMA_INACTIVITY_TIMERS_CLK=(&CLK_GCC_TEST|0x0E1)
&CLK_TEST_GCC_BIMC_CFG_AHB_CLK=(&CLK_GCC_TEST|0x151)
&CLK_TEST_GCC_BIMC_CLK=(&CLK_GCC_TEST|0x154)
&CLK_TEST_GCC_BIMC_KPSS_AXI_CLK=(&CLK_GCC_TEST|0x155)
&CLK_TEST_GCC_BIMC_SLEEP_CLK=(&CLK_GCC_TEST|0x152)
&CLK_TEST_GCC_BIMC_SYSNOC_AXI_CLK=(&CLK_GCC_TEST|0x153)
&CLK_TEST_GCC_BIMC_XO_CLK=(&CLK_GCC_TEST|0x150)
&CLK_TEST_GCC_BLSP1_AHB_CLK=(&CLK_GCC_TEST|0x088)
&CLK_TEST_GCC_BLSP1_SLEEP_CLK=(&CLK_GCC_TEST|0x089)
&CLK_TEST_GCC_BLSP1_QUP1_I2C_APPS_CLK=(&CLK_GCC_TEST|0x08B)
&CLK_TEST_GCC_BLSP1_QUP1_SPI_APPS_CLK=(&CLK_GCC_TEST|0x08A)
&CLK_TEST_GCC_BLSP1_QUP2_I2C_APPS_CLK=(&CLK_GCC_TEST|0x090)
&CLK_TEST_GCC_BLSP1_QUP2_SPI_APPS_CLK=(&CLK_GCC_TEST|0x08E)
&CLK_TEST_GCC_BLSP1_QUP3_I2C_APPS_CLK=(&CLK_GCC_TEST|0x094)
&CLK_TEST_GCC_BLSP1_QUP3_SPI_APPS_CLK=(&CLK_GCC_TEST|0x093)
&CLK_TEST_GCC_BLSP1_QUP4_I2C_APPS_CLK=(&CLK_GCC_TEST|0x099)
&CLK_TEST_GCC_BLSP1_QUP4_SPI_APPS_CLK=(&CLK_GCC_TEST|0x098)
&CLK_TEST_GCC_BLSP1_QUP5_I2C_APPS_CLK=(&CLK_GCC_TEST|0x09D)
&CLK_TEST_GCC_BLSP1_QUP5_SPI_APPS_CLK=(&CLK_GCC_TEST|0x09C)
&CLK_TEST_GCC_BLSP1_QUP6_I2C_APPS_CLK=(&CLK_GCC_TEST|0x0A2)
&CLK_TEST_GCC_BLSP1_QUP6_SPI_APPS_CLK=(&CLK_GCC_TEST|0x0A1)
&CLK_TEST_GCC_BLSP1_UART1_APPS_CLK=(&CLK_GCC_TEST|0x08C)
&CLK_TEST_GCC_BLSP1_UART1_SIM_CLK=(&CLK_GCC_TEST|0x08D)
&CLK_TEST_GCC_BLSP1_UART2_APPS_CLK=(&CLK_GCC_TEST|0x091)
&CLK_TEST_GCC_BLSP1_UART2_SIM_CLK=(&CLK_GCC_TEST|0x092)
&CLK_TEST_GCC_BLSP1_UART3_APPS_CLK=(&CLK_GCC_TEST|0x095)
&CLK_TEST_GCC_BLSP1_UART3_SIM_CLK=(&CLK_GCC_TEST|0x096)
&CLK_TEST_GCC_BLSP1_UART4_APPS_CLK=(&CLK_GCC_TEST|0x09A)
&CLK_TEST_GCC_BLSP1_UART4_SIM_CLK=(&CLK_GCC_TEST|0x09B)
&CLK_TEST_GCC_BLSP1_UART5_APPS_CLK=(&CLK_GCC_TEST|0x09E)
&CLK_TEST_GCC_BLSP1_UART5_SIM_CLK=(&CLK_GCC_TEST|0x0A0)
&CLK_TEST_GCC_BLSP1_UART6_APPS_CLK=(&CLK_GCC_TEST|0x0A3)
&CLK_TEST_GCC_BLSP1_UART6_SIM_CLK=(&CLK_GCC_TEST|0x0A4)
&CLK_TEST_GCC_BLSP2_AHB_CLK=(&CLK_GCC_TEST|0x0A8)
&CLK_TEST_GCC_BLSP2_SLEEP_CLK=(&CLK_GCC_TEST|0x0A9)
&CLK_TEST_GCC_BLSP2_QUP1_I2C_APPS_CLK=(&CLK_GCC_TEST|0x0AB)
&CLK_TEST_GCC_BLSP2_QUP1_SPI_APPS_CLK=(&CLK_GCC_TEST|0x0AA)
&CLK_TEST_GCC_BLSP2_QUP2_I2C_APPS_CLK=(&CLK_GCC_TEST|0x0B0)
&CLK_TEST_GCC_BLSP2_QUP2_SPI_APPS_CLK=(&CLK_GCC_TEST|0x0AE)
&CLK_TEST_GCC_BLSP2_QUP3_I2C_APPS_CLK=(&CLK_GCC_TEST|0x0B4)
&CLK_TEST_GCC_BLSP2_QUP3_SPI_APPS_CLK=(&CLK_GCC_TEST|0x0B3)
&CLK_TEST_GCC_BLSP2_QUP4_I2C_APPS_CLK=(&CLK_GCC_TEST|0x0B9)
&CLK_TEST_GCC_BLSP2_QUP4_SPI_APPS_CLK=(&CLK_GCC_TEST|0x0B8)
&CLK_TEST_GCC_BLSP2_QUP5_I2C_APPS_CLK=(&CLK_GCC_TEST|0x0BD)
&CLK_TEST_GCC_BLSP2_QUP5_SPI_APPS_CLK=(&CLK_GCC_TEST|0x0BC)
&CLK_TEST_GCC_BLSP2_QUP6_I2C_APPS_CLK=(&CLK_GCC_TEST|0x0C2)
&CLK_TEST_GCC_BLSP2_QUP6_SPI_APPS_CLK=(&CLK_GCC_TEST|0x0C1)
&CLK_TEST_GCC_BLSP2_UART1_APPS_CLK=(&CLK_GCC_TEST|0x0AC)
&CLK_TEST_GCC_BLSP2_UART1_SIM_CLK=(&CLK_GCC_TEST|0x0AD)
&CLK_TEST_GCC_BLSP2_UART2_APPS_CLK=(&CLK_GCC_TEST|0x0B1)
&CLK_TEST_GCC_BLSP2_UART2_SIM_CLK=(&CLK_GCC_TEST|0x0B2)
&CLK_TEST_GCC_BLSP2_UART3_APPS_CLK=(&CLK_GCC_TEST|0x0B5)
&CLK_TEST_GCC_BLSP2_UART3_SIM_CLK=(&CLK_GCC_TEST|0x0B6)
&CLK_TEST_GCC_BLSP2_UART4_APPS_CLK=(&CLK_GCC_TEST|0x0BA)
&CLK_TEST_GCC_BLSP2_UART4_SIM_CLK=(&CLK_GCC_TEST|0x0BB)
&CLK_TEST_GCC_BLSP2_UART5_APPS_CLK=(&CLK_GCC_TEST|0x0BE)
&CLK_TEST_GCC_BLSP2_UART5_SIM_CLK=(&CLK_GCC_TEST|0x0C0)
&CLK_TEST_GCC_BLSP2_UART6_APPS_CLK=(&CLK_GCC_TEST|0x0C3)
&CLK_TEST_GCC_BLSP2_UART6_SIM_CLK=(&CLK_GCC_TEST|0x0C4)
&CLK_TEST_GCC_BOOT_ROM_AHB_CLK=(&CLK_GCC_TEST|0x0F8)
&CLK_TEST_GCC_CE1_AHB_CLK=(&CLK_GCC_TEST|0x13A)
&CLK_TEST_GCC_CE1_AXI_CLK=(&CLK_GCC_TEST|0x139)
&CLK_TEST_GCC_CE1_CLK=(&CLK_GCC_TEST|0x138)
&CLK_TEST_GCC_CE2_AHB_CLK=(&CLK_GCC_TEST|0x142)
&CLK_TEST_GCC_CE2_AXI_CLK=(&CLK_GCC_TEST|0x141)
&CLK_TEST_GCC_CE2_CLK=(&CLK_GCC_TEST|0x140)
&CLK_TEST_GCC_CE3_AHB_CLK=(&CLK_GCC_TEST|0x22A)
&CLK_TEST_GCC_CE3_AXI_CLK=(&CLK_GCC_TEST|0x229)
&CLK_TEST_GCC_CE3_CLK=(&CLK_GCC_TEST|0x228)
&CLK_TEST_GCC_CNOC_BUS_TIMEOUT0_AHB_CLK=(&CLK_GCC_TEST|0x180)
&CLK_TEST_GCC_CNOC_BUS_TIMEOUT1_AHB_CLK=(&CLK_GCC_TEST|0x181)
&CLK_TEST_GCC_CNOC_BUS_TIMEOUT2_AHB_CLK=(&CLK_GCC_TEST|0x182)
&CLK_TEST_GCC_CNOC_BUS_TIMEOUT3_AHB_CLK=(&CLK_GCC_TEST|0x183)
&CLK_TEST_GCC_CNOC_BUS_TIMEOUT4_AHB_CLK=(&CLK_GCC_TEST|0x184)
&CLK_TEST_GCC_CNOC_BUS_TIMEOUT5_AHB_CLK=(&CLK_GCC_TEST|0x185)
&CLK_TEST_GCC_CNOC_BUS_TIMEOUT6_AHB_CLK=(&CLK_GCC_TEST|0x186)
&CLK_TEST_GCC_CNOC_BUS_TIMEOUT7_AHB_CLK=(&CLK_GCC_TEST|0x187)
&CLK_TEST_GCC_COPSS_SMMU_AHB_CLK=(&CLK_GCC_TEST|0x1E9)
&CLK_TEST_GCC_COPSS_SMMU_AXI_CLK=(&CLK_GCC_TEST|0x1E8)
&CLK_TEST_GCC_CFG_NOC_AHB_CLK=(&CLK_GCC_TEST|0x008)
&CLK_TEST_GCC_CFG_NOC_DDR_CFG_CLK=(&CLK_GCC_TEST|0x009)
&CLK_TEST_GCC_CFG_NOC_RPM_AHB_CLK=(&CLK_GCC_TEST|0x00A)
&CLK_TEST_GCC_CFG_NOC_TIC_CLK=(&CLK_GCC_TEST|0x00B)
&CLK_TEST_GCC_DCD_XO_CLK=(&CLK_GCC_TEST|0x210)
&CLK_TEST_GCC_BIMC_DDR_CH0_CLK=(&CLK_GCC_TEST|0x15C)
&CLK_TEST_GCC_BIMC_DDR_CH1_CLK=(&CLK_GCC_TEST|0x15D)
&CLK_TEST_GCC_BIMC_DDR_CPLL0_CLK=(&CLK_GCC_TEST|0x159)
&CLK_TEST_GCC_BIMC_DDR_CPLL1_CLK=(&CLK_GCC_TEST|0x15A)
&CLK_TEST_GCC_BIMC_GFX_CLK=(&CLK_GCC_TEST|0x15E)
&CLK_TEST_GCC_DDR_DIM_CFG_CLK=(&CLK_GCC_TEST|0x158)
&CLK_TEST_GCC_DDR_DIM_SLEEP_CLK=(&CLK_GCC_TEST|0x15B)
&CLK_TEST_GCC_DEHR_CLK=(&CLK_GCC_TEST|0x188)
&CLK_TEST_GCC_AHB_CLK=(&CLK_GCC_TEST|0x148)
&CLK_TEST_GCC_IM_SLEEP_CLK=(&CLK_GCC_TEST|0x14B)
&CLK_TEST_GCC_XO_CLK=(&CLK_GCC_TEST|0x149)
&CLK_TEST_GCC_XO_DIV4_CLK=(&CLK_GCC_TEST|0x14A)
&CLK_TEST_GCC_IMEM_AXI_CLK=(&CLK_GCC_TEST|0x020)
&CLK_TEST_GCC_IMEM_CFG_AHB_CLK=(&CLK_GCC_TEST|0x021)
&CLK_TEST_GCC_KPSS_AHB_CLK=(&CLK_GCC_TEST|0x168)
&CLK_TEST_GCC_KPSS_AXI_CLK=(&CLK_GCC_TEST|0x169)
&CLK_TEST_KPSS_GCC_DBG_CLK=(&CLK_GCC_TEST|0x16A)
&CLK_TEST_GCC_LPASS_MPORT_AXI_CLK=(&CLK_GCC_TEST|0x162)
&CLK_TEST_GCC_LPASS_Q6_AXI_CLK=(&CLK_GCC_TEST|0x160)
&CLK_TEST_GCC_LPASS_SWAY_CLK=(&CLK_GCC_TEST|0x163)
&CLK_TEST_LPASS_GCC_DBG_CLK=(&CLK_GCC_TEST|0x161)
&CLK_TEST_GCC_MMSS_BIMC_GFX_CLK=(&CLK_GCC_TEST|0x02D)
&CLK_TEST_GCC_MMSS_NOC_AT_CLK=(&CLK_GCC_TEST|0x02B)
&CLK_TEST_GCC_MMSS_NOC_CFG_AHB_CLK=(&CLK_GCC_TEST|0x02A)
&CLK_TEST_GCC_MMSS_VPU_MAPLE_SYS_NOC_AXI_CLK=(&CLK_GCC_TEST|0x02E)
&CLK_TEST_GCC_OCMEM_NOC_CFG_AHB_CLK=(&CLK_GCC_TEST|0x029)
&CLK_TEST_GCC_OCMEM_SYS_NOC_AXI_CLK=(&CLK_GCC_TEST|0x028)
&CLK_TEST_MMSS_GCC_DBG_CLK=(&CLK_GCC_TEST|0x02C)
&CLK_TEST_GCC_MPM_AHB_CLK=(&CLK_GCC_TEST|0x110)
&CLK_TEST_GCC_MSG_RAM_AHB_CLK=(&CLK_GCC_TEST|0x100)
&CLK_TEST_GCC_NOC_CONF_XPU_AHB_CLK=(&CLK_GCC_TEST|0x018)
&CLK_TEST_GCC_OBT_ODT_CLK=(&CLK_GCC_TEST|0x220)
&CLK_TEST_CH0_DLL0_DTEST=(&CLK_GCC_TEST|0x1E0)
&CLK_TEST_CH0_DLL0_LOCK=(&CLK_GCC_TEST|0x1E1)
&CLK_TEST_CH0_DLL1_DTEST=(&CLK_GCC_TEST|0x1E2)
&CLK_TEST_CH0_DLL1_LOCK=(&CLK_GCC_TEST|0x1E3)
&CLK_TEST_CH1_DLL0_DTEST=(&CLK_GCC_TEST|0x1E4)
&CLK_TEST_CH1_DLL0_LOCK=(&CLK_GCC_TEST|0x1E5)
&CLK_TEST_CH1_DLL1_DTEST=(&CLK_GCC_TEST|0x1E6)
&CLK_TEST_CH1_DLL1_LOCK=(&CLK_GCC_TEST|0x1E7)
&CLK_TEST_GPLL0_DTEST=(&CLK_GCC_TEST|0x1C0)
&CLK_TEST_GPLL0_LOCK_DET=(&CLK_GCC_TEST|0x1C1)
&CLK_TEST_GPLL1_DTEST=(&CLK_GCC_TEST|0x1C2)
&CLK_TEST_GPLL1_LOCK_DET=(&CLK_GCC_TEST|0x1C3)
&CLK_TEST_GPLL2_DTEST=(&CLK_GCC_TEST|0x1C4)
&CLK_TEST_GPLL2_LOCK_DET=(&CLK_GCC_TEST|0x1C5)
&CLK_TEST_GPLL3_DTEST=(&CLK_GCC_TEST|0x1C6)
&CLK_TEST_GPLL3_LOCK_DET=(&CLK_GCC_TEST|0x1C7)
&CLK_TEST_GPLL4_DTEST=(&CLK_GCC_TEST|0x1D8)
&CLK_TEST_GPLL4_LOCK_DET=(&CLK_GCC_TEST|0x1D9)
&CLK_TEST_KPSS_GCC_RINGOSC_CLK=(&CLK_GCC_TEST|0x1D0)
&CLK_TEST_MPM_GCC_TEMP_SENSOR_RINGOSC_CLK=(&CLK_GCC_TEST|0x1C8)
&CLK_TEST_USB2_PHY_GCC_ATEST_ULPI_0_CLK=(&CLK_GCC_TEST|0x1A0)
&CLK_TEST_USB2_PHY_GCC_ATEST_ULPI_1_CLK=(&CLK_GCC_TEST|0x1A8)
&CLK_TEST_USB2_PHY_WRAPPER_GCC_USB30_UTMI_CLK=(&CLK_GCC_TEST|0x1B8)
&CLK_TEST_USB3_PHY_WRAPPER_GCC_USB3_PIPE_CLK=(&CLK_GCC_TEST|0x1B0)
&CLK_TEST_USB_HSPW_GCC_480_TEST_CLK=(&CLK_GCC_TEST|0x198)
&CLK_TEST_GCC_PCIE_0_AUX_CLK=(&CLK_GCC_TEST|0x1FB)
&CLK_TEST_GCC_PCIE_0_CFG_AHB_CLK=(&CLK_GCC_TEST|0x1FA)
&CLK_TEST_GCC_PCIE_0_MSTR_AXI_CLK=(&CLK_GCC_TEST|0x1F9)
&CLK_TEST_GCC_PCIE_0_PIPE_CLK=(&CLK_GCC_TEST|0x1FC)
&CLK_TEST_GCC_PCIE_0_SLV_AXI_CLK=(&CLK_GCC_TEST|0x1F8)
&CLK_TEST_PCIE_0_PIPE_CLK=(&CLK_GCC_TEST|0x1FD)
&CLK_TEST_GCC_PCIE_1_AUX_CLK=(&CLK_GCC_TEST|0x203)
&CLK_TEST_GCC_PCIE_1_CFG_AHB_CLK=(&CLK_GCC_TEST|0x202)
&CLK_TEST_GCC_PCIE_1_MSTR_AXI_CLK=(&CLK_GCC_TEST|0x201)
&CLK_TEST_GCC_PCIE_1_PIPE_CLK=(&CLK_GCC_TEST|0x204)
&CLK_TEST_GCC_PCIE_1_SLV_AXI_CLK=(&CLK_GCC_TEST|0x200)
&CLK_TEST_PCIE_1_PIPE_CLK=(&CLK_GCC_TEST|0x205)
&CLK_TEST_GCC_PDM2_CLK=(&CLK_GCC_TEST|0x0D2)
&CLK_TEST_GCC_PDM_AHB_CLK=(&CLK_GCC_TEST|0x0D0)
&CLK_TEST_GCC_PDM_XO4_CLK=(&CLK_GCC_TEST|0x0D1)
&CLK_TEST_GCC_PNOC_BUS_TIMEOUT0_AHB_CLK=(&CLK_GCC_TEST|0x178)
&CLK_TEST_GCC_PNOC_BUS_TIMEOUT1_AHB_CLK=(&CLK_GCC_TEST|0x179)
&CLK_TEST_GCC_PNOC_BUS_TIMEOUT2_AHB_CLK=(&CLK_GCC_TEST|0x17A)
&CLK_TEST_GCC_PNOC_BUS_TIMEOUT3_AHB_CLK=(&CLK_GCC_TEST|0x17B)
&CLK_TEST_GCC_PNOC_BUS_TIMEOUT4_AHB_CLK=(&CLK_GCC_TEST|0x17C)
&CLK_TEST_GCC_PRNG_AHB_CLK=(&CLK_GCC_TEST|0x0D8)
&CLK_TEST_GCC_PERIPH_NOC_AHB_CLK=(&CLK_GCC_TEST|0x010)
&CLK_TEST_GCC_PERIPH_NOC_AT_CLK=(&CLK_GCC_TEST|0x012)
&CLK_TEST_GCC_PERIPH_NOC_CFG_AHB_CLK=(&CLK_GCC_TEST|0x011)
&CLK_TEST_GCC_PERIPH_NOC_USB_HSIC_AHB_CLK=(&CLK_GCC_TEST|0x013)
&CLK_TEST_GCC_QDSS_AT_CLK=(&CLK_GCC_TEST|0x042)
&CLK_TEST_GCC_QDSS_CFG_AHB_CLK=(&CLK_GCC_TEST|0x041)
&CLK_TEST_GCC_QDSS_DAP_AHB_CLK=(&CLK_GCC_TEST|0x040)
&CLK_TEST_GCC_QDSS_DAP_CLK=(&CLK_GCC_TEST|0x049)
&CLK_TEST_GCC_QDSS_ETR_USB_CLK=(&CLK_GCC_TEST|0x043)
&CLK_TEST_GCC_QDSS_STM_CLK=(&CLK_GCC_TEST|0x044)
&CLK_TEST_GCC_QDSS_TRACECLKIN_CLK=(&CLK_GCC_TEST|0x045)
&CLK_TEST_GCC_QDSS_TSCTR_DIV16_CLK=(&CLK_GCC_TEST|0x04C)
&CLK_TEST_GCC_QDSS_TSCTR_DIV2_CLK=(&CLK_GCC_TEST|0x046)
&CLK_TEST_GCC_QDSS_TSCTR_DIV3_CLK=(&CLK_GCC_TEST|0x048)
&CLK_TEST_GCC_QDSS_TSCTR_DIV4_CLK=(&CLK_GCC_TEST|0x04A)
&CLK_TEST_GCC_QDSS_TSCTR_DIV8_CLK=(&CLK_GCC_TEST|0x04B)
&CLK_TEST_GCC_QDSS_RBCPR_XPU_AHB_CLK=(&CLK_GCC_TEST|0x038)
&CLK_TEST_GCC_RBCPR_AHB_CLK=(&CLK_GCC_TEST|0x191)
&CLK_TEST_GCC_RBCPR_CLK=(&CLK_GCC_TEST|0x190)
&CLK_TEST_GCC_RPM_BUS_AHB_CLK=(&CLK_GCC_TEST|0x11A)
&CLK_TEST_GCC_RPM_PROC_FCLK=(&CLK_GCC_TEST|0x118)
&CLK_TEST_GCC_RPM_PROC_HCLK=(&CLK_GCC_TEST|0x119)
&CLK_TEST_GCC_RPM_SLEEP_CLK=(&CLK_GCC_TEST|0x11B)
&CLK_TEST_GCC_RPM_TIMER_CLK=(&CLK_GCC_TEST|0x11C)
&CLK_TEST_GCC_SATA_ASIC0_CLK=(&CLK_GCC_TEST|0x21C)
&CLK_TEST_GCC_SATA_AXI_CLK=(&CLK_GCC_TEST|0x218)
&CLK_TEST_GCC_SATA_CFG_AHB_CLK=(&CLK_GCC_TEST|0x219)
&CLK_TEST_GCC_SATA_PMALIVE_CLK=(&CLK_GCC_TEST|0x21B)
&CLK_TEST_GCC_SATA_RX_CLK=(&CLK_GCC_TEST|0x21D)
&CLK_TEST_GCC_SATA_RX_OOB_CLK=(&CLK_GCC_TEST|0x21A)
&CLK_TEST_GCC_SDCC1_AHB_CLK=(&CLK_GCC_TEST|0x069)
&CLK_TEST_GCC_SDCC1_APPS_CLK=(&CLK_GCC_TEST|0x068)
&CLK_TEST_GCC_SDCC1_CDCCAL_FF_CLK=(&CLK_GCC_TEST|0x06B)
&CLK_TEST_GCC_SDCC1_CDCCAL_SLEEP_CLK=(&CLK_GCC_TEST|0x06A)
&CLK_TEST_GCC_SDCC2_AHB_CLK=(&CLK_GCC_TEST|0x071)
&CLK_TEST_GCC_SDCC2_APPS_CLK=(&CLK_GCC_TEST|0x070)
&CLK_TEST_GCC_SDCC2_INACTIVITY_TIMERS_CLK=(&CLK_GCC_TEST|0x072)
&CLK_TEST_GCC_SDCC3_AHB_CLK=(&CLK_GCC_TEST|0x079)
&CLK_TEST_GCC_SDCC3_APPS_CLK=(&CLK_GCC_TEST|0x078)
&CLK_TEST_GCC_SDCC3_INACTIVITY_TIMERS_CLK=(&CLK_GCC_TEST|0x07A)
&CLK_TEST_GCC_SDCC4_AHB_CLK=(&CLK_GCC_TEST|0x081)
&CLK_TEST_GCC_SDCC4_APPS_CLK=(&CLK_GCC_TEST|0x080)
&CLK_TEST_GCC_SDCC4_INACTIVITY_TIMERS_CLK=(&CLK_GCC_TEST|0x082)
&CLK_TEST_GCC_SNOC_BUS_TIMEOUT0_AHB_CLK=(&CLK_GCC_TEST|0x170)
&CLK_TEST_GCC_SNOC_BUS_TIMEOUT2_AHB_CLK=(&CLK_GCC_TEST|0x171)
&CLK_TEST_GCC_SNOC_BUS_TIMEOUT3_AHB_CLK=(&CLK_GCC_TEST|0x172)
&CLK_TEST_GCC_SPDM_BIMC_CY_CLK=(&CLK_GCC_TEST|0x133)
&CLK_TEST_GCC_SPDM_CFG_AHB_CLK=(&CLK_GCC_TEST|0x130)
&CLK_TEST_GCC_SPDM_FF_CLK=(&CLK_GCC_TEST|0x132)
&CLK_TEST_GCC_SPDM_MSTR_AHB_CLK=(&CLK_GCC_TEST|0x131)
&CLK_TEST_GCC_SPDM_PNOC_CY_CLK=(&CLK_GCC_TEST|0x135)
&CLK_TEST_GCC_SPDM_RPM_CY_CLK=(&CLK_GCC_TEST|0x136)
&CLK_TEST_GCC_SPDM_SNOC_CY_CLK=(&CLK_GCC_TEST|0x134)
&CLK_TEST_GCC_SPMI_AHB_CLK=(&CLK_GCC_TEST|0x12A)
&CLK_TEST_GCC_SPMI_CNOC_AHB_CLK=(&CLK_GCC_TEST|0x129)
&CLK_TEST_GCC_SPMI_SER_CLK=(&CLK_GCC_TEST|0x128)
&CLK_TEST_GCC_SPSS_AHB_CLK=(&CLK_GCC_TEST|0x1F0)
&CLK_TEST_SPSS_GCC_DBG_CLK=(&CLK_GCC_TEST|0x1F1)
&CLK_TEST_GCC_SEC_CTRL_ACC_CLK=(&CLK_GCC_TEST|0x120)
&CLK_TEST_GCC_SEC_CTRL_AHB_CLK=(&CLK_GCC_TEST|0x121)
&CLK_TEST_GCC_SEC_CTRL_BOOT_ROM_PATCH_CLK=(&CLK_GCC_TEST|0x124)
&CLK_TEST_GCC_SEC_CTRL_CLK=(&CLK_GCC_TEST|0x122)
&CLK_TEST_GCC_SEC_CTRL_SENSE_CLK=(&CLK_GCC_TEST|0x123)
&CLK_TEST_GCC_SNOC_CNOC_AHB_CLK=(&CLK_GCC_TEST|0x004)
&CLK_TEST_GCC_SNOC_PNOC_AHB_CLK=(&CLK_GCC_TEST|0x005)
&CLK_TEST_GCC_SYS_NOC_AT_CLK=(&CLK_GCC_TEST|0x006)
&CLK_TEST_GCC_SYS_NOC_AXI_CLK=(&CLK_GCC_TEST|0x000)
&CLK_TEST_GCC_SYS_NOC_KPSS_AHB_CLK=(&CLK_GCC_TEST|0x003)
&CLK_TEST_GCC_SYS_NOC_QDSS_STM_AXI_CLK=(&CLK_GCC_TEST|0x002)
&CLK_TEST_GCC_SYS_NOC_UFS_AXI_CLK=(&CLK_GCC_TEST|0x030)
&CLK_TEST_GCC_SYS_NOC_USB3_AXI_CLK=(&CLK_GCC_TEST|0x001)
&CLK_TEST_GCC_SYS_NOC_USB3_SEC_AXI_CLK=(&CLK_GCC_TEST|0x007)
&CLK_TEST_GCC_TCSR_AHB_CLK=(&CLK_GCC_TEST|0x0F0)
&CLK_TEST_GCC_TLMM_AHB_CLK=(&CLK_GCC_TEST|0x108)
&CLK_TEST_GCC_TLMM_CLK=(&CLK_GCC_TEST|0x109)
&CLK_TEST_GCC_TSIF_AHB_CLK=(&CLK_GCC_TEST|0x0E8)
&CLK_TEST_GCC_TSIF_INACTIVITY_TIMERS_CLK=(&CLK_GCC_TEST|0x0EA)
&CLK_TEST_GCC_TSIF_REF_CLK=(&CLK_GCC_TEST|0x0E9)
&CLK_TEST_GCC_UFS_AHB_CLK=(&CLK_GCC_TEST|0x231)
&CLK_TEST_GCC_UFS_AXI_CLK=(&CLK_GCC_TEST|0x230)
&CLK_TEST_GCC_UFS_RX_CFG_CLK=(&CLK_GCC_TEST|0x233)
&CLK_TEST_GCC_UFS_RX_SYMBOL_0_CLK=(&CLK_GCC_TEST|0x236)
&CLK_TEST_GCC_UFS_RX_SYMBOL_1_CLK=(&CLK_GCC_TEST|0x237)
&CLK_TEST_GCC_UFS_TX_CFG_CLK=(&CLK_GCC_TEST|0x232)
&CLK_TEST_GCC_UFS_TX_SYMBOL_0_CLK=(&CLK_GCC_TEST|0x234)
&CLK_TEST_GCC_UFS_TX_SYMBOL_1_CLK=(&CLK_GCC_TEST|0x235)
&CLK_TEST_GCC_USB2A_PHY_SLEEP_CLK=(&CLK_GCC_TEST|0x063)
&CLK_TEST_GCC_USB2B_PHY_SLEEP_CLK=(&CLK_GCC_TEST|0x064)
&CLK_TEST_GCC_USB30_MASTER_CLK=(&CLK_GCC_TEST|0x050)
&CLK_TEST_GCC_USB30_MOCK_UTMI_CLK=(&CLK_GCC_TEST|0x052)
&CLK_TEST_GCC_USB30_SLEEP_CLK=(&CLK_GCC_TEST|0x051)
&CLK_TEST_USB2_PHY_WRAPPER_CC_USB3_UTMI_3_CLK=(&CLK_GCC_TEST|0x054)
&CLK_TEST_USB2_PHY_WRAPPER_GCC_USB3_UTMI_2_CLK=(&CLK_GCC_TEST|0x053)
&CLK_TEST_GCC_USB30_SEC_MASTER_CLK=(&CLK_GCC_TEST|0x208)
&CLK_TEST_GCC_USB30_SEC_MOCK_UTMI_CLK=(&CLK_GCC_TEST|0x20A)
&CLK_TEST_GCC_USB30_SEC_SLEEP_CLK=(&CLK_GCC_TEST|0x209)
&CLK_TEST_USB2_PHY_WRAPPER_GCC_USB30_SEC_UTMI_CLK=(&CLK_GCC_TEST|0x20C)
&CLK_TEST_USB3_PHY_WRAPPER_GCC_USB3_SEC_PIPE_CLK=(&CLK_GCC_TEST|0x20B)
&CLK_TEST_GCC_USB_HS_AHB_CLK=(&CLK_GCC_TEST|0x061)
&CLK_TEST_GCC_USB_HS_INACTIVITY_TIMERS_CLK=(&CLK_GCC_TEST|0x062)
&CLK_TEST_GCC_USB_HS_SYSTEM_CLK=(&CLK_GCC_TEST|0x060)
&CLK_TEST_GCC_USB_HSIC_AHB_CLK=(&CLK_GCC_TEST|0x058)
&CLK_TEST_GCC_USB_HSIC_CLK=(&CLK_GCC_TEST|0x05A)
&CLK_TEST_GCC_USB_HSIC_IO_CAL_CLK=(&CLK_GCC_TEST|0x05B)
&CLK_TEST_GCC_USB_HSIC_IO_CAL_SLEEP_CLK=(&CLK_GCC_TEST|0x05C)
&CLK_TEST_GCC_USB_HSIC_MOCK_UTMI_CLK=(&CLK_GCC_TEST|0x05D)
&CLK_TEST_GCC_USB_HSIC_SYSTEM_CLK=(&CLK_GCC_TEST|0x059)
&CLK_TEST_GCC_PERIPH_NOC_MPU_CFG_AHB_CLK=(&CLK_GCC_TEST|0x0C9)
&CLK_TEST_GCC_PERIPH_XPU_AHB_CLK=(&CLK_GCC_TEST|0x0C8)

; LPASS Test Clocks
&CLK_TEST_ATIME_CLK_SRC=(&CLK_LPASS_TEST|0x33)
&CLK_TEST_LPASS_CORE_AVSYNC_ATIME_CLK=(&CLK_LPASS_TEST|0x55)
&CLK_TEST_AHB_SPDMTM_CLK=(&CLK_LPASS_TEST|0x51)
&CLK_TEST_AHBFABRIC_CLK_SRC=(&CLK_LPASS_TEST|0x1A)
&CLK_TEST_AUDIO_CORE_AON_CLK=(&CLK_LPASS_TEST|0x56)
&CLK_TEST_AUDIO_CORE_AVSYNC_CSR_CLK=(&CLK_LPASS_TEST|0x2F)
&CLK_TEST_AUDIO_CORE_BSTC_CLK=(&CLK_LPASS_TEST|0x34)
&CLK_TEST_AUDIO_CORE_CSR_CLK=(&CLK_LPASS_TEST|0x42)
&CLK_TEST_AUDIO_CORE_DML_CLK=(&CLK_LPASS_TEST|0x58)
&CLK_TEST_AUDIO_CORE_IXFABRIC_CLK=(&CLK_LPASS_TEST|0x59)
&CLK_TEST_AUDIO_CORE_IXFABRIC_SPDMTM_CSR_CLK=(&CLK_LPASS_TEST|0x41)
&CLK_TEST_AUDIO_CORE_LPAIF_CSR_CLK=(&CLK_LPASS_TEST|0x37)
&CLK_TEST_AUDIO_CORE_LPAIF_DMA_CLK=(&CLK_LPASS_TEST|0x38)
&CLK_TEST_AUDIO_CORE_LPM_CLK=(&CLK_LPASS_TEST|0x47)
&CLK_TEST_AUDIO_CORE_MIDI_LFABIF_CLK=(&CLK_LPASS_TEST|0x40)
&CLK_TEST_AUDIO_CORE_RESAMPLER_LFABIF_CLK=(&CLK_LPASS_TEST|0x3C)
&CLK_TEST_AUDIO_CORE_SECURITY_CLK=(&CLK_LPASS_TEST|0x3A)
&CLK_TEST_AUDIO_CORE_SLIMBUS_LFABIF_CLK=(&CLK_LPASS_TEST|0x3E)
&CLK_TEST_AUDIO_CORE_SYSNOC_MPORT_CLK=(&CLK_LPASS_TEST|0x1F)
&CLK_TEST_AUDIO_CORE_TIMEOUT_CLK=(&CLK_LPASS_TEST|0x39)
&CLK_TEST_AUDIO_WRAPPER_AON_CLK=(&CLK_LPASS_TEST|0x57)
&CLK_TEST_AUDIO_WRAPPER_BR_CLK=(&CLK_LPASS_TEST|0x22)
&CLK_TEST_AUDIO_WRAPPER_EFABRIC_CLK=(&CLK_LPASS_TEST|0x25)
&CLK_TEST_AUDIO_WRAPPER_EFABRIC_SPDMTM_CSR_CLK=(&CLK_LPASS_TEST|0x24)
&CLK_TEST_AUDIO_WRAPPER_LCC_CSR_CLK=(&CLK_LPASS_TEST|0x27)
&CLK_TEST_AUDIO_WRAPPER_SECURITY_CLK=(&CLK_LPASS_TEST|0x26)
&CLK_TEST_AUDIO_WRAPPER_SMEM_CLK=(&CLK_LPASS_TEST|0x21)
&CLK_TEST_AUDIO_WRAPPER_TIMEOUT_CLK=(&CLK_LPASS_TEST|0x20)
&CLK_TEST_CORE_SMMU_CFG_CLK=(&CLK_LPASS_TEST|0x53)
&CLK_TEST_DIGCODEC_AHB_CLK=(&CLK_LPASS_TEST|0x5A)
&CLK_TEST_HDMIRX_AHB_CLK=(&CLK_LPASS_TEST|0x4F)
&CLK_TEST_Q6_SMMU_CFG_CLK=(&CLK_LPASS_TEST|0x54)
&CLK_TEST_Q6_TCM_SLAVE_CLK=(&CLK_LPASS_TEST|0x58)
&CLK_TEST_Q6SS_AHB_LFABIF_CLK=(&CLK_LPASS_TEST|0x1E)
&CLK_TEST_Q6SS_AHBM_CLK=(&CLK_LPASS_TEST|0x1D)
&CLK_TEST_SIF_AHB_CLK=(&CLK_LPASS_TEST|0x4E)
&CLK_TEST_SPDIFTX_AHBM_CLK=(&CLK_LPASS_TEST|0x4C)
&CLK_TEST_SPDIFTX_AHBS_CLK=(&CLK_LPASS_TEST|0x4B)
&CLK_TEST_AUDIO_CORE_AVSYNC_BT_XO_CLK=(&CLK_LPASS_TEST|0x2D)
&CLK_TEST_AUDIO_CORE_AVSYNC_FM_XO_CLK=(&CLK_LPASS_TEST|0x2C)
&CLK_TEST_AUDIO_CORE_AVSYNC_XO_CLK=(&CLK_LPASS_TEST|0x2E)
&CLK_TEST_AUDIO_CORE_AVTIMER_XO_CLK=(&CLK_LPASS_TEST|0x52)
&CLK_TEST_AUDIO_CORE_GDSC_XO_CLK=(&CLK_LPASS_TEST|0x28)
&CLK_TEST_Q6SS_XO_CLK=(&CLK_LPASS_TEST|0x2B)
&CLK_TEST_XO_CLK_SRC=(&CLK_LPASS_TEST|0xE)
&CLK_TEST_DIGCODEC_CLK=(&CLK_LPASS_TEST|0x5A)
&CLK_TEST_LPASS_GCC_DBG_CLK=(&CLK_LPASS_TEST|0x7)
&CLK_TEST_AUDIO_CORE_LPAIF_PCM_DATA_OE_CLK=(&CLK_LPASS_TEST|0x30)
&CLK_TEST_LPAIF_PCMOE_CLK_SRC=(&CLK_LPASS_TEST|0xF)
&CLK_TEST_LPAIF_PRI_CLK_SRC=(&CLK_LPASS_TEST|0x17)
&CLK_TEST_LPAIF_PCM0_CLK_SRC=(&CLK_LPASS_TEST|0x13)
&CLK_TEST_Q6CORE_CLK_SRC=(&CLK_LPASS_TEST|0x10)
&CLK_TEST_LPAIF_QUAD_CLK_SRC=(&CLK_LPASS_TEST|0x14)
&CLK_TEST_AUDIO_CORE_RESAMPLER_CORE_CLK=(&CLK_LPASS_TEST|0x3B)
&CLK_TEST_RESAMPLER_CLK_SRC=(&CLK_LPASS_TEST|0x6)
&CLK_TEST_SIF_CLK=(&CLK_LPASS_TEST|0x4D)
&CLK_TEST_AUDIO_CORE_SLIMBUS_CORE_CLK=(&CLK_LPASS_TEST|0x3D)
&CLK_TEST_AUDIO_CORE_SLIMBUS_CORE_CLK=(&CLK_LPASS_TEST|0x3D)
&CLK_TEST_SLIMBUS_CLK_SRC=(&CLK_LPASS_TEST|0x11)
&CLK_TEST_SLIMBUS_CLK_SRC=(&CLK_LPASS_TEST|0x11)
&CLK_TEST_SPDIFTX_BMC_CLK=(&CLK_LPASS_TEST|0x35)
&CLK_TEST_SPDIFTX_BMC_CLK_SRC=(&CLK_LPASS_TEST|0x59)
&CLK_TEST_Q6_SPDM_CLK_SRC=(&CLK_LPASS_TEST|0x7)
&CLK_TEST_Q6_SPDMTM_CLK=(&CLK_LPASS_TEST|0x1C)
&CLK_TEST_LPAIF_SEC_CLK_SRC=(&CLK_LPASS_TEST|0x16)
&CLK_TEST_LPAIF_PCM1_CLK_SRC=(&CLK_LPASS_TEST|0x12)
&CLK_TEST_AUDIO_CORE_BCR_SLP_CLK=(&CLK_LPASS_TEST|0x29)
&CLK_TEST_Q6SS_BCR_SLP_CLK=(&CLK_LPASS_TEST|0x1B)
&CLK_TEST_Q6SS_SLP_CLK=(&CLK_LPASS_TEST|0x2A)
&CLK_TEST_SLEEP_CLK_SRC=(&CLK_LPASS_TEST|0xA)
&CLK_TEST_LPAIF_SPKR_CLK_SRC=(&CLK_LPASS_TEST|0x18)
&CLK_TEST_LPAIF_TER_CLK_SRC=(&CLK_LPASS_TEST|0x15)

; MMSS Test Clocks
&CLK_TEST_AVSYNC_AHB_CLK=(&CLK_MMSS_TEST|0x65)
&CLK_TEST_AVSYNC_EDPPIXEL_CLK=(&CLK_MMSS_TEST|0x3e)
&CLK_TEST_AVSYNC_EXTPCLK_CLK=(&CLK_MMSS_TEST|0x62)
&CLK_TEST_AVSYNC_PCLK0_CLK=(&CLK_MMSS_TEST|0xb)
&CLK_TEST_AVSYNC_PCLK1_CLK=(&CLK_MMSS_TEST|0x37)
&CLK_TEST_AVSYNC_VP_CLK=(&CLK_MMSS_TEST|0x76)
&CLK_TEST_CAMSS_AHB_CLK=(&CLK_MMSS_TEST|0x78)
&CLK_TEST_CAMSS_CCI_CCI_AHB_CLK=(&CLK_MMSS_TEST|0x2e)
&CLK_TEST_CAMSS_CCI_CCI_CLK=(&CLK_MMSS_TEST|0x2d)
&CLK_TEST_CAMSS_CSI0_AHB_CLK=(&CLK_MMSS_TEST|0x42)
&CLK_TEST_CAMSS_CSI0_CLK=(&CLK_MMSS_TEST|0x41)
&CLK_TEST_CAMSS_CSI0PHY_CLK=(&CLK_MMSS_TEST|0x43)
&CLK_TEST_CAMSS_CSI0PIX_CLK=(&CLK_MMSS_TEST|0x45)
&CLK_TEST_CAMSS_CSI0RDI_CLK=(&CLK_MMSS_TEST|0x44)
&CLK_TEST_CAMSS_CSI1_AHB_CLK=(&CLK_MMSS_TEST|0x47)
&CLK_TEST_CAMSS_CSI1_CLK=(&CLK_MMSS_TEST|0x46)
&CLK_TEST_CAMSS_CSI1PHY_CLK=(&CLK_MMSS_TEST|0x48)
&CLK_TEST_CAMSS_CSI1PIX_CLK=(&CLK_MMSS_TEST|0x4a)
&CLK_TEST_CAMSS_CSI1RDI_CLK=(&CLK_MMSS_TEST|0x49)
&CLK_TEST_CAMSS_CSI2_AHB_CLK=(&CLK_MMSS_TEST|0x4c)
&CLK_TEST_CAMSS_CSI2_CLK=(&CLK_MMSS_TEST|0x4b)
&CLK_TEST_CAMSS_CSI2PHY_CLK=(&CLK_MMSS_TEST|0x4d)
&CLK_TEST_CAMSS_CSI2PIX_CLK=(&CLK_MMSS_TEST|0x4f)
&CLK_TEST_CAMSS_CSI2RDI_CLK=(&CLK_MMSS_TEST|0x4e)
&CLK_TEST_CAMSS_CSI3_AHB_CLK=(&CLK_MMSS_TEST|0x51)
&CLK_TEST_CAMSS_CSI3_CLK=(&CLK_MMSS_TEST|0x50)
&CLK_TEST_CAMSS_CSI3PHY_CLK=(&CLK_MMSS_TEST|0x52)
&CLK_TEST_CAMSS_CSI3PIX_CLK=(&CLK_MMSS_TEST|0x54)
&CLK_TEST_CAMSS_CSI3RDI_CLK=(&CLK_MMSS_TEST|0x53)
&CLK_TEST_CAMSS_CSI_VFE0_CLK=(&CLK_MMSS_TEST|0x3f)
&CLK_TEST_CAMSS_CSI_VFE1_CLK=(&CLK_MMSS_TEST|0x40)
&CLK_TEST_CAMSS_GP0_CLK=(&CLK_MMSS_TEST|0x27)
&CLK_TEST_CAMSS_GP1_CLK=(&CLK_MMSS_TEST|0x28)
&CLK_TEST_CAMSS_ISPIF_AHB_CLK=(&CLK_MMSS_TEST|0x55)
&CLK_TEST_CAMSS_JPEG_JPEG0_CLK=(&CLK_MMSS_TEST|0x32)
&CLK_TEST_CAMSS_JPEG_JPEG1_CLK=(&CLK_MMSS_TEST|0x33)
&CLK_TEST_CAMSS_JPEG_JPEG2_CLK=(&CLK_MMSS_TEST|0x34)
&CLK_TEST_CAMSS_JPEG_JPEG_AHB_CLK=(&CLK_MMSS_TEST|0x35)
&CLK_TEST_CAMSS_JPEG_JPEG_AXI_CLK=(&CLK_MMSS_TEST|0x36)
&CLK_TEST_CAMSS_MCLK0_CLK=(&CLK_MMSS_TEST|0x29)
&CLK_TEST_CAMSS_MCLK1_CLK=(&CLK_MMSS_TEST|0x2a)
&CLK_TEST_CAMSS_MCLK2_CLK=(&CLK_MMSS_TEST|0x2b)
&CLK_TEST_CAMSS_MCLK3_CLK=(&CLK_MMSS_TEST|0x2c)
&CLK_TEST_CAMSS_MICRO_AHB_CLK=(&CLK_MMSS_TEST|0x26)
&CLK_TEST_CAMSS_PHY0_CSI0PHYTIMER_CLK=(&CLK_MMSS_TEST|0x2f)
&CLK_TEST_CAMSS_PHY1_CSI1PHYTIMER_CLK=(&CLK_MMSS_TEST|0x30)
&CLK_TEST_CAMSS_PHY2_CSI2PHYTIMER_CLK=(&CLK_MMSS_TEST|0x31)
&CLK_TEST_CAMSS_TOP_AHB_CLK=(&CLK_MMSS_TEST|0x25)
&CLK_TEST_CAMSS_VFE_CPP_AHB_CLK=(&CLK_MMSS_TEST|0x3b)
&CLK_TEST_CAMSS_VFE_CPP_CLK=(&CLK_MMSS_TEST|0x3a)
&CLK_TEST_CAMSS_VFE_VFE0_CLK=(&CLK_MMSS_TEST|0x38)
&CLK_TEST_CAMSS_VFE_VFE1_CLK=(&CLK_MMSS_TEST|0x39)
&CLK_TEST_CAMSS_VFE_VFE_AHB_CLK=(&CLK_MMSS_TEST|0x3c)
&CLK_TEST_CAMSS_VFE_VFE_AXI_CLK=(&CLK_MMSS_TEST|0x3d)
&CLK_TEST_MDSS_AHB_CLK=(&CLK_MMSS_TEST|0x22)
&CLK_TEST_MDSS_AXI_CLK=(&CLK_MMSS_TEST|0x24)
&CLK_TEST_MDSS_BYTE0_CLK=(&CLK_MMSS_TEST|0x1e)
&CLK_TEST_MDSS_BYTE1_CLK=(&CLK_MMSS_TEST|0x1f)
&CLK_TEST_MDSS_EDPAUX_CLK=(&CLK_MMSS_TEST|0x1b)
&CLK_TEST_MDSS_EDPLINK_CLK=(&CLK_MMSS_TEST|0x1a)
&CLK_TEST_MDSS_EDPPIXEL_CLK=(&CLK_MMSS_TEST|0x19)
&CLK_TEST_MDSS_ESC0_CLK=(&CLK_MMSS_TEST|0x20)
&CLK_TEST_MDSS_ESC1_CLK=(&CLK_MMSS_TEST|0x21)
&CLK_TEST_MDSS_EXTPCLK_CLK=(&CLK_MMSS_TEST|0x18)
&CLK_TEST_MDSS_HDMI_AHB_CLK=(&CLK_MMSS_TEST|0x23)
&CLK_TEST_MDSS_HDMI_CLK=(&CLK_MMSS_TEST|0x1d)
&CLK_TEST_MDSS_MDP_CLK=(&CLK_MMSS_TEST|0x14)
&CLK_TEST_MDSS_MDP_LUT_CLK=(&CLK_MMSS_TEST|0x15)
&CLK_TEST_MDSS_PCLK0_CLK=(&CLK_MMSS_TEST|0x16)
&CLK_TEST_MDSS_PCLK1_CLK=(&CLK_MMSS_TEST|0x17)
&CLK_TEST_MDSS_VSYNC_CLK=(&CLK_MMSS_TEST|0x1c)
&CLK_TEST_MMSS_MISC_AHB_CLK=(&CLK_MMSS_TEST|0x3)
&CLK_TEST_MMSS_MMSSNOC_AHB_CLK=(&CLK_MMSS_TEST|0x1)
&CLK_TEST_MMSS_MMSSNOC_BTO_AHB_CLK=(&CLK_MMSS_TEST|0x2)
&CLK_TEST_MMSS_MMSSNOC_AXI_CLK=(&CLK_MMSS_TEST|0x4)
&CLK_TEST_MMSS_S0_AXI_CLK=(&CLK_MMSS_TEST|0x5)
&CLK_TEST_MMSS_RBCPR_AHB_CLK=(&CLK_MMSS_TEST|0x13)
&CLK_TEST_MMSS_RBCPR_CLK=(&CLK_MMSS_TEST|0x12)
&CLK_TEST_MMSS_SPDM_AHB_CLK=(&CLK_MMSS_TEST|0x60)
&CLK_TEST_MMSS_SPDM_AXI_CLK=(&CLK_MMSS_TEST|0x59)
&CLK_TEST_MMSS_SPDM_CSI0_CLK=(&CLK_MMSS_TEST|0x63)
&CLK_TEST_MMSS_SPDM_GFX3D_CLK=(&CLK_MMSS_TEST|0x5f)
&CLK_TEST_MMSS_SPDM_JPEG0_CLK=(&CLK_MMSS_TEST|0x56)
&CLK_TEST_MMSS_SPDM_JPEG1_CLK=(&CLK_MMSS_TEST|0x57)
&CLK_TEST_MMSS_SPDM_JPEG2_CLK=(&CLK_MMSS_TEST|0x5d)
&CLK_TEST_MMSS_SPDM_MDP_CLK=(&CLK_MMSS_TEST|0x58)
&CLK_TEST_MMSS_SPDM_PCLK0_CLK=(&CLK_MMSS_TEST|0x61)
&CLK_TEST_MMSS_SPDM_PCLK1_CLK=(&CLK_MMSS_TEST|0x5e)
&CLK_TEST_MMSS_SPDM_VCODEC0_CLK=(&CLK_MMSS_TEST|0x5a)
&CLK_TEST_MMSS_SPDM_VFE0_CLK=(&CLK_MMSS_TEST|0x5b)
&CLK_TEST_MMSS_SPDM_VFE1_CLK=(&CLK_MMSS_TEST|0x5c)
&CLK_TEST_MMSS_SPDM_RM_AXI_CLK=(&CLK_MMSS_TEST|0x64)
&CLK_TEST_MMSS_SPDM_RM_OCMEMNOC_CLK=(&CLK_MMSS_TEST|0x77)
&CLK_TEST_GCC_OCMEM_SYS_NOC_AXI_CLK=(&CLK_MMSS_TEST|0x8)
&CLK_TEST_OCMEMCX_AHB_CLK=(&CLK_MMSS_TEST|0xa)
&CLK_TEST_OCMEMCX_OCMEMNOC_CLK=(&CLK_MMSS_TEST|0x9)
&CLK_TEST_GFX3D_CLK_SRC=(&CLK_MMSS_TEST|0xd)
&CLK_TEST_OXILI_RBBMTIMER_CLK=(&CLK_MMSS_TEST|0x6e)
&CLK_TEST_OXILICX_AHB_CLK=(&CLK_MMSS_TEST|0xc)
&CLK_TEST_MMPLL0_DTEST=(&CLK_MMSS_TEST|0x66)
&CLK_TEST_MMPLL0_DTEST=(&CLK_MMSS_TEST|0x66)
&CLK_TEST_MMPLL0_LOCK_DET=(&CLK_MMSS_TEST|0x67)
&CLK_TEST_MMPLL0_LOCK_DET=(&CLK_MMSS_TEST|0x67)
&CLK_TEST_MMPLL1_DTEST=(&CLK_MMSS_TEST|0x68)
&CLK_TEST_MMPLL1_DTEST=(&CLK_MMSS_TEST|0x68)
&CLK_TEST_MMPLL1_LOCK_DET=(&CLK_MMSS_TEST|0x69)
&CLK_TEST_MMPLL1_LOCK_DET=(&CLK_MMSS_TEST|0x69)
&CLK_TEST_MMPLL2_DTEST=(&CLK_MMSS_TEST|0x6a)
&CLK_TEST_MMPLL2_DTEST=(&CLK_MMSS_TEST|0x6a)
&CLK_TEST_MMPLL2_LOCK_DET=(&CLK_MMSS_TEST|0x6b)
&CLK_TEST_MMPLL2_LOCK_DET=(&CLK_MMSS_TEST|0x6b)
&CLK_TEST_MMPLL3_DTEST=(&CLK_MMSS_TEST|0x6c)
&CLK_TEST_MMPLL3_DTEST=(&CLK_MMSS_TEST|0x6c)
&CLK_TEST_MMPLL3_LOCK_DET=(&CLK_MMSS_TEST|0x6d)
&CLK_TEST_MMPLL3_LOCK_DET=(&CLK_MMSS_TEST|0x6d)
&CLK_TEST_MMPLL4_DTEST=(&CLK_MMSS_TEST|0x6)
&CLK_TEST_MMPLL4_DTEST=(&CLK_MMSS_TEST|0x6)
&CLK_TEST_MMPLL4_LOCK_DET=(&CLK_MMSS_TEST|0x7)
&CLK_TEST_MMPLL4_LOCK_DET=(&CLK_MMSS_TEST|0x7)
&CLK_TEST_VENUS0_AHB_CLK=(&CLK_MMSS_TEST|0x11)
&CLK_TEST_VENUS0_AXI_CLK=(&CLK_MMSS_TEST|0xf)
&CLK_TEST_VENUS0_CORE0_VCODEC_CLK=(&CLK_MMSS_TEST|0x79)
&CLK_TEST_VENUS0_CORE1_VCODEC_CLK=(&CLK_MMSS_TEST|0x80)
&CLK_TEST_VENUS0_OCMEMNOC_CLK=(&CLK_MMSS_TEST|0x10)
&CLK_TEST_VENUS0_VCODEC0_CLK=(&CLK_MMSS_TEST|0xe)
&CLK_TEST_VPU_AHB_CLK=(&CLK_MMSS_TEST|0x72)
&CLK_TEST_VPU_AXI_CLK=(&CLK_MMSS_TEST|0x73)
&CLK_TEST_VPU_BUS_CLK=(&CLK_MMSS_TEST|0x71)
&CLK_TEST_VPU_CXO_CLK=(&CLK_MMSS_TEST|0x74)
&CLK_TEST_VPU_MAPLE_CLK=(&CLK_MMSS_TEST|0x70)
&CLK_TEST_VPU_SLEEP_CLK=(&CLK_MMSS_TEST|0x75)
&CLK_TEST_VPU_VDP_CLK=(&CLK_MMSS_TEST|0x6f)

; APCS Test Clocks
&CLK_TEST_APCS_C0_CLK=(&CLK_APCS_TEST|0x00)
&CLK_TEST_APCS_C1_CLK=(&CLK_APCS_TEST|0x100)
&CLK_TEST_APCS_C2_CLK=(&CLK_APCS_TEST|0x200)
&CLK_TEST_APCS_C3_CLK=(&CLK_APCS_TEST|0x300)
&CLK_TEST_APCS_L2_CLK=(&CLK_APCS_TEST|0x1000)
&CLK_TEST_APCS_SPISLEEP_CLK=(&CLK_APCS_TEST|0x7000)
&CLK_TEST_APCS_SYSAHB_CLK=(&CLK_APCS_TEST|0x4000)
&CLK_TEST_APCS_SYSQSB_CLK=(&CLK_APCS_TEST|0x3000)
&CLK_TEST_APCS_SYSREF_CLK=(&CLK_APCS_TEST|0x6000)

goto Init_Constants_Done



Print_Clock_Help:

  print ""
  print "********************************************************** GCC **********************************************************"
  print ""
  print "[ BAM_DMA ]"
  print " gcc_bam_dma_ahb_clk                     gcc_bam_dma_inactivity_timers_clk                                               "
  print ""
  print "[ BIMC ]"
  print " gcc_bimc_cfg_ahb_clk                    gcc_bimc_clk                            gcc_bimc_kpss_axi_clk                   "
  print " gcc_bimc_sleep_clk                      gcc_bimc_sysnoc_axi_clk                 gcc_bimc_xo_clk                         "
  print ""
  print "[ BLSP1 ]"
  print " gcc_blsp1_ahb_clk                       gcc_blsp1_sleep_clk                                                             "
  print ""
  print "[ BLSP1_QUP1 ]"
  print " gcc_blsp1_qup1_i2c_apps_clk             gcc_blsp1_qup1_spi_apps_clk                                                     "
  print ""
  print "[ BLSP1_QUP2 ]"
  print " gcc_blsp1_qup2_i2c_apps_clk             gcc_blsp1_qup2_spi_apps_clk                                                     "
  print ""
  print "[ BLSP1_QUP3 ]"
  print " gcc_blsp1_qup3_i2c_apps_clk             gcc_blsp1_qup3_spi_apps_clk                                                     "
  print ""
  print "[ BLSP1_QUP4 ]"
  print " gcc_blsp1_qup4_i2c_apps_clk             gcc_blsp1_qup4_spi_apps_clk                                                     "
  print ""
  print "[ BLSP1_QUP5 ]"
  print " gcc_blsp1_qup5_i2c_apps_clk             gcc_blsp1_qup5_spi_apps_clk                                                     "
  print ""
  print "[ BLSP1_QUP6 ]"
  print " gcc_blsp1_qup6_i2c_apps_clk             gcc_blsp1_qup6_spi_apps_clk                                                     "
  print ""
  print "[ BLSP1_UART1 ]"
  print " gcc_blsp1_uart1_apps_clk                gcc_blsp1_uart1_sim_clk                                                         "
  print ""
  print "[ BLSP1_UART2 ]"
  print " gcc_blsp1_uart2_apps_clk                gcc_blsp1_uart2_sim_clk                                                         "
  print ""
  print "[ BLSP1_UART3 ]"
  print " gcc_blsp1_uart3_apps_clk                gcc_blsp1_uart3_sim_clk                                                         "
  print ""
  print "[ BLSP1_UART4 ]"
  print " gcc_blsp1_uart4_apps_clk                gcc_blsp1_uart4_sim_clk                                                         "
  print ""
  print "[ BLSP1_UART5 ]"
  print " gcc_blsp1_uart5_apps_clk                gcc_blsp1_uart5_sim_clk                                                         "
  print ""
  print "[ BLSP1_UART6 ]"
  print " gcc_blsp1_uart6_apps_clk                gcc_blsp1_uart6_sim_clk                                                         "
  print ""
  print "[ BLSP2 ]"
  print " gcc_blsp2_ahb_clk                       gcc_blsp2_sleep_clk                                                             "
  print ""
  print "[ BLSP2_QUP1 ]"
  print " gcc_blsp2_qup1_i2c_apps_clk             gcc_blsp2_qup1_spi_apps_clk                                                     "
  print ""
  print "[ BLSP2_QUP2 ]"
  print " gcc_blsp2_qup2_i2c_apps_clk             gcc_blsp2_qup2_spi_apps_clk                                                     "
  print ""
  print "[ BLSP2_QUP3 ]"
  print " gcc_blsp2_qup3_i2c_apps_clk             gcc_blsp2_qup3_spi_apps_clk                                                     "
  print ""
  print "[ BLSP2_QUP4 ]"
  print " gcc_blsp2_qup4_i2c_apps_clk             gcc_blsp2_qup4_spi_apps_clk                                                     "
  print ""
  print "[ BLSP2_QUP5 ]"
  print " gcc_blsp2_qup5_i2c_apps_clk             gcc_blsp2_qup5_spi_apps_clk                                                     "
  print ""
  print "[ BLSP2_QUP6 ]"
  print " gcc_blsp2_qup6_i2c_apps_clk             gcc_blsp2_qup6_spi_apps_clk                                                     "
  print ""
  print "[ BLSP2_UART1 ]"
  print " gcc_blsp2_uart1_apps_clk                gcc_blsp2_uart1_sim_clk                                                         "
  print ""
  print "[ BLSP2_UART2 ]"
  print " gcc_blsp2_uart2_apps_clk                gcc_blsp2_uart2_sim_clk                                                         "
  print ""
  print "[ BLSP2_UART3 ]"
  print " gcc_blsp2_uart3_apps_clk                gcc_blsp2_uart3_sim_clk                                                         "
  print ""
  print "[ BLSP2_UART4 ]"
  print " gcc_blsp2_uart4_apps_clk                gcc_blsp2_uart4_sim_clk                                                         "
  print ""
  print "[ BLSP2_UART5 ]"
  print " gcc_blsp2_uart5_apps_clk                gcc_blsp2_uart5_sim_clk                                                         "
  print ""
  print "[ BLSP2_UART6 ]"
  print " gcc_blsp2_uart6_apps_clk                gcc_blsp2_uart6_sim_clk                                                         "
  print ""
  print "[ BOOT_ROM ]"
  print " gcc_boot_rom_ahb_clk                                                                                                    "
  print ""
  print "[ CE1 ]"
  print " gcc_ce1_ahb_clk                         gcc_ce1_axi_clk                         gcc_ce1_clk                             "
  print ""
  print "[ CE2 ]"
  print " gcc_ce2_ahb_clk                         gcc_ce2_axi_clk                         gcc_ce2_clk                             "
  print ""
  print "[ CE3 ]"
  print " gcc_ce3_ahb_clk                         gcc_ce3_axi_clk                         gcc_ce3_clk                             "
  print ""
  print "[ CNOC_BUS_TIMEOUT0 ]"
  print " gcc_cnoc_bus_timeout0_ahb_clk                                                                                           "
  print ""
  print "[ CNOC_BUS_TIMEOUT1 ]"
  print " gcc_cnoc_bus_timeout1_ahb_clk                                                                                           "
  print ""
  print "[ CNOC_BUS_TIMEOUT2 ]"
  print " gcc_cnoc_bus_timeout2_ahb_clk                                                                                           "
  print ""
  print "[ CNOC_BUS_TIMEOUT3 ]"
  print " gcc_cnoc_bus_timeout3_ahb_clk                                                                                           "
  print ""
  print "[ CNOC_BUS_TIMEOUT4 ]"
  print " gcc_cnoc_bus_timeout4_ahb_clk                                                                                           "
  print ""
  print "[ CNOC_BUS_TIMEOUT5 ]"
  print " gcc_cnoc_bus_timeout5_ahb_clk                                                                                           "
  print ""
  print "[ CNOC_BUS_TIMEOUT6 ]"
  print " gcc_cnoc_bus_timeout6_ahb_clk                                                                                           "
  print ""
  print "[ CNOC_BUS_TIMEOUT7 ]"
  print " gcc_cnoc_bus_timeout7_ahb_clk                                                                                           "
  print ""
  print "[ COPSS_SMMU ]"
  print " gcc_copss_smmu_ahb_clk                  gcc_copss_smmu_axi_clk                                                          "
  print ""
  print "[ Config_NOC ]"
  print " gcc_cfg_noc_ahb_clk                     gcc_cfg_noc_ddr_cfg_clk                 gcc_cfg_noc_rpm_ahb_clk                 "
  print " gcc_cfg_noc_tic_clk                                                                                                     "
  print ""
  print "[ DCD ]"
  print " gcc_dcd_xo_clk                                                                                                          "
  print ""
  print "[ DDR_DIM_Wrapper ]"
  print " gcc_bimc_ddr_ch0_clk                    gcc_bimc_ddr_ch1_clk                    gcc_bimc_ddr_cpll0_clk                  "
  print " gcc_bimc_ddr_cpll1_clk                  gcc_bimc_gfx_clk                        gcc_ddr_dim_cfg_clk                     "
  print " gcc_ddr_dim_sleep_clk                                                                                                   "
  print ""
  print "[ DEHR ]"
  print " gcc_dehr_clk                                                                                                            "
  print ""
  print "[ GCC ]"
  print " gcc_ahb_clk                             gcc_im_sleep_clk                        gcc_xo_clk                              "
  print " gcc_xo_div4_clk                                                                                                         "
  print ""
  print "[ GP1 ]"
  print " gcc_gp1_clk                                                                                                             "
  print ""
  print "[ GP2 ]"
  print " gcc_gp2_clk                                                                                                             "
  print ""
  print "[ GP3 ]"
  print " gcc_gp3_clk                                                                                                             "
  print ""
  print "[ IMEM ]"
  print " gcc_imem_axi_clk                        gcc_imem_cfg_ahb_clk                                                            "
  print ""
  print "[ KPSS ]"
  print " gcc_kpss_ahb_clk                        gcc_kpss_axi_clk                        kpss_gcc_dbg_clk                        "
  print ""
  print "[ LPASS ]"
  print " gcc_lpass_mport_axi_clk                 gcc_lpass_q6_axi_clk                    gcc_lpass_sway_clk                      "
  print " lpass_gcc_dbg_clk                                                                                                       "
  print ""
  print "[ MMSS ]"
  print " gcc_mmss_bimc_gfx_clk                   gcc_mmss_noc_at_clk                     gcc_mmss_noc_cfg_ahb_clk                "
  print " gcc_mmss_vpu_maple_sys_noc_axi_clk      gcc_ocmem_noc_cfg_ahb_clk               gcc_ocmem_sys_noc_axi_clk               "
  print " mmss_gcc_dbg_clk                                                                                                        "
  print ""
  print "[ MPM ]"
  print " gcc_mpm_ahb_clk                                                                                                         "
  print ""
  print "[ MSG_RAM ]"
  print " gcc_msg_ram_ahb_clk                                                                                                     "
  print ""
  print "[ NOC_Conf_APU ]"
  print " gcc_noc_conf_xpu_ahb_clk                                                                                                "
  print ""
  print "[ OBT_ODT ]"
  print " gcc_obt_odt_clk                                                                                                         "
  print ""
  print "[ OTHERS ]"
  print " ch0_dll0_dtest                          ch0_dll0_lock                           ch0_dll1_dtest                          "
  print " ch0_dll1_lock                           ch1_dll0_dtest                          ch1_dll0_lock                           "
  print " ch1_dll1_dtest                          ch1_dll1_lock                           gpll0_dtest                             "
  print " gpll0_lock_det                          gpll1_dtest                             gpll1_lock_det                          "
  print " gpll2_dtest                             gpll2_lock_det                          gpll3_dtest                             "
  print " gpll3_lock_det                          gpll4_dtest                             gpll4_lock_det                          "
  print " kpss_gcc_ringosc_clk                    mpm_gcc_temp_sensor_ringosc_clk         usb2_phy_gcc_atest_ulpi_0_clk           "
  print " usb2_phy_gcc_atest_ulpi_1_clk           usb2_phy_wrapper_gcc_usb30_utmi_clk     usb3_phy_wrapper_gcc_usb3_pipe_clk      "
  print " usb_hspw_gcc_480_test_clk                                                                                               "
  print ""
  print "[ PCIE_0 ]"
  print " gcc_pcie_0_aux_clk                      gcc_pcie_0_cfg_ahb_clk                  gcc_pcie_0_mstr_axi_clk                 "
  print " gcc_pcie_0_pipe_clk                     gcc_pcie_0_slv_axi_clk                  pcie_0_pipe_clk                         "
  print ""
  print "[ PCIE_1 ]"
  print " gcc_pcie_1_aux_clk                      gcc_pcie_1_cfg_ahb_clk                  gcc_pcie_1_mstr_axi_clk                 "
  print " gcc_pcie_1_pipe_clk                     gcc_pcie_1_slv_axi_clk                  pcie_1_pipe_clk                         "
  print ""
  print "[ PDM ]"
  print " gcc_pdm2_clk                            gcc_pdm_ahb_clk                         gcc_pdm_xo4_clk                         "
  print ""
  print "[ PNOC_BUS_TIMEOUT0 ]"
  print " gcc_pnoc_bus_timeout0_ahb_clk                                                                                           "
  print ""
  print "[ PNOC_BUS_TIMEOUT1 ]"
  print " gcc_pnoc_bus_timeout1_ahb_clk                                                                                           "
  print ""
  print "[ PNOC_BUS_TIMEOUT2 ]"
  print " gcc_pnoc_bus_timeout2_ahb_clk                                                                                           "
  print ""
  print "[ PNOC_BUS_TIMEOUT3 ]"
  print " gcc_pnoc_bus_timeout3_ahb_clk                                                                                           "
  print ""
  print "[ PNOC_BUS_TIMEOUT4 ]"
  print " gcc_pnoc_bus_timeout4_ahb_clk                                                                                           "
  print ""
  print "[ PRNG ]"
  print " gcc_prng_ahb_clk                                                                                                        "
  print ""
  print "[ Periph_NOC ]"
  print " gcc_periph_noc_ahb_clk                  gcc_periph_noc_at_clk                   gcc_periph_noc_cfg_ahb_clk              "
  print " gcc_periph_noc_usb_hsic_ahb_clk                                                                                         "
  print ""
  print "[ QDSS ]"
  print " gcc_qdss_at_clk                         gcc_qdss_cfg_ahb_clk                    gcc_qdss_dap_ahb_clk                    "
  print " gcc_qdss_dap_clk                        gcc_qdss_etr_usb_clk                    gcc_qdss_stm_clk                        "
  print " gcc_qdss_traceclkin_clk                 gcc_qdss_tsctr_div16_clk                gcc_qdss_tsctr_div2_clk                 "
  print " gcc_qdss_tsctr_div3_clk                 gcc_qdss_tsctr_div4_clk                 gcc_qdss_tsctr_div8_clk                 "
  print ""
  print "[ QDSS_RBCPR_APU ]"
  print " gcc_qdss_rbcpr_xpu_ahb_clk                                                                                              "
  print ""
  print "[ RBCPR ]"
  print " gcc_rbcpr_ahb_clk                       gcc_rbcpr_clk                                                                   "
  print ""
  print "[ RPM ]"
  print " gcc_rpm_bus_ahb_clk                     gcc_rpm_proc_fclk                       gcc_rpm_proc_hclk                       "
  print " gcc_rpm_sleep_clk                       gcc_rpm_timer_clk                                                               "
  print ""
  print "[ SATA ]"
  print " gcc_sata_asic0_clk                      gcc_sata_axi_clk                        gcc_sata_cfg_ahb_clk                    "
  print " gcc_sata_pmalive_clk                    gcc_sata_rx_clk                         gcc_sata_rx_oob_clk                     "
  print ""
  print "[ SDCC1 ]"
  print " gcc_sdcc1_ahb_clk                       gcc_sdcc1_apps_clk                      gcc_sdcc1_cdccal_ff_clk                 "
  print " gcc_sdcc1_cdccal_sleep_clk                                                                                              "
  print ""
  print "[ SDCC2 ]"
  print " gcc_sdcc2_ahb_clk                       gcc_sdcc2_apps_clk                      gcc_sdcc2_inactivity_timers_clk         "
  print ""
  print "[ SDCC3 ]"
  print " gcc_sdcc3_ahb_clk                       gcc_sdcc3_apps_clk                      gcc_sdcc3_inactivity_timers_clk         "
  print ""
  print "[ SDCC4 ]"
  print " gcc_sdcc4_ahb_clk                       gcc_sdcc4_apps_clk                      gcc_sdcc4_inactivity_timers_clk         "
  print ""
  print "[ SNOC_BUS_TIMEOUT0 ]"
  print " gcc_snoc_bus_timeout0_ahb_clk                                                                                           "
  print ""
  print "[ SNOC_BUS_TIMEOUT2 ]"
  print " gcc_snoc_bus_timeout2_ahb_clk                                                                                           "
  print ""
  print "[ SNOC_BUS_TIMEOUT3 ]"
  print " gcc_snoc_bus_timeout3_ahb_clk                                                                                           "
  print ""
  print "[ SPDM ]"
  print " gcc_spdm_bimc_cy_clk                    gcc_spdm_cfg_ahb_clk                    gcc_spdm_ff_clk                         "
  print " gcc_spdm_mstr_ahb_clk                   gcc_spdm_pnoc_cy_clk                    gcc_spdm_rpm_cy_clk                     "
  print " gcc_spdm_snoc_cy_clk                                                                                                    "
  print ""
  print "[ SPMI ]"
  print " gcc_spmi_ahb_clk                        gcc_spmi_cnoc_ahb_clk                   gcc_spmi_ser_clk                        "
  print ""
  print "[ SPSS ]"
  print " gcc_spss_ahb_clk                        spss_gcc_dbg_clk                                                                "
  print ""
  print "[ Sec_ctrl ]"
  print " gcc_sec_ctrl_acc_clk                    gcc_sec_ctrl_ahb_clk                    gcc_sec_ctrl_boot_rom_patch_clk         "
  print " gcc_sec_ctrl_clk                        gcc_sec_ctrl_sense_clk                                                          "
  print ""
  print "[ System_NOC ]"
  print " gcc_snoc_cnoc_ahb_clk                   gcc_snoc_pnoc_ahb_clk                   gcc_sys_noc_at_clk                      "
  print " gcc_sys_noc_axi_clk                     gcc_sys_noc_kpss_ahb_clk                gcc_sys_noc_qdss_stm_axi_clk            "
  print " gcc_sys_noc_ufs_axi_clk                 gcc_sys_noc_usb3_axi_clk                gcc_sys_noc_usb3_sec_axi_clk            "
  print ""
  print "[ TCSR ]"
  print " gcc_tcsr_ahb_clk                                                                                                        "
  print ""
  print "[ TLMM ]"
  print " gcc_tlmm_ahb_clk                        gcc_tlmm_clk                                                                    "
  print ""
  print "[ TSIF ]"
  print " gcc_tsif_ahb_clk                        gcc_tsif_inactivity_timers_clk          gcc_tsif_ref_clk                        "
  print ""
  print "[ UFS ]"
  print " gcc_ufs_ahb_clk                         gcc_ufs_axi_clk                         gcc_ufs_rx_cfg_clk                      "
  print " gcc_ufs_rx_symbol_0_clk                 gcc_ufs_rx_symbol_1_clk                 gcc_ufs_tx_cfg_clk                      "
  print " gcc_ufs_tx_symbol_0_clk                 gcc_ufs_tx_symbol_1_clk                                                         "
  print ""
  print "[ USB2A_PHY ]"
  print " gcc_usb2a_phy_sleep_clk                                                                                                 "
  print ""
  print "[ USB2B_PHY ]"
  print " gcc_usb2b_phy_sleep_clk                                                                                                 "
  print ""
  print "[ USB_30 ]"
  print " gcc_usb30_master_clk                    gcc_usb30_mock_utmi_clk                 gcc_usb30_sleep_clk                     "
  print " usb2_phy_wrapper_cc_usb3_utmi_3_clk     usb2_phy_wrapper_gcc_usb3_utmi_2_clk                                            "
  print ""
  print "[ USB_30_sec ]"
  print " gcc_usb30_sec_master_clk                gcc_usb30_sec_mock_utmi_clk             gcc_usb30_sec_sleep_clk                 "
  print " usb2_phy_wrapper_gcc_usb30_sec_utmi_clk usb3_phy_wrapper_gcc_usb3_sec_pipe_clk                                          "
  print ""
  print "[ USB_HS ]"
  print " gcc_usb_hs_ahb_clk                      gcc_usb_hs_inactivity_timers_clk        gcc_usb_hs_system_clk                   "
  print ""
  print "[ USB_HS_HSIC ]"
  print " gcc_usb_hsic_ahb_clk                    gcc_usb_hsic_clk                        gcc_usb_hsic_io_cal_clk                 "
  print " gcc_usb_hsic_io_cal_sleep_clk           gcc_usb_hsic_mock_utmi_clk              gcc_usb_hsic_system_clk                 "
  print ""
  print "[ periph_noc_mpu ]"
  print " gcc_periph_noc_mpu_cfg_ahb_clk                                                                                          "
  print ""
  print "[ periph_xpu ]"
  print " gcc_periph_xpu_ahb_clk                                                                                                  "
  print ""
  print "********************************************************* LPASS *********************************************************"
  print ""
  print "[ ATIME ]"
  print " atime_clk_src                           lpass_core_avsync_atime_clk                                                     "
  print ""
  print "[ BUS ]"
  print " ahb_spdmtm_clk                          ahbfabric_clk_src                       audio_core_aon_clk                      "
  print " audio_core_avsync_csr_clk               audio_core_bstc_clk                     audio_core_csr_clk                      "
  print " audio_core_dml_clk                      audio_core_ixfabric_clk                 audio_core_ixfabric_spdmtm_csr_clk      "
  print " audio_core_lpaif_csr_clk                audio_core_lpaif_dma_clk                audio_core_lpm_clk                      "
  print " audio_core_midi_lfabif_clk              audio_core_resampler_lfabif_clk         audio_core_security_clk                 "
  print " audio_core_slimbus_lfabif_clk           audio_core_sysnoc_mport_clk             audio_core_timeout_clk                  "
  print " audio_wrapper_aon_clk                   audio_wrapper_br_clk                    audio_wrapper_efabric_clk               "
  print " audio_wrapper_efabric_spdmtm_csr_clk    audio_wrapper_lcc_csr_clk               audio_wrapper_security_clk              "
  print " audio_wrapper_smem_clk                  audio_wrapper_sysnoc_sway_clk           audio_wrapper_timeout_clk               "
  print " core_smmu_cfg_clk                       digcodec_ahb_clk                        hdmirx_ahb_clk                          "
  print " q6_smmu_cfg_clk                         q6_tcm_slave_clk                        q6ss_ahb_lfabif_clk                     "
  print " q6ss_ahbm_clk                           sif_ahb_clk                             spdiftx_ahbm_clk                        "
  print " spdiftx_ahbs_clk                                                                                                        "
  print ""
  print "[ CXO ]"
  print " audio_core_avsync_bt_xo_clk             audio_core_avsync_fm_xo_clk             audio_core_avsync_xo_clk                "
  print " audio_core_avtimer_xo_clk               audio_core_gdsc_xo_clk                  audio_wrapper_stm_xo_clk                "
  print " q6ss_xo_clk                             xo_clk_src                                                                      "
  print ""
  print "[ DIGCODEC ]"
  print " digcodec_clk                                                                                                            "
  print ""
  print "[ DebugClockMUX ]"
  print " lpass_gcc_dbg_clk                                                                                                       "
  print ""
  print "[ PCMDataOE ]"
  print " audio_core_lpaif_pcm_data_oe_clk        lpaif_pcmoe_clk_src                                                             "
  print ""
  print "[ PrimaryMI2S ]"
  print " audio_core_lpaif_pri_ebit_clk           audio_core_lpaif_pri_ibit_clk           audio_core_lpaif_pri_osr_clk            "
  print " lpaif_pri_clk_src                                                                                                       "
  print ""
  print "[ PrimaryPCM ]"
  print " audio_core_lpaif_pcm0_ebit_clk          audio_core_lpaif_pcm0_ibit_clk          lpaif_pcm0_clk_src                      "
  print ""
  print "[ Q6Core ]"
  print " q6core_clk_src                                                                                                          "
  print ""
  print "[ QuaternaryMI2S ]"
  print " audio_core_lpaif_quad_ebit_clk          audio_core_lpaif_quad_ibit_clk          audio_core_lpaif_quad_osr_clk           "
  print " lpaif_quad_clk_src                                                                                                      "
  print ""
  print "[ Resampler ]"
  print " audio_core_resampler_core_clk           resampler_clk_src                                                               "
  print ""
  print "[ SIF ]"
  print " sif_clk                                                                                                                 "
  print ""
  print "[ SLIMbus ]"
  print " audio_core_slimbus_core_clk             audio_core_slimbus_core_clk             slimbus_clk_src                         "
  print " slimbus_clk_src                                                                                                         "
  print ""
  print "[ SPDIFTX_BMC ]"
  print " spdiftx_bmc_clk                         spdiftx_bmc_clk_src                                                             "
  print ""
  print "[ SPDM ]"
  print " q6_spdm_clk_src                         q6_spdmtm_clk                                                                   "
  print ""
  print "[ SecondaryMI2S ]"
  print " audio_core_lpaif_sec_ebit_clk           audio_core_lpaif_sec_ibit_clk           audio_core_lpaif_sec_osr_clk            "
  print " lpaif_sec_clk_src                                                                                                       "
  print ""
  print "[ SecondaryPCM ]"
  print " audio_core_lpaif_pcm1_ebit_clk          audio_core_lpaif_pcm1_ibit_clk          lpaif_pcm1_clk_src                      "
  print ""
  print "[ Sleep ]"
  print " audio_core_bcr_slp_clk                  q6ss_bcr_slp_clk                        q6ss_slp_clk                            "
  print " sleep_clk_src                                                                                                           "
  print ""
  print "[ SpeakerI2S ]"
  print " audio_core_lpaif_codec_spkr_ebit_clk    audio_core_lpaif_codec_spkr_ibit_clk    audio_core_lpaif_codec_spkr_osr_clk     "
  print " lpaif_spkr_clk_src                                                                                                      "
  print ""
  print "[ TertiaryMI2S ]"
  print " audio_core_lpaif_ter_ebit_clk           audio_core_lpaif_ter_ibit_clk           audio_core_lpaif_ter_osr_clk            "
  print " lpaif_ter_clk_src                                                                                                       "
  print ""
  print "********************************************************** MMSS *********************************************************"
  print ""
  print "[ AVSYNC ]"
  print " avsync_ahb_clk                          avsync_edppixel_clk                     avsync_extpclk_clk                      "
  print " avsync_pclk0_clk                        avsync_pclk1_clk                        avsync_vp_clk                           "
  print ""
  print "[ CAMSS_AHB ]"
  print " camss_ahb_clk                                                                                                           "
  print ""
  print "[ CAMSS_CCI ]"
  print " camss_cci_cci_ahb_clk                   camss_cci_cci_clk                                                               "
  print ""
  print "[ CAMSS_CSI0 ]"
  print " camss_csi0_ahb_clk                      camss_csi0_clk                                                                  "
  print ""
  print "[ CAMSS_CSI0PHY ]"
  print " camss_csi0phy_clk                                                                                                       "
  print ""
  print "[ CAMSS_CSI0PIX ]"
  print " camss_csi0pix_clk                                                                                                       "
  print ""
  print "[ CAMSS_CSI0RDI ]"
  print " camss_csi0rdi_clk                                                                                                       "
  print ""
  print "[ CAMSS_CSI1 ]"
  print " camss_csi1_ahb_clk                      camss_csi1_clk                                                                  "
  print ""
  print "[ CAMSS_CSI1PHY ]"
  print " camss_csi1phy_clk                                                                                                       "
  print ""
  print "[ CAMSS_CSI1PIX ]"
  print " camss_csi1pix_clk                                                                                                       "
  print ""
  print "[ CAMSS_CSI1RDI ]"
  print " camss_csi1rdi_clk                                                                                                       "
  print ""
  print "[ CAMSS_CSI2 ]"
  print " camss_csi2_ahb_clk                      camss_csi2_clk                                                                  "
  print ""
  print "[ CAMSS_CSI2PHY ]"
  print " camss_csi2phy_clk                                                                                                       "
  print ""
  print "[ CAMSS_CSI2PIX ]"
  print " camss_csi2pix_clk                                                                                                       "
  print ""
  print "[ CAMSS_CSI2RDI ]"
  print " camss_csi2rdi_clk                                                                                                       "
  print ""
  print "[ CAMSS_CSI3 ]"
  print " camss_csi3_ahb_clk                      camss_csi3_clk                                                                  "
  print ""
  print "[ CAMSS_CSI3PHY ]"
  print " camss_csi3phy_clk                                                                                                       "
  print ""
  print "[ CAMSS_CSI3PIX ]"
  print " camss_csi3pix_clk                                                                                                       "
  print ""
  print "[ CAMSS_CSI3RDI ]"
  print " camss_csi3rdi_clk                                                                                                       "
  print ""
  print "[ CAMSS_CSI_VFE0 ]"
  print " camss_csi_vfe0_clk                                                                                                      "
  print ""
  print "[ CAMSS_CSI_VFE1 ]"
  print " camss_csi_vfe1_clk                                                                                                      "
  print ""
  print "[ CAMSS_GP0 ]"
  print " camss_gp0_clk                                                                                                           "
  print ""
  print "[ CAMSS_GP1 ]"
  print " camss_gp1_clk                                                                                                           "
  print ""
  print "[ CAMSS_ISPIF ]"
  print " camss_ispif_ahb_clk                                                                                                     "
  print ""
  print "[ CAMSS_JPEG ]"
  print " camss_jpeg_jpeg0_clk                    camss_jpeg_jpeg1_clk                    camss_jpeg_jpeg2_clk                    "
  print " camss_jpeg_jpeg_ahb_clk                 camss_jpeg_jpeg_axi_clk                                                         "
  print ""
  print "[ CAMSS_MCLK0 ]"
  print " camss_mclk0_clk                                                                                                         "
  print ""
  print "[ CAMSS_MCLK1 ]"
  print " camss_mclk1_clk                                                                                                         "
  print ""
  print "[ CAMSS_MCLK2 ]"
  print " camss_mclk2_clk                                                                                                         "
  print ""
  print "[ CAMSS_MCLK3 ]"
  print " camss_mclk3_clk                                                                                                         "
  print ""
  print "[ CAMSS_MICRO ]"
  print " camss_micro_ahb_clk                                                                                                     "
  print ""
  print "[ CAMSS_PHY0 ]"
  print " camss_phy0_csi0phytimer_clk                                                                                             "
  print ""
  print "[ CAMSS_PHY1 ]"
  print " camss_phy1_csi1phytimer_clk                                                                                             "
  print ""
  print "[ CAMSS_PHY2 ]"
  print " camss_phy2_csi2phytimer_clk                                                                                             "
  print ""
  print "[ CAMSS_TOP ]"
  print " camss_top_ahb_clk                                                                                                       "
  print ""
  print "[ CAMSS_VFE ]"
  print " camss_vfe_cpp_ahb_clk                   camss_vfe_cpp_clk                       camss_vfe_vfe0_clk                      "
  print " camss_vfe_vfe1_clk                      camss_vfe_vfe_ahb_clk                   camss_vfe_vfe_axi_clk                   "
  print ""
  print "[ MDSS ]"
  print " mdss_ahb_clk                            mdss_axi_clk                            mdss_byte0_clk                          "
  print " mdss_byte1_clk                          mdss_edpaux_clk                         mdss_edplink_clk                        "
  print " mdss_edppixel_clk                       mdss_esc0_clk                           mdss_esc1_clk                           "
  print " mdss_extpclk_clk                        mdss_hdmi_ahb_clk                       mdss_hdmi_clk                           "
  print " mdss_mdp_clk                            mdss_mdp_lut_clk                        mdss_pclk0_clk                          "
  print " mdss_pclk1_clk                          mdss_vsync_clk                                                                  "
  print ""
  print "[ MMSSCXOSLEEP ]"
  print " mmss_cxo_clk                            mmss_sleepclk_clk                                                               "
  print ""
  print "[ MMSSNOCAHB ]"
  print " mmss_misc_ahb_clk                       mmss_mmssnoc_ahb_clk                    mmss_mmssnoc_bto_ahb_clk                "
  print ""
  print "[ MMSSNOCAXI ]"
  print " mmss_mmssnoc_axi_clk                    mmss_s0_axi_clk                                                                 "
  print ""
  print "[ MMSS_RBCPR ]"
  print " mmss_rbcpr_ahb_clk                      mmss_rbcpr_clk                                                                  "
  print ""
  print "[ MMSS_SPDM ]"
  print " mmss_spdm_ahb_clk                       mmss_spdm_axi_clk                       mmss_spdm_csi0_clk                      "
  print " mmss_spdm_gfx3d_clk                     mmss_spdm_jpeg0_clk                     mmss_spdm_jpeg1_clk                     "
  print " mmss_spdm_jpeg2_clk                     mmss_spdm_mdp_clk                       mmss_spdm_pclk0_clk                     "
  print " mmss_spdm_pclk1_clk                     mmss_spdm_vcodec0_clk                   mmss_spdm_vfe0_clk                      "
  print " mmss_spdm_vfe1_clk                                                                                                      "
  print ""
  print "[ MMSS_SPDM_RM ]"
  print " mmss_spdm_rm_axi_clk                    mmss_spdm_rm_ocmemnoc_clk                                                       "
  print ""
  print "[ OCMEMCX ]"
  print " gcc_ocmem_sys_noc_axi_clk               ocmemcx_ahb_clk                         ocmemcx_ocmemnoc_clk                    "
  print " oxili_ocmemgx_clk                                                                                                       "
  print ""
  print "[ OXILI ]"
  print " gfx3d_clk_src                           oxili_gfx3d_clk                         oxili_rbbmtimer_clk                     "
  print ""
  print "[ OXILICX ]"
  print " oxilicx_ahb_clk                                                                                                         "
  print ""
  print "[ PLL ]"
  print " mmpll0_dtest                            mmpll0_dtest                            mmpll0_lock_det                         "
  print " mmpll0_lock_det                         mmpll1_dtest                            mmpll1_dtest                            "
  print " mmpll1_lock_det                         mmpll1_lock_det                         mmpll2_dtest                            "
  print " mmpll2_dtest                            mmpll2_lock_det                         mmpll2_lock_det                         "
  print " mmpll3_dtest                            mmpll3_dtest                            mmpll3_lock_det                         "
  print " mmpll3_lock_det                         mmpll4_dtest                            mmpll4_dtest                            "
  print " mmpll4_lock_det                         mmpll4_lock_det                                                                 "
  print ""
  print "[ VENUS0_CORE1 ]"
  print " venus0_ahb_clk                          venus0_axi_clk                          venus0_core0_vcodec_clk                 "
  print " venus0_core1_vcodec_clk                 venus0_ocmemnoc_clk                     venus0_vcodec0_clk                      "
  print ""
  print "[ VPU ]"
  print " vpu_ahb_clk                             vpu_axi_clk                             vpu_bus_clk                             "
  print " vpu_cxo_clk                             vpu_maple_clk                           vpu_sleep_clk                           "
  print " vpu_vdp_clk                                                                                                             "
  print ""
  print "********************************************************** APCS *********************************************************"
  print ""
  print "[ APCS ]"
  print " apcs_c0_clk                             apcs_c1_clk                             apcs_c2_clk                             "
  print " apcs_c3_clk                             apcs_l2_clk                             apcs_spisleep_clk                       "
  print " apcs_sysahb_clk                         apcs_sysqsb_clk                         apcs_sysref_clk                         "


  return
  


Print_All:


  gosub Find_Print_Clock gcc_bam_dma_ahb_clk
  gosub Find_Print_Clock gcc_bam_dma_inactivity_timers_clk
  gosub Find_Print_Clock gcc_bimc_cfg_ahb_clk
  gosub Find_Print_Clock gcc_bimc_clk
  gosub Find_Print_Clock gcc_bimc_kpss_axi_clk
  gosub Find_Print_Clock gcc_bimc_sleep_clk
  gosub Find_Print_Clock gcc_bimc_sysnoc_axi_clk
  gosub Find_Print_Clock gcc_bimc_xo_clk
  gosub Find_Print_Clock gcc_blsp1_ahb_clk
  gosub Find_Print_Clock gcc_blsp1_sleep_clk
  gosub Find_Print_Clock gcc_blsp1_qup1_i2c_apps_clk
  gosub Find_Print_Clock gcc_blsp1_qup1_spi_apps_clk
  gosub Find_Print_Clock gcc_blsp1_qup2_i2c_apps_clk
  gosub Find_Print_Clock gcc_blsp1_qup2_spi_apps_clk
  gosub Find_Print_Clock gcc_blsp1_qup3_i2c_apps_clk
  gosub Find_Print_Clock gcc_blsp1_qup3_spi_apps_clk
  gosub Find_Print_Clock gcc_blsp1_qup4_i2c_apps_clk
  gosub Find_Print_Clock gcc_blsp1_qup4_spi_apps_clk
  gosub Find_Print_Clock gcc_blsp1_qup5_i2c_apps_clk
  gosub Find_Print_Clock gcc_blsp1_qup5_spi_apps_clk
  gosub Find_Print_Clock gcc_blsp1_qup6_i2c_apps_clk
  gosub Find_Print_Clock gcc_blsp1_qup6_spi_apps_clk
  gosub Find_Print_Clock gcc_blsp1_uart1_apps_clk
  gosub Find_Print_Clock gcc_blsp1_uart1_sim_clk
  gosub Find_Print_Clock gcc_blsp1_uart2_apps_clk
  gosub Find_Print_Clock gcc_blsp1_uart2_sim_clk
  gosub Find_Print_Clock gcc_blsp1_uart3_apps_clk
  gosub Find_Print_Clock gcc_blsp1_uart3_sim_clk
  gosub Find_Print_Clock gcc_blsp1_uart4_apps_clk
  gosub Find_Print_Clock gcc_blsp1_uart4_sim_clk
  gosub Find_Print_Clock gcc_blsp1_uart5_apps_clk
  gosub Find_Print_Clock gcc_blsp1_uart5_sim_clk
  gosub Find_Print_Clock gcc_blsp1_uart6_apps_clk
  gosub Find_Print_Clock gcc_blsp1_uart6_sim_clk
  gosub Find_Print_Clock gcc_blsp2_ahb_clk
  gosub Find_Print_Clock gcc_blsp2_sleep_clk
  gosub Find_Print_Clock gcc_blsp2_qup1_i2c_apps_clk
  gosub Find_Print_Clock gcc_blsp2_qup1_spi_apps_clk
  gosub Find_Print_Clock gcc_blsp2_qup2_i2c_apps_clk
  gosub Find_Print_Clock gcc_blsp2_qup2_spi_apps_clk
  gosub Find_Print_Clock gcc_blsp2_qup3_i2c_apps_clk
  gosub Find_Print_Clock gcc_blsp2_qup3_spi_apps_clk
  gosub Find_Print_Clock gcc_blsp2_qup4_i2c_apps_clk
  gosub Find_Print_Clock gcc_blsp2_qup4_spi_apps_clk
  gosub Find_Print_Clock gcc_blsp2_qup5_i2c_apps_clk
  gosub Find_Print_Clock gcc_blsp2_qup5_spi_apps_clk
  gosub Find_Print_Clock gcc_blsp2_qup6_i2c_apps_clk
  gosub Find_Print_Clock gcc_blsp2_qup6_spi_apps_clk
  gosub Find_Print_Clock gcc_blsp2_uart1_apps_clk
  gosub Find_Print_Clock gcc_blsp2_uart1_sim_clk
  gosub Find_Print_Clock gcc_blsp2_uart2_apps_clk
  gosub Find_Print_Clock gcc_blsp2_uart2_sim_clk
  gosub Find_Print_Clock gcc_blsp2_uart3_apps_clk
  gosub Find_Print_Clock gcc_blsp2_uart3_sim_clk
  gosub Find_Print_Clock gcc_blsp2_uart4_apps_clk
  gosub Find_Print_Clock gcc_blsp2_uart4_sim_clk
  gosub Find_Print_Clock gcc_blsp2_uart5_apps_clk
  gosub Find_Print_Clock gcc_blsp2_uart5_sim_clk
  gosub Find_Print_Clock gcc_blsp2_uart6_apps_clk
  gosub Find_Print_Clock gcc_blsp2_uart6_sim_clk
  gosub Find_Print_Clock gcc_boot_rom_ahb_clk
  gosub Find_Print_Clock gcc_ce1_ahb_clk
  gosub Find_Print_Clock gcc_ce1_axi_clk
  gosub Find_Print_Clock gcc_ce1_clk
  gosub Find_Print_Clock gcc_ce2_ahb_clk
  gosub Find_Print_Clock gcc_ce2_axi_clk
  gosub Find_Print_Clock gcc_ce2_clk
  gosub Find_Print_Clock gcc_ce3_ahb_clk
  gosub Find_Print_Clock gcc_ce3_axi_clk
  gosub Find_Print_Clock gcc_ce3_clk
  gosub Find_Print_Clock gcc_cnoc_bus_timeout0_ahb_clk
  gosub Find_Print_Clock gcc_cnoc_bus_timeout1_ahb_clk
  gosub Find_Print_Clock gcc_cnoc_bus_timeout2_ahb_clk
  gosub Find_Print_Clock gcc_cnoc_bus_timeout3_ahb_clk
  gosub Find_Print_Clock gcc_cnoc_bus_timeout4_ahb_clk
  gosub Find_Print_Clock gcc_cnoc_bus_timeout5_ahb_clk
  gosub Find_Print_Clock gcc_cnoc_bus_timeout6_ahb_clk
  gosub Find_Print_Clock gcc_cnoc_bus_timeout7_ahb_clk
  gosub Find_Print_Clock gcc_copss_smmu_ahb_clk
  gosub Find_Print_Clock gcc_copss_smmu_axi_clk
  gosub Find_Print_Clock gcc_cfg_noc_ahb_clk
  gosub Find_Print_Clock gcc_cfg_noc_ddr_cfg_clk
  gosub Find_Print_Clock gcc_cfg_noc_rpm_ahb_clk
  gosub Find_Print_Clock gcc_cfg_noc_tic_clk
  gosub Find_Print_Clock gcc_dcd_xo_clk
  gosub Find_Print_Clock gcc_bimc_ddr_ch0_clk
  gosub Find_Print_Clock gcc_bimc_ddr_ch1_clk
  gosub Find_Print_Clock gcc_bimc_ddr_cpll0_clk
  gosub Find_Print_Clock gcc_bimc_ddr_cpll1_clk
  gosub Find_Print_Clock gcc_bimc_gfx_clk
  gosub Find_Print_Clock gcc_ddr_dim_cfg_clk
  gosub Find_Print_Clock gcc_ddr_dim_sleep_clk
  gosub Find_Print_Clock gcc_dehr_clk
  gosub Find_Print_Clock gcc_ahb_clk
  gosub Find_Print_Clock gcc_im_sleep_clk
  gosub Find_Print_Clock gcc_xo_clk
  gosub Find_Print_Clock gcc_xo_div4_clk
  gosub Find_Print_Clock gcc_gp1_clk
  gosub Find_Print_Clock gcc_gp2_clk
  gosub Find_Print_Clock gcc_gp3_clk
  gosub Find_Print_Clock gcc_imem_axi_clk
  gosub Find_Print_Clock gcc_imem_cfg_ahb_clk
  gosub Find_Print_Clock gcc_kpss_ahb_clk
  gosub Find_Print_Clock gcc_kpss_axi_clk
  gosub Find_Print_Clock kpss_gcc_dbg_clk
  gosub Find_Print_Clock gcc_lpass_mport_axi_clk
  gosub Find_Print_Clock gcc_lpass_q6_axi_clk
  gosub Find_Print_Clock gcc_lpass_sway_clk
  gosub Find_Print_Clock lpass_gcc_dbg_clk
  gosub Find_Print_Clock gcc_mmss_bimc_gfx_clk
  gosub Find_Print_Clock gcc_mmss_noc_at_clk
  gosub Find_Print_Clock gcc_mmss_noc_cfg_ahb_clk
  gosub Find_Print_Clock gcc_mmss_vpu_maple_sys_noc_axi_clk
  gosub Find_Print_Clock gcc_ocmem_noc_cfg_ahb_clk
  gosub Find_Print_Clock gcc_ocmem_sys_noc_axi_clk
  gosub Find_Print_Clock mmss_gcc_dbg_clk
  gosub Find_Print_Clock gcc_mpm_ahb_clk
  gosub Find_Print_Clock gcc_msg_ram_ahb_clk
  gosub Find_Print_Clock gcc_noc_conf_xpu_ahb_clk
  gosub Find_Print_Clock gcc_obt_odt_clk
  gosub Find_Print_Clock ch0_dll0_dtest
  gosub Find_Print_Clock ch0_dll0_lock
  gosub Find_Print_Clock ch0_dll1_dtest
  gosub Find_Print_Clock ch0_dll1_lock
  gosub Find_Print_Clock ch1_dll0_dtest
  gosub Find_Print_Clock ch1_dll0_lock
  gosub Find_Print_Clock ch1_dll1_dtest
  gosub Find_Print_Clock ch1_dll1_lock
  gosub Find_Print_Clock gpll0_dtest
  gosub Find_Print_Clock gpll0_lock_det
  gosub Find_Print_Clock gpll1_dtest
  gosub Find_Print_Clock gpll1_lock_det
  gosub Find_Print_Clock gpll2_dtest
  gosub Find_Print_Clock gpll2_lock_det
  gosub Find_Print_Clock gpll3_dtest
  gosub Find_Print_Clock gpll3_lock_det
  gosub Find_Print_Clock gpll4_dtest
  gosub Find_Print_Clock gpll4_lock_det
  gosub Find_Print_Clock kpss_gcc_ringosc_clk
  gosub Find_Print_Clock mpm_gcc_temp_sensor_ringosc_clk
  gosub Find_Print_Clock usb2_phy_gcc_atest_ulpi_0_clk
  gosub Find_Print_Clock usb2_phy_gcc_atest_ulpi_1_clk
  gosub Find_Print_Clock usb2_phy_wrapper_gcc_usb30_utmi_clk
  gosub Find_Print_Clock usb3_phy_wrapper_gcc_usb3_pipe_clk
  gosub Find_Print_Clock usb_hspw_gcc_480_test_clk
  gosub Find_Print_Clock gcc_pcie_0_aux_clk
  gosub Find_Print_Clock gcc_pcie_0_cfg_ahb_clk
  gosub Find_Print_Clock gcc_pcie_0_mstr_axi_clk
  gosub Find_Print_Clock gcc_pcie_0_pipe_clk
  gosub Find_Print_Clock gcc_pcie_0_slv_axi_clk
  gosub Find_Print_Clock pcie_0_pipe_clk
  gosub Find_Print_Clock gcc_pcie_1_aux_clk
  gosub Find_Print_Clock gcc_pcie_1_cfg_ahb_clk
  gosub Find_Print_Clock gcc_pcie_1_mstr_axi_clk
  gosub Find_Print_Clock gcc_pcie_1_pipe_clk
  gosub Find_Print_Clock gcc_pcie_1_slv_axi_clk
  gosub Find_Print_Clock pcie_1_pipe_clk
  gosub Find_Print_Clock gcc_pdm2_clk
  gosub Find_Print_Clock gcc_pdm_ahb_clk
  gosub Find_Print_Clock gcc_pdm_xo4_clk
  gosub Find_Print_Clock gcc_pnoc_bus_timeout0_ahb_clk
  gosub Find_Print_Clock gcc_pnoc_bus_timeout1_ahb_clk
  gosub Find_Print_Clock gcc_pnoc_bus_timeout2_ahb_clk
  gosub Find_Print_Clock gcc_pnoc_bus_timeout3_ahb_clk
  gosub Find_Print_Clock gcc_pnoc_bus_timeout4_ahb_clk
  gosub Find_Print_Clock gcc_prng_ahb_clk
  gosub Find_Print_Clock gcc_periph_noc_ahb_clk
  gosub Find_Print_Clock gcc_periph_noc_at_clk
  gosub Find_Print_Clock gcc_periph_noc_cfg_ahb_clk
  gosub Find_Print_Clock gcc_periph_noc_usb_hsic_ahb_clk
  gosub Find_Print_Clock gcc_qdss_at_clk
  gosub Find_Print_Clock gcc_qdss_cfg_ahb_clk
  gosub Find_Print_Clock gcc_qdss_dap_ahb_clk
  gosub Find_Print_Clock gcc_qdss_dap_clk
  gosub Find_Print_Clock gcc_qdss_etr_usb_clk
  gosub Find_Print_Clock gcc_qdss_stm_clk
  gosub Find_Print_Clock gcc_qdss_traceclkin_clk
  gosub Find_Print_Clock gcc_qdss_tsctr_div16_clk
  gosub Find_Print_Clock gcc_qdss_tsctr_div2_clk
  gosub Find_Print_Clock gcc_qdss_tsctr_div3_clk
  gosub Find_Print_Clock gcc_qdss_tsctr_div4_clk
  gosub Find_Print_Clock gcc_qdss_tsctr_div8_clk
  gosub Find_Print_Clock gcc_qdss_rbcpr_xpu_ahb_clk
  gosub Find_Print_Clock gcc_rbcpr_ahb_clk
  gosub Find_Print_Clock gcc_rbcpr_clk
  gosub Find_Print_Clock gcc_rpm_bus_ahb_clk
  gosub Find_Print_Clock gcc_rpm_proc_fclk
  gosub Find_Print_Clock gcc_rpm_proc_hclk
  gosub Find_Print_Clock gcc_rpm_sleep_clk
  gosub Find_Print_Clock gcc_rpm_timer_clk
  gosub Find_Print_Clock gcc_sata_asic0_clk
  gosub Find_Print_Clock gcc_sata_axi_clk
  gosub Find_Print_Clock gcc_sata_cfg_ahb_clk
  gosub Find_Print_Clock gcc_sata_pmalive_clk
  gosub Find_Print_Clock gcc_sata_rx_clk
  gosub Find_Print_Clock gcc_sata_rx_oob_clk
  gosub Find_Print_Clock gcc_sdcc1_ahb_clk
  gosub Find_Print_Clock gcc_sdcc1_apps_clk
  gosub Find_Print_Clock gcc_sdcc1_cdccal_ff_clk
  gosub Find_Print_Clock gcc_sdcc1_cdccal_sleep_clk
  gosub Find_Print_Clock gcc_sdcc2_ahb_clk
  gosub Find_Print_Clock gcc_sdcc2_apps_clk
  gosub Find_Print_Clock gcc_sdcc2_inactivity_timers_clk
  gosub Find_Print_Clock gcc_sdcc3_ahb_clk
  gosub Find_Print_Clock gcc_sdcc3_apps_clk
  gosub Find_Print_Clock gcc_sdcc3_inactivity_timers_clk
  gosub Find_Print_Clock gcc_sdcc4_ahb_clk
  gosub Find_Print_Clock gcc_sdcc4_apps_clk
  gosub Find_Print_Clock gcc_sdcc4_inactivity_timers_clk
  gosub Find_Print_Clock gcc_snoc_bus_timeout0_ahb_clk
  gosub Find_Print_Clock gcc_snoc_bus_timeout2_ahb_clk
  gosub Find_Print_Clock gcc_snoc_bus_timeout3_ahb_clk
  gosub Find_Print_Clock gcc_spdm_bimc_cy_clk
  gosub Find_Print_Clock gcc_spdm_cfg_ahb_clk
  gosub Find_Print_Clock gcc_spdm_ff_clk
  gosub Find_Print_Clock gcc_spdm_mstr_ahb_clk
  gosub Find_Print_Clock gcc_spdm_pnoc_cy_clk
  gosub Find_Print_Clock gcc_spdm_rpm_cy_clk
  gosub Find_Print_Clock gcc_spdm_snoc_cy_clk
  gosub Find_Print_Clock gcc_spmi_ahb_clk
  gosub Find_Print_Clock gcc_spmi_cnoc_ahb_clk
  gosub Find_Print_Clock gcc_spmi_ser_clk
  gosub Find_Print_Clock gcc_spss_ahb_clk
  gosub Find_Print_Clock spss_gcc_dbg_clk
  gosub Find_Print_Clock gcc_sec_ctrl_acc_clk
  gosub Find_Print_Clock gcc_sec_ctrl_ahb_clk
  gosub Find_Print_Clock gcc_sec_ctrl_boot_rom_patch_clk
  gosub Find_Print_Clock gcc_sec_ctrl_clk
  gosub Find_Print_Clock gcc_sec_ctrl_sense_clk
  gosub Find_Print_Clock gcc_snoc_cnoc_ahb_clk
  gosub Find_Print_Clock gcc_snoc_pnoc_ahb_clk
  gosub Find_Print_Clock gcc_sys_noc_at_clk
  gosub Find_Print_Clock gcc_sys_noc_axi_clk
  gosub Find_Print_Clock gcc_sys_noc_kpss_ahb_clk
  gosub Find_Print_Clock gcc_sys_noc_qdss_stm_axi_clk
  gosub Find_Print_Clock gcc_sys_noc_ufs_axi_clk
  gosub Find_Print_Clock gcc_sys_noc_usb3_axi_clk
  gosub Find_Print_Clock gcc_sys_noc_usb3_sec_axi_clk
  gosub Find_Print_Clock gcc_tcsr_ahb_clk
  gosub Find_Print_Clock gcc_tlmm_ahb_clk
  gosub Find_Print_Clock gcc_tlmm_clk
  gosub Find_Print_Clock gcc_tsif_ahb_clk
  gosub Find_Print_Clock gcc_tsif_inactivity_timers_clk
  gosub Find_Print_Clock gcc_tsif_ref_clk
  gosub Find_Print_Clock gcc_ufs_ahb_clk
  gosub Find_Print_Clock gcc_ufs_axi_clk
  gosub Find_Print_Clock gcc_ufs_rx_cfg_clk
  gosub Find_Print_Clock gcc_ufs_rx_symbol_0_clk
  gosub Find_Print_Clock gcc_ufs_rx_symbol_1_clk
  gosub Find_Print_Clock gcc_ufs_tx_cfg_clk
  gosub Find_Print_Clock gcc_ufs_tx_symbol_0_clk
  gosub Find_Print_Clock gcc_ufs_tx_symbol_1_clk
  gosub Find_Print_Clock gcc_usb2a_phy_sleep_clk
  gosub Find_Print_Clock gcc_usb2b_phy_sleep_clk
  gosub Find_Print_Clock gcc_usb30_master_clk
  gosub Find_Print_Clock gcc_usb30_mock_utmi_clk
  gosub Find_Print_Clock gcc_usb30_sleep_clk
  gosub Find_Print_Clock usb2_phy_wrapper_cc_usb3_utmi_3_clk
  gosub Find_Print_Clock usb2_phy_wrapper_gcc_usb3_utmi_2_clk
  gosub Find_Print_Clock gcc_usb30_sec_master_clk
  gosub Find_Print_Clock gcc_usb30_sec_mock_utmi_clk
  gosub Find_Print_Clock gcc_usb30_sec_sleep_clk
  gosub Find_Print_Clock usb2_phy_wrapper_gcc_usb30_sec_utmi_clk
  gosub Find_Print_Clock usb3_phy_wrapper_gcc_usb3_sec_pipe_clk
  gosub Find_Print_Clock gcc_usb_hs_ahb_clk
  gosub Find_Print_Clock gcc_usb_hs_inactivity_timers_clk
  gosub Find_Print_Clock gcc_usb_hs_system_clk
  gosub Find_Print_Clock gcc_usb_hsic_ahb_clk
  gosub Find_Print_Clock gcc_usb_hsic_clk
  gosub Find_Print_Clock gcc_usb_hsic_io_cal_clk
  gosub Find_Print_Clock gcc_usb_hsic_io_cal_sleep_clk
  gosub Find_Print_Clock gcc_usb_hsic_mock_utmi_clk
  gosub Find_Print_Clock gcc_usb_hsic_system_clk
  gosub Find_Print_Clock gcc_periph_noc_mpu_cfg_ahb_clk
  gosub Find_Print_Clock gcc_periph_xpu_ahb_clk
  gosub Find_Print_Clock atime_clk_src
  gosub Find_Print_Clock lpass_core_avsync_atime_clk
  gosub Find_Print_Clock ahb_spdmtm_clk
  gosub Find_Print_Clock ahbfabric_clk_src
  gosub Find_Print_Clock audio_core_aon_clk
  gosub Find_Print_Clock audio_core_avsync_csr_clk
  gosub Find_Print_Clock audio_core_bstc_clk
  gosub Find_Print_Clock audio_core_csr_clk
  gosub Find_Print_Clock audio_core_dml_clk
  gosub Find_Print_Clock audio_core_ixfabric_clk
  gosub Find_Print_Clock audio_core_ixfabric_spdmtm_csr_clk
  gosub Find_Print_Clock audio_core_lpaif_csr_clk
  gosub Find_Print_Clock audio_core_lpaif_dma_clk
  gosub Find_Print_Clock audio_core_lpm_clk
  gosub Find_Print_Clock audio_core_midi_lfabif_clk
  gosub Find_Print_Clock audio_core_resampler_lfabif_clk
  gosub Find_Print_Clock audio_core_security_clk
  gosub Find_Print_Clock audio_core_slimbus_lfabif_clk
  gosub Find_Print_Clock audio_core_sysnoc_mport_clk
  gosub Find_Print_Clock audio_core_timeout_clk
  gosub Find_Print_Clock audio_wrapper_aon_clk
  gosub Find_Print_Clock audio_wrapper_br_clk
  gosub Find_Print_Clock audio_wrapper_efabric_clk
  gosub Find_Print_Clock audio_wrapper_efabric_spdmtm_csr_clk
  gosub Find_Print_Clock audio_wrapper_lcc_csr_clk
  gosub Find_Print_Clock audio_wrapper_security_clk
  gosub Find_Print_Clock audio_wrapper_smem_clk
  gosub Find_Print_Clock audio_wrapper_sysnoc_sway_clk
  gosub Find_Print_Clock audio_wrapper_timeout_clk
  gosub Find_Print_Clock core_smmu_cfg_clk
  gosub Find_Print_Clock digcodec_ahb_clk
  gosub Find_Print_Clock hdmirx_ahb_clk
  gosub Find_Print_Clock q6_smmu_cfg_clk
  gosub Find_Print_Clock q6_tcm_slave_clk
  gosub Find_Print_Clock q6ss_ahb_lfabif_clk
  gosub Find_Print_Clock q6ss_ahbm_clk
  gosub Find_Print_Clock sif_ahb_clk
  gosub Find_Print_Clock spdiftx_ahbm_clk
  gosub Find_Print_Clock spdiftx_ahbs_clk
  gosub Find_Print_Clock audio_core_avsync_bt_xo_clk
  gosub Find_Print_Clock audio_core_avsync_fm_xo_clk
  gosub Find_Print_Clock audio_core_avsync_xo_clk
  gosub Find_Print_Clock audio_core_avtimer_xo_clk
  gosub Find_Print_Clock audio_core_gdsc_xo_clk
  gosub Find_Print_Clock audio_wrapper_stm_xo_clk
  gosub Find_Print_Clock q6ss_xo_clk
  gosub Find_Print_Clock xo_clk_src
  gosub Find_Print_Clock digcodec_clk
  gosub Find_Print_Clock lpass_gcc_dbg_clk
  gosub Find_Print_Clock audio_core_lpaif_pcm_data_oe_clk
  gosub Find_Print_Clock lpaif_pcmoe_clk_src
  gosub Find_Print_Clock audio_core_lpaif_pri_ebit_clk
  gosub Find_Print_Clock audio_core_lpaif_pri_ibit_clk
  gosub Find_Print_Clock audio_core_lpaif_pri_osr_clk
  gosub Find_Print_Clock lpaif_pri_clk_src
  gosub Find_Print_Clock audio_core_lpaif_pcm0_ebit_clk
  gosub Find_Print_Clock audio_core_lpaif_pcm0_ibit_clk
  gosub Find_Print_Clock lpaif_pcm0_clk_src
  gosub Find_Print_Clock q6core_clk_src
  gosub Find_Print_Clock audio_core_lpaif_quad_ebit_clk
  gosub Find_Print_Clock audio_core_lpaif_quad_ibit_clk
  gosub Find_Print_Clock audio_core_lpaif_quad_osr_clk
  gosub Find_Print_Clock lpaif_quad_clk_src
  gosub Find_Print_Clock audio_core_resampler_core_clk
  gosub Find_Print_Clock resampler_clk_src
  gosub Find_Print_Clock sif_clk
  gosub Find_Print_Clock audio_core_slimbus_core_clk
  gosub Find_Print_Clock audio_core_slimbus_core_clk
  gosub Find_Print_Clock slimbus_clk_src
  gosub Find_Print_Clock slimbus_clk_src
  gosub Find_Print_Clock spdiftx_bmc_clk
  gosub Find_Print_Clock spdiftx_bmc_clk_src
  gosub Find_Print_Clock q6_spdm_clk_src
  gosub Find_Print_Clock q6_spdmtm_clk
  gosub Find_Print_Clock audio_core_lpaif_sec_ebit_clk
  gosub Find_Print_Clock audio_core_lpaif_sec_ibit_clk
  gosub Find_Print_Clock audio_core_lpaif_sec_osr_clk
  gosub Find_Print_Clock lpaif_sec_clk_src
  gosub Find_Print_Clock audio_core_lpaif_pcm1_ebit_clk
  gosub Find_Print_Clock audio_core_lpaif_pcm1_ibit_clk
  gosub Find_Print_Clock lpaif_pcm1_clk_src
  gosub Find_Print_Clock audio_core_bcr_slp_clk
  gosub Find_Print_Clock q6ss_bcr_slp_clk
  gosub Find_Print_Clock q6ss_slp_clk
  gosub Find_Print_Clock sleep_clk_src
  gosub Find_Print_Clock audio_core_lpaif_codec_spkr_ebit_clk
  gosub Find_Print_Clock audio_core_lpaif_codec_spkr_ibit_clk
  gosub Find_Print_Clock audio_core_lpaif_codec_spkr_osr_clk
  gosub Find_Print_Clock lpaif_spkr_clk_src
  gosub Find_Print_Clock audio_core_lpaif_ter_ebit_clk
  gosub Find_Print_Clock audio_core_lpaif_ter_ibit_clk
  gosub Find_Print_Clock audio_core_lpaif_ter_osr_clk
  gosub Find_Print_Clock lpaif_ter_clk_src
  gosub Find_Print_Clock avsync_ahb_clk
  gosub Find_Print_Clock avsync_edppixel_clk
  gosub Find_Print_Clock avsync_extpclk_clk
  gosub Find_Print_Clock avsync_pclk0_clk
  gosub Find_Print_Clock avsync_pclk1_clk
  gosub Find_Print_Clock avsync_vp_clk
  gosub Find_Print_Clock camss_ahb_clk
  gosub Find_Print_Clock camss_cci_cci_ahb_clk
  gosub Find_Print_Clock camss_cci_cci_clk
  gosub Find_Print_Clock camss_csi0_ahb_clk
  gosub Find_Print_Clock camss_csi0_clk
  gosub Find_Print_Clock camss_csi0phy_clk
  gosub Find_Print_Clock camss_csi0pix_clk
  gosub Find_Print_Clock camss_csi0rdi_clk
  gosub Find_Print_Clock camss_csi1_ahb_clk
  gosub Find_Print_Clock camss_csi1_clk
  gosub Find_Print_Clock camss_csi1phy_clk
  gosub Find_Print_Clock camss_csi1pix_clk
  gosub Find_Print_Clock camss_csi1rdi_clk
  gosub Find_Print_Clock camss_csi2_ahb_clk
  gosub Find_Print_Clock camss_csi2_clk
  gosub Find_Print_Clock camss_csi2phy_clk
  gosub Find_Print_Clock camss_csi2pix_clk
  gosub Find_Print_Clock camss_csi2rdi_clk
  gosub Find_Print_Clock camss_csi3_ahb_clk
  gosub Find_Print_Clock camss_csi3_clk
  gosub Find_Print_Clock camss_csi3phy_clk
  gosub Find_Print_Clock camss_csi3pix_clk
  gosub Find_Print_Clock camss_csi3rdi_clk
  gosub Find_Print_Clock camss_csi_vfe0_clk
  gosub Find_Print_Clock camss_csi_vfe1_clk
  gosub Find_Print_Clock camss_gp0_clk
  gosub Find_Print_Clock camss_gp1_clk
  gosub Find_Print_Clock camss_ispif_ahb_clk
  gosub Find_Print_Clock camss_jpeg_jpeg0_clk
  gosub Find_Print_Clock camss_jpeg_jpeg1_clk
  gosub Find_Print_Clock camss_jpeg_jpeg2_clk
  gosub Find_Print_Clock camss_jpeg_jpeg_ahb_clk
  gosub Find_Print_Clock camss_jpeg_jpeg_axi_clk
  gosub Find_Print_Clock camss_mclk0_clk
  gosub Find_Print_Clock camss_mclk1_clk
  gosub Find_Print_Clock camss_mclk2_clk
  gosub Find_Print_Clock camss_mclk3_clk
  gosub Find_Print_Clock camss_micro_ahb_clk
  gosub Find_Print_Clock camss_phy0_csi0phytimer_clk
  gosub Find_Print_Clock camss_phy1_csi1phytimer_clk
  gosub Find_Print_Clock camss_phy2_csi2phytimer_clk
  gosub Find_Print_Clock camss_top_ahb_clk
  gosub Find_Print_Clock camss_vfe_cpp_ahb_clk
  gosub Find_Print_Clock camss_vfe_cpp_clk
  gosub Find_Print_Clock camss_vfe_vfe0_clk
  gosub Find_Print_Clock camss_vfe_vfe1_clk
  gosub Find_Print_Clock camss_vfe_vfe_ahb_clk
  gosub Find_Print_Clock camss_vfe_vfe_axi_clk
  gosub Find_Print_Clock mdss_ahb_clk
  gosub Find_Print_Clock mdss_axi_clk
  gosub Find_Print_Clock mdss_byte0_clk
  gosub Find_Print_Clock mdss_byte1_clk
  gosub Find_Print_Clock mdss_edpaux_clk
  gosub Find_Print_Clock mdss_edplink_clk
  gosub Find_Print_Clock mdss_edppixel_clk
  gosub Find_Print_Clock mdss_esc0_clk
  gosub Find_Print_Clock mdss_esc1_clk
  gosub Find_Print_Clock mdss_extpclk_clk
  gosub Find_Print_Clock mdss_hdmi_ahb_clk
  gosub Find_Print_Clock mdss_hdmi_clk
  gosub Find_Print_Clock mdss_mdp_clk
  gosub Find_Print_Clock mdss_mdp_lut_clk
  gosub Find_Print_Clock mdss_pclk0_clk
  gosub Find_Print_Clock mdss_pclk1_clk
  gosub Find_Print_Clock mdss_vsync_clk
  gosub Find_Print_Clock mmss_cxo_clk
  gosub Find_Print_Clock mmss_sleepclk_clk
  gosub Find_Print_Clock mmss_misc_ahb_clk
  gosub Find_Print_Clock mmss_mmssnoc_ahb_clk
  gosub Find_Print_Clock mmss_mmssnoc_bto_ahb_clk
  gosub Find_Print_Clock mmss_mmssnoc_axi_clk
  gosub Find_Print_Clock mmss_s0_axi_clk
  gosub Find_Print_Clock mmss_rbcpr_ahb_clk
  gosub Find_Print_Clock mmss_rbcpr_clk
  gosub Find_Print_Clock mmss_spdm_ahb_clk
  gosub Find_Print_Clock mmss_spdm_axi_clk
  gosub Find_Print_Clock mmss_spdm_csi0_clk
  gosub Find_Print_Clock mmss_spdm_gfx3d_clk
  gosub Find_Print_Clock mmss_spdm_jpeg0_clk
  gosub Find_Print_Clock mmss_spdm_jpeg1_clk
  gosub Find_Print_Clock mmss_spdm_jpeg2_clk
  gosub Find_Print_Clock mmss_spdm_mdp_clk
  gosub Find_Print_Clock mmss_spdm_pclk0_clk
  gosub Find_Print_Clock mmss_spdm_pclk1_clk
  gosub Find_Print_Clock mmss_spdm_vcodec0_clk
  gosub Find_Print_Clock mmss_spdm_vfe0_clk
  gosub Find_Print_Clock mmss_spdm_vfe1_clk
  gosub Find_Print_Clock mmss_spdm_rm_axi_clk
  gosub Find_Print_Clock mmss_spdm_rm_ocmemnoc_clk
  gosub Find_Print_Clock gcc_ocmem_sys_noc_axi_clk
  gosub Find_Print_Clock ocmemcx_ahb_clk
  gosub Find_Print_Clock ocmemcx_ocmemnoc_clk
  gosub Find_Print_Clock oxili_ocmemgx_clk
  gosub Find_Print_Clock gfx3d_clk_src
  gosub Find_Print_Clock oxili_gfx3d_clk
  gosub Find_Print_Clock oxili_rbbmtimer_clk
  gosub Find_Print_Clock oxilicx_ahb_clk
  gosub Find_Print_Clock mmpll0_dtest
  gosub Find_Print_Clock mmpll0_dtest
  gosub Find_Print_Clock mmpll0_lock_det
  gosub Find_Print_Clock mmpll0_lock_det
  gosub Find_Print_Clock mmpll1_dtest
  gosub Find_Print_Clock mmpll1_dtest
  gosub Find_Print_Clock mmpll1_lock_det
  gosub Find_Print_Clock mmpll1_lock_det
  gosub Find_Print_Clock mmpll2_dtest
  gosub Find_Print_Clock mmpll2_dtest
  gosub Find_Print_Clock mmpll2_lock_det
  gosub Find_Print_Clock mmpll2_lock_det
  gosub Find_Print_Clock mmpll3_dtest
  gosub Find_Print_Clock mmpll3_dtest
  gosub Find_Print_Clock mmpll3_lock_det
  gosub Find_Print_Clock mmpll3_lock_det
  gosub Find_Print_Clock mmpll4_dtest
  gosub Find_Print_Clock mmpll4_dtest
  gosub Find_Print_Clock mmpll4_lock_det
  gosub Find_Print_Clock mmpll4_lock_det
  gosub Find_Print_Clock venus0_ahb_clk
  gosub Find_Print_Clock venus0_axi_clk
  gosub Find_Print_Clock venus0_core0_vcodec_clk
  gosub Find_Print_Clock venus0_core1_vcodec_clk
  gosub Find_Print_Clock venus0_ocmemnoc_clk
  gosub Find_Print_Clock venus0_vcodec0_clk
  gosub Find_Print_Clock vpu_ahb_clk
  gosub Find_Print_Clock vpu_axi_clk
  gosub Find_Print_Clock vpu_bus_clk
  gosub Find_Print_Clock vpu_cxo_clk
  gosub Find_Print_Clock vpu_maple_clk
  gosub Find_Print_Clock vpu_sleep_clk
  gosub Find_Print_Clock vpu_vdp_clk
  gosub Find_Print_Clock apcs_c0_clk
  gosub Find_Print_Clock apcs_c1_clk
  gosub Find_Print_Clock apcs_c2_clk
  gosub Find_Print_Clock apcs_c3_clk
  gosub Find_Print_Clock apcs_l2_clk
  gosub Find_Print_Clock apcs_spisleep_clk
  gosub Find_Print_Clock apcs_sysahb_clk
  gosub Find_Print_Clock apcs_sysqsb_clk
  gosub Find_Print_Clock apcs_sysref_clk

  return
  


Print_All_SS:

  if ("&choice"=="gcc_all")
  (
    gosub Find_Print_Clock gcc_bam_dma_ahb_clk
    gosub Find_Print_Clock gcc_bam_dma_inactivity_timers_clk
    gosub Find_Print_Clock gcc_bimc_cfg_ahb_clk
    gosub Find_Print_Clock gcc_bimc_clk
    gosub Find_Print_Clock gcc_bimc_kpss_axi_clk
    gosub Find_Print_Clock gcc_bimc_sleep_clk
    gosub Find_Print_Clock gcc_bimc_sysnoc_axi_clk
    gosub Find_Print_Clock gcc_bimc_xo_clk
    gosub Find_Print_Clock gcc_blsp1_ahb_clk
    gosub Find_Print_Clock gcc_blsp1_sleep_clk
    gosub Find_Print_Clock gcc_blsp1_qup1_i2c_apps_clk
    gosub Find_Print_Clock gcc_blsp1_qup1_spi_apps_clk
    gosub Find_Print_Clock gcc_blsp1_qup2_i2c_apps_clk
    gosub Find_Print_Clock gcc_blsp1_qup2_spi_apps_clk
    gosub Find_Print_Clock gcc_blsp1_qup3_i2c_apps_clk
    gosub Find_Print_Clock gcc_blsp1_qup3_spi_apps_clk
    gosub Find_Print_Clock gcc_blsp1_qup4_i2c_apps_clk
    gosub Find_Print_Clock gcc_blsp1_qup4_spi_apps_clk
    gosub Find_Print_Clock gcc_blsp1_qup5_i2c_apps_clk
    gosub Find_Print_Clock gcc_blsp1_qup5_spi_apps_clk
    gosub Find_Print_Clock gcc_blsp1_qup6_i2c_apps_clk
    gosub Find_Print_Clock gcc_blsp1_qup6_spi_apps_clk
    gosub Find_Print_Clock gcc_blsp1_uart1_apps_clk
    gosub Find_Print_Clock gcc_blsp1_uart1_sim_clk
    gosub Find_Print_Clock gcc_blsp1_uart2_apps_clk
    gosub Find_Print_Clock gcc_blsp1_uart2_sim_clk
    gosub Find_Print_Clock gcc_blsp1_uart3_apps_clk
    gosub Find_Print_Clock gcc_blsp1_uart3_sim_clk
    gosub Find_Print_Clock gcc_blsp1_uart4_apps_clk
    gosub Find_Print_Clock gcc_blsp1_uart4_sim_clk
    gosub Find_Print_Clock gcc_blsp1_uart5_apps_clk
    gosub Find_Print_Clock gcc_blsp1_uart5_sim_clk
    gosub Find_Print_Clock gcc_blsp1_uart6_apps_clk
    gosub Find_Print_Clock gcc_blsp1_uart6_sim_clk
    gosub Find_Print_Clock gcc_blsp2_ahb_clk
    gosub Find_Print_Clock gcc_blsp2_sleep_clk
    gosub Find_Print_Clock gcc_blsp2_qup1_i2c_apps_clk
    gosub Find_Print_Clock gcc_blsp2_qup1_spi_apps_clk
    gosub Find_Print_Clock gcc_blsp2_qup2_i2c_apps_clk
    gosub Find_Print_Clock gcc_blsp2_qup2_spi_apps_clk
    gosub Find_Print_Clock gcc_blsp2_qup3_i2c_apps_clk
    gosub Find_Print_Clock gcc_blsp2_qup3_spi_apps_clk
    gosub Find_Print_Clock gcc_blsp2_qup4_i2c_apps_clk
    gosub Find_Print_Clock gcc_blsp2_qup4_spi_apps_clk
    gosub Find_Print_Clock gcc_blsp2_qup5_i2c_apps_clk
    gosub Find_Print_Clock gcc_blsp2_qup5_spi_apps_clk
    gosub Find_Print_Clock gcc_blsp2_qup6_i2c_apps_clk
    gosub Find_Print_Clock gcc_blsp2_qup6_spi_apps_clk
    gosub Find_Print_Clock gcc_blsp2_uart1_apps_clk
    gosub Find_Print_Clock gcc_blsp2_uart1_sim_clk
    gosub Find_Print_Clock gcc_blsp2_uart2_apps_clk
    gosub Find_Print_Clock gcc_blsp2_uart2_sim_clk
    gosub Find_Print_Clock gcc_blsp2_uart3_apps_clk
    gosub Find_Print_Clock gcc_blsp2_uart3_sim_clk
    gosub Find_Print_Clock gcc_blsp2_uart4_apps_clk
    gosub Find_Print_Clock gcc_blsp2_uart4_sim_clk
    gosub Find_Print_Clock gcc_blsp2_uart5_apps_clk
    gosub Find_Print_Clock gcc_blsp2_uart5_sim_clk
    gosub Find_Print_Clock gcc_blsp2_uart6_apps_clk
    gosub Find_Print_Clock gcc_blsp2_uart6_sim_clk
    gosub Find_Print_Clock gcc_boot_rom_ahb_clk
    gosub Find_Print_Clock gcc_ce1_ahb_clk
    gosub Find_Print_Clock gcc_ce1_axi_clk
    gosub Find_Print_Clock gcc_ce1_clk
    gosub Find_Print_Clock gcc_ce2_ahb_clk
    gosub Find_Print_Clock gcc_ce2_axi_clk
    gosub Find_Print_Clock gcc_ce2_clk
    gosub Find_Print_Clock gcc_ce3_ahb_clk
    gosub Find_Print_Clock gcc_ce3_axi_clk
    gosub Find_Print_Clock gcc_ce3_clk
    gosub Find_Print_Clock gcc_cnoc_bus_timeout0_ahb_clk
    gosub Find_Print_Clock gcc_cnoc_bus_timeout1_ahb_clk
    gosub Find_Print_Clock gcc_cnoc_bus_timeout2_ahb_clk
    gosub Find_Print_Clock gcc_cnoc_bus_timeout3_ahb_clk
    gosub Find_Print_Clock gcc_cnoc_bus_timeout4_ahb_clk
    gosub Find_Print_Clock gcc_cnoc_bus_timeout5_ahb_clk
    gosub Find_Print_Clock gcc_cnoc_bus_timeout6_ahb_clk
    gosub Find_Print_Clock gcc_cnoc_bus_timeout7_ahb_clk
    gosub Find_Print_Clock gcc_copss_smmu_ahb_clk
    gosub Find_Print_Clock gcc_copss_smmu_axi_clk
    gosub Find_Print_Clock gcc_cfg_noc_ahb_clk
    gosub Find_Print_Clock gcc_cfg_noc_ddr_cfg_clk
    gosub Find_Print_Clock gcc_cfg_noc_rpm_ahb_clk
    gosub Find_Print_Clock gcc_cfg_noc_tic_clk
    gosub Find_Print_Clock gcc_dcd_xo_clk
    gosub Find_Print_Clock gcc_bimc_ddr_ch0_clk
    gosub Find_Print_Clock gcc_bimc_ddr_ch1_clk
    gosub Find_Print_Clock gcc_bimc_ddr_cpll0_clk
    gosub Find_Print_Clock gcc_bimc_ddr_cpll1_clk
    gosub Find_Print_Clock gcc_bimc_gfx_clk
    gosub Find_Print_Clock gcc_ddr_dim_cfg_clk
    gosub Find_Print_Clock gcc_ddr_dim_sleep_clk
    gosub Find_Print_Clock gcc_dehr_clk
    gosub Find_Print_Clock gcc_ahb_clk
    gosub Find_Print_Clock gcc_im_sleep_clk
    gosub Find_Print_Clock gcc_xo_clk
    gosub Find_Print_Clock gcc_xo_div4_clk
    gosub Find_Print_Clock gcc_gp1_clk
    gosub Find_Print_Clock gcc_gp2_clk
    gosub Find_Print_Clock gcc_gp3_clk
    gosub Find_Print_Clock gcc_imem_axi_clk
    gosub Find_Print_Clock gcc_imem_cfg_ahb_clk
    gosub Find_Print_Clock gcc_kpss_ahb_clk
    gosub Find_Print_Clock gcc_kpss_axi_clk
    gosub Find_Print_Clock kpss_gcc_dbg_clk
    gosub Find_Print_Clock gcc_lpass_mport_axi_clk
    gosub Find_Print_Clock gcc_lpass_q6_axi_clk
    gosub Find_Print_Clock gcc_lpass_sway_clk
    gosub Find_Print_Clock lpass_gcc_dbg_clk
    gosub Find_Print_Clock gcc_mmss_bimc_gfx_clk
    gosub Find_Print_Clock gcc_mmss_noc_at_clk
    gosub Find_Print_Clock gcc_mmss_noc_cfg_ahb_clk
    gosub Find_Print_Clock gcc_mmss_vpu_maple_sys_noc_axi_clk
    gosub Find_Print_Clock gcc_ocmem_noc_cfg_ahb_clk
    gosub Find_Print_Clock gcc_ocmem_sys_noc_axi_clk
    gosub Find_Print_Clock mmss_gcc_dbg_clk
    gosub Find_Print_Clock gcc_mpm_ahb_clk
    gosub Find_Print_Clock gcc_msg_ram_ahb_clk
    gosub Find_Print_Clock gcc_noc_conf_xpu_ahb_clk
    gosub Find_Print_Clock gcc_obt_odt_clk
    gosub Find_Print_Clock ch0_dll0_dtest
    gosub Find_Print_Clock ch0_dll0_lock
    gosub Find_Print_Clock ch0_dll1_dtest
    gosub Find_Print_Clock ch0_dll1_lock
    gosub Find_Print_Clock ch1_dll0_dtest
    gosub Find_Print_Clock ch1_dll0_lock
    gosub Find_Print_Clock ch1_dll1_dtest
    gosub Find_Print_Clock ch1_dll1_lock
    gosub Find_Print_Clock gpll0_dtest
    gosub Find_Print_Clock gpll0_lock_det
    gosub Find_Print_Clock gpll1_dtest
    gosub Find_Print_Clock gpll1_lock_det
    gosub Find_Print_Clock gpll2_dtest
    gosub Find_Print_Clock gpll2_lock_det
    gosub Find_Print_Clock gpll3_dtest
    gosub Find_Print_Clock gpll3_lock_det
    gosub Find_Print_Clock gpll4_dtest
    gosub Find_Print_Clock gpll4_lock_det
    gosub Find_Print_Clock kpss_gcc_ringosc_clk
    gosub Find_Print_Clock mpm_gcc_temp_sensor_ringosc_clk
    gosub Find_Print_Clock usb2_phy_gcc_atest_ulpi_0_clk
    gosub Find_Print_Clock usb2_phy_gcc_atest_ulpi_1_clk
    gosub Find_Print_Clock usb2_phy_wrapper_gcc_usb30_utmi_clk
    gosub Find_Print_Clock usb3_phy_wrapper_gcc_usb3_pipe_clk
    gosub Find_Print_Clock usb_hspw_gcc_480_test_clk
    gosub Find_Print_Clock gcc_pcie_0_aux_clk
    gosub Find_Print_Clock gcc_pcie_0_cfg_ahb_clk
    gosub Find_Print_Clock gcc_pcie_0_mstr_axi_clk
    gosub Find_Print_Clock gcc_pcie_0_pipe_clk
    gosub Find_Print_Clock gcc_pcie_0_slv_axi_clk
    gosub Find_Print_Clock pcie_0_pipe_clk
    gosub Find_Print_Clock gcc_pcie_1_aux_clk
    gosub Find_Print_Clock gcc_pcie_1_cfg_ahb_clk
    gosub Find_Print_Clock gcc_pcie_1_mstr_axi_clk
    gosub Find_Print_Clock gcc_pcie_1_pipe_clk
    gosub Find_Print_Clock gcc_pcie_1_slv_axi_clk
    gosub Find_Print_Clock pcie_1_pipe_clk
    gosub Find_Print_Clock gcc_pdm2_clk
    gosub Find_Print_Clock gcc_pdm_ahb_clk
    gosub Find_Print_Clock gcc_pdm_xo4_clk
    gosub Find_Print_Clock gcc_pnoc_bus_timeout0_ahb_clk
    gosub Find_Print_Clock gcc_pnoc_bus_timeout1_ahb_clk
    gosub Find_Print_Clock gcc_pnoc_bus_timeout2_ahb_clk
    gosub Find_Print_Clock gcc_pnoc_bus_timeout3_ahb_clk
    gosub Find_Print_Clock gcc_pnoc_bus_timeout4_ahb_clk
    gosub Find_Print_Clock gcc_prng_ahb_clk
    gosub Find_Print_Clock gcc_periph_noc_ahb_clk
    gosub Find_Print_Clock gcc_periph_noc_at_clk
    gosub Find_Print_Clock gcc_periph_noc_cfg_ahb_clk
    gosub Find_Print_Clock gcc_periph_noc_usb_hsic_ahb_clk
    gosub Find_Print_Clock gcc_qdss_at_clk
    gosub Find_Print_Clock gcc_qdss_cfg_ahb_clk
    gosub Find_Print_Clock gcc_qdss_dap_ahb_clk
    gosub Find_Print_Clock gcc_qdss_dap_clk
    gosub Find_Print_Clock gcc_qdss_etr_usb_clk
    gosub Find_Print_Clock gcc_qdss_stm_clk
    gosub Find_Print_Clock gcc_qdss_traceclkin_clk
    gosub Find_Print_Clock gcc_qdss_tsctr_div16_clk
    gosub Find_Print_Clock gcc_qdss_tsctr_div2_clk
    gosub Find_Print_Clock gcc_qdss_tsctr_div3_clk
    gosub Find_Print_Clock gcc_qdss_tsctr_div4_clk
    gosub Find_Print_Clock gcc_qdss_tsctr_div8_clk
    gosub Find_Print_Clock gcc_qdss_rbcpr_xpu_ahb_clk
    gosub Find_Print_Clock gcc_rbcpr_ahb_clk
    gosub Find_Print_Clock gcc_rbcpr_clk
    gosub Find_Print_Clock gcc_rpm_bus_ahb_clk
    gosub Find_Print_Clock gcc_rpm_proc_fclk
    gosub Find_Print_Clock gcc_rpm_proc_hclk
    gosub Find_Print_Clock gcc_rpm_sleep_clk
    gosub Find_Print_Clock gcc_rpm_timer_clk
    gosub Find_Print_Clock gcc_sata_asic0_clk
    gosub Find_Print_Clock gcc_sata_axi_clk
    gosub Find_Print_Clock gcc_sata_cfg_ahb_clk
    gosub Find_Print_Clock gcc_sata_pmalive_clk
    gosub Find_Print_Clock gcc_sata_rx_clk
    gosub Find_Print_Clock gcc_sata_rx_oob_clk
    gosub Find_Print_Clock gcc_sdcc1_ahb_clk
    gosub Find_Print_Clock gcc_sdcc1_apps_clk
    gosub Find_Print_Clock gcc_sdcc1_cdccal_ff_clk
    gosub Find_Print_Clock gcc_sdcc1_cdccal_sleep_clk
    gosub Find_Print_Clock gcc_sdcc2_ahb_clk
    gosub Find_Print_Clock gcc_sdcc2_apps_clk
    gosub Find_Print_Clock gcc_sdcc2_inactivity_timers_clk
    gosub Find_Print_Clock gcc_sdcc3_ahb_clk
    gosub Find_Print_Clock gcc_sdcc3_apps_clk
    gosub Find_Print_Clock gcc_sdcc3_inactivity_timers_clk
    gosub Find_Print_Clock gcc_sdcc4_ahb_clk
    gosub Find_Print_Clock gcc_sdcc4_apps_clk
    gosub Find_Print_Clock gcc_sdcc4_inactivity_timers_clk
    gosub Find_Print_Clock gcc_snoc_bus_timeout0_ahb_clk
    gosub Find_Print_Clock gcc_snoc_bus_timeout2_ahb_clk
    gosub Find_Print_Clock gcc_snoc_bus_timeout3_ahb_clk
    gosub Find_Print_Clock gcc_spdm_bimc_cy_clk
    gosub Find_Print_Clock gcc_spdm_cfg_ahb_clk
    gosub Find_Print_Clock gcc_spdm_ff_clk
    gosub Find_Print_Clock gcc_spdm_mstr_ahb_clk
    gosub Find_Print_Clock gcc_spdm_pnoc_cy_clk
    gosub Find_Print_Clock gcc_spdm_rpm_cy_clk
    gosub Find_Print_Clock gcc_spdm_snoc_cy_clk
    gosub Find_Print_Clock gcc_spmi_ahb_clk
    gosub Find_Print_Clock gcc_spmi_cnoc_ahb_clk
    gosub Find_Print_Clock gcc_spmi_ser_clk
    gosub Find_Print_Clock gcc_spss_ahb_clk
    gosub Find_Print_Clock spss_gcc_dbg_clk
    gosub Find_Print_Clock gcc_sec_ctrl_acc_clk
    gosub Find_Print_Clock gcc_sec_ctrl_ahb_clk
    gosub Find_Print_Clock gcc_sec_ctrl_boot_rom_patch_clk
    gosub Find_Print_Clock gcc_sec_ctrl_clk
    gosub Find_Print_Clock gcc_sec_ctrl_sense_clk
    gosub Find_Print_Clock gcc_snoc_cnoc_ahb_clk
    gosub Find_Print_Clock gcc_snoc_pnoc_ahb_clk
    gosub Find_Print_Clock gcc_sys_noc_at_clk
    gosub Find_Print_Clock gcc_sys_noc_axi_clk
    gosub Find_Print_Clock gcc_sys_noc_kpss_ahb_clk
    gosub Find_Print_Clock gcc_sys_noc_qdss_stm_axi_clk
    gosub Find_Print_Clock gcc_sys_noc_ufs_axi_clk
    gosub Find_Print_Clock gcc_sys_noc_usb3_axi_clk
    gosub Find_Print_Clock gcc_sys_noc_usb3_sec_axi_clk
    gosub Find_Print_Clock gcc_tcsr_ahb_clk
    gosub Find_Print_Clock gcc_tlmm_ahb_clk
    gosub Find_Print_Clock gcc_tlmm_clk
    gosub Find_Print_Clock gcc_tsif_ahb_clk
    gosub Find_Print_Clock gcc_tsif_inactivity_timers_clk
    gosub Find_Print_Clock gcc_tsif_ref_clk
    gosub Find_Print_Clock gcc_ufs_ahb_clk
    gosub Find_Print_Clock gcc_ufs_axi_clk
    gosub Find_Print_Clock gcc_ufs_rx_cfg_clk
    gosub Find_Print_Clock gcc_ufs_rx_symbol_0_clk
    gosub Find_Print_Clock gcc_ufs_rx_symbol_1_clk
    gosub Find_Print_Clock gcc_ufs_tx_cfg_clk
    gosub Find_Print_Clock gcc_ufs_tx_symbol_0_clk
    gosub Find_Print_Clock gcc_ufs_tx_symbol_1_clk
    gosub Find_Print_Clock gcc_usb2a_phy_sleep_clk
    gosub Find_Print_Clock gcc_usb2b_phy_sleep_clk
    gosub Find_Print_Clock gcc_usb30_master_clk
    gosub Find_Print_Clock gcc_usb30_mock_utmi_clk
    gosub Find_Print_Clock gcc_usb30_sleep_clk
    gosub Find_Print_Clock usb2_phy_wrapper_cc_usb3_utmi_3_clk
    gosub Find_Print_Clock usb2_phy_wrapper_gcc_usb3_utmi_2_clk
    gosub Find_Print_Clock gcc_usb30_sec_master_clk
    gosub Find_Print_Clock gcc_usb30_sec_mock_utmi_clk
    gosub Find_Print_Clock gcc_usb30_sec_sleep_clk
    gosub Find_Print_Clock usb2_phy_wrapper_gcc_usb30_sec_utmi_clk
    gosub Find_Print_Clock usb3_phy_wrapper_gcc_usb3_sec_pipe_clk
    gosub Find_Print_Clock gcc_usb_hs_ahb_clk
    gosub Find_Print_Clock gcc_usb_hs_inactivity_timers_clk
    gosub Find_Print_Clock gcc_usb_hs_system_clk
    gosub Find_Print_Clock gcc_usb_hsic_ahb_clk
    gosub Find_Print_Clock gcc_usb_hsic_clk
    gosub Find_Print_Clock gcc_usb_hsic_io_cal_clk
    gosub Find_Print_Clock gcc_usb_hsic_io_cal_sleep_clk
    gosub Find_Print_Clock gcc_usb_hsic_mock_utmi_clk
    gosub Find_Print_Clock gcc_usb_hsic_system_clk
    gosub Find_Print_Clock gcc_periph_noc_mpu_cfg_ahb_clk
    gosub Find_Print_Clock gcc_periph_xpu_ahb_clk

    &choice_handled=1
    return
  )
  else if ("&choice"=="lpass_all")
  (
    gosub Find_Print_Clock atime_clk_src
    gosub Find_Print_Clock lpass_core_avsync_atime_clk
    gosub Find_Print_Clock ahb_spdmtm_clk
    gosub Find_Print_Clock ahbfabric_clk_src
    gosub Find_Print_Clock audio_core_aon_clk
    gosub Find_Print_Clock audio_core_avsync_csr_clk
    gosub Find_Print_Clock audio_core_bstc_clk
    gosub Find_Print_Clock audio_core_csr_clk
    gosub Find_Print_Clock audio_core_dml_clk
    gosub Find_Print_Clock audio_core_ixfabric_clk
    gosub Find_Print_Clock audio_core_ixfabric_spdmtm_csr_clk
    gosub Find_Print_Clock audio_core_lpaif_csr_clk
    gosub Find_Print_Clock audio_core_lpaif_dma_clk
    gosub Find_Print_Clock audio_core_lpm_clk
    gosub Find_Print_Clock audio_core_midi_lfabif_clk
    gosub Find_Print_Clock audio_core_resampler_lfabif_clk
    gosub Find_Print_Clock audio_core_security_clk
    gosub Find_Print_Clock audio_core_slimbus_lfabif_clk
    gosub Find_Print_Clock audio_core_sysnoc_mport_clk
    gosub Find_Print_Clock audio_core_timeout_clk
    gosub Find_Print_Clock audio_wrapper_aon_clk
    gosub Find_Print_Clock audio_wrapper_br_clk
    gosub Find_Print_Clock audio_wrapper_efabric_clk
    gosub Find_Print_Clock audio_wrapper_efabric_spdmtm_csr_clk
    gosub Find_Print_Clock audio_wrapper_lcc_csr_clk
    gosub Find_Print_Clock audio_wrapper_security_clk
    gosub Find_Print_Clock audio_wrapper_smem_clk
    gosub Find_Print_Clock audio_wrapper_sysnoc_sway_clk
    gosub Find_Print_Clock audio_wrapper_timeout_clk
    gosub Find_Print_Clock core_smmu_cfg_clk
    gosub Find_Print_Clock digcodec_ahb_clk
    gosub Find_Print_Clock hdmirx_ahb_clk
    gosub Find_Print_Clock q6_smmu_cfg_clk
    gosub Find_Print_Clock q6_tcm_slave_clk
    gosub Find_Print_Clock q6ss_ahb_lfabif_clk
    gosub Find_Print_Clock q6ss_ahbm_clk
    gosub Find_Print_Clock sif_ahb_clk
    gosub Find_Print_Clock spdiftx_ahbm_clk
    gosub Find_Print_Clock spdiftx_ahbs_clk
    gosub Find_Print_Clock audio_core_avsync_bt_xo_clk
    gosub Find_Print_Clock audio_core_avsync_fm_xo_clk
    gosub Find_Print_Clock audio_core_avsync_xo_clk
    gosub Find_Print_Clock audio_core_avtimer_xo_clk
    gosub Find_Print_Clock audio_core_gdsc_xo_clk
    gosub Find_Print_Clock audio_wrapper_stm_xo_clk
    gosub Find_Print_Clock q6ss_xo_clk
    gosub Find_Print_Clock xo_clk_src
    gosub Find_Print_Clock digcodec_clk
    gosub Find_Print_Clock lpass_gcc_dbg_clk
    gosub Find_Print_Clock audio_core_lpaif_pcm_data_oe_clk
    gosub Find_Print_Clock lpaif_pcmoe_clk_src
    gosub Find_Print_Clock audio_core_lpaif_pri_ebit_clk
    gosub Find_Print_Clock audio_core_lpaif_pri_ibit_clk
    gosub Find_Print_Clock audio_core_lpaif_pri_osr_clk
    gosub Find_Print_Clock lpaif_pri_clk_src
    gosub Find_Print_Clock audio_core_lpaif_pcm0_ebit_clk
    gosub Find_Print_Clock audio_core_lpaif_pcm0_ibit_clk
    gosub Find_Print_Clock lpaif_pcm0_clk_src
    gosub Find_Print_Clock q6core_clk_src
    gosub Find_Print_Clock audio_core_lpaif_quad_ebit_clk
    gosub Find_Print_Clock audio_core_lpaif_quad_ibit_clk
    gosub Find_Print_Clock audio_core_lpaif_quad_osr_clk
    gosub Find_Print_Clock lpaif_quad_clk_src
    gosub Find_Print_Clock audio_core_resampler_core_clk
    gosub Find_Print_Clock resampler_clk_src
    gosub Find_Print_Clock sif_clk
    gosub Find_Print_Clock audio_core_slimbus_core_clk
    gosub Find_Print_Clock audio_core_slimbus_core_clk
    gosub Find_Print_Clock slimbus_clk_src
    gosub Find_Print_Clock slimbus_clk_src
    gosub Find_Print_Clock spdiftx_bmc_clk
    gosub Find_Print_Clock spdiftx_bmc_clk_src
    gosub Find_Print_Clock q6_spdm_clk_src
    gosub Find_Print_Clock q6_spdmtm_clk
    gosub Find_Print_Clock audio_core_lpaif_sec_ebit_clk
    gosub Find_Print_Clock audio_core_lpaif_sec_ibit_clk
    gosub Find_Print_Clock audio_core_lpaif_sec_osr_clk
    gosub Find_Print_Clock lpaif_sec_clk_src
    gosub Find_Print_Clock audio_core_lpaif_pcm1_ebit_clk
    gosub Find_Print_Clock audio_core_lpaif_pcm1_ibit_clk
    gosub Find_Print_Clock lpaif_pcm1_clk_src
    gosub Find_Print_Clock audio_core_bcr_slp_clk
    gosub Find_Print_Clock q6ss_bcr_slp_clk
    gosub Find_Print_Clock q6ss_slp_clk
    gosub Find_Print_Clock sleep_clk_src
    gosub Find_Print_Clock audio_core_lpaif_codec_spkr_ebit_clk
    gosub Find_Print_Clock audio_core_lpaif_codec_spkr_ibit_clk
    gosub Find_Print_Clock audio_core_lpaif_codec_spkr_osr_clk
    gosub Find_Print_Clock lpaif_spkr_clk_src
    gosub Find_Print_Clock audio_core_lpaif_ter_ebit_clk
    gosub Find_Print_Clock audio_core_lpaif_ter_ibit_clk
    gosub Find_Print_Clock audio_core_lpaif_ter_osr_clk
    gosub Find_Print_Clock lpaif_ter_clk_src

    &choice_handled=1
    return
  )
  else if ("&choice"=="mmss_all")
  (
    gosub Find_Print_Clock avsync_ahb_clk
    gosub Find_Print_Clock avsync_edppixel_clk
    gosub Find_Print_Clock avsync_extpclk_clk
    gosub Find_Print_Clock avsync_pclk0_clk
    gosub Find_Print_Clock avsync_pclk1_clk
    gosub Find_Print_Clock avsync_vp_clk
    gosub Find_Print_Clock camss_ahb_clk
    gosub Find_Print_Clock camss_cci_cci_ahb_clk
    gosub Find_Print_Clock camss_cci_cci_clk
    gosub Find_Print_Clock camss_csi0_ahb_clk
    gosub Find_Print_Clock camss_csi0_clk
    gosub Find_Print_Clock camss_csi0phy_clk
    gosub Find_Print_Clock camss_csi0pix_clk
    gosub Find_Print_Clock camss_csi0rdi_clk
    gosub Find_Print_Clock camss_csi1_ahb_clk
    gosub Find_Print_Clock camss_csi1_clk
    gosub Find_Print_Clock camss_csi1phy_clk
    gosub Find_Print_Clock camss_csi1pix_clk
    gosub Find_Print_Clock camss_csi1rdi_clk
    gosub Find_Print_Clock camss_csi2_ahb_clk
    gosub Find_Print_Clock camss_csi2_clk
    gosub Find_Print_Clock camss_csi2phy_clk
    gosub Find_Print_Clock camss_csi2pix_clk
    gosub Find_Print_Clock camss_csi2rdi_clk
    gosub Find_Print_Clock camss_csi3_ahb_clk
    gosub Find_Print_Clock camss_csi3_clk
    gosub Find_Print_Clock camss_csi3phy_clk
    gosub Find_Print_Clock camss_csi3pix_clk
    gosub Find_Print_Clock camss_csi3rdi_clk
    gosub Find_Print_Clock camss_csi_vfe0_clk
    gosub Find_Print_Clock camss_csi_vfe1_clk
    gosub Find_Print_Clock camss_gp0_clk
    gosub Find_Print_Clock camss_gp1_clk
    gosub Find_Print_Clock camss_ispif_ahb_clk
    gosub Find_Print_Clock camss_jpeg_jpeg0_clk
    gosub Find_Print_Clock camss_jpeg_jpeg1_clk
    gosub Find_Print_Clock camss_jpeg_jpeg2_clk
    gosub Find_Print_Clock camss_jpeg_jpeg_ahb_clk
    gosub Find_Print_Clock camss_jpeg_jpeg_axi_clk
    gosub Find_Print_Clock camss_mclk0_clk
    gosub Find_Print_Clock camss_mclk1_clk
    gosub Find_Print_Clock camss_mclk2_clk
    gosub Find_Print_Clock camss_mclk3_clk
    gosub Find_Print_Clock camss_micro_ahb_clk
    gosub Find_Print_Clock camss_phy0_csi0phytimer_clk
    gosub Find_Print_Clock camss_phy1_csi1phytimer_clk
    gosub Find_Print_Clock camss_phy2_csi2phytimer_clk
    gosub Find_Print_Clock camss_top_ahb_clk
    gosub Find_Print_Clock camss_vfe_cpp_ahb_clk
    gosub Find_Print_Clock camss_vfe_cpp_clk
    gosub Find_Print_Clock camss_vfe_vfe0_clk
    gosub Find_Print_Clock camss_vfe_vfe1_clk
    gosub Find_Print_Clock camss_vfe_vfe_ahb_clk
    gosub Find_Print_Clock camss_vfe_vfe_axi_clk
    gosub Find_Print_Clock mdss_ahb_clk
    gosub Find_Print_Clock mdss_axi_clk
    gosub Find_Print_Clock mdss_byte0_clk
    gosub Find_Print_Clock mdss_byte1_clk
    gosub Find_Print_Clock mdss_edpaux_clk
    gosub Find_Print_Clock mdss_edplink_clk
    gosub Find_Print_Clock mdss_edppixel_clk
    gosub Find_Print_Clock mdss_esc0_clk
    gosub Find_Print_Clock mdss_esc1_clk
    gosub Find_Print_Clock mdss_extpclk_clk
    gosub Find_Print_Clock mdss_hdmi_ahb_clk
    gosub Find_Print_Clock mdss_hdmi_clk
    gosub Find_Print_Clock mdss_mdp_clk
    gosub Find_Print_Clock mdss_mdp_lut_clk
    gosub Find_Print_Clock mdss_pclk0_clk
    gosub Find_Print_Clock mdss_pclk1_clk
    gosub Find_Print_Clock mdss_vsync_clk
    gosub Find_Print_Clock mmss_cxo_clk
    gosub Find_Print_Clock mmss_sleepclk_clk
    gosub Find_Print_Clock mmss_misc_ahb_clk
    gosub Find_Print_Clock mmss_mmssnoc_ahb_clk
    gosub Find_Print_Clock mmss_mmssnoc_bto_ahb_clk
    gosub Find_Print_Clock mmss_mmssnoc_axi_clk
    gosub Find_Print_Clock mmss_s0_axi_clk
    gosub Find_Print_Clock mmss_rbcpr_ahb_clk
    gosub Find_Print_Clock mmss_rbcpr_clk
    gosub Find_Print_Clock mmss_spdm_ahb_clk
    gosub Find_Print_Clock mmss_spdm_axi_clk
    gosub Find_Print_Clock mmss_spdm_csi0_clk
    gosub Find_Print_Clock mmss_spdm_gfx3d_clk
    gosub Find_Print_Clock mmss_spdm_jpeg0_clk
    gosub Find_Print_Clock mmss_spdm_jpeg1_clk
    gosub Find_Print_Clock mmss_spdm_jpeg2_clk
    gosub Find_Print_Clock mmss_spdm_mdp_clk
    gosub Find_Print_Clock mmss_spdm_pclk0_clk
    gosub Find_Print_Clock mmss_spdm_pclk1_clk
    gosub Find_Print_Clock mmss_spdm_vcodec0_clk
    gosub Find_Print_Clock mmss_spdm_vfe0_clk
    gosub Find_Print_Clock mmss_spdm_vfe1_clk
    gosub Find_Print_Clock mmss_spdm_rm_axi_clk
    gosub Find_Print_Clock mmss_spdm_rm_ocmemnoc_clk
    gosub Find_Print_Clock gcc_ocmem_sys_noc_axi_clk
    gosub Find_Print_Clock ocmemcx_ahb_clk
    gosub Find_Print_Clock ocmemcx_ocmemnoc_clk
    gosub Find_Print_Clock oxili_ocmemgx_clk
    gosub Find_Print_Clock gfx3d_clk_src
    gosub Find_Print_Clock oxili_gfx3d_clk
    gosub Find_Print_Clock oxili_rbbmtimer_clk
    gosub Find_Print_Clock oxilicx_ahb_clk
    gosub Find_Print_Clock mmpll0_dtest
    gosub Find_Print_Clock mmpll0_dtest
    gosub Find_Print_Clock mmpll0_lock_det
    gosub Find_Print_Clock mmpll0_lock_det
    gosub Find_Print_Clock mmpll1_dtest
    gosub Find_Print_Clock mmpll1_dtest
    gosub Find_Print_Clock mmpll1_lock_det
    gosub Find_Print_Clock mmpll1_lock_det
    gosub Find_Print_Clock mmpll2_dtest
    gosub Find_Print_Clock mmpll2_dtest
    gosub Find_Print_Clock mmpll2_lock_det
    gosub Find_Print_Clock mmpll2_lock_det
    gosub Find_Print_Clock mmpll3_dtest
    gosub Find_Print_Clock mmpll3_dtest
    gosub Find_Print_Clock mmpll3_lock_det
    gosub Find_Print_Clock mmpll3_lock_det
    gosub Find_Print_Clock mmpll4_dtest
    gosub Find_Print_Clock mmpll4_dtest
    gosub Find_Print_Clock mmpll4_lock_det
    gosub Find_Print_Clock mmpll4_lock_det
    gosub Find_Print_Clock venus0_ahb_clk
    gosub Find_Print_Clock venus0_axi_clk
    gosub Find_Print_Clock venus0_core0_vcodec_clk
    gosub Find_Print_Clock venus0_core1_vcodec_clk
    gosub Find_Print_Clock venus0_ocmemnoc_clk
    gosub Find_Print_Clock venus0_vcodec0_clk
    gosub Find_Print_Clock vpu_ahb_clk
    gosub Find_Print_Clock vpu_axi_clk
    gosub Find_Print_Clock vpu_bus_clk
    gosub Find_Print_Clock vpu_cxo_clk
    gosub Find_Print_Clock vpu_maple_clk
    gosub Find_Print_Clock vpu_sleep_clk
    gosub Find_Print_Clock vpu_vdp_clk

    &choice_handled=1
    return
  )
  else if ("&choice"=="apcs_all")
  (
    gosub Find_Print_Clock apcs_c0_clk
    gosub Find_Print_Clock apcs_c1_clk
    gosub Find_Print_Clock apcs_c2_clk
    gosub Find_Print_Clock apcs_c3_clk
    gosub Find_Print_Clock apcs_l2_clk
    gosub Find_Print_Clock apcs_spisleep_clk
    gosub Find_Print_Clock apcs_sysahb_clk
    gosub Find_Print_Clock apcs_sysqsb_clk
    gosub Find_Print_Clock apcs_sysref_clk

    &choice_handled=1
    return
  )

  return
  

  
Find_Print_Clock:

ENTRY &clk

&clk_test=0
&clk_reg=0
&clk_reg_name=""


; Setting appropriate access mode for non-MSS clocks
&clk_access_mod="eahb:"

  &match=0
  &wild_head=0
  &wild_tail=0
  &clk_input_length=STRING.LENGTH("&clk")
  &clk_itr_length=STRING.LENGTH("gcc_bam_dma_ahb_clk")

  if (STRING.SCAN("&clk", "*", 0)==0)
  (
    &wild_head=1
  )
  if (STRING.SCAN("&clk", "*", 1)==(STRING.LENGTH("&clk")-1))
  (
    &wild_tail=1
  )

  if ((&wild_head==1)&&(&wild_tail==1))
  (
    if (STRING.SCAN("gcc_bam_dma_ahb_clk", STRING.MID("&clk", 1, &clk_input_length-2), 0)!=-1)
    ( 
      &match=1
    )
  )
  else if (&wild_head==1)
  (
    if (STRING.MID("gcc_bam_dma_ahb_clk", &clk_itr_length-&clk_input_length+1, &clk_input_length-1)==STRING.CUT("&clk", 1))
    ( 
      &match=1
    )
  )
  else if (&wild_tail==1)
  (
    if (STRING.MID("gcc_bam_dma_ahb_clk", 0, &clk_input_length-1)==STRING.CUT("&clk", -1))
    ( 
      &match=1
    )
  )	  
  else if ("gcc_bam_dma_ahb_clk"=="&clk")
  (
    &match=1
  )
  
  if (&match==1)
  (
    &clk_test=&CLK_TEST_GCC_BAM_DMA_AHB_CLK
    &clk_reg=&HWIO_GCC_BAM_DMA_AHB_CBCR_ADDR
    &clk_reg_name="GCC_BAM_DMA_AHB_CBCR"
    &clk_name="gcc_bam_dma_ahb_clk"
    &clk_reg_cbcr_type="sm_pscbc"

    gosub Print_Clk_Info_Line
  )
  
  &match=0
  &wild_head=0
  &wild_tail=0
  &clk_input_length=STRING.LENGTH("&clk")
  &clk_itr_length=STRING.LENGTH("gcc_bam_dma_inactivity_timers_clk")

  if (STRING.SCAN("&clk", "*", 0)==0)
  (
    &wild_head=1
  )
  if (STRING.SCAN("&clk", "*", 1)==(STRING.LENGTH("&clk")-1))
  (
    &wild_tail=1
  )

  if ((&wild_head==1)&&(&wild_tail==1))
  (
    if (STRING.SCAN("gcc_bam_dma_inactivity_timers_clk", STRING.MID("&clk", 1, &clk_input_length-2), 0)!=-1)
    ( 
      &match=1
    )
  )
  else if (&wild_head==1)
  (
    if (STRING.MID("gcc_bam_dma_inactivity_timers_clk", &clk_itr_length-&clk_input_length+1, &clk_input_length-1)==STRING.CUT("&clk", 1))
    ( 
      &match=1
    )
  )
  else if (&wild_tail==1)
  (
    if (STRING.MID("gcc_bam_dma_inactivity_timers_clk", 0, &clk_input_length-1)==STRING.CUT("&clk", -1))
    ( 
      &match=1
    )
  )	  
  else if ("gcc_bam_dma_inactivity_timers_clk"=="&clk")
  (
    &match=1
  )
  
  if (&match==1)
  (
    &clk_test=&CLK_TEST_GCC_BAM_DMA_INACTIVITY_TIMERS_CLK
    &clk_reg=&HWIO_GCC_BAM_DMA_INACTIVITY_TIMERS_CBCR_ADDR
    &clk_reg_name="GCC_BAM_DMA_INACTIVITY_TIMERS_CBCR"
    &clk_name="gcc_bam_dma_inactivity_timers_clk"
    &clk_reg_cbcr_type="sm_cbc"

    gosub Print_Clk_Info_Line
  )
  
  &match=0
  &wild_head=0
  &wild_tail=0
  &clk_input_length=STRING.LENGTH("&clk")
  &clk_itr_length=STRING.LENGTH("gcc_bimc_cfg_ahb_clk")

  if (STRING.SCAN("&clk", "*", 0)==0)
  (
    &wild_head=1
  )
  if (STRING.SCAN("&clk", "*", 1)==(STRING.LENGTH("&clk")-1))
  (
    &wild_tail=1
  )

  if ((&wild_head==1)&&(&wild_tail==1))
  (
    if (STRING.SCAN("gcc_bimc_cfg_ahb_clk", STRING.MID("&clk", 1, &clk_input_length-2), 0)!=-1)
    ( 
      &match=1
    )
  )
  else if (&wild_head==1)
  (
    if (STRING.MID("gcc_bimc_cfg_ahb_clk", &clk_itr_length-&clk_input_length+1, &clk_input_length-1)==STRING.CUT("&clk", 1))
    ( 
      &match=1
    )
  )
  else if (&wild_tail==1)
  (
    if (STRING.MID("gcc_bimc_cfg_ahb_clk", 0, &clk_input_length-1)==STRING.CUT("&clk", -1))
    ( 
      &match=1
    )
  )	  
  else if ("gcc_bimc_cfg_ahb_clk"=="&clk")
  (
    &match=1
  )
  
  if (&match==1)
  (
    &clk_test=&CLK_TEST_GCC_BIMC_CFG_AHB_CLK
    &clk_reg=&HWIO_GCC_BIMC_CFG_AHB_CBCR_ADDR
    &clk_reg_name="GCC_BIMC_CFG_AHB_CBCR"
    &clk_name="gcc_bimc_cfg_ahb_clk"
    &clk_reg_cbcr_type="sm_cbc"

    gosub Print_Clk_Info_Line
  )
  
  &match=0
  &wild_head=0
  &wild_tail=0
  &clk_input_length=STRING.LENGTH("&clk")
  &clk_itr_length=STRING.LENGTH("gcc_bimc_clk")

  if (STRING.SCAN("&clk", "*", 0)==0)
  (
    &wild_head=1
  )
  if (STRING.SCAN("&clk", "*", 1)==(STRING.LENGTH("&clk")-1))
  (
    &wild_tail=1
  )

  if ((&wild_head==1)&&(&wild_tail==1))
  (
    if (STRING.SCAN("gcc_bimc_clk", STRING.MID("&clk", 1, &clk_input_length-2), 0)!=-1)
    ( 
      &match=1
    )
  )
  else if (&wild_head==1)
  (
    if (STRING.MID("gcc_bimc_clk", &clk_itr_length-&clk_input_length+1, &clk_input_length-1)==STRING.CUT("&clk", 1))
    ( 
      &match=1
    )
  )
  else if (&wild_tail==1)
  (
    if (STRING.MID("gcc_bimc_clk", 0, &clk_input_length-1)==STRING.CUT("&clk", -1))
    ( 
      &match=1
    )
  )	  
  else if ("gcc_bimc_clk"=="&clk")
  (
    &match=1
  )
  
  ; This clock belongs to the 'buses' display group.
  if ("buses"=="&clk")
  (
    &match=1	  
  )
  
  if (&match==1)
  (
    &clk_test=&CLK_TEST_GCC_BIMC_CLK
    &clk_reg=&HWIO_GCC_BIMC_CBCR_ADDR
    &clk_reg_name="GCC_BIMC_CBCR"
    &clk_name="gcc_bimc_clk"
    &clk_reg_cbcr_type="sm_cbc"

    gosub Print_Clk_Info_Line
  )
  
  &match=0
  &wild_head=0
  &wild_tail=0
  &clk_input_length=STRING.LENGTH("&clk")
  &clk_itr_length=STRING.LENGTH("gcc_bimc_kpss_axi_clk")

  if (STRING.SCAN("&clk", "*", 0)==0)
  (
    &wild_head=1
  )
  if (STRING.SCAN("&clk", "*", 1)==(STRING.LENGTH("&clk")-1))
  (
    &wild_tail=1
  )

  if ((&wild_head==1)&&(&wild_tail==1))
  (
    if (STRING.SCAN("gcc_bimc_kpss_axi_clk", STRING.MID("&clk", 1, &clk_input_length-2), 0)!=-1)
    ( 
      &match=1
    )
  )
  else if (&wild_head==1)
  (
    if (STRING.MID("gcc_bimc_kpss_axi_clk", &clk_itr_length-&clk_input_length+1, &clk_input_length-1)==STRING.CUT("&clk", 1))
    ( 
      &match=1
    )
  )
  else if (&wild_tail==1)
  (
    if (STRING.MID("gcc_bimc_kpss_axi_clk", 0, &clk_input_length-1)==STRING.CUT("&clk", -1))
    ( 
      &match=1
    )
  )	  
  else if ("gcc_bimc_kpss_axi_clk"=="&clk")
  (
    &match=1
  )
  
  if (&match==1)
  (
    &clk_test=&CLK_TEST_GCC_BIMC_KPSS_AXI_CLK
    &clk_reg=&HWIO_GCC_BIMC_KPSS_AXI_CBCR_ADDR
    &clk_reg_name="GCC_BIMC_KPSS_AXI_CBCR"
    &clk_name="gcc_bimc_kpss_axi_clk"
    &clk_reg_cbcr_type="sm_cbc"

    gosub Print_Clk_Info_Line
  )
  
  &match=0
  &wild_head=0
  &wild_tail=0
  &clk_input_length=STRING.LENGTH("&clk")
  &clk_itr_length=STRING.LENGTH("gcc_bimc_sleep_clk")

  if (STRING.SCAN("&clk", "*", 0)==0)
  (
    &wild_head=1
  )
  if (STRING.SCAN("&clk", "*", 1)==(STRING.LENGTH("&clk")-1))
  (
    &wild_tail=1
  )

  if ((&wild_head==1)&&(&wild_tail==1))
  (
    if (STRING.SCAN("gcc_bimc_sleep_clk", STRING.MID("&clk", 1, &clk_input_length-2), 0)!=-1)
    ( 
      &match=1
    )
  )
  else if (&wild_head==1)
  (
    if (STRING.MID("gcc_bimc_sleep_clk", &clk_itr_length-&clk_input_length+1, &clk_input_length-1)==STRING.CUT("&clk", 1))
    ( 
      &match=1
    )
  )
  else if (&wild_tail==1)
  (
    if (STRING.MID("gcc_bimc_sleep_clk", 0, &clk_input_length-1)==STRING.CUT("&clk", -1))
    ( 
      &match=1
    )
  )	  
  else if ("gcc_bimc_sleep_clk"=="&clk")
  (
    &match=1
  )
  
  if (&match==1)
  (
    &clk_test=&CLK_TEST_GCC_BIMC_SLEEP_CLK
    &clk_reg=&HWIO_GCC_BIMC_SLEEP_CBCR_ADDR
    &clk_reg_name="GCC_BIMC_SLEEP_CBCR"
    &clk_name="gcc_bimc_sleep_clk"
    &clk_reg_cbcr_type="sm_cbc"

    gosub Print_Clk_Info_Line
  )
  
  &match=0
  &wild_head=0
  &wild_tail=0
  &clk_input_length=STRING.LENGTH("&clk")
  &clk_itr_length=STRING.LENGTH("gcc_bimc_sysnoc_axi_clk")

  if (STRING.SCAN("&clk", "*", 0)==0)
  (
    &wild_head=1
  )
  if (STRING.SCAN("&clk", "*", 1)==(STRING.LENGTH("&clk")-1))
  (
    &wild_tail=1
  )

  if ((&wild_head==1)&&(&wild_tail==1))
  (
    if (STRING.SCAN("gcc_bimc_sysnoc_axi_clk", STRING.MID("&clk", 1, &clk_input_length-2), 0)!=-1)
    ( 
      &match=1
    )
  )
  else if (&wild_head==1)
  (
    if (STRING.MID("gcc_bimc_sysnoc_axi_clk", &clk_itr_length-&clk_input_length+1, &clk_input_length-1)==STRING.CUT("&clk", 1))
    ( 
      &match=1
    )
  )
  else if (&wild_tail==1)
  (
    if (STRING.MID("gcc_bimc_sysnoc_axi_clk", 0, &clk_input_length-1)==STRING.CUT("&clk", -1))
    ( 
      &match=1
    )
  )	  
  else if ("gcc_bimc_sysnoc_axi_clk"=="&clk")
  (
    &match=1
  )
  
  if (&match==1)
  (
    &clk_test=&CLK_TEST_GCC_BIMC_SYSNOC_AXI_CLK
    &clk_reg=&HWIO_GCC_BIMC_SYSNOC_AXI_CBCR_ADDR
    &clk_reg_name="GCC_BIMC_SYSNOC_AXI_CBCR"
    &clk_name="gcc_bimc_sysnoc_axi_clk"
    &clk_reg_cbcr_type="sm_cbc"

    gosub Print_Clk_Info_Line
  )
  
  &match=0
  &wild_head=0
  &wild_tail=0
  &clk_input_length=STRING.LENGTH("&clk")
  &clk_itr_length=STRING.LENGTH("gcc_bimc_xo_clk")

  if (STRING.SCAN("&clk", "*", 0)==0)
  (
    &wild_head=1
  )
  if (STRING.SCAN("&clk", "*", 1)==(STRING.LENGTH("&clk")-1))
  (
    &wild_tail=1
  )

  if ((&wild_head==1)&&(&wild_tail==1))
  (
    if (STRING.SCAN("gcc_bimc_xo_clk", STRING.MID("&clk", 1, &clk_input_length-2), 0)!=-1)
    ( 
      &match=1
    )
  )
  else if (&wild_head==1)
  (
    if (STRING.MID("gcc_bimc_xo_clk", &clk_itr_length-&clk_input_length+1, &clk_input_length-1)==STRING.CUT("&clk", 1))
    ( 
      &match=1
    )
  )
  else if (&wild_tail==1)
  (
    if (STRING.MID("gcc_bimc_xo_clk", 0, &clk_input_length-1)==STRING.CUT("&clk", -1))
    ( 
      &match=1
    )
  )	  
  else if ("gcc_bimc_xo_clk"=="&clk")
  (
    &match=1
  )
  
  if (&match==1)
  (
    &clk_test=&CLK_TEST_GCC_BIMC_XO_CLK
    &clk_reg=&HWIO_GCC_BIMC_XO_CBCR_ADDR
    &clk_reg_name="GCC_BIMC_XO_CBCR"
    &clk_name="gcc_bimc_xo_clk"
    &clk_reg_cbcr_type="sm_cbc"

    gosub Print_Clk_Info_Line
  )
  
  &match=0
  &wild_head=0
  &wild_tail=0
  &clk_input_length=STRING.LENGTH("&clk")
  &clk_itr_length=STRING.LENGTH("gcc_blsp1_ahb_clk")

  if (STRING.SCAN("&clk", "*", 0)==0)
  (
    &wild_head=1
  )
  if (STRING.SCAN("&clk", "*", 1)==(STRING.LENGTH("&clk")-1))
  (
    &wild_tail=1
  )

  if ((&wild_head==1)&&(&wild_tail==1))
  (
    if (STRING.SCAN("gcc_blsp1_ahb_clk", STRING.MID("&clk", 1, &clk_input_length-2), 0)!=-1)
    ( 
      &match=1
    )
  )
  else if (&wild_head==1)
  (
    if (STRING.MID("gcc_blsp1_ahb_clk", &clk_itr_length-&clk_input_length+1, &clk_input_length-1)==STRING.CUT("&clk", 1))
    ( 
      &match=1
    )
  )
  else if (&wild_tail==1)
  (
    if (STRING.MID("gcc_blsp1_ahb_clk", 0, &clk_input_length-1)==STRING.CUT("&clk", -1))
    ( 
      &match=1
    )
  )	  
  else if ("gcc_blsp1_ahb_clk"=="&clk")
  (
    &match=1
  )
  
  if (&match==1)
  (
    &clk_test=&CLK_TEST_GCC_BLSP1_AHB_CLK
    &clk_reg=&HWIO_GCC_BLSP1_AHB_CBCR_ADDR
    &clk_reg_name="GCC_BLSP1_AHB_CBCR"
    &clk_name="gcc_blsp1_ahb_clk"
    &clk_reg_cbcr_type="sm_pscbc"

    gosub Print_Clk_Info_Line
  )
  
  &match=0
  &wild_head=0
  &wild_tail=0
  &clk_input_length=STRING.LENGTH("&clk")
  &clk_itr_length=STRING.LENGTH("gcc_blsp1_sleep_clk")

  if (STRING.SCAN("&clk", "*", 0)==0)
  (
    &wild_head=1
  )
  if (STRING.SCAN("&clk", "*", 1)==(STRING.LENGTH("&clk")-1))
  (
    &wild_tail=1
  )

  if ((&wild_head==1)&&(&wild_tail==1))
  (
    if (STRING.SCAN("gcc_blsp1_sleep_clk", STRING.MID("&clk", 1, &clk_input_length-2), 0)!=-1)
    ( 
      &match=1
    )
  )
  else if (&wild_head==1)
  (
    if (STRING.MID("gcc_blsp1_sleep_clk", &clk_itr_length-&clk_input_length+1, &clk_input_length-1)==STRING.CUT("&clk", 1))
    ( 
      &match=1
    )
  )
  else if (&wild_tail==1)
  (
    if (STRING.MID("gcc_blsp1_sleep_clk", 0, &clk_input_length-1)==STRING.CUT("&clk", -1))
    ( 
      &match=1
    )
  )	  
  else if ("gcc_blsp1_sleep_clk"=="&clk")
  (
    &match=1
  )
  
  if (&match==1)
  (
    &clk_test=&CLK_TEST_GCC_BLSP1_SLEEP_CLK
    &clk_reg=&HWIO_GCC_BLSP1_SLEEP_CBCR_ADDR
    &clk_reg_name="GCC_BLSP1_SLEEP_CBCR"
    &clk_name="gcc_blsp1_sleep_clk"
    &clk_reg_cbcr_type="sm_cbc"

    gosub Print_Clk_Info_Line
  )
  
  &match=0
  &wild_head=0
  &wild_tail=0
  &clk_input_length=STRING.LENGTH("&clk")
  &clk_itr_length=STRING.LENGTH("gcc_blsp1_qup1_i2c_apps_clk")

  if (STRING.SCAN("&clk", "*", 0)==0)
  (
    &wild_head=1
  )
  if (STRING.SCAN("&clk", "*", 1)==(STRING.LENGTH("&clk")-1))
  (
    &wild_tail=1
  )

  if ((&wild_head==1)&&(&wild_tail==1))
  (
    if (STRING.SCAN("gcc_blsp1_qup1_i2c_apps_clk", STRING.MID("&clk", 1, &clk_input_length-2), 0)!=-1)
    ( 
      &match=1
    )
  )
  else if (&wild_head==1)
  (
    if (STRING.MID("gcc_blsp1_qup1_i2c_apps_clk", &clk_itr_length-&clk_input_length+1, &clk_input_length-1)==STRING.CUT("&clk", 1))
    ( 
      &match=1
    )
  )
  else if (&wild_tail==1)
  (
    if (STRING.MID("gcc_blsp1_qup1_i2c_apps_clk", 0, &clk_input_length-1)==STRING.CUT("&clk", -1))
    ( 
      &match=1
    )
  )	  
  else if ("gcc_blsp1_qup1_i2c_apps_clk"=="&clk")
  (
    &match=1
  )
  
  if (&match==1)
  (
    &clk_test=&CLK_TEST_GCC_BLSP1_QUP1_I2C_APPS_CLK
    &clk_reg=&HWIO_GCC_BLSP1_QUP1_I2C_APPS_CBCR_ADDR
    &clk_reg_name="GCC_BLSP1_QUP1_I2C_APPS_CBCR"
    &clk_name="gcc_blsp1_qup1_i2c_apps_clk"
    &clk_reg_cbcr_type="sm_cbc"

    gosub Print_Clk_Info_Line
  )
  
  &match=0
  &wild_head=0
  &wild_tail=0
  &clk_input_length=STRING.LENGTH("&clk")
  &clk_itr_length=STRING.LENGTH("gcc_blsp1_qup1_spi_apps_clk")

  if (STRING.SCAN("&clk", "*", 0)==0)
  (
    &wild_head=1
  )
  if (STRING.SCAN("&clk", "*", 1)==(STRING.LENGTH("&clk")-1))
  (
    &wild_tail=1
  )

  if ((&wild_head==1)&&(&wild_tail==1))
  (
    if (STRING.SCAN("gcc_blsp1_qup1_spi_apps_clk", STRING.MID("&clk", 1, &clk_input_length-2), 0)!=-1)
    ( 
      &match=1
    )
  )
  else if (&wild_head==1)
  (
    if (STRING.MID("gcc_blsp1_qup1_spi_apps_clk", &clk_itr_length-&clk_input_length+1, &clk_input_length-1)==STRING.CUT("&clk", 1))
    ( 
      &match=1
    )
  )
  else if (&wild_tail==1)
  (
    if (STRING.MID("gcc_blsp1_qup1_spi_apps_clk", 0, &clk_input_length-1)==STRING.CUT("&clk", -1))
    ( 
      &match=1
    )
  )	  
  else if ("gcc_blsp1_qup1_spi_apps_clk"=="&clk")
  (
    &match=1
  )
  
  if (&match==1)
  (
    &clk_test=&CLK_TEST_GCC_BLSP1_QUP1_SPI_APPS_CLK
    &clk_reg=&HWIO_GCC_BLSP1_QUP1_SPI_APPS_CBCR_ADDR
    &clk_reg_name="GCC_BLSP1_QUP1_SPI_APPS_CBCR"
    &clk_name="gcc_blsp1_qup1_spi_apps_clk"
    &clk_reg_cbcr_type="sm_cbc"

    gosub Print_Clk_Info_Line
  )
  
  &match=0
  &wild_head=0
  &wild_tail=0
  &clk_input_length=STRING.LENGTH("&clk")
  &clk_itr_length=STRING.LENGTH("gcc_blsp1_qup2_i2c_apps_clk")

  if (STRING.SCAN("&clk", "*", 0)==0)
  (
    &wild_head=1
  )
  if (STRING.SCAN("&clk", "*", 1)==(STRING.LENGTH("&clk")-1))
  (
    &wild_tail=1
  )

  if ((&wild_head==1)&&(&wild_tail==1))
  (
    if (STRING.SCAN("gcc_blsp1_qup2_i2c_apps_clk", STRING.MID("&clk", 1, &clk_input_length-2), 0)!=-1)
    ( 
      &match=1
    )
  )
  else if (&wild_head==1)
  (
    if (STRING.MID("gcc_blsp1_qup2_i2c_apps_clk", &clk_itr_length-&clk_input_length+1, &clk_input_length-1)==STRING.CUT("&clk", 1))
    ( 
      &match=1
    )
  )
  else if (&wild_tail==1)
  (
    if (STRING.MID("gcc_blsp1_qup2_i2c_apps_clk", 0, &clk_input_length-1)==STRING.CUT("&clk", -1))
    ( 
      &match=1
    )
  )	  
  else if ("gcc_blsp1_qup2_i2c_apps_clk"=="&clk")
  (
    &match=1
  )
  
  if (&match==1)
  (
    &clk_test=&CLK_TEST_GCC_BLSP1_QUP2_I2C_APPS_CLK
    &clk_reg=&HWIO_GCC_BLSP1_QUP2_I2C_APPS_CBCR_ADDR
    &clk_reg_name="GCC_BLSP1_QUP2_I2C_APPS_CBCR"
    &clk_name="gcc_blsp1_qup2_i2c_apps_clk"
    &clk_reg_cbcr_type="sm_cbc"

    gosub Print_Clk_Info_Line
  )
  
  &match=0
  &wild_head=0
  &wild_tail=0
  &clk_input_length=STRING.LENGTH("&clk")
  &clk_itr_length=STRING.LENGTH("gcc_blsp1_qup2_spi_apps_clk")

  if (STRING.SCAN("&clk", "*", 0)==0)
  (
    &wild_head=1
  )
  if (STRING.SCAN("&clk", "*", 1)==(STRING.LENGTH("&clk")-1))
  (
    &wild_tail=1
  )

  if ((&wild_head==1)&&(&wild_tail==1))
  (
    if (STRING.SCAN("gcc_blsp1_qup2_spi_apps_clk", STRING.MID("&clk", 1, &clk_input_length-2), 0)!=-1)
    ( 
      &match=1
    )
  )
  else if (&wild_head==1)
  (
    if (STRING.MID("gcc_blsp1_qup2_spi_apps_clk", &clk_itr_length-&clk_input_length+1, &clk_input_length-1)==STRING.CUT("&clk", 1))
    ( 
      &match=1
    )
  )
  else if (&wild_tail==1)
  (
    if (STRING.MID("gcc_blsp1_qup2_spi_apps_clk", 0, &clk_input_length-1)==STRING.CUT("&clk", -1))
    ( 
      &match=1
    )
  )	  
  else if ("gcc_blsp1_qup2_spi_apps_clk"=="&clk")
  (
    &match=1
  )
  
  if (&match==1)
  (
    &clk_test=&CLK_TEST_GCC_BLSP1_QUP2_SPI_APPS_CLK
    &clk_reg=&HWIO_GCC_BLSP1_QUP2_SPI_APPS_CBCR_ADDR
    &clk_reg_name="GCC_BLSP1_QUP2_SPI_APPS_CBCR"
    &clk_name="gcc_blsp1_qup2_spi_apps_clk"
    &clk_reg_cbcr_type="sm_cbc"

    gosub Print_Clk_Info_Line
  )
  
  &match=0
  &wild_head=0
  &wild_tail=0
  &clk_input_length=STRING.LENGTH("&clk")
  &clk_itr_length=STRING.LENGTH("gcc_blsp1_qup3_i2c_apps_clk")

  if (STRING.SCAN("&clk", "*", 0)==0)
  (
    &wild_head=1
  )
  if (STRING.SCAN("&clk", "*", 1)==(STRING.LENGTH("&clk")-1))
  (
    &wild_tail=1
  )

  if ((&wild_head==1)&&(&wild_tail==1))
  (
    if (STRING.SCAN("gcc_blsp1_qup3_i2c_apps_clk", STRING.MID("&clk", 1, &clk_input_length-2), 0)!=-1)
    ( 
      &match=1
    )
  )
  else if (&wild_head==1)
  (
    if (STRING.MID("gcc_blsp1_qup3_i2c_apps_clk", &clk_itr_length-&clk_input_length+1, &clk_input_length-1)==STRING.CUT("&clk", 1))
    ( 
      &match=1
    )
  )
  else if (&wild_tail==1)
  (
    if (STRING.MID("gcc_blsp1_qup3_i2c_apps_clk", 0, &clk_input_length-1)==STRING.CUT("&clk", -1))
    ( 
      &match=1
    )
  )	  
  else if ("gcc_blsp1_qup3_i2c_apps_clk"=="&clk")
  (
    &match=1
  )
  
  if (&match==1)
  (
    &clk_test=&CLK_TEST_GCC_BLSP1_QUP3_I2C_APPS_CLK
    &clk_reg=&HWIO_GCC_BLSP1_QUP3_I2C_APPS_CBCR_ADDR
    &clk_reg_name="GCC_BLSP1_QUP3_I2C_APPS_CBCR"
    &clk_name="gcc_blsp1_qup3_i2c_apps_clk"
    &clk_reg_cbcr_type="sm_cbc"

    gosub Print_Clk_Info_Line
  )
  
  &match=0
  &wild_head=0
  &wild_tail=0
  &clk_input_length=STRING.LENGTH("&clk")
  &clk_itr_length=STRING.LENGTH("gcc_blsp1_qup3_spi_apps_clk")

  if (STRING.SCAN("&clk", "*", 0)==0)
  (
    &wild_head=1
  )
  if (STRING.SCAN("&clk", "*", 1)==(STRING.LENGTH("&clk")-1))
  (
    &wild_tail=1
  )

  if ((&wild_head==1)&&(&wild_tail==1))
  (
    if (STRING.SCAN("gcc_blsp1_qup3_spi_apps_clk", STRING.MID("&clk", 1, &clk_input_length-2), 0)!=-1)
    ( 
      &match=1
    )
  )
  else if (&wild_head==1)
  (
    if (STRING.MID("gcc_blsp1_qup3_spi_apps_clk", &clk_itr_length-&clk_input_length+1, &clk_input_length-1)==STRING.CUT("&clk", 1))
    ( 
      &match=1
    )
  )
  else if (&wild_tail==1)
  (
    if (STRING.MID("gcc_blsp1_qup3_spi_apps_clk", 0, &clk_input_length-1)==STRING.CUT("&clk", -1))
    ( 
      &match=1
    )
  )	  
  else if ("gcc_blsp1_qup3_spi_apps_clk"=="&clk")
  (
    &match=1
  )
  
  if (&match==1)
  (
    &clk_test=&CLK_TEST_GCC_BLSP1_QUP3_SPI_APPS_CLK
    &clk_reg=&HWIO_GCC_BLSP1_QUP3_SPI_APPS_CBCR_ADDR
    &clk_reg_name="GCC_BLSP1_QUP3_SPI_APPS_CBCR"
    &clk_name="gcc_blsp1_qup3_spi_apps_clk"
    &clk_reg_cbcr_type="sm_cbc"

    gosub Print_Clk_Info_Line
  )
  
  &match=0
  &wild_head=0
  &wild_tail=0
  &clk_input_length=STRING.LENGTH("&clk")
  &clk_itr_length=STRING.LENGTH("gcc_blsp1_qup4_i2c_apps_clk")

  if (STRING.SCAN("&clk", "*", 0)==0)
  (
    &wild_head=1
  )
  if (STRING.SCAN("&clk", "*", 1)==(STRING.LENGTH("&clk")-1))
  (
    &wild_tail=1
  )

  if ((&wild_head==1)&&(&wild_tail==1))
  (
    if (STRING.SCAN("gcc_blsp1_qup4_i2c_apps_clk", STRING.MID("&clk", 1, &clk_input_length-2), 0)!=-1)
    ( 
      &match=1
    )
  )
  else if (&wild_head==1)
  (
    if (STRING.MID("gcc_blsp1_qup4_i2c_apps_clk", &clk_itr_length-&clk_input_length+1, &clk_input_length-1)==STRING.CUT("&clk", 1))
    ( 
      &match=1
    )
  )
  else if (&wild_tail==1)
  (
    if (STRING.MID("gcc_blsp1_qup4_i2c_apps_clk", 0, &clk_input_length-1)==STRING.CUT("&clk", -1))
    ( 
      &match=1
    )
  )	  
  else if ("gcc_blsp1_qup4_i2c_apps_clk"=="&clk")
  (
    &match=1
  )
  
  if (&match==1)
  (
    &clk_test=&CLK_TEST_GCC_BLSP1_QUP4_I2C_APPS_CLK
    &clk_reg=&HWIO_GCC_BLSP1_QUP4_I2C_APPS_CBCR_ADDR
    &clk_reg_name="GCC_BLSP1_QUP4_I2C_APPS_CBCR"
    &clk_name="gcc_blsp1_qup4_i2c_apps_clk"
    &clk_reg_cbcr_type="sm_cbc"

    gosub Print_Clk_Info_Line
  )
  
  &match=0
  &wild_head=0
  &wild_tail=0
  &clk_input_length=STRING.LENGTH("&clk")
  &clk_itr_length=STRING.LENGTH("gcc_blsp1_qup4_spi_apps_clk")

  if (STRING.SCAN("&clk", "*", 0)==0)
  (
    &wild_head=1
  )
  if (STRING.SCAN("&clk", "*", 1)==(STRING.LENGTH("&clk")-1))
  (
    &wild_tail=1
  )

  if ((&wild_head==1)&&(&wild_tail==1))
  (
    if (STRING.SCAN("gcc_blsp1_qup4_spi_apps_clk", STRING.MID("&clk", 1, &clk_input_length-2), 0)!=-1)
    ( 
      &match=1
    )
  )
  else if (&wild_head==1)
  (
    if (STRING.MID("gcc_blsp1_qup4_spi_apps_clk", &clk_itr_length-&clk_input_length+1, &clk_input_length-1)==STRING.CUT("&clk", 1))
    ( 
      &match=1
    )
  )
  else if (&wild_tail==1)
  (
    if (STRING.MID("gcc_blsp1_qup4_spi_apps_clk", 0, &clk_input_length-1)==STRING.CUT("&clk", -1))
    ( 
      &match=1
    )
  )	  
  else if ("gcc_blsp1_qup4_spi_apps_clk"=="&clk")
  (
    &match=1
  )
  
  if (&match==1)
  (
    &clk_test=&CLK_TEST_GCC_BLSP1_QUP4_SPI_APPS_CLK
    &clk_reg=&HWIO_GCC_BLSP1_QUP4_SPI_APPS_CBCR_ADDR
    &clk_reg_name="GCC_BLSP1_QUP4_SPI_APPS_CBCR"
    &clk_name="gcc_blsp1_qup4_spi_apps_clk"
    &clk_reg_cbcr_type="sm_cbc"

    gosub Print_Clk_Info_Line
  )
  
  &match=0
  &wild_head=0
  &wild_tail=0
  &clk_input_length=STRING.LENGTH("&clk")
  &clk_itr_length=STRING.LENGTH("gcc_blsp1_qup5_i2c_apps_clk")

  if (STRING.SCAN("&clk", "*", 0)==0)
  (
    &wild_head=1
  )
  if (STRING.SCAN("&clk", "*", 1)==(STRING.LENGTH("&clk")-1))
  (
    &wild_tail=1
  )

  if ((&wild_head==1)&&(&wild_tail==1))
  (
    if (STRING.SCAN("gcc_blsp1_qup5_i2c_apps_clk", STRING.MID("&clk", 1, &clk_input_length-2), 0)!=-1)
    ( 
      &match=1
    )
  )
  else if (&wild_head==1)
  (
    if (STRING.MID("gcc_blsp1_qup5_i2c_apps_clk", &clk_itr_length-&clk_input_length+1, &clk_input_length-1)==STRING.CUT("&clk", 1))
    ( 
      &match=1
    )
  )
  else if (&wild_tail==1)
  (
    if (STRING.MID("gcc_blsp1_qup5_i2c_apps_clk", 0, &clk_input_length-1)==STRING.CUT("&clk", -1))
    ( 
      &match=1
    )
  )	  
  else if ("gcc_blsp1_qup5_i2c_apps_clk"=="&clk")
  (
    &match=1
  )
  
  if (&match==1)
  (
    &clk_test=&CLK_TEST_GCC_BLSP1_QUP5_I2C_APPS_CLK
    &clk_reg=&HWIO_GCC_BLSP1_QUP5_I2C_APPS_CBCR_ADDR
    &clk_reg_name="GCC_BLSP1_QUP5_I2C_APPS_CBCR"
    &clk_name="gcc_blsp1_qup5_i2c_apps_clk"
    &clk_reg_cbcr_type="sm_cbc"

    gosub Print_Clk_Info_Line
  )
  
  &match=0
  &wild_head=0
  &wild_tail=0
  &clk_input_length=STRING.LENGTH("&clk")
  &clk_itr_length=STRING.LENGTH("gcc_blsp1_qup5_spi_apps_clk")

  if (STRING.SCAN("&clk", "*", 0)==0)
  (
    &wild_head=1
  )
  if (STRING.SCAN("&clk", "*", 1)==(STRING.LENGTH("&clk")-1))
  (
    &wild_tail=1
  )

  if ((&wild_head==1)&&(&wild_tail==1))
  (
    if (STRING.SCAN("gcc_blsp1_qup5_spi_apps_clk", STRING.MID("&clk", 1, &clk_input_length-2), 0)!=-1)
    ( 
      &match=1
    )
  )
  else if (&wild_head==1)
  (
    if (STRING.MID("gcc_blsp1_qup5_spi_apps_clk", &clk_itr_length-&clk_input_length+1, &clk_input_length-1)==STRING.CUT("&clk", 1))
    ( 
      &match=1
    )
  )
  else if (&wild_tail==1)
  (
    if (STRING.MID("gcc_blsp1_qup5_spi_apps_clk", 0, &clk_input_length-1)==STRING.CUT("&clk", -1))
    ( 
      &match=1
    )
  )	  
  else if ("gcc_blsp1_qup5_spi_apps_clk"=="&clk")
  (
    &match=1
  )
  
  if (&match==1)
  (
    &clk_test=&CLK_TEST_GCC_BLSP1_QUP5_SPI_APPS_CLK
    &clk_reg=&HWIO_GCC_BLSP1_QUP5_SPI_APPS_CBCR_ADDR
    &clk_reg_name="GCC_BLSP1_QUP5_SPI_APPS_CBCR"
    &clk_name="gcc_blsp1_qup5_spi_apps_clk"
    &clk_reg_cbcr_type="sm_cbc"

    gosub Print_Clk_Info_Line
  )
  
  &match=0
  &wild_head=0
  &wild_tail=0
  &clk_input_length=STRING.LENGTH("&clk")
  &clk_itr_length=STRING.LENGTH("gcc_blsp1_qup6_i2c_apps_clk")

  if (STRING.SCAN("&clk", "*", 0)==0)
  (
    &wild_head=1
  )
  if (STRING.SCAN("&clk", "*", 1)==(STRING.LENGTH("&clk")-1))
  (
    &wild_tail=1
  )

  if ((&wild_head==1)&&(&wild_tail==1))
  (
    if (STRING.SCAN("gcc_blsp1_qup6_i2c_apps_clk", STRING.MID("&clk", 1, &clk_input_length-2), 0)!=-1)
    ( 
      &match=1
    )
  )
  else if (&wild_head==1)
  (
    if (STRING.MID("gcc_blsp1_qup6_i2c_apps_clk", &clk_itr_length-&clk_input_length+1, &clk_input_length-1)==STRING.CUT("&clk", 1))
    ( 
      &match=1
    )
  )
  else if (&wild_tail==1)
  (
    if (STRING.MID("gcc_blsp1_qup6_i2c_apps_clk", 0, &clk_input_length-1)==STRING.CUT("&clk", -1))
    ( 
      &match=1
    )
  )	  
  else if ("gcc_blsp1_qup6_i2c_apps_clk"=="&clk")
  (
    &match=1
  )
  
  if (&match==1)
  (
    &clk_test=&CLK_TEST_GCC_BLSP1_QUP6_I2C_APPS_CLK
    &clk_reg=&HWIO_GCC_BLSP1_QUP6_I2C_APPS_CBCR_ADDR
    &clk_reg_name="GCC_BLSP1_QUP6_I2C_APPS_CBCR"
    &clk_name="gcc_blsp1_qup6_i2c_apps_clk"
    &clk_reg_cbcr_type="sm_cbc"

    gosub Print_Clk_Info_Line
  )
  
  &match=0
  &wild_head=0
  &wild_tail=0
  &clk_input_length=STRING.LENGTH("&clk")
  &clk_itr_length=STRING.LENGTH("gcc_blsp1_qup6_spi_apps_clk")

  if (STRING.SCAN("&clk", "*", 0)==0)
  (
    &wild_head=1
  )
  if (STRING.SCAN("&clk", "*", 1)==(STRING.LENGTH("&clk")-1))
  (
    &wild_tail=1
  )

  if ((&wild_head==1)&&(&wild_tail==1))
  (
    if (STRING.SCAN("gcc_blsp1_qup6_spi_apps_clk", STRING.MID("&clk", 1, &clk_input_length-2), 0)!=-1)
    ( 
      &match=1
    )
  )
  else if (&wild_head==1)
  (
    if (STRING.MID("gcc_blsp1_qup6_spi_apps_clk", &clk_itr_length-&clk_input_length+1, &clk_input_length-1)==STRING.CUT("&clk", 1))
    ( 
      &match=1
    )
  )
  else if (&wild_tail==1)
  (
    if (STRING.MID("gcc_blsp1_qup6_spi_apps_clk", 0, &clk_input_length-1)==STRING.CUT("&clk", -1))
    ( 
      &match=1
    )
  )	  
  else if ("gcc_blsp1_qup6_spi_apps_clk"=="&clk")
  (
    &match=1
  )
  
  if (&match==1)
  (
    &clk_test=&CLK_TEST_GCC_BLSP1_QUP6_SPI_APPS_CLK
    &clk_reg=&HWIO_GCC_BLSP1_QUP6_SPI_APPS_CBCR_ADDR
    &clk_reg_name="GCC_BLSP1_QUP6_SPI_APPS_CBCR"
    &clk_name="gcc_blsp1_qup6_spi_apps_clk"
    &clk_reg_cbcr_type="sm_cbc"

    gosub Print_Clk_Info_Line
  )
  
  &match=0
  &wild_head=0
  &wild_tail=0
  &clk_input_length=STRING.LENGTH("&clk")
  &clk_itr_length=STRING.LENGTH("gcc_blsp1_uart1_apps_clk")

  if (STRING.SCAN("&clk", "*", 0)==0)
  (
    &wild_head=1
  )
  if (STRING.SCAN("&clk", "*", 1)==(STRING.LENGTH("&clk")-1))
  (
    &wild_tail=1
  )

  if ((&wild_head==1)&&(&wild_tail==1))
  (
    if (STRING.SCAN("gcc_blsp1_uart1_apps_clk", STRING.MID("&clk", 1, &clk_input_length-2), 0)!=-1)
    ( 
      &match=1
    )
  )
  else if (&wild_head==1)
  (
    if (STRING.MID("gcc_blsp1_uart1_apps_clk", &clk_itr_length-&clk_input_length+1, &clk_input_length-1)==STRING.CUT("&clk", 1))
    ( 
      &match=1
    )
  )
  else if (&wild_tail==1)
  (
    if (STRING.MID("gcc_blsp1_uart1_apps_clk", 0, &clk_input_length-1)==STRING.CUT("&clk", -1))
    ( 
      &match=1
    )
  )	  
  else if ("gcc_blsp1_uart1_apps_clk"=="&clk")
  (
    &match=1
  )
  
  if (&match==1)
  (
    &clk_test=&CLK_TEST_GCC_BLSP1_UART1_APPS_CLK
    &clk_reg=&HWIO_GCC_BLSP1_UART1_APPS_CBCR_ADDR
    &clk_reg_name="GCC_BLSP1_UART1_APPS_CBCR"
    &clk_name="gcc_blsp1_uart1_apps_clk"
    &clk_reg_cbcr_type="sm_cbc"

    gosub Print_Clk_Info_Line
  )
  
  &match=0
  &wild_head=0
  &wild_tail=0
  &clk_input_length=STRING.LENGTH("&clk")
  &clk_itr_length=STRING.LENGTH("gcc_blsp1_uart1_sim_clk")

  if (STRING.SCAN("&clk", "*", 0)==0)
  (
    &wild_head=1
  )
  if (STRING.SCAN("&clk", "*", 1)==(STRING.LENGTH("&clk")-1))
  (
    &wild_tail=1
  )

  if ((&wild_head==1)&&(&wild_tail==1))
  (
    if (STRING.SCAN("gcc_blsp1_uart1_sim_clk", STRING.MID("&clk", 1, &clk_input_length-2), 0)!=-1)
    ( 
      &match=1
    )
  )
  else if (&wild_head==1)
  (
    if (STRING.MID("gcc_blsp1_uart1_sim_clk", &clk_itr_length-&clk_input_length+1, &clk_input_length-1)==STRING.CUT("&clk", 1))
    ( 
      &match=1
    )
  )
  else if (&wild_tail==1)
  (
    if (STRING.MID("gcc_blsp1_uart1_sim_clk", 0, &clk_input_length-1)==STRING.CUT("&clk", -1))
    ( 
      &match=1
    )
  )	  
  else if ("gcc_blsp1_uart1_sim_clk"=="&clk")
  (
    &match=1
  )
  
  if (&match==1)
  (
    &clk_test=&CLK_TEST_GCC_BLSP1_UART1_SIM_CLK
    &clk_reg=&HWIO_GCC_BLSP1_UART1_SIM_CBCR_ADDR
    &clk_reg_name="GCC_BLSP1_UART1_SIM_CBCR"
    &clk_name="gcc_blsp1_uart1_sim_clk"
    &clk_reg_cbcr_type="sm_cbc"

    gosub Print_Clk_Info_Line
  )
  
  &match=0
  &wild_head=0
  &wild_tail=0
  &clk_input_length=STRING.LENGTH("&clk")
  &clk_itr_length=STRING.LENGTH("gcc_blsp1_uart2_apps_clk")

  if (STRING.SCAN("&clk", "*", 0)==0)
  (
    &wild_head=1
  )
  if (STRING.SCAN("&clk", "*", 1)==(STRING.LENGTH("&clk")-1))
  (
    &wild_tail=1
  )

  if ((&wild_head==1)&&(&wild_tail==1))
  (
    if (STRING.SCAN("gcc_blsp1_uart2_apps_clk", STRING.MID("&clk", 1, &clk_input_length-2), 0)!=-1)
    ( 
      &match=1
    )
  )
  else if (&wild_head==1)
  (
    if (STRING.MID("gcc_blsp1_uart2_apps_clk", &clk_itr_length-&clk_input_length+1, &clk_input_length-1)==STRING.CUT("&clk", 1))
    ( 
      &match=1
    )
  )
  else if (&wild_tail==1)
  (
    if (STRING.MID("gcc_blsp1_uart2_apps_clk", 0, &clk_input_length-1)==STRING.CUT("&clk", -1))
    ( 
      &match=1
    )
  )	  
  else if ("gcc_blsp1_uart2_apps_clk"=="&clk")
  (
    &match=1
  )
  
  if (&match==1)
  (
    &clk_test=&CLK_TEST_GCC_BLSP1_UART2_APPS_CLK
    &clk_reg=&HWIO_GCC_BLSP1_UART2_APPS_CBCR_ADDR
    &clk_reg_name="GCC_BLSP1_UART2_APPS_CBCR"
    &clk_name="gcc_blsp1_uart2_apps_clk"
    &clk_reg_cbcr_type="sm_cbc"

    gosub Print_Clk_Info_Line
  )
  
  &match=0
  &wild_head=0
  &wild_tail=0
  &clk_input_length=STRING.LENGTH("&clk")
  &clk_itr_length=STRING.LENGTH("gcc_blsp1_uart2_sim_clk")

  if (STRING.SCAN("&clk", "*", 0)==0)
  (
    &wild_head=1
  )
  if (STRING.SCAN("&clk", "*", 1)==(STRING.LENGTH("&clk")-1))
  (
    &wild_tail=1
  )

  if ((&wild_head==1)&&(&wild_tail==1))
  (
    if (STRING.SCAN("gcc_blsp1_uart2_sim_clk", STRING.MID("&clk", 1, &clk_input_length-2), 0)!=-1)
    ( 
      &match=1
    )
  )
  else if (&wild_head==1)
  (
    if (STRING.MID("gcc_blsp1_uart2_sim_clk", &clk_itr_length-&clk_input_length+1, &clk_input_length-1)==STRING.CUT("&clk", 1))
    ( 
      &match=1
    )
  )
  else if (&wild_tail==1)
  (
    if (STRING.MID("gcc_blsp1_uart2_sim_clk", 0, &clk_input_length-1)==STRING.CUT("&clk", -1))
    ( 
      &match=1
    )
  )	  
  else if ("gcc_blsp1_uart2_sim_clk"=="&clk")
  (
    &match=1
  )
  
  if (&match==1)
  (
    &clk_test=&CLK_TEST_GCC_BLSP1_UART2_SIM_CLK
    &clk_reg=&HWIO_GCC_BLSP1_UART2_SIM_CBCR_ADDR
    &clk_reg_name="GCC_BLSP1_UART2_SIM_CBCR"
    &clk_name="gcc_blsp1_uart2_sim_clk"
    &clk_reg_cbcr_type="sm_cbc"

    gosub Print_Clk_Info_Line
  )
  
  &match=0
  &wild_head=0
  &wild_tail=0
  &clk_input_length=STRING.LENGTH("&clk")
  &clk_itr_length=STRING.LENGTH("gcc_blsp1_uart3_apps_clk")

  if (STRING.SCAN("&clk", "*", 0)==0)
  (
    &wild_head=1
  )
  if (STRING.SCAN("&clk", "*", 1)==(STRING.LENGTH("&clk")-1))
  (
    &wild_tail=1
  )

  if ((&wild_head==1)&&(&wild_tail==1))
  (
    if (STRING.SCAN("gcc_blsp1_uart3_apps_clk", STRING.MID("&clk", 1, &clk_input_length-2), 0)!=-1)
    ( 
      &match=1
    )
  )
  else if (&wild_head==1)
  (
    if (STRING.MID("gcc_blsp1_uart3_apps_clk", &clk_itr_length-&clk_input_length+1, &clk_input_length-1)==STRING.CUT("&clk", 1))
    ( 
      &match=1
    )
  )
  else if (&wild_tail==1)
  (
    if (STRING.MID("gcc_blsp1_uart3_apps_clk", 0, &clk_input_length-1)==STRING.CUT("&clk", -1))
    ( 
      &match=1
    )
  )	  
  else if ("gcc_blsp1_uart3_apps_clk"=="&clk")
  (
    &match=1
  )
  
  if (&match==1)
  (
    &clk_test=&CLK_TEST_GCC_BLSP1_UART3_APPS_CLK
    &clk_reg=&HWIO_GCC_BLSP1_UART3_APPS_CBCR_ADDR
    &clk_reg_name="GCC_BLSP1_UART3_APPS_CBCR"
    &clk_name="gcc_blsp1_uart3_apps_clk"
    &clk_reg_cbcr_type="sm_cbc"

    gosub Print_Clk_Info_Line
  )
  
  &match=0
  &wild_head=0
  &wild_tail=0
  &clk_input_length=STRING.LENGTH("&clk")
  &clk_itr_length=STRING.LENGTH("gcc_blsp1_uart3_sim_clk")

  if (STRING.SCAN("&clk", "*", 0)==0)
  (
    &wild_head=1
  )
  if (STRING.SCAN("&clk", "*", 1)==(STRING.LENGTH("&clk")-1))
  (
    &wild_tail=1
  )

  if ((&wild_head==1)&&(&wild_tail==1))
  (
    if (STRING.SCAN("gcc_blsp1_uart3_sim_clk", STRING.MID("&clk", 1, &clk_input_length-2), 0)!=-1)
    ( 
      &match=1
    )
  )
  else if (&wild_head==1)
  (
    if (STRING.MID("gcc_blsp1_uart3_sim_clk", &clk_itr_length-&clk_input_length+1, &clk_input_length-1)==STRING.CUT("&clk", 1))
    ( 
      &match=1
    )
  )
  else if (&wild_tail==1)
  (
    if (STRING.MID("gcc_blsp1_uart3_sim_clk", 0, &clk_input_length-1)==STRING.CUT("&clk", -1))
    ( 
      &match=1
    )
  )	  
  else if ("gcc_blsp1_uart3_sim_clk"=="&clk")
  (
    &match=1
  )
  
  if (&match==1)
  (
    &clk_test=&CLK_TEST_GCC_BLSP1_UART3_SIM_CLK
    &clk_reg=&HWIO_GCC_BLSP1_UART3_SIM_CBCR_ADDR
    &clk_reg_name="GCC_BLSP1_UART3_SIM_CBCR"
    &clk_name="gcc_blsp1_uart3_sim_clk"
    &clk_reg_cbcr_type="sm_cbc"

    gosub Print_Clk_Info_Line
  )
  
  &match=0
  &wild_head=0
  &wild_tail=0
  &clk_input_length=STRING.LENGTH("&clk")
  &clk_itr_length=STRING.LENGTH("gcc_blsp1_uart4_apps_clk")

  if (STRING.SCAN("&clk", "*", 0)==0)
  (
    &wild_head=1
  )
  if (STRING.SCAN("&clk", "*", 1)==(STRING.LENGTH("&clk")-1))
  (
    &wild_tail=1
  )

  if ((&wild_head==1)&&(&wild_tail==1))
  (
    if (STRING.SCAN("gcc_blsp1_uart4_apps_clk", STRING.MID("&clk", 1, &clk_input_length-2), 0)!=-1)
    ( 
      &match=1
    )
  )
  else if (&wild_head==1)
  (
    if (STRING.MID("gcc_blsp1_uart4_apps_clk", &clk_itr_length-&clk_input_length+1, &clk_input_length-1)==STRING.CUT("&clk", 1))
    ( 
      &match=1
    )
  )
  else if (&wild_tail==1)
  (
    if (STRING.MID("gcc_blsp1_uart4_apps_clk", 0, &clk_input_length-1)==STRING.CUT("&clk", -1))
    ( 
      &match=1
    )
  )	  
  else if ("gcc_blsp1_uart4_apps_clk"=="&clk")
  (
    &match=1
  )
  
  if (&match==1)
  (
    &clk_test=&CLK_TEST_GCC_BLSP1_UART4_APPS_CLK
    &clk_reg=&HWIO_GCC_BLSP1_UART4_APPS_CBCR_ADDR
    &clk_reg_name="GCC_BLSP1_UART4_APPS_CBCR"
    &clk_name="gcc_blsp1_uart4_apps_clk"
    &clk_reg_cbcr_type="sm_cbc"

    gosub Print_Clk_Info_Line
  )
  
  &match=0
  &wild_head=0
  &wild_tail=0
  &clk_input_length=STRING.LENGTH("&clk")
  &clk_itr_length=STRING.LENGTH("gcc_blsp1_uart4_sim_clk")

  if (STRING.SCAN("&clk", "*", 0)==0)
  (
    &wild_head=1
  )
  if (STRING.SCAN("&clk", "*", 1)==(STRING.LENGTH("&clk")-1))
  (
    &wild_tail=1
  )

  if ((&wild_head==1)&&(&wild_tail==1))
  (
    if (STRING.SCAN("gcc_blsp1_uart4_sim_clk", STRING.MID("&clk", 1, &clk_input_length-2), 0)!=-1)
    ( 
      &match=1
    )
  )
  else if (&wild_head==1)
  (
    if (STRING.MID("gcc_blsp1_uart4_sim_clk", &clk_itr_length-&clk_input_length+1, &clk_input_length-1)==STRING.CUT("&clk", 1))
    ( 
      &match=1
    )
  )
  else if (&wild_tail==1)
  (
    if (STRING.MID("gcc_blsp1_uart4_sim_clk", 0, &clk_input_length-1)==STRING.CUT("&clk", -1))
    ( 
      &match=1
    )
  )	  
  else if ("gcc_blsp1_uart4_sim_clk"=="&clk")
  (
    &match=1
  )
  
  if (&match==1)
  (
    &clk_test=&CLK_TEST_GCC_BLSP1_UART4_SIM_CLK
    &clk_reg=&HWIO_GCC_BLSP1_UART4_SIM_CBCR_ADDR
    &clk_reg_name="GCC_BLSP1_UART4_SIM_CBCR"
    &clk_name="gcc_blsp1_uart4_sim_clk"
    &clk_reg_cbcr_type="sm_cbc"

    gosub Print_Clk_Info_Line
  )
  
  &match=0
  &wild_head=0
  &wild_tail=0
  &clk_input_length=STRING.LENGTH("&clk")
  &clk_itr_length=STRING.LENGTH("gcc_blsp1_uart5_apps_clk")

  if (STRING.SCAN("&clk", "*", 0)==0)
  (
    &wild_head=1
  )
  if (STRING.SCAN("&clk", "*", 1)==(STRING.LENGTH("&clk")-1))
  (
    &wild_tail=1
  )

  if ((&wild_head==1)&&(&wild_tail==1))
  (
    if (STRING.SCAN("gcc_blsp1_uart5_apps_clk", STRING.MID("&clk", 1, &clk_input_length-2), 0)!=-1)
    ( 
      &match=1
    )
  )
  else if (&wild_head==1)
  (
    if (STRING.MID("gcc_blsp1_uart5_apps_clk", &clk_itr_length-&clk_input_length+1, &clk_input_length-1)==STRING.CUT("&clk", 1))
    ( 
      &match=1
    )
  )
  else if (&wild_tail==1)
  (
    if (STRING.MID("gcc_blsp1_uart5_apps_clk", 0, &clk_input_length-1)==STRING.CUT("&clk", -1))
    ( 
      &match=1
    )
  )	  
  else if ("gcc_blsp1_uart5_apps_clk"=="&clk")
  (
    &match=1
  )
  
  if (&match==1)
  (
    &clk_test=&CLK_TEST_GCC_BLSP1_UART5_APPS_CLK
    &clk_reg=&HWIO_GCC_BLSP1_UART5_APPS_CBCR_ADDR
    &clk_reg_name="GCC_BLSP1_UART5_APPS_CBCR"
    &clk_name="gcc_blsp1_uart5_apps_clk"
    &clk_reg_cbcr_type="sm_cbc"

    gosub Print_Clk_Info_Line
  )
  
  &match=0
  &wild_head=0
  &wild_tail=0
  &clk_input_length=STRING.LENGTH("&clk")
  &clk_itr_length=STRING.LENGTH("gcc_blsp1_uart5_sim_clk")

  if (STRING.SCAN("&clk", "*", 0)==0)
  (
    &wild_head=1
  )
  if (STRING.SCAN("&clk", "*", 1)==(STRING.LENGTH("&clk")-1))
  (
    &wild_tail=1
  )

  if ((&wild_head==1)&&(&wild_tail==1))
  (
    if (STRING.SCAN("gcc_blsp1_uart5_sim_clk", STRING.MID("&clk", 1, &clk_input_length-2), 0)!=-1)
    ( 
      &match=1
    )
  )
  else if (&wild_head==1)
  (
    if (STRING.MID("gcc_blsp1_uart5_sim_clk", &clk_itr_length-&clk_input_length+1, &clk_input_length-1)==STRING.CUT("&clk", 1))
    ( 
      &match=1
    )
  )
  else if (&wild_tail==1)
  (
    if (STRING.MID("gcc_blsp1_uart5_sim_clk", 0, &clk_input_length-1)==STRING.CUT("&clk", -1))
    ( 
      &match=1
    )
  )	  
  else if ("gcc_blsp1_uart5_sim_clk"=="&clk")
  (
    &match=1
  )
  
  if (&match==1)
  (
    &clk_test=&CLK_TEST_GCC_BLSP1_UART5_SIM_CLK
    &clk_reg=&HWIO_GCC_BLSP1_UART5_SIM_CBCR_ADDR
    &clk_reg_name="GCC_BLSP1_UART5_SIM_CBCR"
    &clk_name="gcc_blsp1_uart5_sim_clk"
    &clk_reg_cbcr_type="sm_cbc"

    gosub Print_Clk_Info_Line
  )
  
  &match=0
  &wild_head=0
  &wild_tail=0
  &clk_input_length=STRING.LENGTH("&clk")
  &clk_itr_length=STRING.LENGTH("gcc_blsp1_uart6_apps_clk")

  if (STRING.SCAN("&clk", "*", 0)==0)
  (
    &wild_head=1
  )
  if (STRING.SCAN("&clk", "*", 1)==(STRING.LENGTH("&clk")-1))
  (
    &wild_tail=1
  )

  if ((&wild_head==1)&&(&wild_tail==1))
  (
    if (STRING.SCAN("gcc_blsp1_uart6_apps_clk", STRING.MID("&clk", 1, &clk_input_length-2), 0)!=-1)
    ( 
      &match=1
    )
  )
  else if (&wild_head==1)
  (
    if (STRING.MID("gcc_blsp1_uart6_apps_clk", &clk_itr_length-&clk_input_length+1, &clk_input_length-1)==STRING.CUT("&clk", 1))
    ( 
      &match=1
    )
  )
  else if (&wild_tail==1)
  (
    if (STRING.MID("gcc_blsp1_uart6_apps_clk", 0, &clk_input_length-1)==STRING.CUT("&clk", -1))
    ( 
      &match=1
    )
  )	  
  else if ("gcc_blsp1_uart6_apps_clk"=="&clk")
  (
    &match=1
  )
  
  if (&match==1)
  (
    &clk_test=&CLK_TEST_GCC_BLSP1_UART6_APPS_CLK
    &clk_reg=&HWIO_GCC_BLSP1_UART6_APPS_CBCR_ADDR
    &clk_reg_name="GCC_BLSP1_UART6_APPS_CBCR"
    &clk_name="gcc_blsp1_uart6_apps_clk"
    &clk_reg_cbcr_type="sm_cbc"

    gosub Print_Clk_Info_Line
  )
  
  &match=0
  &wild_head=0
  &wild_tail=0
  &clk_input_length=STRING.LENGTH("&clk")
  &clk_itr_length=STRING.LENGTH("gcc_blsp1_uart6_sim_clk")

  if (STRING.SCAN("&clk", "*", 0)==0)
  (
    &wild_head=1
  )
  if (STRING.SCAN("&clk", "*", 1)==(STRING.LENGTH("&clk")-1))
  (
    &wild_tail=1
  )

  if ((&wild_head==1)&&(&wild_tail==1))
  (
    if (STRING.SCAN("gcc_blsp1_uart6_sim_clk", STRING.MID("&clk", 1, &clk_input_length-2), 0)!=-1)
    ( 
      &match=1
    )
  )
  else if (&wild_head==1)
  (
    if (STRING.MID("gcc_blsp1_uart6_sim_clk", &clk_itr_length-&clk_input_length+1, &clk_input_length-1)==STRING.CUT("&clk", 1))
    ( 
      &match=1
    )
  )
  else if (&wild_tail==1)
  (
    if (STRING.MID("gcc_blsp1_uart6_sim_clk", 0, &clk_input_length-1)==STRING.CUT("&clk", -1))
    ( 
      &match=1
    )
  )	  
  else if ("gcc_blsp1_uart6_sim_clk"=="&clk")
  (
    &match=1
  )
  
  if (&match==1)
  (
    &clk_test=&CLK_TEST_GCC_BLSP1_UART6_SIM_CLK
    &clk_reg=&HWIO_GCC_BLSP1_UART6_SIM_CBCR_ADDR
    &clk_reg_name="GCC_BLSP1_UART6_SIM_CBCR"
    &clk_name="gcc_blsp1_uart6_sim_clk"
    &clk_reg_cbcr_type="sm_cbc"

    gosub Print_Clk_Info_Line
  )
  
  &match=0
  &wild_head=0
  &wild_tail=0
  &clk_input_length=STRING.LENGTH("&clk")
  &clk_itr_length=STRING.LENGTH("gcc_blsp2_ahb_clk")

  if (STRING.SCAN("&clk", "*", 0)==0)
  (
    &wild_head=1
  )
  if (STRING.SCAN("&clk", "*", 1)==(STRING.LENGTH("&clk")-1))
  (
    &wild_tail=1
  )

  if ((&wild_head==1)&&(&wild_tail==1))
  (
    if (STRING.SCAN("gcc_blsp2_ahb_clk", STRING.MID("&clk", 1, &clk_input_length-2), 0)!=-1)
    ( 
      &match=1
    )
  )
  else if (&wild_head==1)
  (
    if (STRING.MID("gcc_blsp2_ahb_clk", &clk_itr_length-&clk_input_length+1, &clk_input_length-1)==STRING.CUT("&clk", 1))
    ( 
      &match=1
    )
  )
  else if (&wild_tail==1)
  (
    if (STRING.MID("gcc_blsp2_ahb_clk", 0, &clk_input_length-1)==STRING.CUT("&clk", -1))
    ( 
      &match=1
    )
  )	  
  else if ("gcc_blsp2_ahb_clk"=="&clk")
  (
    &match=1
  )
  
  if (&match==1)
  (
    &clk_test=&CLK_TEST_GCC_BLSP2_AHB_CLK
    &clk_reg=&HWIO_GCC_BLSP2_AHB_CBCR_ADDR
    &clk_reg_name="GCC_BLSP2_AHB_CBCR"
    &clk_name="gcc_blsp2_ahb_clk"
    &clk_reg_cbcr_type="sm_pscbc"

    gosub Print_Clk_Info_Line
  )
  
  &match=0
  &wild_head=0
  &wild_tail=0
  &clk_input_length=STRING.LENGTH("&clk")
  &clk_itr_length=STRING.LENGTH("gcc_blsp2_sleep_clk")

  if (STRING.SCAN("&clk", "*", 0)==0)
  (
    &wild_head=1
  )
  if (STRING.SCAN("&clk", "*", 1)==(STRING.LENGTH("&clk")-1))
  (
    &wild_tail=1
  )

  if ((&wild_head==1)&&(&wild_tail==1))
  (
    if (STRING.SCAN("gcc_blsp2_sleep_clk", STRING.MID("&clk", 1, &clk_input_length-2), 0)!=-1)
    ( 
      &match=1
    )
  )
  else if (&wild_head==1)
  (
    if (STRING.MID("gcc_blsp2_sleep_clk", &clk_itr_length-&clk_input_length+1, &clk_input_length-1)==STRING.CUT("&clk", 1))
    ( 
      &match=1
    )
  )
  else if (&wild_tail==1)
  (
    if (STRING.MID("gcc_blsp2_sleep_clk", 0, &clk_input_length-1)==STRING.CUT("&clk", -1))
    ( 
      &match=1
    )
  )	  
  else if ("gcc_blsp2_sleep_clk"=="&clk")
  (
    &match=1
  )
  
  if (&match==1)
  (
    &clk_test=&CLK_TEST_GCC_BLSP2_SLEEP_CLK
    &clk_reg=&HWIO_GCC_BLSP2_SLEEP_CBCR_ADDR
    &clk_reg_name="GCC_BLSP2_SLEEP_CBCR"
    &clk_name="gcc_blsp2_sleep_clk"
    &clk_reg_cbcr_type="sm_cbc"

    gosub Print_Clk_Info_Line
  )
  
  &match=0
  &wild_head=0
  &wild_tail=0
  &clk_input_length=STRING.LENGTH("&clk")
  &clk_itr_length=STRING.LENGTH("gcc_blsp2_qup1_i2c_apps_clk")

  if (STRING.SCAN("&clk", "*", 0)==0)
  (
    &wild_head=1
  )
  if (STRING.SCAN("&clk", "*", 1)==(STRING.LENGTH("&clk")-1))
  (
    &wild_tail=1
  )

  if ((&wild_head==1)&&(&wild_tail==1))
  (
    if (STRING.SCAN("gcc_blsp2_qup1_i2c_apps_clk", STRING.MID("&clk", 1, &clk_input_length-2), 0)!=-1)
    ( 
      &match=1
    )
  )
  else if (&wild_head==1)
  (
    if (STRING.MID("gcc_blsp2_qup1_i2c_apps_clk", &clk_itr_length-&clk_input_length+1, &clk_input_length-1)==STRING.CUT("&clk", 1))
    ( 
      &match=1
    )
  )
  else if (&wild_tail==1)
  (
    if (STRING.MID("gcc_blsp2_qup1_i2c_apps_clk", 0, &clk_input_length-1)==STRING.CUT("&clk", -1))
    ( 
      &match=1
    )
  )	  
  else if ("gcc_blsp2_qup1_i2c_apps_clk"=="&clk")
  (
    &match=1
  )
  
  if (&match==1)
  (
    &clk_test=&CLK_TEST_GCC_BLSP2_QUP1_I2C_APPS_CLK
    &clk_reg=&HWIO_GCC_BLSP2_QUP1_I2C_APPS_CBCR_ADDR
    &clk_reg_name="GCC_BLSP2_QUP1_I2C_APPS_CBCR"
    &clk_name="gcc_blsp2_qup1_i2c_apps_clk"
    &clk_reg_cbcr_type="sm_cbc"

    gosub Print_Clk_Info_Line
  )
  
  &match=0
  &wild_head=0
  &wild_tail=0
  &clk_input_length=STRING.LENGTH("&clk")
  &clk_itr_length=STRING.LENGTH("gcc_blsp2_qup1_spi_apps_clk")

  if (STRING.SCAN("&clk", "*", 0)==0)
  (
    &wild_head=1
  )
  if (STRING.SCAN("&clk", "*", 1)==(STRING.LENGTH("&clk")-1))
  (
    &wild_tail=1
  )

  if ((&wild_head==1)&&(&wild_tail==1))
  (
    if (STRING.SCAN("gcc_blsp2_qup1_spi_apps_clk", STRING.MID("&clk", 1, &clk_input_length-2), 0)!=-1)
    ( 
      &match=1
    )
  )
  else if (&wild_head==1)
  (
    if (STRING.MID("gcc_blsp2_qup1_spi_apps_clk", &clk_itr_length-&clk_input_length+1, &clk_input_length-1)==STRING.CUT("&clk", 1))
    ( 
      &match=1
    )
  )
  else if (&wild_tail==1)
  (
    if (STRING.MID("gcc_blsp2_qup1_spi_apps_clk", 0, &clk_input_length-1)==STRING.CUT("&clk", -1))
    ( 
      &match=1
    )
  )	  
  else if ("gcc_blsp2_qup1_spi_apps_clk"=="&clk")
  (
    &match=1
  )
  
  if (&match==1)
  (
    &clk_test=&CLK_TEST_GCC_BLSP2_QUP1_SPI_APPS_CLK
    &clk_reg=&HWIO_GCC_BLSP2_QUP1_SPI_APPS_CBCR_ADDR
    &clk_reg_name="GCC_BLSP2_QUP1_SPI_APPS_CBCR"
    &clk_name="gcc_blsp2_qup1_spi_apps_clk"
    &clk_reg_cbcr_type="sm_cbc"

    gosub Print_Clk_Info_Line
  )
  
  &match=0
  &wild_head=0
  &wild_tail=0
  &clk_input_length=STRING.LENGTH("&clk")
  &clk_itr_length=STRING.LENGTH("gcc_blsp2_qup2_i2c_apps_clk")

  if (STRING.SCAN("&clk", "*", 0)==0)
  (
    &wild_head=1
  )
  if (STRING.SCAN("&clk", "*", 1)==(STRING.LENGTH("&clk")-1))
  (
    &wild_tail=1
  )

  if ((&wild_head==1)&&(&wild_tail==1))
  (
    if (STRING.SCAN("gcc_blsp2_qup2_i2c_apps_clk", STRING.MID("&clk", 1, &clk_input_length-2), 0)!=-1)
    ( 
      &match=1
    )
  )
  else if (&wild_head==1)
  (
    if (STRING.MID("gcc_blsp2_qup2_i2c_apps_clk", &clk_itr_length-&clk_input_length+1, &clk_input_length-1)==STRING.CUT("&clk", 1))
    ( 
      &match=1
    )
  )
  else if (&wild_tail==1)
  (
    if (STRING.MID("gcc_blsp2_qup2_i2c_apps_clk", 0, &clk_input_length-1)==STRING.CUT("&clk", -1))
    ( 
      &match=1
    )
  )	  
  else if ("gcc_blsp2_qup2_i2c_apps_clk"=="&clk")
  (
    &match=1
  )
  
  if (&match==1)
  (
    &clk_test=&CLK_TEST_GCC_BLSP2_QUP2_I2C_APPS_CLK
    &clk_reg=&HWIO_GCC_BLSP2_QUP2_I2C_APPS_CBCR_ADDR
    &clk_reg_name="GCC_BLSP2_QUP2_I2C_APPS_CBCR"
    &clk_name="gcc_blsp2_qup2_i2c_apps_clk"
    &clk_reg_cbcr_type="sm_cbc"

    gosub Print_Clk_Info_Line
  )
  
  &match=0
  &wild_head=0
  &wild_tail=0
  &clk_input_length=STRING.LENGTH("&clk")
  &clk_itr_length=STRING.LENGTH("gcc_blsp2_qup2_spi_apps_clk")

  if (STRING.SCAN("&clk", "*", 0)==0)
  (
    &wild_head=1
  )
  if (STRING.SCAN("&clk", "*", 1)==(STRING.LENGTH("&clk")-1))
  (
    &wild_tail=1
  )

  if ((&wild_head==1)&&(&wild_tail==1))
  (
    if (STRING.SCAN("gcc_blsp2_qup2_spi_apps_clk", STRING.MID("&clk", 1, &clk_input_length-2), 0)!=-1)
    ( 
      &match=1
    )
  )
  else if (&wild_head==1)
  (
    if (STRING.MID("gcc_blsp2_qup2_spi_apps_clk", &clk_itr_length-&clk_input_length+1, &clk_input_length-1)==STRING.CUT("&clk", 1))
    ( 
      &match=1
    )
  )
  else if (&wild_tail==1)
  (
    if (STRING.MID("gcc_blsp2_qup2_spi_apps_clk", 0, &clk_input_length-1)==STRING.CUT("&clk", -1))
    ( 
      &match=1
    )
  )	  
  else if ("gcc_blsp2_qup2_spi_apps_clk"=="&clk")
  (
    &match=1
  )
  
  if (&match==1)
  (
    &clk_test=&CLK_TEST_GCC_BLSP2_QUP2_SPI_APPS_CLK
    &clk_reg=&HWIO_GCC_BLSP2_QUP2_SPI_APPS_CBCR_ADDR
    &clk_reg_name="GCC_BLSP2_QUP2_SPI_APPS_CBCR"
    &clk_name="gcc_blsp2_qup2_spi_apps_clk"
    &clk_reg_cbcr_type="sm_cbc"

    gosub Print_Clk_Info_Line
  )
  
  &match=0
  &wild_head=0
  &wild_tail=0
  &clk_input_length=STRING.LENGTH("&clk")
  &clk_itr_length=STRING.LENGTH("gcc_blsp2_qup3_i2c_apps_clk")

  if (STRING.SCAN("&clk", "*", 0)==0)
  (
    &wild_head=1
  )
  if (STRING.SCAN("&clk", "*", 1)==(STRING.LENGTH("&clk")-1))
  (
    &wild_tail=1
  )

  if ((&wild_head==1)&&(&wild_tail==1))
  (
    if (STRING.SCAN("gcc_blsp2_qup3_i2c_apps_clk", STRING.MID("&clk", 1, &clk_input_length-2), 0)!=-1)
    ( 
      &match=1
    )
  )
  else if (&wild_head==1)
  (
    if (STRING.MID("gcc_blsp2_qup3_i2c_apps_clk", &clk_itr_length-&clk_input_length+1, &clk_input_length-1)==STRING.CUT("&clk", 1))
    ( 
      &match=1
    )
  )
  else if (&wild_tail==1)
  (
    if (STRING.MID("gcc_blsp2_qup3_i2c_apps_clk", 0, &clk_input_length-1)==STRING.CUT("&clk", -1))
    ( 
      &match=1
    )
  )	  
  else if ("gcc_blsp2_qup3_i2c_apps_clk"=="&clk")
  (
    &match=1
  )
  
  if (&match==1)
  (
    &clk_test=&CLK_TEST_GCC_BLSP2_QUP3_I2C_APPS_CLK
    &clk_reg=&HWIO_GCC_BLSP2_QUP3_I2C_APPS_CBCR_ADDR
    &clk_reg_name="GCC_BLSP2_QUP3_I2C_APPS_CBCR"
    &clk_name="gcc_blsp2_qup3_i2c_apps_clk"
    &clk_reg_cbcr_type="sm_cbc"

    gosub Print_Clk_Info_Line
  )
  
  &match=0
  &wild_head=0
  &wild_tail=0
  &clk_input_length=STRING.LENGTH("&clk")
  &clk_itr_length=STRING.LENGTH("gcc_blsp2_qup3_spi_apps_clk")

  if (STRING.SCAN("&clk", "*", 0)==0)
  (
    &wild_head=1
  )
  if (STRING.SCAN("&clk", "*", 1)==(STRING.LENGTH("&clk")-1))
  (
    &wild_tail=1
  )

  if ((&wild_head==1)&&(&wild_tail==1))
  (
    if (STRING.SCAN("gcc_blsp2_qup3_spi_apps_clk", STRING.MID("&clk", 1, &clk_input_length-2), 0)!=-1)
    ( 
      &match=1
    )
  )
  else if (&wild_head==1)
  (
    if (STRING.MID("gcc_blsp2_qup3_spi_apps_clk", &clk_itr_length-&clk_input_length+1, &clk_input_length-1)==STRING.CUT("&clk", 1))
    ( 
      &match=1
    )
  )
  else if (&wild_tail==1)
  (
    if (STRING.MID("gcc_blsp2_qup3_spi_apps_clk", 0, &clk_input_length-1)==STRING.CUT("&clk", -1))
    ( 
      &match=1
    )
  )	  
  else if ("gcc_blsp2_qup3_spi_apps_clk"=="&clk")
  (
    &match=1
  )
  
  if (&match==1)
  (
    &clk_test=&CLK_TEST_GCC_BLSP2_QUP3_SPI_APPS_CLK
    &clk_reg=&HWIO_GCC_BLSP2_QUP3_SPI_APPS_CBCR_ADDR
    &clk_reg_name="GCC_BLSP2_QUP3_SPI_APPS_CBCR"
    &clk_name="gcc_blsp2_qup3_spi_apps_clk"
    &clk_reg_cbcr_type="sm_cbc"

    gosub Print_Clk_Info_Line
  )
  
  &match=0
  &wild_head=0
  &wild_tail=0
  &clk_input_length=STRING.LENGTH("&clk")
  &clk_itr_length=STRING.LENGTH("gcc_blsp2_qup4_i2c_apps_clk")

  if (STRING.SCAN("&clk", "*", 0)==0)
  (
    &wild_head=1
  )
  if (STRING.SCAN("&clk", "*", 1)==(STRING.LENGTH("&clk")-1))
  (
    &wild_tail=1
  )

  if ((&wild_head==1)&&(&wild_tail==1))
  (
    if (STRING.SCAN("gcc_blsp2_qup4_i2c_apps_clk", STRING.MID("&clk", 1, &clk_input_length-2), 0)!=-1)
    ( 
      &match=1
    )
  )
  else if (&wild_head==1)
  (
    if (STRING.MID("gcc_blsp2_qup4_i2c_apps_clk", &clk_itr_length-&clk_input_length+1, &clk_input_length-1)==STRING.CUT("&clk", 1))
    ( 
      &match=1
    )
  )
  else if (&wild_tail==1)
  (
    if (STRING.MID("gcc_blsp2_qup4_i2c_apps_clk", 0, &clk_input_length-1)==STRING.CUT("&clk", -1))
    ( 
      &match=1
    )
  )	  
  else if ("gcc_blsp2_qup4_i2c_apps_clk"=="&clk")
  (
    &match=1
  )
  
  if (&match==1)
  (
    &clk_test=&CLK_TEST_GCC_BLSP2_QUP4_I2C_APPS_CLK
    &clk_reg=&HWIO_GCC_BLSP2_QUP4_I2C_APPS_CBCR_ADDR
    &clk_reg_name="GCC_BLSP2_QUP4_I2C_APPS_CBCR"
    &clk_name="gcc_blsp2_qup4_i2c_apps_clk"
    &clk_reg_cbcr_type="sm_cbc"

    gosub Print_Clk_Info_Line
  )
  
  &match=0
  &wild_head=0
  &wild_tail=0
  &clk_input_length=STRING.LENGTH("&clk")
  &clk_itr_length=STRING.LENGTH("gcc_blsp2_qup4_spi_apps_clk")

  if (STRING.SCAN("&clk", "*", 0)==0)
  (
    &wild_head=1
  )
  if (STRING.SCAN("&clk", "*", 1)==(STRING.LENGTH("&clk")-1))
  (
    &wild_tail=1
  )

  if ((&wild_head==1)&&(&wild_tail==1))
  (
    if (STRING.SCAN("gcc_blsp2_qup4_spi_apps_clk", STRING.MID("&clk", 1, &clk_input_length-2), 0)!=-1)
    ( 
      &match=1
    )
  )
  else if (&wild_head==1)
  (
    if (STRING.MID("gcc_blsp2_qup4_spi_apps_clk", &clk_itr_length-&clk_input_length+1, &clk_input_length-1)==STRING.CUT("&clk", 1))
    ( 
      &match=1
    )
  )
  else if (&wild_tail==1)
  (
    if (STRING.MID("gcc_blsp2_qup4_spi_apps_clk", 0, &clk_input_length-1)==STRING.CUT("&clk", -1))
    ( 
      &match=1
    )
  )	  
  else if ("gcc_blsp2_qup4_spi_apps_clk"=="&clk")
  (
    &match=1
  )
  
  if (&match==1)
  (
    &clk_test=&CLK_TEST_GCC_BLSP2_QUP4_SPI_APPS_CLK
    &clk_reg=&HWIO_GCC_BLSP2_QUP4_SPI_APPS_CBCR_ADDR
    &clk_reg_name="GCC_BLSP2_QUP4_SPI_APPS_CBCR"
    &clk_name="gcc_blsp2_qup4_spi_apps_clk"
    &clk_reg_cbcr_type="sm_cbc"

    gosub Print_Clk_Info_Line
  )
  
  &match=0
  &wild_head=0
  &wild_tail=0
  &clk_input_length=STRING.LENGTH("&clk")
  &clk_itr_length=STRING.LENGTH("gcc_blsp2_qup5_i2c_apps_clk")

  if (STRING.SCAN("&clk", "*", 0)==0)
  (
    &wild_head=1
  )
  if (STRING.SCAN("&clk", "*", 1)==(STRING.LENGTH("&clk")-1))
  (
    &wild_tail=1
  )

  if ((&wild_head==1)&&(&wild_tail==1))
  (
    if (STRING.SCAN("gcc_blsp2_qup5_i2c_apps_clk", STRING.MID("&clk", 1, &clk_input_length-2), 0)!=-1)
    ( 
      &match=1
    )
  )
  else if (&wild_head==1)
  (
    if (STRING.MID("gcc_blsp2_qup5_i2c_apps_clk", &clk_itr_length-&clk_input_length+1, &clk_input_length-1)==STRING.CUT("&clk", 1))
    ( 
      &match=1
    )
  )
  else if (&wild_tail==1)
  (
    if (STRING.MID("gcc_blsp2_qup5_i2c_apps_clk", 0, &clk_input_length-1)==STRING.CUT("&clk", -1))
    ( 
      &match=1
    )
  )	  
  else if ("gcc_blsp2_qup5_i2c_apps_clk"=="&clk")
  (
    &match=1
  )
  
  if (&match==1)
  (
    &clk_test=&CLK_TEST_GCC_BLSP2_QUP5_I2C_APPS_CLK
    &clk_reg=&HWIO_GCC_BLSP2_QUP5_I2C_APPS_CBCR_ADDR
    &clk_reg_name="GCC_BLSP2_QUP5_I2C_APPS_CBCR"
    &clk_name="gcc_blsp2_qup5_i2c_apps_clk"
    &clk_reg_cbcr_type="sm_cbc"

    gosub Print_Clk_Info_Line
  )
  
  &match=0
  &wild_head=0
  &wild_tail=0
  &clk_input_length=STRING.LENGTH("&clk")
  &clk_itr_length=STRING.LENGTH("gcc_blsp2_qup5_spi_apps_clk")

  if (STRING.SCAN("&clk", "*", 0)==0)
  (
    &wild_head=1
  )
  if (STRING.SCAN("&clk", "*", 1)==(STRING.LENGTH("&clk")-1))
  (
    &wild_tail=1
  )

  if ((&wild_head==1)&&(&wild_tail==1))
  (
    if (STRING.SCAN("gcc_blsp2_qup5_spi_apps_clk", STRING.MID("&clk", 1, &clk_input_length-2), 0)!=-1)
    ( 
      &match=1
    )
  )
  else if (&wild_head==1)
  (
    if (STRING.MID("gcc_blsp2_qup5_spi_apps_clk", &clk_itr_length-&clk_input_length+1, &clk_input_length-1)==STRING.CUT("&clk", 1))
    ( 
      &match=1
    )
  )
  else if (&wild_tail==1)
  (
    if (STRING.MID("gcc_blsp2_qup5_spi_apps_clk", 0, &clk_input_length-1)==STRING.CUT("&clk", -1))
    ( 
      &match=1
    )
  )	  
  else if ("gcc_blsp2_qup5_spi_apps_clk"=="&clk")
  (
    &match=1
  )
  
  if (&match==1)
  (
    &clk_test=&CLK_TEST_GCC_BLSP2_QUP5_SPI_APPS_CLK
    &clk_reg=&HWIO_GCC_BLSP2_QUP5_SPI_APPS_CBCR_ADDR
    &clk_reg_name="GCC_BLSP2_QUP5_SPI_APPS_CBCR"
    &clk_name="gcc_blsp2_qup5_spi_apps_clk"
    &clk_reg_cbcr_type="sm_cbc"

    gosub Print_Clk_Info_Line
  )
  
  &match=0
  &wild_head=0
  &wild_tail=0
  &clk_input_length=STRING.LENGTH("&clk")
  &clk_itr_length=STRING.LENGTH("gcc_blsp2_qup6_i2c_apps_clk")

  if (STRING.SCAN("&clk", "*", 0)==0)
  (
    &wild_head=1
  )
  if (STRING.SCAN("&clk", "*", 1)==(STRING.LENGTH("&clk")-1))
  (
    &wild_tail=1
  )

  if ((&wild_head==1)&&(&wild_tail==1))
  (
    if (STRING.SCAN("gcc_blsp2_qup6_i2c_apps_clk", STRING.MID("&clk", 1, &clk_input_length-2), 0)!=-1)
    ( 
      &match=1
    )
  )
  else if (&wild_head==1)
  (
    if (STRING.MID("gcc_blsp2_qup6_i2c_apps_clk", &clk_itr_length-&clk_input_length+1, &clk_input_length-1)==STRING.CUT("&clk", 1))
    ( 
      &match=1
    )
  )
  else if (&wild_tail==1)
  (
    if (STRING.MID("gcc_blsp2_qup6_i2c_apps_clk", 0, &clk_input_length-1)==STRING.CUT("&clk", -1))
    ( 
      &match=1
    )
  )	  
  else if ("gcc_blsp2_qup6_i2c_apps_clk"=="&clk")
  (
    &match=1
  )
  
  if (&match==1)
  (
    &clk_test=&CLK_TEST_GCC_BLSP2_QUP6_I2C_APPS_CLK
    &clk_reg=&HWIO_GCC_BLSP2_QUP6_I2C_APPS_CBCR_ADDR
    &clk_reg_name="GCC_BLSP2_QUP6_I2C_APPS_CBCR"
    &clk_name="gcc_blsp2_qup6_i2c_apps_clk"
    &clk_reg_cbcr_type="sm_cbc"

    gosub Print_Clk_Info_Line
  )
  
  &match=0
  &wild_head=0
  &wild_tail=0
  &clk_input_length=STRING.LENGTH("&clk")
  &clk_itr_length=STRING.LENGTH("gcc_blsp2_qup6_spi_apps_clk")

  if (STRING.SCAN("&clk", "*", 0)==0)
  (
    &wild_head=1
  )
  if (STRING.SCAN("&clk", "*", 1)==(STRING.LENGTH("&clk")-1))
  (
    &wild_tail=1
  )

  if ((&wild_head==1)&&(&wild_tail==1))
  (
    if (STRING.SCAN("gcc_blsp2_qup6_spi_apps_clk", STRING.MID("&clk", 1, &clk_input_length-2), 0)!=-1)
    ( 
      &match=1
    )
  )
  else if (&wild_head==1)
  (
    if (STRING.MID("gcc_blsp2_qup6_spi_apps_clk", &clk_itr_length-&clk_input_length+1, &clk_input_length-1)==STRING.CUT("&clk", 1))
    ( 
      &match=1
    )
  )
  else if (&wild_tail==1)
  (
    if (STRING.MID("gcc_blsp2_qup6_spi_apps_clk", 0, &clk_input_length-1)==STRING.CUT("&clk", -1))
    ( 
      &match=1
    )
  )	  
  else if ("gcc_blsp2_qup6_spi_apps_clk"=="&clk")
  (
    &match=1
  )
  
  if (&match==1)
  (
    &clk_test=&CLK_TEST_GCC_BLSP2_QUP6_SPI_APPS_CLK
    &clk_reg=&HWIO_GCC_BLSP2_QUP6_SPI_APPS_CBCR_ADDR
    &clk_reg_name="GCC_BLSP2_QUP6_SPI_APPS_CBCR"
    &clk_name="gcc_blsp2_qup6_spi_apps_clk"
    &clk_reg_cbcr_type="sm_cbc"

    gosub Print_Clk_Info_Line
  )
  
  &match=0
  &wild_head=0
  &wild_tail=0
  &clk_input_length=STRING.LENGTH("&clk")
  &clk_itr_length=STRING.LENGTH("gcc_blsp2_uart1_apps_clk")

  if (STRING.SCAN("&clk", "*", 0)==0)
  (
    &wild_head=1
  )
  if (STRING.SCAN("&clk", "*", 1)==(STRING.LENGTH("&clk")-1))
  (
    &wild_tail=1
  )

  if ((&wild_head==1)&&(&wild_tail==1))
  (
    if (STRING.SCAN("gcc_blsp2_uart1_apps_clk", STRING.MID("&clk", 1, &clk_input_length-2), 0)!=-1)
    ( 
      &match=1
    )
  )
  else if (&wild_head==1)
  (
    if (STRING.MID("gcc_blsp2_uart1_apps_clk", &clk_itr_length-&clk_input_length+1, &clk_input_length-1)==STRING.CUT("&clk", 1))
    ( 
      &match=1
    )
  )
  else if (&wild_tail==1)
  (
    if (STRING.MID("gcc_blsp2_uart1_apps_clk", 0, &clk_input_length-1)==STRING.CUT("&clk", -1))
    ( 
      &match=1
    )
  )	  
  else if ("gcc_blsp2_uart1_apps_clk"=="&clk")
  (
    &match=1
  )
  
  if (&match==1)
  (
    &clk_test=&CLK_TEST_GCC_BLSP2_UART1_APPS_CLK
    &clk_reg=&HWIO_GCC_BLSP2_UART1_APPS_CBCR_ADDR
    &clk_reg_name="GCC_BLSP2_UART1_APPS_CBCR"
    &clk_name="gcc_blsp2_uart1_apps_clk"
    &clk_reg_cbcr_type="sm_cbc"

    gosub Print_Clk_Info_Line
  )
  
  &match=0
  &wild_head=0
  &wild_tail=0
  &clk_input_length=STRING.LENGTH("&clk")
  &clk_itr_length=STRING.LENGTH("gcc_blsp2_uart1_sim_clk")

  if (STRING.SCAN("&clk", "*", 0)==0)
  (
    &wild_head=1
  )
  if (STRING.SCAN("&clk", "*", 1)==(STRING.LENGTH("&clk")-1))
  (
    &wild_tail=1
  )

  if ((&wild_head==1)&&(&wild_tail==1))
  (
    if (STRING.SCAN("gcc_blsp2_uart1_sim_clk", STRING.MID("&clk", 1, &clk_input_length-2), 0)!=-1)
    ( 
      &match=1
    )
  )
  else if (&wild_head==1)
  (
    if (STRING.MID("gcc_blsp2_uart1_sim_clk", &clk_itr_length-&clk_input_length+1, &clk_input_length-1)==STRING.CUT("&clk", 1))
    ( 
      &match=1
    )
  )
  else if (&wild_tail==1)
  (
    if (STRING.MID("gcc_blsp2_uart1_sim_clk", 0, &clk_input_length-1)==STRING.CUT("&clk", -1))
    ( 
      &match=1
    )
  )	  
  else if ("gcc_blsp2_uart1_sim_clk"=="&clk")
  (
    &match=1
  )
  
  if (&match==1)
  (
    &clk_test=&CLK_TEST_GCC_BLSP2_UART1_SIM_CLK
    &clk_reg=&HWIO_GCC_BLSP2_UART1_SIM_CBCR_ADDR
    &clk_reg_name="GCC_BLSP2_UART1_SIM_CBCR"
    &clk_name="gcc_blsp2_uart1_sim_clk"
    &clk_reg_cbcr_type="sm_cbc"

    gosub Print_Clk_Info_Line
  )
  
  &match=0
  &wild_head=0
  &wild_tail=0
  &clk_input_length=STRING.LENGTH("&clk")
  &clk_itr_length=STRING.LENGTH("gcc_blsp2_uart2_apps_clk")

  if (STRING.SCAN("&clk", "*", 0)==0)
  (
    &wild_head=1
  )
  if (STRING.SCAN("&clk", "*", 1)==(STRING.LENGTH("&clk")-1))
  (
    &wild_tail=1
  )

  if ((&wild_head==1)&&(&wild_tail==1))
  (
    if (STRING.SCAN("gcc_blsp2_uart2_apps_clk", STRING.MID("&clk", 1, &clk_input_length-2), 0)!=-1)
    ( 
      &match=1
    )
  )
  else if (&wild_head==1)
  (
    if (STRING.MID("gcc_blsp2_uart2_apps_clk", &clk_itr_length-&clk_input_length+1, &clk_input_length-1)==STRING.CUT("&clk", 1))
    ( 
      &match=1
    )
  )
  else if (&wild_tail==1)
  (
    if (STRING.MID("gcc_blsp2_uart2_apps_clk", 0, &clk_input_length-1)==STRING.CUT("&clk", -1))
    ( 
      &match=1
    )
  )	  
  else if ("gcc_blsp2_uart2_apps_clk"=="&clk")
  (
    &match=1
  )
  
  if (&match==1)
  (
    &clk_test=&CLK_TEST_GCC_BLSP2_UART2_APPS_CLK
    &clk_reg=&HWIO_GCC_BLSP2_UART2_APPS_CBCR_ADDR
    &clk_reg_name="GCC_BLSP2_UART2_APPS_CBCR"
    &clk_name="gcc_blsp2_uart2_apps_clk"
    &clk_reg_cbcr_type="sm_cbc"

    gosub Print_Clk_Info_Line
  )
  
  &match=0
  &wild_head=0
  &wild_tail=0
  &clk_input_length=STRING.LENGTH("&clk")
  &clk_itr_length=STRING.LENGTH("gcc_blsp2_uart2_sim_clk")

  if (STRING.SCAN("&clk", "*", 0)==0)
  (
    &wild_head=1
  )
  if (STRING.SCAN("&clk", "*", 1)==(STRING.LENGTH("&clk")-1))
  (
    &wild_tail=1
  )

  if ((&wild_head==1)&&(&wild_tail==1))
  (
    if (STRING.SCAN("gcc_blsp2_uart2_sim_clk", STRING.MID("&clk", 1, &clk_input_length-2), 0)!=-1)
    ( 
      &match=1
    )
  )
  else if (&wild_head==1)
  (
    if (STRING.MID("gcc_blsp2_uart2_sim_clk", &clk_itr_length-&clk_input_length+1, &clk_input_length-1)==STRING.CUT("&clk", 1))
    ( 
      &match=1
    )
  )
  else if (&wild_tail==1)
  (
    if (STRING.MID("gcc_blsp2_uart2_sim_clk", 0, &clk_input_length-1)==STRING.CUT("&clk", -1))
    ( 
      &match=1
    )
  )	  
  else if ("gcc_blsp2_uart2_sim_clk"=="&clk")
  (
    &match=1
  )
  
  if (&match==1)
  (
    &clk_test=&CLK_TEST_GCC_BLSP2_UART2_SIM_CLK
    &clk_reg=&HWIO_GCC_BLSP2_UART2_SIM_CBCR_ADDR
    &clk_reg_name="GCC_BLSP2_UART2_SIM_CBCR"
    &clk_name="gcc_blsp2_uart2_sim_clk"
    &clk_reg_cbcr_type="sm_cbc"

    gosub Print_Clk_Info_Line
  )
  
  &match=0
  &wild_head=0
  &wild_tail=0
  &clk_input_length=STRING.LENGTH("&clk")
  &clk_itr_length=STRING.LENGTH("gcc_blsp2_uart3_apps_clk")

  if (STRING.SCAN("&clk", "*", 0)==0)
  (
    &wild_head=1
  )
  if (STRING.SCAN("&clk", "*", 1)==(STRING.LENGTH("&clk")-1))
  (
    &wild_tail=1
  )

  if ((&wild_head==1)&&(&wild_tail==1))
  (
    if (STRING.SCAN("gcc_blsp2_uart3_apps_clk", STRING.MID("&clk", 1, &clk_input_length-2), 0)!=-1)
    ( 
      &match=1
    )
  )
  else if (&wild_head==1)
  (
    if (STRING.MID("gcc_blsp2_uart3_apps_clk", &clk_itr_length-&clk_input_length+1, &clk_input_length-1)==STRING.CUT("&clk", 1))
    ( 
      &match=1
    )
  )
  else if (&wild_tail==1)
  (
    if (STRING.MID("gcc_blsp2_uart3_apps_clk", 0, &clk_input_length-1)==STRING.CUT("&clk", -1))
    ( 
      &match=1
    )
  )	  
  else if ("gcc_blsp2_uart3_apps_clk"=="&clk")
  (
    &match=1
  )
  
  if (&match==1)
  (
    &clk_test=&CLK_TEST_GCC_BLSP2_UART3_APPS_CLK
    &clk_reg=&HWIO_GCC_BLSP2_UART3_APPS_CBCR_ADDR
    &clk_reg_name="GCC_BLSP2_UART3_APPS_CBCR"
    &clk_name="gcc_blsp2_uart3_apps_clk"
    &clk_reg_cbcr_type="sm_cbc"

    gosub Print_Clk_Info_Line
  )
  
  &match=0
  &wild_head=0
  &wild_tail=0
  &clk_input_length=STRING.LENGTH("&clk")
  &clk_itr_length=STRING.LENGTH("gcc_blsp2_uart3_sim_clk")

  if (STRING.SCAN("&clk", "*", 0)==0)
  (
    &wild_head=1
  )
  if (STRING.SCAN("&clk", "*", 1)==(STRING.LENGTH("&clk")-1))
  (
    &wild_tail=1
  )

  if ((&wild_head==1)&&(&wild_tail==1))
  (
    if (STRING.SCAN("gcc_blsp2_uart3_sim_clk", STRING.MID("&clk", 1, &clk_input_length-2), 0)!=-1)
    ( 
      &match=1
    )
  )
  else if (&wild_head==1)
  (
    if (STRING.MID("gcc_blsp2_uart3_sim_clk", &clk_itr_length-&clk_input_length+1, &clk_input_length-1)==STRING.CUT("&clk", 1))
    ( 
      &match=1
    )
  )
  else if (&wild_tail==1)
  (
    if (STRING.MID("gcc_blsp2_uart3_sim_clk", 0, &clk_input_length-1)==STRING.CUT("&clk", -1))
    ( 
      &match=1
    )
  )	  
  else if ("gcc_blsp2_uart3_sim_clk"=="&clk")
  (
    &match=1
  )
  
  if (&match==1)
  (
    &clk_test=&CLK_TEST_GCC_BLSP2_UART3_SIM_CLK
    &clk_reg=&HWIO_GCC_BLSP2_UART3_SIM_CBCR_ADDR
    &clk_reg_name="GCC_BLSP2_UART3_SIM_CBCR"
    &clk_name="gcc_blsp2_uart3_sim_clk"
    &clk_reg_cbcr_type="sm_cbc"

    gosub Print_Clk_Info_Line
  )
  
  &match=0
  &wild_head=0
  &wild_tail=0
  &clk_input_length=STRING.LENGTH("&clk")
  &clk_itr_length=STRING.LENGTH("gcc_blsp2_uart4_apps_clk")

  if (STRING.SCAN("&clk", "*", 0)==0)
  (
    &wild_head=1
  )
  if (STRING.SCAN("&clk", "*", 1)==(STRING.LENGTH("&clk")-1))
  (
    &wild_tail=1
  )

  if ((&wild_head==1)&&(&wild_tail==1))
  (
    if (STRING.SCAN("gcc_blsp2_uart4_apps_clk", STRING.MID("&clk", 1, &clk_input_length-2), 0)!=-1)
    ( 
      &match=1
    )
  )
  else if (&wild_head==1)
  (
    if (STRING.MID("gcc_blsp2_uart4_apps_clk", &clk_itr_length-&clk_input_length+1, &clk_input_length-1)==STRING.CUT("&clk", 1))
    ( 
      &match=1
    )
  )
  else if (&wild_tail==1)
  (
    if (STRING.MID("gcc_blsp2_uart4_apps_clk", 0, &clk_input_length-1)==STRING.CUT("&clk", -1))
    ( 
      &match=1
    )
  )	  
  else if ("gcc_blsp2_uart4_apps_clk"=="&clk")
  (
    &match=1
  )
  
  if (&match==1)
  (
    &clk_test=&CLK_TEST_GCC_BLSP2_UART4_APPS_CLK
    &clk_reg=&HWIO_GCC_BLSP2_UART4_APPS_CBCR_ADDR
    &clk_reg_name="GCC_BLSP2_UART4_APPS_CBCR"
    &clk_name="gcc_blsp2_uart4_apps_clk"
    &clk_reg_cbcr_type="sm_cbc"

    gosub Print_Clk_Info_Line
  )
  
  &match=0
  &wild_head=0
  &wild_tail=0
  &clk_input_length=STRING.LENGTH("&clk")
  &clk_itr_length=STRING.LENGTH("gcc_blsp2_uart4_sim_clk")

  if (STRING.SCAN("&clk", "*", 0)==0)
  (
    &wild_head=1
  )
  if (STRING.SCAN("&clk", "*", 1)==(STRING.LENGTH("&clk")-1))
  (
    &wild_tail=1
  )

  if ((&wild_head==1)&&(&wild_tail==1))
  (
    if (STRING.SCAN("gcc_blsp2_uart4_sim_clk", STRING.MID("&clk", 1, &clk_input_length-2), 0)!=-1)
    ( 
      &match=1
    )
  )
  else if (&wild_head==1)
  (
    if (STRING.MID("gcc_blsp2_uart4_sim_clk", &clk_itr_length-&clk_input_length+1, &clk_input_length-1)==STRING.CUT("&clk", 1))
    ( 
      &match=1
    )
  )
  else if (&wild_tail==1)
  (
    if (STRING.MID("gcc_blsp2_uart4_sim_clk", 0, &clk_input_length-1)==STRING.CUT("&clk", -1))
    ( 
      &match=1
    )
  )	  
  else if ("gcc_blsp2_uart4_sim_clk"=="&clk")
  (
    &match=1
  )
  
  if (&match==1)
  (
    &clk_test=&CLK_TEST_GCC_BLSP2_UART4_SIM_CLK
    &clk_reg=&HWIO_GCC_BLSP2_UART4_SIM_CBCR_ADDR
    &clk_reg_name="GCC_BLSP2_UART4_SIM_CBCR"
    &clk_name="gcc_blsp2_uart4_sim_clk"
    &clk_reg_cbcr_type="sm_cbc"

    gosub Print_Clk_Info_Line
  )
  
  &match=0
  &wild_head=0
  &wild_tail=0
  &clk_input_length=STRING.LENGTH("&clk")
  &clk_itr_length=STRING.LENGTH("gcc_blsp2_uart5_apps_clk")

  if (STRING.SCAN("&clk", "*", 0)==0)
  (
    &wild_head=1
  )
  if (STRING.SCAN("&clk", "*", 1)==(STRING.LENGTH("&clk")-1))
  (
    &wild_tail=1
  )

  if ((&wild_head==1)&&(&wild_tail==1))
  (
    if (STRING.SCAN("gcc_blsp2_uart5_apps_clk", STRING.MID("&clk", 1, &clk_input_length-2), 0)!=-1)
    ( 
      &match=1
    )
  )
  else if (&wild_head==1)
  (
    if (STRING.MID("gcc_blsp2_uart5_apps_clk", &clk_itr_length-&clk_input_length+1, &clk_input_length-1)==STRING.CUT("&clk", 1))
    ( 
      &match=1
    )
  )
  else if (&wild_tail==1)
  (
    if (STRING.MID("gcc_blsp2_uart5_apps_clk", 0, &clk_input_length-1)==STRING.CUT("&clk", -1))
    ( 
      &match=1
    )
  )	  
  else if ("gcc_blsp2_uart5_apps_clk"=="&clk")
  (
    &match=1
  )
  
  if (&match==1)
  (
    &clk_test=&CLK_TEST_GCC_BLSP2_UART5_APPS_CLK
    &clk_reg=&HWIO_GCC_BLSP2_UART5_APPS_CBCR_ADDR
    &clk_reg_name="GCC_BLSP2_UART5_APPS_CBCR"
    &clk_name="gcc_blsp2_uart5_apps_clk"
    &clk_reg_cbcr_type="sm_cbc"

    gosub Print_Clk_Info_Line
  )
  
  &match=0
  &wild_head=0
  &wild_tail=0
  &clk_input_length=STRING.LENGTH("&clk")
  &clk_itr_length=STRING.LENGTH("gcc_blsp2_uart5_sim_clk")

  if (STRING.SCAN("&clk", "*", 0)==0)
  (
    &wild_head=1
  )
  if (STRING.SCAN("&clk", "*", 1)==(STRING.LENGTH("&clk")-1))
  (
    &wild_tail=1
  )

  if ((&wild_head==1)&&(&wild_tail==1))
  (
    if (STRING.SCAN("gcc_blsp2_uart5_sim_clk", STRING.MID("&clk", 1, &clk_input_length-2), 0)!=-1)
    ( 
      &match=1
    )
  )
  else if (&wild_head==1)
  (
    if (STRING.MID("gcc_blsp2_uart5_sim_clk", &clk_itr_length-&clk_input_length+1, &clk_input_length-1)==STRING.CUT("&clk", 1))
    ( 
      &match=1
    )
  )
  else if (&wild_tail==1)
  (
    if (STRING.MID("gcc_blsp2_uart5_sim_clk", 0, &clk_input_length-1)==STRING.CUT("&clk", -1))
    ( 
      &match=1
    )
  )	  
  else if ("gcc_blsp2_uart5_sim_clk"=="&clk")
  (
    &match=1
  )
  
  if (&match==1)
  (
    &clk_test=&CLK_TEST_GCC_BLSP2_UART5_SIM_CLK
    &clk_reg=&HWIO_GCC_BLSP2_UART5_SIM_CBCR_ADDR
    &clk_reg_name="GCC_BLSP2_UART5_SIM_CBCR"
    &clk_name="gcc_blsp2_uart5_sim_clk"
    &clk_reg_cbcr_type="sm_cbc"

    gosub Print_Clk_Info_Line
  )
  
  &match=0
  &wild_head=0
  &wild_tail=0
  &clk_input_length=STRING.LENGTH("&clk")
  &clk_itr_length=STRING.LENGTH("gcc_blsp2_uart6_apps_clk")

  if (STRING.SCAN("&clk", "*", 0)==0)
  (
    &wild_head=1
  )
  if (STRING.SCAN("&clk", "*", 1)==(STRING.LENGTH("&clk")-1))
  (
    &wild_tail=1
  )

  if ((&wild_head==1)&&(&wild_tail==1))
  (
    if (STRING.SCAN("gcc_blsp2_uart6_apps_clk", STRING.MID("&clk", 1, &clk_input_length-2), 0)!=-1)
    ( 
      &match=1
    )
  )
  else if (&wild_head==1)
  (
    if (STRING.MID("gcc_blsp2_uart6_apps_clk", &clk_itr_length-&clk_input_length+1, &clk_input_length-1)==STRING.CUT("&clk", 1))
    ( 
      &match=1
    )
  )
  else if (&wild_tail==1)
  (
    if (STRING.MID("gcc_blsp2_uart6_apps_clk", 0, &clk_input_length-1)==STRING.CUT("&clk", -1))
    ( 
      &match=1
    )
  )	  
  else if ("gcc_blsp2_uart6_apps_clk"=="&clk")
  (
    &match=1
  )
  
  if (&match==1)
  (
    &clk_test=&CLK_TEST_GCC_BLSP2_UART6_APPS_CLK
    &clk_reg=&HWIO_GCC_BLSP2_UART6_APPS_CBCR_ADDR
    &clk_reg_name="GCC_BLSP2_UART6_APPS_CBCR"
    &clk_name="gcc_blsp2_uart6_apps_clk"
    &clk_reg_cbcr_type="sm_cbc"

    gosub Print_Clk_Info_Line
  )
  
  &match=0
  &wild_head=0
  &wild_tail=0
  &clk_input_length=STRING.LENGTH("&clk")
  &clk_itr_length=STRING.LENGTH("gcc_blsp2_uart6_sim_clk")

  if (STRING.SCAN("&clk", "*", 0)==0)
  (
    &wild_head=1
  )
  if (STRING.SCAN("&clk", "*", 1)==(STRING.LENGTH("&clk")-1))
  (
    &wild_tail=1
  )

  if ((&wild_head==1)&&(&wild_tail==1))
  (
    if (STRING.SCAN("gcc_blsp2_uart6_sim_clk", STRING.MID("&clk", 1, &clk_input_length-2), 0)!=-1)
    ( 
      &match=1
    )
  )
  else if (&wild_head==1)
  (
    if (STRING.MID("gcc_blsp2_uart6_sim_clk", &clk_itr_length-&clk_input_length+1, &clk_input_length-1)==STRING.CUT("&clk", 1))
    ( 
      &match=1
    )
  )
  else if (&wild_tail==1)
  (
    if (STRING.MID("gcc_blsp2_uart6_sim_clk", 0, &clk_input_length-1)==STRING.CUT("&clk", -1))
    ( 
      &match=1
    )
  )	  
  else if ("gcc_blsp2_uart6_sim_clk"=="&clk")
  (
    &match=1
  )
  
  if (&match==1)
  (
    &clk_test=&CLK_TEST_GCC_BLSP2_UART6_SIM_CLK
    &clk_reg=&HWIO_GCC_BLSP2_UART6_SIM_CBCR_ADDR
    &clk_reg_name="GCC_BLSP2_UART6_SIM_CBCR"
    &clk_name="gcc_blsp2_uart6_sim_clk"
    &clk_reg_cbcr_type="sm_cbc"

    gosub Print_Clk_Info_Line
  )
  
  &match=0
  &wild_head=0
  &wild_tail=0
  &clk_input_length=STRING.LENGTH("&clk")
  &clk_itr_length=STRING.LENGTH("gcc_boot_rom_ahb_clk")

  if (STRING.SCAN("&clk", "*", 0)==0)
  (
    &wild_head=1
  )
  if (STRING.SCAN("&clk", "*", 1)==(STRING.LENGTH("&clk")-1))
  (
    &wild_tail=1
  )

  if ((&wild_head==1)&&(&wild_tail==1))
  (
    if (STRING.SCAN("gcc_boot_rom_ahb_clk", STRING.MID("&clk", 1, &clk_input_length-2), 0)!=-1)
    ( 
      &match=1
    )
  )
  else if (&wild_head==1)
  (
    if (STRING.MID("gcc_boot_rom_ahb_clk", &clk_itr_length-&clk_input_length+1, &clk_input_length-1)==STRING.CUT("&clk", 1))
    ( 
      &match=1
    )
  )
  else if (&wild_tail==1)
  (
    if (STRING.MID("gcc_boot_rom_ahb_clk", 0, &clk_input_length-1)==STRING.CUT("&clk", -1))
    ( 
      &match=1
    )
  )	  
  else if ("gcc_boot_rom_ahb_clk"=="&clk")
  (
    &match=1
  )
  
  if (&match==1)
  (
    &clk_test=&CLK_TEST_GCC_BOOT_ROM_AHB_CLK
    &clk_reg=&HWIO_GCC_BOOT_ROM_AHB_CBCR_ADDR
    &clk_reg_name="GCC_BOOT_ROM_AHB_CBCR"
    &clk_name="gcc_boot_rom_ahb_clk"
    &clk_reg_cbcr_type="sm_pscbc"

    gosub Print_Clk_Info_Line
  )
  
  &match=0
  &wild_head=0
  &wild_tail=0
  &clk_input_length=STRING.LENGTH("&clk")
  &clk_itr_length=STRING.LENGTH("gcc_ce1_ahb_clk")

  if (STRING.SCAN("&clk", "*", 0)==0)
  (
    &wild_head=1
  )
  if (STRING.SCAN("&clk", "*", 1)==(STRING.LENGTH("&clk")-1))
  (
    &wild_tail=1
  )

  if ((&wild_head==1)&&(&wild_tail==1))
  (
    if (STRING.SCAN("gcc_ce1_ahb_clk", STRING.MID("&clk", 1, &clk_input_length-2), 0)!=-1)
    ( 
      &match=1
    )
  )
  else if (&wild_head==1)
  (
    if (STRING.MID("gcc_ce1_ahb_clk", &clk_itr_length-&clk_input_length+1, &clk_input_length-1)==STRING.CUT("&clk", 1))
    ( 
      &match=1
    )
  )
  else if (&wild_tail==1)
  (
    if (STRING.MID("gcc_ce1_ahb_clk", 0, &clk_input_length-1)==STRING.CUT("&clk", -1))
    ( 
      &match=1
    )
  )	  
  else if ("gcc_ce1_ahb_clk"=="&clk")
  (
    &match=1
  )
  
  if (&match==1)
  (
    &clk_test=&CLK_TEST_GCC_CE1_AHB_CLK
    &clk_reg=&HWIO_GCC_CE1_AHB_CBCR_ADDR
    &clk_reg_name="GCC_CE1_AHB_CBCR"
    &clk_name="gcc_ce1_ahb_clk"
    &clk_reg_cbcr_type="sm_cbc"

    gosub Print_Clk_Info_Line
  )
  
  &match=0
  &wild_head=0
  &wild_tail=0
  &clk_input_length=STRING.LENGTH("&clk")
  &clk_itr_length=STRING.LENGTH("gcc_ce1_axi_clk")

  if (STRING.SCAN("&clk", "*", 0)==0)
  (
    &wild_head=1
  )
  if (STRING.SCAN("&clk", "*", 1)==(STRING.LENGTH("&clk")-1))
  (
    &wild_tail=1
  )

  if ((&wild_head==1)&&(&wild_tail==1))
  (
    if (STRING.SCAN("gcc_ce1_axi_clk", STRING.MID("&clk", 1, &clk_input_length-2), 0)!=-1)
    ( 
      &match=1
    )
  )
  else if (&wild_head==1)
  (
    if (STRING.MID("gcc_ce1_axi_clk", &clk_itr_length-&clk_input_length+1, &clk_input_length-1)==STRING.CUT("&clk", 1))
    ( 
      &match=1
    )
  )
  else if (&wild_tail==1)
  (
    if (STRING.MID("gcc_ce1_axi_clk", 0, &clk_input_length-1)==STRING.CUT("&clk", -1))
    ( 
      &match=1
    )
  )	  
  else if ("gcc_ce1_axi_clk"=="&clk")
  (
    &match=1
  )
  
  if (&match==1)
  (
    &clk_test=&CLK_TEST_GCC_CE1_AXI_CLK
    &clk_reg=&HWIO_GCC_CE1_AXI_CBCR_ADDR
    &clk_reg_name="GCC_CE1_AXI_CBCR"
    &clk_name="gcc_ce1_axi_clk"
    &clk_reg_cbcr_type="sm_cbc"

    gosub Print_Clk_Info_Line
  )
  
  &match=0
  &wild_head=0
  &wild_tail=0
  &clk_input_length=STRING.LENGTH("&clk")
  &clk_itr_length=STRING.LENGTH("gcc_ce1_clk")

  if (STRING.SCAN("&clk", "*", 0)==0)
  (
    &wild_head=1
  )
  if (STRING.SCAN("&clk", "*", 1)==(STRING.LENGTH("&clk")-1))
  (
    &wild_tail=1
  )

  if ((&wild_head==1)&&(&wild_tail==1))
  (
    if (STRING.SCAN("gcc_ce1_clk", STRING.MID("&clk", 1, &clk_input_length-2), 0)!=-1)
    ( 
      &match=1
    )
  )
  else if (&wild_head==1)
  (
    if (STRING.MID("gcc_ce1_clk", &clk_itr_length-&clk_input_length+1, &clk_input_length-1)==STRING.CUT("&clk", 1))
    ( 
      &match=1
    )
  )
  else if (&wild_tail==1)
  (
    if (STRING.MID("gcc_ce1_clk", 0, &clk_input_length-1)==STRING.CUT("&clk", -1))
    ( 
      &match=1
    )
  )	  
  else if ("gcc_ce1_clk"=="&clk")
  (
    &match=1
  )
  
  if (&match==1)
  (
    &clk_test=&CLK_TEST_GCC_CE1_CLK
    &clk_reg=&HWIO_GCC_CE1_CBCR_ADDR
    &clk_reg_name="GCC_CE1_CBCR"
    &clk_name="gcc_ce1_clk"
    &clk_reg_cbcr_type="sm_pscbc"

    gosub Print_Clk_Info_Line
  )
  
  &match=0
  &wild_head=0
  &wild_tail=0
  &clk_input_length=STRING.LENGTH("&clk")
  &clk_itr_length=STRING.LENGTH("gcc_ce2_ahb_clk")

  if (STRING.SCAN("&clk", "*", 0)==0)
  (
    &wild_head=1
  )
  if (STRING.SCAN("&clk", "*", 1)==(STRING.LENGTH("&clk")-1))
  (
    &wild_tail=1
  )

  if ((&wild_head==1)&&(&wild_tail==1))
  (
    if (STRING.SCAN("gcc_ce2_ahb_clk", STRING.MID("&clk", 1, &clk_input_length-2), 0)!=-1)
    ( 
      &match=1
    )
  )
  else if (&wild_head==1)
  (
    if (STRING.MID("gcc_ce2_ahb_clk", &clk_itr_length-&clk_input_length+1, &clk_input_length-1)==STRING.CUT("&clk", 1))
    ( 
      &match=1
    )
  )
  else if (&wild_tail==1)
  (
    if (STRING.MID("gcc_ce2_ahb_clk", 0, &clk_input_length-1)==STRING.CUT("&clk", -1))
    ( 
      &match=1
    )
  )	  
  else if ("gcc_ce2_ahb_clk"=="&clk")
  (
    &match=1
  )
  
  if (&match==1)
  (
    &clk_test=&CLK_TEST_GCC_CE2_AHB_CLK
    &clk_reg=&HWIO_GCC_CE2_AHB_CBCR_ADDR
    &clk_reg_name="GCC_CE2_AHB_CBCR"
    &clk_name="gcc_ce2_ahb_clk"
    &clk_reg_cbcr_type="sm_cbc"

    gosub Print_Clk_Info_Line
  )
  
  &match=0
  &wild_head=0
  &wild_tail=0
  &clk_input_length=STRING.LENGTH("&clk")
  &clk_itr_length=STRING.LENGTH("gcc_ce2_axi_clk")

  if (STRING.SCAN("&clk", "*", 0)==0)
  (
    &wild_head=1
  )
  if (STRING.SCAN("&clk", "*", 1)==(STRING.LENGTH("&clk")-1))
  (
    &wild_tail=1
  )

  if ((&wild_head==1)&&(&wild_tail==1))
  (
    if (STRING.SCAN("gcc_ce2_axi_clk", STRING.MID("&clk", 1, &clk_input_length-2), 0)!=-1)
    ( 
      &match=1
    )
  )
  else if (&wild_head==1)
  (
    if (STRING.MID("gcc_ce2_axi_clk", &clk_itr_length-&clk_input_length+1, &clk_input_length-1)==STRING.CUT("&clk", 1))
    ( 
      &match=1
    )
  )
  else if (&wild_tail==1)
  (
    if (STRING.MID("gcc_ce2_axi_clk", 0, &clk_input_length-1)==STRING.CUT("&clk", -1))
    ( 
      &match=1
    )
  )	  
  else if ("gcc_ce2_axi_clk"=="&clk")
  (
    &match=1
  )
  
  if (&match==1)
  (
    &clk_test=&CLK_TEST_GCC_CE2_AXI_CLK
    &clk_reg=&HWIO_GCC_CE2_AXI_CBCR_ADDR
    &clk_reg_name="GCC_CE2_AXI_CBCR"
    &clk_name="gcc_ce2_axi_clk"
    &clk_reg_cbcr_type="sm_cbc"

    gosub Print_Clk_Info_Line
  )
  
  &match=0
  &wild_head=0
  &wild_tail=0
  &clk_input_length=STRING.LENGTH("&clk")
  &clk_itr_length=STRING.LENGTH("gcc_ce2_clk")

  if (STRING.SCAN("&clk", "*", 0)==0)
  (
    &wild_head=1
  )
  if (STRING.SCAN("&clk", "*", 1)==(STRING.LENGTH("&clk")-1))
  (
    &wild_tail=1
  )

  if ((&wild_head==1)&&(&wild_tail==1))
  (
    if (STRING.SCAN("gcc_ce2_clk", STRING.MID("&clk", 1, &clk_input_length-2), 0)!=-1)
    ( 
      &match=1
    )
  )
  else if (&wild_head==1)
  (
    if (STRING.MID("gcc_ce2_clk", &clk_itr_length-&clk_input_length+1, &clk_input_length-1)==STRING.CUT("&clk", 1))
    ( 
      &match=1
    )
  )
  else if (&wild_tail==1)
  (
    if (STRING.MID("gcc_ce2_clk", 0, &clk_input_length-1)==STRING.CUT("&clk", -1))
    ( 
      &match=1
    )
  )	  
  else if ("gcc_ce2_clk"=="&clk")
  (
    &match=1
  )
  
  if (&match==1)
  (
    &clk_test=&CLK_TEST_GCC_CE2_CLK
    &clk_reg=&HWIO_GCC_CE2_CBCR_ADDR
    &clk_reg_name="GCC_CE2_CBCR"
    &clk_name="gcc_ce2_clk"
    &clk_reg_cbcr_type="sm_pscbc"

    gosub Print_Clk_Info_Line
  )
  
  &match=0
  &wild_head=0
  &wild_tail=0
  &clk_input_length=STRING.LENGTH("&clk")
  &clk_itr_length=STRING.LENGTH("gcc_ce3_ahb_clk")

  if (STRING.SCAN("&clk", "*", 0)==0)
  (
    &wild_head=1
  )
  if (STRING.SCAN("&clk", "*", 1)==(STRING.LENGTH("&clk")-1))
  (
    &wild_tail=1
  )

  if ((&wild_head==1)&&(&wild_tail==1))
  (
    if (STRING.SCAN("gcc_ce3_ahb_clk", STRING.MID("&clk", 1, &clk_input_length-2), 0)!=-1)
    ( 
      &match=1
    )
  )
  else if (&wild_head==1)
  (
    if (STRING.MID("gcc_ce3_ahb_clk", &clk_itr_length-&clk_input_length+1, &clk_input_length-1)==STRING.CUT("&clk", 1))
    ( 
      &match=1
    )
  )
  else if (&wild_tail==1)
  (
    if (STRING.MID("gcc_ce3_ahb_clk", 0, &clk_input_length-1)==STRING.CUT("&clk", -1))
    ( 
      &match=1
    )
  )	  
  else if ("gcc_ce3_ahb_clk"=="&clk")
  (
    &match=1
  )
  
  if (&match==1)
  (
    &clk_test=&CLK_TEST_GCC_CE3_AHB_CLK
    &clk_reg=&HWIO_GCC_CE3_AHB_CBCR_ADDR
    &clk_reg_name="GCC_CE3_AHB_CBCR"
    &clk_name="gcc_ce3_ahb_clk"
    &clk_reg_cbcr_type="sm_cbc"

    gosub Print_Clk_Info_Line
  )
  
  &match=0
  &wild_head=0
  &wild_tail=0
  &clk_input_length=STRING.LENGTH("&clk")
  &clk_itr_length=STRING.LENGTH("gcc_ce3_axi_clk")

  if (STRING.SCAN("&clk", "*", 0)==0)
  (
    &wild_head=1
  )
  if (STRING.SCAN("&clk", "*", 1)==(STRING.LENGTH("&clk")-1))
  (
    &wild_tail=1
  )

  if ((&wild_head==1)&&(&wild_tail==1))
  (
    if (STRING.SCAN("gcc_ce3_axi_clk", STRING.MID("&clk", 1, &clk_input_length-2), 0)!=-1)
    ( 
      &match=1
    )
  )
  else if (&wild_head==1)
  (
    if (STRING.MID("gcc_ce3_axi_clk", &clk_itr_length-&clk_input_length+1, &clk_input_length-1)==STRING.CUT("&clk", 1))
    ( 
      &match=1
    )
  )
  else if (&wild_tail==1)
  (
    if (STRING.MID("gcc_ce3_axi_clk", 0, &clk_input_length-1)==STRING.CUT("&clk", -1))
    ( 
      &match=1
    )
  )	  
  else if ("gcc_ce3_axi_clk"=="&clk")
  (
    &match=1
  )
  
  if (&match==1)
  (
    &clk_test=&CLK_TEST_GCC_CE3_AXI_CLK
    &clk_reg=&HWIO_GCC_CE3_AXI_CBCR_ADDR
    &clk_reg_name="GCC_CE3_AXI_CBCR"
    &clk_name="gcc_ce3_axi_clk"
    &clk_reg_cbcr_type="sm_cbc"

    gosub Print_Clk_Info_Line
  )
  
  &match=0
  &wild_head=0
  &wild_tail=0
  &clk_input_length=STRING.LENGTH("&clk")
  &clk_itr_length=STRING.LENGTH("gcc_ce3_clk")

  if (STRING.SCAN("&clk", "*", 0)==0)
  (
    &wild_head=1
  )
  if (STRING.SCAN("&clk", "*", 1)==(STRING.LENGTH("&clk")-1))
  (
    &wild_tail=1
  )

  if ((&wild_head==1)&&(&wild_tail==1))
  (
    if (STRING.SCAN("gcc_ce3_clk", STRING.MID("&clk", 1, &clk_input_length-2), 0)!=-1)
    ( 
      &match=1
    )
  )
  else if (&wild_head==1)
  (
    if (STRING.MID("gcc_ce3_clk", &clk_itr_length-&clk_input_length+1, &clk_input_length-1)==STRING.CUT("&clk", 1))
    ( 
      &match=1
    )
  )
  else if (&wild_tail==1)
  (
    if (STRING.MID("gcc_ce3_clk", 0, &clk_input_length-1)==STRING.CUT("&clk", -1))
    ( 
      &match=1
    )
  )	  
  else if ("gcc_ce3_clk"=="&clk")
  (
    &match=1
  )
  
  if (&match==1)
  (
    &clk_test=&CLK_TEST_GCC_CE3_CLK
    &clk_reg=&HWIO_GCC_CE3_CBCR_ADDR
    &clk_reg_name="GCC_CE3_CBCR"
    &clk_name="gcc_ce3_clk"
    &clk_reg_cbcr_type="sm_pscbc"

    gosub Print_Clk_Info_Line
  )
  
  &match=0
  &wild_head=0
  &wild_tail=0
  &clk_input_length=STRING.LENGTH("&clk")
  &clk_itr_length=STRING.LENGTH("gcc_cnoc_bus_timeout0_ahb_clk")

  if (STRING.SCAN("&clk", "*", 0)==0)
  (
    &wild_head=1
  )
  if (STRING.SCAN("&clk", "*", 1)==(STRING.LENGTH("&clk")-1))
  (
    &wild_tail=1
  )

  if ((&wild_head==1)&&(&wild_tail==1))
  (
    if (STRING.SCAN("gcc_cnoc_bus_timeout0_ahb_clk", STRING.MID("&clk", 1, &clk_input_length-2), 0)!=-1)
    ( 
      &match=1
    )
  )
  else if (&wild_head==1)
  (
    if (STRING.MID("gcc_cnoc_bus_timeout0_ahb_clk", &clk_itr_length-&clk_input_length+1, &clk_input_length-1)==STRING.CUT("&clk", 1))
    ( 
      &match=1
    )
  )
  else if (&wild_tail==1)
  (
    if (STRING.MID("gcc_cnoc_bus_timeout0_ahb_clk", 0, &clk_input_length-1)==STRING.CUT("&clk", -1))
    ( 
      &match=1
    )
  )	  
  else if ("gcc_cnoc_bus_timeout0_ahb_clk"=="&clk")
  (
    &match=1
  )
  
  if (&match==1)
  (
    &clk_test=&CLK_TEST_GCC_CNOC_BUS_TIMEOUT0_AHB_CLK
    &clk_reg=&HWIO_GCC_CNOC_BUS_TIMEOUT0_AHB_CBCR_ADDR
    &clk_reg_name="GCC_CNOC_BUS_TIMEOUT0_AHB_CBCR"
    &clk_name="gcc_cnoc_bus_timeout0_ahb_clk"
    &clk_reg_cbcr_type="sm_cbc"

    gosub Print_Clk_Info_Line
  )
  
  &match=0
  &wild_head=0
  &wild_tail=0
  &clk_input_length=STRING.LENGTH("&clk")
  &clk_itr_length=STRING.LENGTH("gcc_cnoc_bus_timeout1_ahb_clk")

  if (STRING.SCAN("&clk", "*", 0)==0)
  (
    &wild_head=1
  )
  if (STRING.SCAN("&clk", "*", 1)==(STRING.LENGTH("&clk")-1))
  (
    &wild_tail=1
  )

  if ((&wild_head==1)&&(&wild_tail==1))
  (
    if (STRING.SCAN("gcc_cnoc_bus_timeout1_ahb_clk", STRING.MID("&clk", 1, &clk_input_length-2), 0)!=-1)
    ( 
      &match=1
    )
  )
  else if (&wild_head==1)
  (
    if (STRING.MID("gcc_cnoc_bus_timeout1_ahb_clk", &clk_itr_length-&clk_input_length+1, &clk_input_length-1)==STRING.CUT("&clk", 1))
    ( 
      &match=1
    )
  )
  else if (&wild_tail==1)
  (
    if (STRING.MID("gcc_cnoc_bus_timeout1_ahb_clk", 0, &clk_input_length-1)==STRING.CUT("&clk", -1))
    ( 
      &match=1
    )
  )	  
  else if ("gcc_cnoc_bus_timeout1_ahb_clk"=="&clk")
  (
    &match=1
  )
  
  if (&match==1)
  (
    &clk_test=&CLK_TEST_GCC_CNOC_BUS_TIMEOUT1_AHB_CLK
    &clk_reg=&HWIO_GCC_CNOC_BUS_TIMEOUT1_AHB_CBCR_ADDR
    &clk_reg_name="GCC_CNOC_BUS_TIMEOUT1_AHB_CBCR"
    &clk_name="gcc_cnoc_bus_timeout1_ahb_clk"
    &clk_reg_cbcr_type="sm_cbc"

    gosub Print_Clk_Info_Line
  )
  
  &match=0
  &wild_head=0
  &wild_tail=0
  &clk_input_length=STRING.LENGTH("&clk")
  &clk_itr_length=STRING.LENGTH("gcc_cnoc_bus_timeout2_ahb_clk")

  if (STRING.SCAN("&clk", "*", 0)==0)
  (
    &wild_head=1
  )
  if (STRING.SCAN("&clk", "*", 1)==(STRING.LENGTH("&clk")-1))
  (
    &wild_tail=1
  )

  if ((&wild_head==1)&&(&wild_tail==1))
  (
    if (STRING.SCAN("gcc_cnoc_bus_timeout2_ahb_clk", STRING.MID("&clk", 1, &clk_input_length-2), 0)!=-1)
    ( 
      &match=1
    )
  )
  else if (&wild_head==1)
  (
    if (STRING.MID("gcc_cnoc_bus_timeout2_ahb_clk", &clk_itr_length-&clk_input_length+1, &clk_input_length-1)==STRING.CUT("&clk", 1))
    ( 
      &match=1
    )
  )
  else if (&wild_tail==1)
  (
    if (STRING.MID("gcc_cnoc_bus_timeout2_ahb_clk", 0, &clk_input_length-1)==STRING.CUT("&clk", -1))
    ( 
      &match=1
    )
  )	  
  else if ("gcc_cnoc_bus_timeout2_ahb_clk"=="&clk")
  (
    &match=1
  )
  
  if (&match==1)
  (
    &clk_test=&CLK_TEST_GCC_CNOC_BUS_TIMEOUT2_AHB_CLK
    &clk_reg=&HWIO_GCC_CNOC_BUS_TIMEOUT2_AHB_CBCR_ADDR
    &clk_reg_name="GCC_CNOC_BUS_TIMEOUT2_AHB_CBCR"
    &clk_name="gcc_cnoc_bus_timeout2_ahb_clk"
    &clk_reg_cbcr_type="sm_cbc"

    gosub Print_Clk_Info_Line
  )
  
  &match=0
  &wild_head=0
  &wild_tail=0
  &clk_input_length=STRING.LENGTH("&clk")
  &clk_itr_length=STRING.LENGTH("gcc_cnoc_bus_timeout3_ahb_clk")

  if (STRING.SCAN("&clk", "*", 0)==0)
  (
    &wild_head=1
  )
  if (STRING.SCAN("&clk", "*", 1)==(STRING.LENGTH("&clk")-1))
  (
    &wild_tail=1
  )

  if ((&wild_head==1)&&(&wild_tail==1))
  (
    if (STRING.SCAN("gcc_cnoc_bus_timeout3_ahb_clk", STRING.MID("&clk", 1, &clk_input_length-2), 0)!=-1)
    ( 
      &match=1
    )
  )
  else if (&wild_head==1)
  (
    if (STRING.MID("gcc_cnoc_bus_timeout3_ahb_clk", &clk_itr_length-&clk_input_length+1, &clk_input_length-1)==STRING.CUT("&clk", 1))
    ( 
      &match=1
    )
  )
  else if (&wild_tail==1)
  (
    if (STRING.MID("gcc_cnoc_bus_timeout3_ahb_clk", 0, &clk_input_length-1)==STRING.CUT("&clk", -1))
    ( 
      &match=1
    )
  )	  
  else if ("gcc_cnoc_bus_timeout3_ahb_clk"=="&clk")
  (
    &match=1
  )
  
  if (&match==1)
  (
    &clk_test=&CLK_TEST_GCC_CNOC_BUS_TIMEOUT3_AHB_CLK
    &clk_reg=&HWIO_GCC_CNOC_BUS_TIMEOUT3_AHB_CBCR_ADDR
    &clk_reg_name="GCC_CNOC_BUS_TIMEOUT3_AHB_CBCR"
    &clk_name="gcc_cnoc_bus_timeout3_ahb_clk"
    &clk_reg_cbcr_type="sm_cbc"

    gosub Print_Clk_Info_Line
  )
  
  &match=0
  &wild_head=0
  &wild_tail=0
  &clk_input_length=STRING.LENGTH("&clk")
  &clk_itr_length=STRING.LENGTH("gcc_cnoc_bus_timeout4_ahb_clk")

  if (STRING.SCAN("&clk", "*", 0)==0)
  (
    &wild_head=1
  )
  if (STRING.SCAN("&clk", "*", 1)==(STRING.LENGTH("&clk")-1))
  (
    &wild_tail=1
  )

  if ((&wild_head==1)&&(&wild_tail==1))
  (
    if (STRING.SCAN("gcc_cnoc_bus_timeout4_ahb_clk", STRING.MID("&clk", 1, &clk_input_length-2), 0)!=-1)
    ( 
      &match=1
    )
  )
  else if (&wild_head==1)
  (
    if (STRING.MID("gcc_cnoc_bus_timeout4_ahb_clk", &clk_itr_length-&clk_input_length+1, &clk_input_length-1)==STRING.CUT("&clk", 1))
    ( 
      &match=1
    )
  )
  else if (&wild_tail==1)
  (
    if (STRING.MID("gcc_cnoc_bus_timeout4_ahb_clk", 0, &clk_input_length-1)==STRING.CUT("&clk", -1))
    ( 
      &match=1
    )
  )	  
  else if ("gcc_cnoc_bus_timeout4_ahb_clk"=="&clk")
  (
    &match=1
  )
  
  if (&match==1)
  (
    &clk_test=&CLK_TEST_GCC_CNOC_BUS_TIMEOUT4_AHB_CLK
    &clk_reg=&HWIO_GCC_CNOC_BUS_TIMEOUT4_AHB_CBCR_ADDR
    &clk_reg_name="GCC_CNOC_BUS_TIMEOUT4_AHB_CBCR"
    &clk_name="gcc_cnoc_bus_timeout4_ahb_clk"
    &clk_reg_cbcr_type="sm_cbc"

    gosub Print_Clk_Info_Line
  )
  
  &match=0
  &wild_head=0
  &wild_tail=0
  &clk_input_length=STRING.LENGTH("&clk")
  &clk_itr_length=STRING.LENGTH("gcc_cnoc_bus_timeout5_ahb_clk")

  if (STRING.SCAN("&clk", "*", 0)==0)
  (
    &wild_head=1
  )
  if (STRING.SCAN("&clk", "*", 1)==(STRING.LENGTH("&clk")-1))
  (
    &wild_tail=1
  )

  if ((&wild_head==1)&&(&wild_tail==1))
  (
    if (STRING.SCAN("gcc_cnoc_bus_timeout5_ahb_clk", STRING.MID("&clk", 1, &clk_input_length-2), 0)!=-1)
    ( 
      &match=1
    )
  )
  else if (&wild_head==1)
  (
    if (STRING.MID("gcc_cnoc_bus_timeout5_ahb_clk", &clk_itr_length-&clk_input_length+1, &clk_input_length-1)==STRING.CUT("&clk", 1))
    ( 
      &match=1
    )
  )
  else if (&wild_tail==1)
  (
    if (STRING.MID("gcc_cnoc_bus_timeout5_ahb_clk", 0, &clk_input_length-1)==STRING.CUT("&clk", -1))
    ( 
      &match=1
    )
  )	  
  else if ("gcc_cnoc_bus_timeout5_ahb_clk"=="&clk")
  (
    &match=1
  )
  
  if (&match==1)
  (
    &clk_test=&CLK_TEST_GCC_CNOC_BUS_TIMEOUT5_AHB_CLK
    &clk_reg=&HWIO_GCC_CNOC_BUS_TIMEOUT5_AHB_CBCR_ADDR
    &clk_reg_name="GCC_CNOC_BUS_TIMEOUT5_AHB_CBCR"
    &clk_name="gcc_cnoc_bus_timeout5_ahb_clk"
    &clk_reg_cbcr_type="sm_cbc"

    gosub Print_Clk_Info_Line
  )
  
  &match=0
  &wild_head=0
  &wild_tail=0
  &clk_input_length=STRING.LENGTH("&clk")
  &clk_itr_length=STRING.LENGTH("gcc_cnoc_bus_timeout6_ahb_clk")

  if (STRING.SCAN("&clk", "*", 0)==0)
  (
    &wild_head=1
  )
  if (STRING.SCAN("&clk", "*", 1)==(STRING.LENGTH("&clk")-1))
  (
    &wild_tail=1
  )

  if ((&wild_head==1)&&(&wild_tail==1))
  (
    if (STRING.SCAN("gcc_cnoc_bus_timeout6_ahb_clk", STRING.MID("&clk", 1, &clk_input_length-2), 0)!=-1)
    ( 
      &match=1
    )
  )
  else if (&wild_head==1)
  (
    if (STRING.MID("gcc_cnoc_bus_timeout6_ahb_clk", &clk_itr_length-&clk_input_length+1, &clk_input_length-1)==STRING.CUT("&clk", 1))
    ( 
      &match=1
    )
  )
  else if (&wild_tail==1)
  (
    if (STRING.MID("gcc_cnoc_bus_timeout6_ahb_clk", 0, &clk_input_length-1)==STRING.CUT("&clk", -1))
    ( 
      &match=1
    )
  )	  
  else if ("gcc_cnoc_bus_timeout6_ahb_clk"=="&clk")
  (
    &match=1
  )
  
  if (&match==1)
  (
    &clk_test=&CLK_TEST_GCC_CNOC_BUS_TIMEOUT6_AHB_CLK
    &clk_reg=&HWIO_GCC_CNOC_BUS_TIMEOUT6_AHB_CBCR_ADDR
    &clk_reg_name="GCC_CNOC_BUS_TIMEOUT6_AHB_CBCR"
    &clk_name="gcc_cnoc_bus_timeout6_ahb_clk"
    &clk_reg_cbcr_type="sm_cbc"

    gosub Print_Clk_Info_Line
  )
  
  &match=0
  &wild_head=0
  &wild_tail=0
  &clk_input_length=STRING.LENGTH("&clk")
  &clk_itr_length=STRING.LENGTH("gcc_cnoc_bus_timeout7_ahb_clk")

  if (STRING.SCAN("&clk", "*", 0)==0)
  (
    &wild_head=1
  )
  if (STRING.SCAN("&clk", "*", 1)==(STRING.LENGTH("&clk")-1))
  (
    &wild_tail=1
  )

  if ((&wild_head==1)&&(&wild_tail==1))
  (
    if (STRING.SCAN("gcc_cnoc_bus_timeout7_ahb_clk", STRING.MID("&clk", 1, &clk_input_length-2), 0)!=-1)
    ( 
      &match=1
    )
  )
  else if (&wild_head==1)
  (
    if (STRING.MID("gcc_cnoc_bus_timeout7_ahb_clk", &clk_itr_length-&clk_input_length+1, &clk_input_length-1)==STRING.CUT("&clk", 1))
    ( 
      &match=1
    )
  )
  else if (&wild_tail==1)
  (
    if (STRING.MID("gcc_cnoc_bus_timeout7_ahb_clk", 0, &clk_input_length-1)==STRING.CUT("&clk", -1))
    ( 
      &match=1
    )
  )	  
  else if ("gcc_cnoc_bus_timeout7_ahb_clk"=="&clk")
  (
    &match=1
  )
  
  if (&match==1)
  (
    &clk_test=&CLK_TEST_GCC_CNOC_BUS_TIMEOUT7_AHB_CLK
    &clk_reg=&HWIO_GCC_CNOC_BUS_TIMEOUT7_AHB_CBCR_ADDR
    &clk_reg_name="GCC_CNOC_BUS_TIMEOUT7_AHB_CBCR"
    &clk_name="gcc_cnoc_bus_timeout7_ahb_clk"
    &clk_reg_cbcr_type="sm_cbc"

    gosub Print_Clk_Info_Line
  )
  
  &match=0
  &wild_head=0
  &wild_tail=0
  &clk_input_length=STRING.LENGTH("&clk")
  &clk_itr_length=STRING.LENGTH("gcc_copss_smmu_ahb_clk")

  if (STRING.SCAN("&clk", "*", 0)==0)
  (
    &wild_head=1
  )
  if (STRING.SCAN("&clk", "*", 1)==(STRING.LENGTH("&clk")-1))
  (
    &wild_tail=1
  )

  if ((&wild_head==1)&&(&wild_tail==1))
  (
    if (STRING.SCAN("gcc_copss_smmu_ahb_clk", STRING.MID("&clk", 1, &clk_input_length-2), 0)!=-1)
    ( 
      &match=1
    )
  )
  else if (&wild_head==1)
  (
    if (STRING.MID("gcc_copss_smmu_ahb_clk", &clk_itr_length-&clk_input_length+1, &clk_input_length-1)==STRING.CUT("&clk", 1))
    ( 
      &match=1
    )
  )
  else if (&wild_tail==1)
  (
    if (STRING.MID("gcc_copss_smmu_ahb_clk", 0, &clk_input_length-1)==STRING.CUT("&clk", -1))
    ( 
      &match=1
    )
  )	  
  else if ("gcc_copss_smmu_ahb_clk"=="&clk")
  (
    &match=1
  )
  
  if (&match==1)
  (
    &clk_test=&CLK_TEST_GCC_COPSS_SMMU_AHB_CLK
    &clk_reg=&HWIO_GCC_COPSS_SMMU_AHB_CBCR_ADDR
    &clk_reg_name="GCC_COPSS_SMMU_AHB_CBCR"
    &clk_name="gcc_copss_smmu_ahb_clk"
    &clk_reg_cbcr_type="sm_pscbc"

    gosub Print_Clk_Info_Line
  )
  
  &match=0
  &wild_head=0
  &wild_tail=0
  &clk_input_length=STRING.LENGTH("&clk")
  &clk_itr_length=STRING.LENGTH("gcc_copss_smmu_axi_clk")

  if (STRING.SCAN("&clk", "*", 0)==0)
  (
    &wild_head=1
  )
  if (STRING.SCAN("&clk", "*", 1)==(STRING.LENGTH("&clk")-1))
  (
    &wild_tail=1
  )

  if ((&wild_head==1)&&(&wild_tail==1))
  (
    if (STRING.SCAN("gcc_copss_smmu_axi_clk", STRING.MID("&clk", 1, &clk_input_length-2), 0)!=-1)
    ( 
      &match=1
    )
  )
  else if (&wild_head==1)
  (
    if (STRING.MID("gcc_copss_smmu_axi_clk", &clk_itr_length-&clk_input_length+1, &clk_input_length-1)==STRING.CUT("&clk", 1))
    ( 
      &match=1
    )
  )
  else if (&wild_tail==1)
  (
    if (STRING.MID("gcc_copss_smmu_axi_clk", 0, &clk_input_length-1)==STRING.CUT("&clk", -1))
    ( 
      &match=1
    )
  )	  
  else if ("gcc_copss_smmu_axi_clk"=="&clk")
  (
    &match=1
  )
  
  if (&match==1)
  (
    &clk_test=&CLK_TEST_GCC_COPSS_SMMU_AXI_CLK
    &clk_reg=&HWIO_GCC_COPSS_SMMU_AXI_CBCR_ADDR
    &clk_reg_name="GCC_COPSS_SMMU_AXI_CBCR"
    &clk_name="gcc_copss_smmu_axi_clk"
    &clk_reg_cbcr_type="sm_pscbc"

    gosub Print_Clk_Info_Line
  )
  
  &match=0
  &wild_head=0
  &wild_tail=0
  &clk_input_length=STRING.LENGTH("&clk")
  &clk_itr_length=STRING.LENGTH("gcc_cfg_noc_ahb_clk")

  if (STRING.SCAN("&clk", "*", 0)==0)
  (
    &wild_head=1
  )
  if (STRING.SCAN("&clk", "*", 1)==(STRING.LENGTH("&clk")-1))
  (
    &wild_tail=1
  )

  if ((&wild_head==1)&&(&wild_tail==1))
  (
    if (STRING.SCAN("gcc_cfg_noc_ahb_clk", STRING.MID("&clk", 1, &clk_input_length-2), 0)!=-1)
    ( 
      &match=1
    )
  )
  else if (&wild_head==1)
  (
    if (STRING.MID("gcc_cfg_noc_ahb_clk", &clk_itr_length-&clk_input_length+1, &clk_input_length-1)==STRING.CUT("&clk", 1))
    ( 
      &match=1
    )
  )
  else if (&wild_tail==1)
  (
    if (STRING.MID("gcc_cfg_noc_ahb_clk", 0, &clk_input_length-1)==STRING.CUT("&clk", -1))
    ( 
      &match=1
    )
  )	  
  else if ("gcc_cfg_noc_ahb_clk"=="&clk")
  (
    &match=1
  )
  
  ; This clock belongs to the 'buses' display group.
  if ("buses"=="&clk")
  (
    &match=1	  
  )
  
  if (&match==1)
  (
    &clk_test=&CLK_TEST_GCC_CFG_NOC_AHB_CLK
    &clk_reg=&HWIO_GCC_CFG_NOC_AHB_CBCR_ADDR
    &clk_reg_name="GCC_CFG_NOC_AHB_CBCR"
    &clk_name="gcc_cfg_noc_ahb_clk"
    &clk_reg_cbcr_type="sm_cbc"

    gosub Print_Clk_Info_Line
  )
  
  &match=0
  &wild_head=0
  &wild_tail=0
  &clk_input_length=STRING.LENGTH("&clk")
  &clk_itr_length=STRING.LENGTH("gcc_cfg_noc_ddr_cfg_clk")

  if (STRING.SCAN("&clk", "*", 0)==0)
  (
    &wild_head=1
  )
  if (STRING.SCAN("&clk", "*", 1)==(STRING.LENGTH("&clk")-1))
  (
    &wild_tail=1
  )

  if ((&wild_head==1)&&(&wild_tail==1))
  (
    if (STRING.SCAN("gcc_cfg_noc_ddr_cfg_clk", STRING.MID("&clk", 1, &clk_input_length-2), 0)!=-1)
    ( 
      &match=1
    )
  )
  else if (&wild_head==1)
  (
    if (STRING.MID("gcc_cfg_noc_ddr_cfg_clk", &clk_itr_length-&clk_input_length+1, &clk_input_length-1)==STRING.CUT("&clk", 1))
    ( 
      &match=1
    )
  )
  else if (&wild_tail==1)
  (
    if (STRING.MID("gcc_cfg_noc_ddr_cfg_clk", 0, &clk_input_length-1)==STRING.CUT("&clk", -1))
    ( 
      &match=1
    )
  )	  
  else if ("gcc_cfg_noc_ddr_cfg_clk"=="&clk")
  (
    &match=1
  )
  
  if (&match==1)
  (
    &clk_test=&CLK_TEST_GCC_CFG_NOC_DDR_CFG_CLK
    &clk_reg=&HWIO_GCC_CFG_NOC_DDR_CFG_CBCR_ADDR
    &clk_reg_name="GCC_CFG_NOC_DDR_CFG_CBCR"
    &clk_name="gcc_cfg_noc_ddr_cfg_clk"
    &clk_reg_cbcr_type="sm_cbc"

    gosub Print_Clk_Info_Line
  )
  
  &match=0
  &wild_head=0
  &wild_tail=0
  &clk_input_length=STRING.LENGTH("&clk")
  &clk_itr_length=STRING.LENGTH("gcc_cfg_noc_rpm_ahb_clk")

  if (STRING.SCAN("&clk", "*", 0)==0)
  (
    &wild_head=1
  )
  if (STRING.SCAN("&clk", "*", 1)==(STRING.LENGTH("&clk")-1))
  (
    &wild_tail=1
  )

  if ((&wild_head==1)&&(&wild_tail==1))
  (
    if (STRING.SCAN("gcc_cfg_noc_rpm_ahb_clk", STRING.MID("&clk", 1, &clk_input_length-2), 0)!=-1)
    ( 
      &match=1
    )
  )
  else if (&wild_head==1)
  (
    if (STRING.MID("gcc_cfg_noc_rpm_ahb_clk", &clk_itr_length-&clk_input_length+1, &clk_input_length-1)==STRING.CUT("&clk", 1))
    ( 
      &match=1
    )
  )
  else if (&wild_tail==1)
  (
    if (STRING.MID("gcc_cfg_noc_rpm_ahb_clk", 0, &clk_input_length-1)==STRING.CUT("&clk", -1))
    ( 
      &match=1
    )
  )	  
  else if ("gcc_cfg_noc_rpm_ahb_clk"=="&clk")
  (
    &match=1
  )
  
  if (&match==1)
  (
    &clk_test=&CLK_TEST_GCC_CFG_NOC_RPM_AHB_CLK
    &clk_reg=&HWIO_GCC_CFG_NOC_RPM_AHB_CBCR_ADDR
    &clk_reg_name="GCC_CFG_NOC_RPM_AHB_CBCR"
    &clk_name="gcc_cfg_noc_rpm_ahb_clk"
    &clk_reg_cbcr_type="sm_cbc"

    gosub Print_Clk_Info_Line
  )
  
  &match=0
  &wild_head=0
  &wild_tail=0
  &clk_input_length=STRING.LENGTH("&clk")
  &clk_itr_length=STRING.LENGTH("gcc_cfg_noc_tic_clk")

  if (STRING.SCAN("&clk", "*", 0)==0)
  (
    &wild_head=1
  )
  if (STRING.SCAN("&clk", "*", 1)==(STRING.LENGTH("&clk")-1))
  (
    &wild_tail=1
  )

  if ((&wild_head==1)&&(&wild_tail==1))
  (
    if (STRING.SCAN("gcc_cfg_noc_tic_clk", STRING.MID("&clk", 1, &clk_input_length-2), 0)!=-1)
    ( 
      &match=1
    )
  )
  else if (&wild_head==1)
  (
    if (STRING.MID("gcc_cfg_noc_tic_clk", &clk_itr_length-&clk_input_length+1, &clk_input_length-1)==STRING.CUT("&clk", 1))
    ( 
      &match=1
    )
  )
  else if (&wild_tail==1)
  (
    if (STRING.MID("gcc_cfg_noc_tic_clk", 0, &clk_input_length-1)==STRING.CUT("&clk", -1))
    ( 
      &match=1
    )
  )	  
  else if ("gcc_cfg_noc_tic_clk"=="&clk")
  (
    &match=1
  )
  
  if (&match==1)
  (
    &clk_test=&CLK_TEST_GCC_CFG_NOC_TIC_CLK
    &clk_reg=0
    &clk_reg_name="No CBCR"
    &clk_name="gcc_cfg_noc_tic_clk"
    &clk_reg_cbcr_type="sm_cbc"

    gosub Print_Clk_Info_Line
  )
  
  &match=0
  &wild_head=0
  &wild_tail=0
  &clk_input_length=STRING.LENGTH("&clk")
  &clk_itr_length=STRING.LENGTH("gcc_dcd_xo_clk")

  if (STRING.SCAN("&clk", "*", 0)==0)
  (
    &wild_head=1
  )
  if (STRING.SCAN("&clk", "*", 1)==(STRING.LENGTH("&clk")-1))
  (
    &wild_tail=1
  )

  if ((&wild_head==1)&&(&wild_tail==1))
  (
    if (STRING.SCAN("gcc_dcd_xo_clk", STRING.MID("&clk", 1, &clk_input_length-2), 0)!=-1)
    ( 
      &match=1
    )
  )
  else if (&wild_head==1)
  (
    if (STRING.MID("gcc_dcd_xo_clk", &clk_itr_length-&clk_input_length+1, &clk_input_length-1)==STRING.CUT("&clk", 1))
    ( 
      &match=1
    )
  )
  else if (&wild_tail==1)
  (
    if (STRING.MID("gcc_dcd_xo_clk", 0, &clk_input_length-1)==STRING.CUT("&clk", -1))
    ( 
      &match=1
    )
  )	  
  else if ("gcc_dcd_xo_clk"=="&clk")
  (
    &match=1
  )
  
  if (&match==1)
  (
    &clk_test=&CLK_TEST_GCC_DCD_XO_CLK
    &clk_reg=&HWIO_GCC_DCD_XO_CBCR_ADDR
    &clk_reg_name="GCC_DCD_XO_CBCR"
    &clk_name="gcc_dcd_xo_clk"
    &clk_reg_cbcr_type="sm_cbc"

    gosub Print_Clk_Info_Line
  )
  
  &match=0
  &wild_head=0
  &wild_tail=0
  &clk_input_length=STRING.LENGTH("&clk")
  &clk_itr_length=STRING.LENGTH("gcc_bimc_ddr_ch0_clk")

  if (STRING.SCAN("&clk", "*", 0)==0)
  (
    &wild_head=1
  )
  if (STRING.SCAN("&clk", "*", 1)==(STRING.LENGTH("&clk")-1))
  (
    &wild_tail=1
  )

  if ((&wild_head==1)&&(&wild_tail==1))
  (
    if (STRING.SCAN("gcc_bimc_ddr_ch0_clk", STRING.MID("&clk", 1, &clk_input_length-2), 0)!=-1)
    ( 
      &match=1
    )
  )
  else if (&wild_head==1)
  (
    if (STRING.MID("gcc_bimc_ddr_ch0_clk", &clk_itr_length-&clk_input_length+1, &clk_input_length-1)==STRING.CUT("&clk", 1))
    ( 
      &match=1
    )
  )
  else if (&wild_tail==1)
  (
    if (STRING.MID("gcc_bimc_ddr_ch0_clk", 0, &clk_input_length-1)==STRING.CUT("&clk", -1))
    ( 
      &match=1
    )
  )	  
  else if ("gcc_bimc_ddr_ch0_clk"=="&clk")
  (
    &match=1
  )
  
  if (&match==1)
  (
    &clk_test=&CLK_TEST_GCC_BIMC_DDR_CH0_CLK
    &clk_reg=&HWIO_GCC_BIMC_DDR_CH0_CBCR_ADDR
    &clk_reg_name="GCC_BIMC_DDR_CH0_CBCR"
    &clk_name="gcc_bimc_ddr_ch0_clk"
    &clk_reg_cbcr_type="sm_cbc"

    gosub Print_Clk_Info_Line
  )
  
  &match=0
  &wild_head=0
  &wild_tail=0
  &clk_input_length=STRING.LENGTH("&clk")
  &clk_itr_length=STRING.LENGTH("gcc_bimc_ddr_ch1_clk")

  if (STRING.SCAN("&clk", "*", 0)==0)
  (
    &wild_head=1
  )
  if (STRING.SCAN("&clk", "*", 1)==(STRING.LENGTH("&clk")-1))
  (
    &wild_tail=1
  )

  if ((&wild_head==1)&&(&wild_tail==1))
  (
    if (STRING.SCAN("gcc_bimc_ddr_ch1_clk", STRING.MID("&clk", 1, &clk_input_length-2), 0)!=-1)
    ( 
      &match=1
    )
  )
  else if (&wild_head==1)
  (
    if (STRING.MID("gcc_bimc_ddr_ch1_clk", &clk_itr_length-&clk_input_length+1, &clk_input_length-1)==STRING.CUT("&clk", 1))
    ( 
      &match=1
    )
  )
  else if (&wild_tail==1)
  (
    if (STRING.MID("gcc_bimc_ddr_ch1_clk", 0, &clk_input_length-1)==STRING.CUT("&clk", -1))
    ( 
      &match=1
    )
  )	  
  else if ("gcc_bimc_ddr_ch1_clk"=="&clk")
  (
    &match=1
  )
  
  if (&match==1)
  (
    &clk_test=&CLK_TEST_GCC_BIMC_DDR_CH1_CLK
    &clk_reg=&HWIO_GCC_BIMC_DDR_CH1_CBCR_ADDR
    &clk_reg_name="GCC_BIMC_DDR_CH1_CBCR"
    &clk_name="gcc_bimc_ddr_ch1_clk"
    &clk_reg_cbcr_type="sm_cbc"

    gosub Print_Clk_Info_Line
  )
  
  &match=0
  &wild_head=0
  &wild_tail=0
  &clk_input_length=STRING.LENGTH("&clk")
  &clk_itr_length=STRING.LENGTH("gcc_bimc_ddr_cpll0_clk")

  if (STRING.SCAN("&clk", "*", 0)==0)
  (
    &wild_head=1
  )
  if (STRING.SCAN("&clk", "*", 1)==(STRING.LENGTH("&clk")-1))
  (
    &wild_tail=1
  )

  if ((&wild_head==1)&&(&wild_tail==1))
  (
    if (STRING.SCAN("gcc_bimc_ddr_cpll0_clk", STRING.MID("&clk", 1, &clk_input_length-2), 0)!=-1)
    ( 
      &match=1
    )
  )
  else if (&wild_head==1)
  (
    if (STRING.MID("gcc_bimc_ddr_cpll0_clk", &clk_itr_length-&clk_input_length+1, &clk_input_length-1)==STRING.CUT("&clk", 1))
    ( 
      &match=1
    )
  )
  else if (&wild_tail==1)
  (
    if (STRING.MID("gcc_bimc_ddr_cpll0_clk", 0, &clk_input_length-1)==STRING.CUT("&clk", -1))
    ( 
      &match=1
    )
  )	  
  else if ("gcc_bimc_ddr_cpll0_clk"=="&clk")
  (
    &match=1
  )
  
  if (&match==1)
  (
    &clk_test=&CLK_TEST_GCC_BIMC_DDR_CPLL0_CLK
    &clk_reg=&HWIO_GCC_BIMC_DDR_CPLL0_CBCR_ADDR
    &clk_reg_name="GCC_BIMC_DDR_CPLL0_CBCR"
    &clk_name="gcc_bimc_ddr_cpll0_clk"
    &clk_reg_cbcr_type="sm_cbc"

    gosub Print_Clk_Info_Line
  )
  
  &match=0
  &wild_head=0
  &wild_tail=0
  &clk_input_length=STRING.LENGTH("&clk")
  &clk_itr_length=STRING.LENGTH("gcc_bimc_ddr_cpll1_clk")

  if (STRING.SCAN("&clk", "*", 0)==0)
  (
    &wild_head=1
  )
  if (STRING.SCAN("&clk", "*", 1)==(STRING.LENGTH("&clk")-1))
  (
    &wild_tail=1
  )

  if ((&wild_head==1)&&(&wild_tail==1))
  (
    if (STRING.SCAN("gcc_bimc_ddr_cpll1_clk", STRING.MID("&clk", 1, &clk_input_length-2), 0)!=-1)
    ( 
      &match=1
    )
  )
  else if (&wild_head==1)
  (
    if (STRING.MID("gcc_bimc_ddr_cpll1_clk", &clk_itr_length-&clk_input_length+1, &clk_input_length-1)==STRING.CUT("&clk", 1))
    ( 
      &match=1
    )
  )
  else if (&wild_tail==1)
  (
    if (STRING.MID("gcc_bimc_ddr_cpll1_clk", 0, &clk_input_length-1)==STRING.CUT("&clk", -1))
    ( 
      &match=1
    )
  )	  
  else if ("gcc_bimc_ddr_cpll1_clk"=="&clk")
  (
    &match=1
  )
  
  if (&match==1)
  (
    &clk_test=&CLK_TEST_GCC_BIMC_DDR_CPLL1_CLK
    &clk_reg=&HWIO_GCC_BIMC_DDR_CPLL1_CBCR_ADDR
    &clk_reg_name="GCC_BIMC_DDR_CPLL1_CBCR"
    &clk_name="gcc_bimc_ddr_cpll1_clk"
    &clk_reg_cbcr_type="sm_cbc"

    gosub Print_Clk_Info_Line
  )
  
  &match=0
  &wild_head=0
  &wild_tail=0
  &clk_input_length=STRING.LENGTH("&clk")
  &clk_itr_length=STRING.LENGTH("gcc_bimc_gfx_clk")

  if (STRING.SCAN("&clk", "*", 0)==0)
  (
    &wild_head=1
  )
  if (STRING.SCAN("&clk", "*", 1)==(STRING.LENGTH("&clk")-1))
  (
    &wild_tail=1
  )

  if ((&wild_head==1)&&(&wild_tail==1))
  (
    if (STRING.SCAN("gcc_bimc_gfx_clk", STRING.MID("&clk", 1, &clk_input_length-2), 0)!=-1)
    ( 
      &match=1
    )
  )
  else if (&wild_head==1)
  (
    if (STRING.MID("gcc_bimc_gfx_clk", &clk_itr_length-&clk_input_length+1, &clk_input_length-1)==STRING.CUT("&clk", 1))
    ( 
      &match=1
    )
  )
  else if (&wild_tail==1)
  (
    if (STRING.MID("gcc_bimc_gfx_clk", 0, &clk_input_length-1)==STRING.CUT("&clk", -1))
    ( 
      &match=1
    )
  )	  
  else if ("gcc_bimc_gfx_clk"=="&clk")
  (
    &match=1
  )
  
  if (&match==1)
  (
    &clk_test=&CLK_TEST_GCC_BIMC_GFX_CLK
    &clk_reg=&HWIO_GCC_BIMC_GFX_CBCR_ADDR
    &clk_reg_name="GCC_BIMC_GFX_CBCR"
    &clk_name="gcc_bimc_gfx_clk"
    &clk_reg_cbcr_type="sm_cbc"

    gosub Print_Clk_Info_Line
  )
  
  &match=0
  &wild_head=0
  &wild_tail=0
  &clk_input_length=STRING.LENGTH("&clk")
  &clk_itr_length=STRING.LENGTH("gcc_ddr_dim_cfg_clk")

  if (STRING.SCAN("&clk", "*", 0)==0)
  (
    &wild_head=1
  )
  if (STRING.SCAN("&clk", "*", 1)==(STRING.LENGTH("&clk")-1))
  (
    &wild_tail=1
  )

  if ((&wild_head==1)&&(&wild_tail==1))
  (
    if (STRING.SCAN("gcc_ddr_dim_cfg_clk", STRING.MID("&clk", 1, &clk_input_length-2), 0)!=-1)
    ( 
      &match=1
    )
  )
  else if (&wild_head==1)
  (
    if (STRING.MID("gcc_ddr_dim_cfg_clk", &clk_itr_length-&clk_input_length+1, &clk_input_length-1)==STRING.CUT("&clk", 1))
    ( 
      &match=1
    )
  )
  else if (&wild_tail==1)
  (
    if (STRING.MID("gcc_ddr_dim_cfg_clk", 0, &clk_input_length-1)==STRING.CUT("&clk", -1))
    ( 
      &match=1
    )
  )	  
  else if ("gcc_ddr_dim_cfg_clk"=="&clk")
  (
    &match=1
  )
  
  if (&match==1)
  (
    &clk_test=&CLK_TEST_GCC_DDR_DIM_CFG_CLK
    &clk_reg=&HWIO_GCC_DDR_DIM_CFG_CBCR_ADDR
    &clk_reg_name="GCC_DDR_DIM_CFG_CBCR"
    &clk_name="gcc_ddr_dim_cfg_clk"
    &clk_reg_cbcr_type="sm_cbc"

    gosub Print_Clk_Info_Line
  )
  
  &match=0
  &wild_head=0
  &wild_tail=0
  &clk_input_length=STRING.LENGTH("&clk")
  &clk_itr_length=STRING.LENGTH("gcc_ddr_dim_sleep_clk")

  if (STRING.SCAN("&clk", "*", 0)==0)
  (
    &wild_head=1
  )
  if (STRING.SCAN("&clk", "*", 1)==(STRING.LENGTH("&clk")-1))
  (
    &wild_tail=1
  )

  if ((&wild_head==1)&&(&wild_tail==1))
  (
    if (STRING.SCAN("gcc_ddr_dim_sleep_clk", STRING.MID("&clk", 1, &clk_input_length-2), 0)!=-1)
    ( 
      &match=1
    )
  )
  else if (&wild_head==1)
  (
    if (STRING.MID("gcc_ddr_dim_sleep_clk", &clk_itr_length-&clk_input_length+1, &clk_input_length-1)==STRING.CUT("&clk", 1))
    ( 
      &match=1
    )
  )
  else if (&wild_tail==1)
  (
    if (STRING.MID("gcc_ddr_dim_sleep_clk", 0, &clk_input_length-1)==STRING.CUT("&clk", -1))
    ( 
      &match=1
    )
  )	  
  else if ("gcc_ddr_dim_sleep_clk"=="&clk")
  (
    &match=1
  )
  
  if (&match==1)
  (
    &clk_test=&CLK_TEST_GCC_DDR_DIM_SLEEP_CLK
    &clk_reg=&HWIO_GCC_DDR_DIM_SLEEP_CBCR_ADDR
    &clk_reg_name="GCC_DDR_DIM_SLEEP_CBCR"
    &clk_name="gcc_ddr_dim_sleep_clk"
    &clk_reg_cbcr_type="sm_cbc"

    gosub Print_Clk_Info_Line
  )
  
  &match=0
  &wild_head=0
  &wild_tail=0
  &clk_input_length=STRING.LENGTH("&clk")
  &clk_itr_length=STRING.LENGTH("gcc_dehr_clk")

  if (STRING.SCAN("&clk", "*", 0)==0)
  (
    &wild_head=1
  )
  if (STRING.SCAN("&clk", "*", 1)==(STRING.LENGTH("&clk")-1))
  (
    &wild_tail=1
  )

  if ((&wild_head==1)&&(&wild_tail==1))
  (
    if (STRING.SCAN("gcc_dehr_clk", STRING.MID("&clk", 1, &clk_input_length-2), 0)!=-1)
    ( 
      &match=1
    )
  )
  else if (&wild_head==1)
  (
    if (STRING.MID("gcc_dehr_clk", &clk_itr_length-&clk_input_length+1, &clk_input_length-1)==STRING.CUT("&clk", 1))
    ( 
      &match=1
    )
  )
  else if (&wild_tail==1)
  (
    if (STRING.MID("gcc_dehr_clk", 0, &clk_input_length-1)==STRING.CUT("&clk", -1))
    ( 
      &match=1
    )
  )	  
  else if ("gcc_dehr_clk"=="&clk")
  (
    &match=1
  )
  
  if (&match==1)
  (
    &clk_test=&CLK_TEST_GCC_DEHR_CLK
    &clk_reg=&HWIO_GCC_DEHR_CBCR_ADDR
    &clk_reg_name="GCC_DEHR_CBCR"
    &clk_name="gcc_dehr_clk"
    &clk_reg_cbcr_type="sm_pscbc"

    gosub Print_Clk_Info_Line
  )
  
  &match=0
  &wild_head=0
  &wild_tail=0
  &clk_input_length=STRING.LENGTH("&clk")
  &clk_itr_length=STRING.LENGTH("gcc_ahb_clk")

  if (STRING.SCAN("&clk", "*", 0)==0)
  (
    &wild_head=1
  )
  if (STRING.SCAN("&clk", "*", 1)==(STRING.LENGTH("&clk")-1))
  (
    &wild_tail=1
  )

  if ((&wild_head==1)&&(&wild_tail==1))
  (
    if (STRING.SCAN("gcc_ahb_clk", STRING.MID("&clk", 1, &clk_input_length-2), 0)!=-1)
    ( 
      &match=1
    )
  )
  else if (&wild_head==1)
  (
    if (STRING.MID("gcc_ahb_clk", &clk_itr_length-&clk_input_length+1, &clk_input_length-1)==STRING.CUT("&clk", 1))
    ( 
      &match=1
    )
  )
  else if (&wild_tail==1)
  (
    if (STRING.MID("gcc_ahb_clk", 0, &clk_input_length-1)==STRING.CUT("&clk", -1))
    ( 
      &match=1
    )
  )	  
  else if ("gcc_ahb_clk"=="&clk")
  (
    &match=1
  )
  
  if (&match==1)
  (
    &clk_test=&CLK_TEST_GCC_AHB_CLK
    &clk_reg=&HWIO_GCC_AHB_CBCR_ADDR
    &clk_reg_name="GCC_AHB_CBCR"
    &clk_name="gcc_ahb_clk"
    &clk_reg_cbcr_type="sm_cbc"

    gosub Print_Clk_Info_Line
  )
  
  &match=0
  &wild_head=0
  &wild_tail=0
  &clk_input_length=STRING.LENGTH("&clk")
  &clk_itr_length=STRING.LENGTH("gcc_im_sleep_clk")

  if (STRING.SCAN("&clk", "*", 0)==0)
  (
    &wild_head=1
  )
  if (STRING.SCAN("&clk", "*", 1)==(STRING.LENGTH("&clk")-1))
  (
    &wild_tail=1
  )

  if ((&wild_head==1)&&(&wild_tail==1))
  (
    if (STRING.SCAN("gcc_im_sleep_clk", STRING.MID("&clk", 1, &clk_input_length-2), 0)!=-1)
    ( 
      &match=1
    )
  )
  else if (&wild_head==1)
  (
    if (STRING.MID("gcc_im_sleep_clk", &clk_itr_length-&clk_input_length+1, &clk_input_length-1)==STRING.CUT("&clk", 1))
    ( 
      &match=1
    )
  )
  else if (&wild_tail==1)
  (
    if (STRING.MID("gcc_im_sleep_clk", 0, &clk_input_length-1)==STRING.CUT("&clk", -1))
    ( 
      &match=1
    )
  )	  
  else if ("gcc_im_sleep_clk"=="&clk")
  (
    &match=1
  )
  
  if (&match==1)
  (
    &clk_test=&CLK_TEST_GCC_IM_SLEEP_CLK
    &clk_reg=&HWIO_GCC_IM_SLEEP_CBCR_ADDR
    &clk_reg_name="GCC_IM_SLEEP_CBCR"
    &clk_name="gcc_im_sleep_clk"
    &clk_reg_cbcr_type="sm_cbc"

    gosub Print_Clk_Info_Line
  )
  
  &match=0
  &wild_head=0
  &wild_tail=0
  &clk_input_length=STRING.LENGTH("&clk")
  &clk_itr_length=STRING.LENGTH("gcc_xo_clk")

  if (STRING.SCAN("&clk", "*", 0)==0)
  (
    &wild_head=1
  )
  if (STRING.SCAN("&clk", "*", 1)==(STRING.LENGTH("&clk")-1))
  (
    &wild_tail=1
  )

  if ((&wild_head==1)&&(&wild_tail==1))
  (
    if (STRING.SCAN("gcc_xo_clk", STRING.MID("&clk", 1, &clk_input_length-2), 0)!=-1)
    ( 
      &match=1
    )
  )
  else if (&wild_head==1)
  (
    if (STRING.MID("gcc_xo_clk", &clk_itr_length-&clk_input_length+1, &clk_input_length-1)==STRING.CUT("&clk", 1))
    ( 
      &match=1
    )
  )
  else if (&wild_tail==1)
  (
    if (STRING.MID("gcc_xo_clk", 0, &clk_input_length-1)==STRING.CUT("&clk", -1))
    ( 
      &match=1
    )
  )	  
  else if ("gcc_xo_clk"=="&clk")
  (
    &match=1
  )
  
  if (&match==1)
  (
    &clk_test=&CLK_TEST_GCC_XO_CLK
    &clk_reg=&HWIO_GCC_XO_CBCR_ADDR
    &clk_reg_name="GCC_XO_CBCR"
    &clk_name="gcc_xo_clk"
    &clk_reg_cbcr_type="sm_cbc"

    gosub Print_Clk_Info_Line
  )
  
  &match=0
  &wild_head=0
  &wild_tail=0
  &clk_input_length=STRING.LENGTH("&clk")
  &clk_itr_length=STRING.LENGTH("gcc_xo_div4_clk")

  if (STRING.SCAN("&clk", "*", 0)==0)
  (
    &wild_head=1
  )
  if (STRING.SCAN("&clk", "*", 1)==(STRING.LENGTH("&clk")-1))
  (
    &wild_tail=1
  )

  if ((&wild_head==1)&&(&wild_tail==1))
  (
    if (STRING.SCAN("gcc_xo_div4_clk", STRING.MID("&clk", 1, &clk_input_length-2), 0)!=-1)
    ( 
      &match=1
    )
  )
  else if (&wild_head==1)
  (
    if (STRING.MID("gcc_xo_div4_clk", &clk_itr_length-&clk_input_length+1, &clk_input_length-1)==STRING.CUT("&clk", 1))
    ( 
      &match=1
    )
  )
  else if (&wild_tail==1)
  (
    if (STRING.MID("gcc_xo_div4_clk", 0, &clk_input_length-1)==STRING.CUT("&clk", -1))
    ( 
      &match=1
    )
  )	  
  else if ("gcc_xo_div4_clk"=="&clk")
  (
    &match=1
  )
  
  if (&match==1)
  (
    &clk_test=&CLK_TEST_GCC_XO_DIV4_CLK
    &clk_reg=&HWIO_GCC_XO_DIV4_CBCR_ADDR
    &clk_reg_name="GCC_XO_DIV4_CBCR"
    &clk_name="gcc_xo_div4_clk"
    &clk_reg_cbcr_type="sm_cbc"

    gosub Print_Clk_Info_Line
  )
  
  &match=0
  &wild_head=0
  &wild_tail=0
  &clk_input_length=STRING.LENGTH("&clk")
  &clk_itr_length=STRING.LENGTH("gcc_gp1_clk")

  if (STRING.SCAN("&clk", "*", 0)==0)
  (
    &wild_head=1
  )
  if (STRING.SCAN("&clk", "*", 1)==(STRING.LENGTH("&clk")-1))
  (
    &wild_tail=1
  )

  if ((&wild_head==1)&&(&wild_tail==1))
  (
    if (STRING.SCAN("gcc_gp1_clk", STRING.MID("&clk", 1, &clk_input_length-2), 0)!=-1)
    ( 
      &match=1
    )
  )
  else if (&wild_head==1)
  (
    if (STRING.MID("gcc_gp1_clk", &clk_itr_length-&clk_input_length+1, &clk_input_length-1)==STRING.CUT("&clk", 1))
    ( 
      &match=1
    )
  )
  else if (&wild_tail==1)
  (
    if (STRING.MID("gcc_gp1_clk", 0, &clk_input_length-1)==STRING.CUT("&clk", -1))
    ( 
      &match=1
    )
  )	  
  else if ("gcc_gp1_clk"=="&clk")
  (
    &match=1
  )
  
  if (&match==1)
  (
    &clk_test=0
    &clk_reg=&HWIO_GCC_GP1_CBCR_ADDR
    &clk_reg_name="GCC_GP1_CBCR"
    &clk_name="gcc_gp1_clk"
    &clk_reg_cbcr_type="sm_cbc"

    gosub Print_Clk_Info_Line
  )
  
  &match=0
  &wild_head=0
  &wild_tail=0
  &clk_input_length=STRING.LENGTH("&clk")
  &clk_itr_length=STRING.LENGTH("gcc_gp2_clk")

  if (STRING.SCAN("&clk", "*", 0)==0)
  (
    &wild_head=1
  )
  if (STRING.SCAN("&clk", "*", 1)==(STRING.LENGTH("&clk")-1))
  (
    &wild_tail=1
  )

  if ((&wild_head==1)&&(&wild_tail==1))
  (
    if (STRING.SCAN("gcc_gp2_clk", STRING.MID("&clk", 1, &clk_input_length-2), 0)!=-1)
    ( 
      &match=1
    )
  )
  else if (&wild_head==1)
  (
    if (STRING.MID("gcc_gp2_clk", &clk_itr_length-&clk_input_length+1, &clk_input_length-1)==STRING.CUT("&clk", 1))
    ( 
      &match=1
    )
  )
  else if (&wild_tail==1)
  (
    if (STRING.MID("gcc_gp2_clk", 0, &clk_input_length-1)==STRING.CUT("&clk", -1))
    ( 
      &match=1
    )
  )	  
  else if ("gcc_gp2_clk"=="&clk")
  (
    &match=1
  )
  
  if (&match==1)
  (
    &clk_test=0
    &clk_reg=&HWIO_GCC_GP2_CBCR_ADDR
    &clk_reg_name="GCC_GP2_CBCR"
    &clk_name="gcc_gp2_clk"
    &clk_reg_cbcr_type="sm_cbc"

    gosub Print_Clk_Info_Line
  )
  
  &match=0
  &wild_head=0
  &wild_tail=0
  &clk_input_length=STRING.LENGTH("&clk")
  &clk_itr_length=STRING.LENGTH("gcc_gp3_clk")

  if (STRING.SCAN("&clk", "*", 0)==0)
  (
    &wild_head=1
  )
  if (STRING.SCAN("&clk", "*", 1)==(STRING.LENGTH("&clk")-1))
  (
    &wild_tail=1
  )

  if ((&wild_head==1)&&(&wild_tail==1))
  (
    if (STRING.SCAN("gcc_gp3_clk", STRING.MID("&clk", 1, &clk_input_length-2), 0)!=-1)
    ( 
      &match=1
    )
  )
  else if (&wild_head==1)
  (
    if (STRING.MID("gcc_gp3_clk", &clk_itr_length-&clk_input_length+1, &clk_input_length-1)==STRING.CUT("&clk", 1))
    ( 
      &match=1
    )
  )
  else if (&wild_tail==1)
  (
    if (STRING.MID("gcc_gp3_clk", 0, &clk_input_length-1)==STRING.CUT("&clk", -1))
    ( 
      &match=1
    )
  )	  
  else if ("gcc_gp3_clk"=="&clk")
  (
    &match=1
  )
  
  if (&match==1)
  (
    &clk_test=0
    &clk_reg=&HWIO_GCC_GP3_CBCR_ADDR
    &clk_reg_name="GCC_GP3_CBCR"
    &clk_name="gcc_gp3_clk"
    &clk_reg_cbcr_type="sm_cbc"

    gosub Print_Clk_Info_Line
  )
  
  &match=0
  &wild_head=0
  &wild_tail=0
  &clk_input_length=STRING.LENGTH("&clk")
  &clk_itr_length=STRING.LENGTH("gcc_imem_axi_clk")

  if (STRING.SCAN("&clk", "*", 0)==0)
  (
    &wild_head=1
  )
  if (STRING.SCAN("&clk", "*", 1)==(STRING.LENGTH("&clk")-1))
  (
    &wild_tail=1
  )

  if ((&wild_head==1)&&(&wild_tail==1))
  (
    if (STRING.SCAN("gcc_imem_axi_clk", STRING.MID("&clk", 1, &clk_input_length-2), 0)!=-1)
    ( 
      &match=1
    )
  )
  else if (&wild_head==1)
  (
    if (STRING.MID("gcc_imem_axi_clk", &clk_itr_length-&clk_input_length+1, &clk_input_length-1)==STRING.CUT("&clk", 1))
    ( 
      &match=1
    )
  )
  else if (&wild_tail==1)
  (
    if (STRING.MID("gcc_imem_axi_clk", 0, &clk_input_length-1)==STRING.CUT("&clk", -1))
    ( 
      &match=1
    )
  )	  
  else if ("gcc_imem_axi_clk"=="&clk")
  (
    &match=1
  )
  
  if (&match==1)
  (
    &clk_test=&CLK_TEST_GCC_IMEM_AXI_CLK
    &clk_reg=&HWIO_GCC_IMEM_AXI_CBCR_ADDR
    &clk_reg_name="GCC_IMEM_AXI_CBCR"
    &clk_name="gcc_imem_axi_clk"
    &clk_reg_cbcr_type="sm_pscbc"

    gosub Print_Clk_Info_Line
  )
  
  &match=0
  &wild_head=0
  &wild_tail=0
  &clk_input_length=STRING.LENGTH("&clk")
  &clk_itr_length=STRING.LENGTH("gcc_imem_cfg_ahb_clk")

  if (STRING.SCAN("&clk", "*", 0)==0)
  (
    &wild_head=1
  )
  if (STRING.SCAN("&clk", "*", 1)==(STRING.LENGTH("&clk")-1))
  (
    &wild_tail=1
  )

  if ((&wild_head==1)&&(&wild_tail==1))
  (
    if (STRING.SCAN("gcc_imem_cfg_ahb_clk", STRING.MID("&clk", 1, &clk_input_length-2), 0)!=-1)
    ( 
      &match=1
    )
  )
  else if (&wild_head==1)
  (
    if (STRING.MID("gcc_imem_cfg_ahb_clk", &clk_itr_length-&clk_input_length+1, &clk_input_length-1)==STRING.CUT("&clk", 1))
    ( 
      &match=1
    )
  )
  else if (&wild_tail==1)
  (
    if (STRING.MID("gcc_imem_cfg_ahb_clk", 0, &clk_input_length-1)==STRING.CUT("&clk", -1))
    ( 
      &match=1
    )
  )	  
  else if ("gcc_imem_cfg_ahb_clk"=="&clk")
  (
    &match=1
  )
  
  if (&match==1)
  (
    &clk_test=&CLK_TEST_GCC_IMEM_CFG_AHB_CLK
    &clk_reg=&HWIO_GCC_IMEM_CFG_AHB_CBCR_ADDR
    &clk_reg_name="GCC_IMEM_CFG_AHB_CBCR"
    &clk_name="gcc_imem_cfg_ahb_clk"
    &clk_reg_cbcr_type="sm_cbc"

    gosub Print_Clk_Info_Line
  )
  
  &match=0
  &wild_head=0
  &wild_tail=0
  &clk_input_length=STRING.LENGTH("&clk")
  &clk_itr_length=STRING.LENGTH("gcc_kpss_ahb_clk")

  if (STRING.SCAN("&clk", "*", 0)==0)
  (
    &wild_head=1
  )
  if (STRING.SCAN("&clk", "*", 1)==(STRING.LENGTH("&clk")-1))
  (
    &wild_tail=1
  )

  if ((&wild_head==1)&&(&wild_tail==1))
  (
    if (STRING.SCAN("gcc_kpss_ahb_clk", STRING.MID("&clk", 1, &clk_input_length-2), 0)!=-1)
    ( 
      &match=1
    )
  )
  else if (&wild_head==1)
  (
    if (STRING.MID("gcc_kpss_ahb_clk", &clk_itr_length-&clk_input_length+1, &clk_input_length-1)==STRING.CUT("&clk", 1))
    ( 
      &match=1
    )
  )
  else if (&wild_tail==1)
  (
    if (STRING.MID("gcc_kpss_ahb_clk", 0, &clk_input_length-1)==STRING.CUT("&clk", -1))
    ( 
      &match=1
    )
  )	  
  else if ("gcc_kpss_ahb_clk"=="&clk")
  (
    &match=1
  )
  
  if (&match==1)
  (
    &clk_test=&CLK_TEST_GCC_KPSS_AHB_CLK
    &clk_reg=&HWIO_GCC_KPSS_AHB_CBCR_ADDR
    &clk_reg_name="GCC_KPSS_AHB_CBCR"
    &clk_name="gcc_kpss_ahb_clk"
    &clk_reg_cbcr_type="sm_cbc"

    gosub Print_Clk_Info_Line
  )
  
  &match=0
  &wild_head=0
  &wild_tail=0
  &clk_input_length=STRING.LENGTH("&clk")
  &clk_itr_length=STRING.LENGTH("gcc_kpss_axi_clk")

  if (STRING.SCAN("&clk", "*", 0)==0)
  (
    &wild_head=1
  )
  if (STRING.SCAN("&clk", "*", 1)==(STRING.LENGTH("&clk")-1))
  (
    &wild_tail=1
  )

  if ((&wild_head==1)&&(&wild_tail==1))
  (
    if (STRING.SCAN("gcc_kpss_axi_clk", STRING.MID("&clk", 1, &clk_input_length-2), 0)!=-1)
    ( 
      &match=1
    )
  )
  else if (&wild_head==1)
  (
    if (STRING.MID("gcc_kpss_axi_clk", &clk_itr_length-&clk_input_length+1, &clk_input_length-1)==STRING.CUT("&clk", 1))
    ( 
      &match=1
    )
  )
  else if (&wild_tail==1)
  (
    if (STRING.MID("gcc_kpss_axi_clk", 0, &clk_input_length-1)==STRING.CUT("&clk", -1))
    ( 
      &match=1
    )
  )	  
  else if ("gcc_kpss_axi_clk"=="&clk")
  (
    &match=1
  )
  
  if (&match==1)
  (
    &clk_test=&CLK_TEST_GCC_KPSS_AXI_CLK
    &clk_reg=&HWIO_GCC_KPSS_AXI_CBCR_ADDR
    &clk_reg_name="GCC_KPSS_AXI_CBCR"
    &clk_name="gcc_kpss_axi_clk"
    &clk_reg_cbcr_type="sm_cbc"

    gosub Print_Clk_Info_Line
  )
  
  &match=0
  &wild_head=0
  &wild_tail=0
  &clk_input_length=STRING.LENGTH("&clk")
  &clk_itr_length=STRING.LENGTH("kpss_gcc_dbg_clk")

  if (STRING.SCAN("&clk", "*", 0)==0)
  (
    &wild_head=1
  )
  if (STRING.SCAN("&clk", "*", 1)==(STRING.LENGTH("&clk")-1))
  (
    &wild_tail=1
  )

  if ((&wild_head==1)&&(&wild_tail==1))
  (
    if (STRING.SCAN("kpss_gcc_dbg_clk", STRING.MID("&clk", 1, &clk_input_length-2), 0)!=-1)
    ( 
      &match=1
    )
  )
  else if (&wild_head==1)
  (
    if (STRING.MID("kpss_gcc_dbg_clk", &clk_itr_length-&clk_input_length+1, &clk_input_length-1)==STRING.CUT("&clk", 1))
    ( 
      &match=1
    )
  )
  else if (&wild_tail==1)
  (
    if (STRING.MID("kpss_gcc_dbg_clk", 0, &clk_input_length-1)==STRING.CUT("&clk", -1))
    ( 
      &match=1
    )
  )	  
  else if ("kpss_gcc_dbg_clk"=="&clk")
  (
    &match=1
  )
  
  if (&match==1)
  (
    &clk_test=&CLK_TEST_KPSS_GCC_DBG_CLK
    &clk_reg=0
    &clk_reg_name="No CBCR"
    &clk_name="kpss_gcc_dbg_clk"
    &clk_reg_cbcr_type=""

    gosub Print_Clk_Info_Line
  )
  
  &match=0
  &wild_head=0
  &wild_tail=0
  &clk_input_length=STRING.LENGTH("&clk")
  &clk_itr_length=STRING.LENGTH("gcc_lpass_mport_axi_clk")

  if (STRING.SCAN("&clk", "*", 0)==0)
  (
    &wild_head=1
  )
  if (STRING.SCAN("&clk", "*", 1)==(STRING.LENGTH("&clk")-1))
  (
    &wild_tail=1
  )

  if ((&wild_head==1)&&(&wild_tail==1))
  (
    if (STRING.SCAN("gcc_lpass_mport_axi_clk", STRING.MID("&clk", 1, &clk_input_length-2), 0)!=-1)
    ( 
      &match=1
    )
  )
  else if (&wild_head==1)
  (
    if (STRING.MID("gcc_lpass_mport_axi_clk", &clk_itr_length-&clk_input_length+1, &clk_input_length-1)==STRING.CUT("&clk", 1))
    ( 
      &match=1
    )
  )
  else if (&wild_tail==1)
  (
    if (STRING.MID("gcc_lpass_mport_axi_clk", 0, &clk_input_length-1)==STRING.CUT("&clk", -1))
    ( 
      &match=1
    )
  )	  
  else if ("gcc_lpass_mport_axi_clk"=="&clk")
  (
    &match=1
  )
  
  if (&match==1)
  (
    &clk_test=&CLK_TEST_GCC_LPASS_MPORT_AXI_CLK
    &clk_reg=&HWIO_GCC_LPASS_MPORT_AXI_CBCR_ADDR
    &clk_reg_name="GCC_LPASS_MPORT_AXI_CBCR"
    &clk_name="gcc_lpass_mport_axi_clk"
    &clk_reg_cbcr_type="sm_pscbc"

    gosub Print_Clk_Info_Line
  )
  
  &match=0
  &wild_head=0
  &wild_tail=0
  &clk_input_length=STRING.LENGTH("&clk")
  &clk_itr_length=STRING.LENGTH("gcc_lpass_q6_axi_clk")

  if (STRING.SCAN("&clk", "*", 0)==0)
  (
    &wild_head=1
  )
  if (STRING.SCAN("&clk", "*", 1)==(STRING.LENGTH("&clk")-1))
  (
    &wild_tail=1
  )

  if ((&wild_head==1)&&(&wild_tail==1))
  (
    if (STRING.SCAN("gcc_lpass_q6_axi_clk", STRING.MID("&clk", 1, &clk_input_length-2), 0)!=-1)
    ( 
      &match=1
    )
  )
  else if (&wild_head==1)
  (
    if (STRING.MID("gcc_lpass_q6_axi_clk", &clk_itr_length-&clk_input_length+1, &clk_input_length-1)==STRING.CUT("&clk", 1))
    ( 
      &match=1
    )
  )
  else if (&wild_tail==1)
  (
    if (STRING.MID("gcc_lpass_q6_axi_clk", 0, &clk_input_length-1)==STRING.CUT("&clk", -1))
    ( 
      &match=1
    )
  )	  
  else if ("gcc_lpass_q6_axi_clk"=="&clk")
  (
    &match=1
  )
  
  if (&match==1)
  (
    &clk_test=&CLK_TEST_GCC_LPASS_Q6_AXI_CLK
    &clk_reg=&HWIO_GCC_LPASS_Q6_AXI_CBCR_ADDR
    &clk_reg_name="GCC_LPASS_Q6_AXI_CBCR"
    &clk_name="gcc_lpass_q6_axi_clk"
    &clk_reg_cbcr_type="sm_pscbc"

    gosub Print_Clk_Info_Line
  )
  
  &match=0
  &wild_head=0
  &wild_tail=0
  &clk_input_length=STRING.LENGTH("&clk")
  &clk_itr_length=STRING.LENGTH("gcc_lpass_sway_clk")

  if (STRING.SCAN("&clk", "*", 0)==0)
  (
    &wild_head=1
  )
  if (STRING.SCAN("&clk", "*", 1)==(STRING.LENGTH("&clk")-1))
  (
    &wild_tail=1
  )

  if ((&wild_head==1)&&(&wild_tail==1))
  (
    if (STRING.SCAN("gcc_lpass_sway_clk", STRING.MID("&clk", 1, &clk_input_length-2), 0)!=-1)
    ( 
      &match=1
    )
  )
  else if (&wild_head==1)
  (
    if (STRING.MID("gcc_lpass_sway_clk", &clk_itr_length-&clk_input_length+1, &clk_input_length-1)==STRING.CUT("&clk", 1))
    ( 
      &match=1
    )
  )
  else if (&wild_tail==1)
  (
    if (STRING.MID("gcc_lpass_sway_clk", 0, &clk_input_length-1)==STRING.CUT("&clk", -1))
    ( 
      &match=1
    )
  )	  
  else if ("gcc_lpass_sway_clk"=="&clk")
  (
    &match=1
  )
  
  if (&match==1)
  (
    &clk_test=&CLK_TEST_GCC_LPASS_SWAY_CLK
    &clk_reg=&HWIO_GCC_LPASS_SWAY_CBCR_ADDR
    &clk_reg_name="GCC_LPASS_SWAY_CBCR"
    &clk_name="gcc_lpass_sway_clk"
    &clk_reg_cbcr_type="sm_cbc"

    gosub Print_Clk_Info_Line
  )
  
  &match=0
  &wild_head=0
  &wild_tail=0
  &clk_input_length=STRING.LENGTH("&clk")
  &clk_itr_length=STRING.LENGTH("lpass_gcc_dbg_clk")

  if (STRING.SCAN("&clk", "*", 0)==0)
  (
    &wild_head=1
  )
  if (STRING.SCAN("&clk", "*", 1)==(STRING.LENGTH("&clk")-1))
  (
    &wild_tail=1
  )

  if ((&wild_head==1)&&(&wild_tail==1))
  (
    if (STRING.SCAN("lpass_gcc_dbg_clk", STRING.MID("&clk", 1, &clk_input_length-2), 0)!=-1)
    ( 
      &match=1
    )
  )
  else if (&wild_head==1)
  (
    if (STRING.MID("lpass_gcc_dbg_clk", &clk_itr_length-&clk_input_length+1, &clk_input_length-1)==STRING.CUT("&clk", 1))
    ( 
      &match=1
    )
  )
  else if (&wild_tail==1)
  (
    if (STRING.MID("lpass_gcc_dbg_clk", 0, &clk_input_length-1)==STRING.CUT("&clk", -1))
    ( 
      &match=1
    )
  )	  
  else if ("lpass_gcc_dbg_clk"=="&clk")
  (
    &match=1
  )
  
  if (&match==1)
  (
    &clk_test=&CLK_TEST_LPASS_GCC_DBG_CLK
    &clk_reg=0
    &clk_reg_name="No CBCR"
    &clk_name="lpass_gcc_dbg_clk"
    &clk_reg_cbcr_type=""

    gosub Print_Clk_Info_Line
  )
  
  &match=0
  &wild_head=0
  &wild_tail=0
  &clk_input_length=STRING.LENGTH("&clk")
  &clk_itr_length=STRING.LENGTH("gcc_mmss_bimc_gfx_clk")

  if (STRING.SCAN("&clk", "*", 0)==0)
  (
    &wild_head=1
  )
  if (STRING.SCAN("&clk", "*", 1)==(STRING.LENGTH("&clk")-1))
  (
    &wild_tail=1
  )

  if ((&wild_head==1)&&(&wild_tail==1))
  (
    if (STRING.SCAN("gcc_mmss_bimc_gfx_clk", STRING.MID("&clk", 1, &clk_input_length-2), 0)!=-1)
    ( 
      &match=1
    )
  )
  else if (&wild_head==1)
  (
    if (STRING.MID("gcc_mmss_bimc_gfx_clk", &clk_itr_length-&clk_input_length+1, &clk_input_length-1)==STRING.CUT("&clk", 1))
    ( 
      &match=1
    )
  )
  else if (&wild_tail==1)
  (
    if (STRING.MID("gcc_mmss_bimc_gfx_clk", 0, &clk_input_length-1)==STRING.CUT("&clk", -1))
    ( 
      &match=1
    )
  )	  
  else if ("gcc_mmss_bimc_gfx_clk"=="&clk")
  (
    &match=1
  )
  
  if (&match==1)
  (
    &clk_test=&CLK_TEST_GCC_MMSS_BIMC_GFX_CLK
    &clk_reg=&HWIO_GCC_MMSS_BIMC_GFX_CBCR_ADDR
    &clk_reg_name="GCC_MMSS_BIMC_GFX_CBCR"
    &clk_name="gcc_mmss_bimc_gfx_clk"
    &clk_reg_cbcr_type="sm_pscbc"

    gosub Print_Clk_Info_Line
  )
  
  &match=0
  &wild_head=0
  &wild_tail=0
  &clk_input_length=STRING.LENGTH("&clk")
  &clk_itr_length=STRING.LENGTH("gcc_mmss_noc_at_clk")

  if (STRING.SCAN("&clk", "*", 0)==0)
  (
    &wild_head=1
  )
  if (STRING.SCAN("&clk", "*", 1)==(STRING.LENGTH("&clk")-1))
  (
    &wild_tail=1
  )

  if ((&wild_head==1)&&(&wild_tail==1))
  (
    if (STRING.SCAN("gcc_mmss_noc_at_clk", STRING.MID("&clk", 1, &clk_input_length-2), 0)!=-1)
    ( 
      &match=1
    )
  )
  else if (&wild_head==1)
  (
    if (STRING.MID("gcc_mmss_noc_at_clk", &clk_itr_length-&clk_input_length+1, &clk_input_length-1)==STRING.CUT("&clk", 1))
    ( 
      &match=1
    )
  )
  else if (&wild_tail==1)
  (
    if (STRING.MID("gcc_mmss_noc_at_clk", 0, &clk_input_length-1)==STRING.CUT("&clk", -1))
    ( 
      &match=1
    )
  )	  
  else if ("gcc_mmss_noc_at_clk"=="&clk")
  (
    &match=1
  )
  
  if (&match==1)
  (
    &clk_test=&CLK_TEST_GCC_MMSS_NOC_AT_CLK
    &clk_reg=&HWIO_GCC_MMSS_NOC_AT_CBCR_ADDR
    &clk_reg_name="GCC_MMSS_NOC_AT_CBCR"
    &clk_name="gcc_mmss_noc_at_clk"
    &clk_reg_cbcr_type="sm_cbc"

    gosub Print_Clk_Info_Line
  )
  
  &match=0
  &wild_head=0
  &wild_tail=0
  &clk_input_length=STRING.LENGTH("&clk")
  &clk_itr_length=STRING.LENGTH("gcc_mmss_noc_cfg_ahb_clk")

  if (STRING.SCAN("&clk", "*", 0)==0)
  (
    &wild_head=1
  )
  if (STRING.SCAN("&clk", "*", 1)==(STRING.LENGTH("&clk")-1))
  (
    &wild_tail=1
  )

  if ((&wild_head==1)&&(&wild_tail==1))
  (
    if (STRING.SCAN("gcc_mmss_noc_cfg_ahb_clk", STRING.MID("&clk", 1, &clk_input_length-2), 0)!=-1)
    ( 
      &match=1
    )
  )
  else if (&wild_head==1)
  (
    if (STRING.MID("gcc_mmss_noc_cfg_ahb_clk", &clk_itr_length-&clk_input_length+1, &clk_input_length-1)==STRING.CUT("&clk", 1))
    ( 
      &match=1
    )
  )
  else if (&wild_tail==1)
  (
    if (STRING.MID("gcc_mmss_noc_cfg_ahb_clk", 0, &clk_input_length-1)==STRING.CUT("&clk", -1))
    ( 
      &match=1
    )
  )	  
  else if ("gcc_mmss_noc_cfg_ahb_clk"=="&clk")
  (
    &match=1
  )
  
  if (&match==1)
  (
    &clk_test=&CLK_TEST_GCC_MMSS_NOC_CFG_AHB_CLK
    &clk_reg=&HWIO_GCC_MMSS_NOC_CFG_AHB_CBCR_ADDR
    &clk_reg_name="GCC_MMSS_NOC_CFG_AHB_CBCR"
    &clk_name="gcc_mmss_noc_cfg_ahb_clk"
    &clk_reg_cbcr_type="sm_cbc"

    gosub Print_Clk_Info_Line
  )
  
  &match=0
  &wild_head=0
  &wild_tail=0
  &clk_input_length=STRING.LENGTH("&clk")
  &clk_itr_length=STRING.LENGTH("gcc_mmss_vpu_maple_sys_noc_axi_clk")

  if (STRING.SCAN("&clk", "*", 0)==0)
  (
    &wild_head=1
  )
  if (STRING.SCAN("&clk", "*", 1)==(STRING.LENGTH("&clk")-1))
  (
    &wild_tail=1
  )

  if ((&wild_head==1)&&(&wild_tail==1))
  (
    if (STRING.SCAN("gcc_mmss_vpu_maple_sys_noc_axi_clk", STRING.MID("&clk", 1, &clk_input_length-2), 0)!=-1)
    ( 
      &match=1
    )
  )
  else if (&wild_head==1)
  (
    if (STRING.MID("gcc_mmss_vpu_maple_sys_noc_axi_clk", &clk_itr_length-&clk_input_length+1, &clk_input_length-1)==STRING.CUT("&clk", 1))
    ( 
      &match=1
    )
  )
  else if (&wild_tail==1)
  (
    if (STRING.MID("gcc_mmss_vpu_maple_sys_noc_axi_clk", 0, &clk_input_length-1)==STRING.CUT("&clk", -1))
    ( 
      &match=1
    )
  )	  
  else if ("gcc_mmss_vpu_maple_sys_noc_axi_clk"=="&clk")
  (
    &match=1
  )
  
  if (&match==1)
  (
    &clk_test=&CLK_TEST_GCC_MMSS_VPU_MAPLE_SYS_NOC_AXI_CLK
    &clk_reg=&HWIO_GCC_MMSS_VPU_MAPLE_SYS_NOC_AXI_CBCR_ADDR
    &clk_reg_name="GCC_MMSS_VPU_MAPLE_SYS_NOC_AXI_CBCR"
    &clk_name="gcc_mmss_vpu_maple_sys_noc_axi_clk"
    &clk_reg_cbcr_type="sm_cbc"

    gosub Print_Clk_Info_Line
  )
  
  &match=0
  &wild_head=0
  &wild_tail=0
  &clk_input_length=STRING.LENGTH("&clk")
  &clk_itr_length=STRING.LENGTH("gcc_ocmem_noc_cfg_ahb_clk")

  if (STRING.SCAN("&clk", "*", 0)==0)
  (
    &wild_head=1
  )
  if (STRING.SCAN("&clk", "*", 1)==(STRING.LENGTH("&clk")-1))
  (
    &wild_tail=1
  )

  if ((&wild_head==1)&&(&wild_tail==1))
  (
    if (STRING.SCAN("gcc_ocmem_noc_cfg_ahb_clk", STRING.MID("&clk", 1, &clk_input_length-2), 0)!=-1)
    ( 
      &match=1
    )
  )
  else if (&wild_head==1)
  (
    if (STRING.MID("gcc_ocmem_noc_cfg_ahb_clk", &clk_itr_length-&clk_input_length+1, &clk_input_length-1)==STRING.CUT("&clk", 1))
    ( 
      &match=1
    )
  )
  else if (&wild_tail==1)
  (
    if (STRING.MID("gcc_ocmem_noc_cfg_ahb_clk", 0, &clk_input_length-1)==STRING.CUT("&clk", -1))
    ( 
      &match=1
    )
  )	  
  else if ("gcc_ocmem_noc_cfg_ahb_clk"=="&clk")
  (
    &match=1
  )
  
  if (&match==1)
  (
    &clk_test=&CLK_TEST_GCC_OCMEM_NOC_CFG_AHB_CLK
    &clk_reg=&HWIO_GCC_OCMEM_NOC_CFG_AHB_CBCR_ADDR
    &clk_reg_name="GCC_OCMEM_NOC_CFG_AHB_CBCR"
    &clk_name="gcc_ocmem_noc_cfg_ahb_clk"
    &clk_reg_cbcr_type="sm_cbc"

    gosub Print_Clk_Info_Line
  )
  
  &match=0
  &wild_head=0
  &wild_tail=0
  &clk_input_length=STRING.LENGTH("&clk")
  &clk_itr_length=STRING.LENGTH("gcc_ocmem_sys_noc_axi_clk")

  if (STRING.SCAN("&clk", "*", 0)==0)
  (
    &wild_head=1
  )
  if (STRING.SCAN("&clk", "*", 1)==(STRING.LENGTH("&clk")-1))
  (
    &wild_tail=1
  )

  if ((&wild_head==1)&&(&wild_tail==1))
  (
    if (STRING.SCAN("gcc_ocmem_sys_noc_axi_clk", STRING.MID("&clk", 1, &clk_input_length-2), 0)!=-1)
    ( 
      &match=1
    )
  )
  else if (&wild_head==1)
  (
    if (STRING.MID("gcc_ocmem_sys_noc_axi_clk", &clk_itr_length-&clk_input_length+1, &clk_input_length-1)==STRING.CUT("&clk", 1))
    ( 
      &match=1
    )
  )
  else if (&wild_tail==1)
  (
    if (STRING.MID("gcc_ocmem_sys_noc_axi_clk", 0, &clk_input_length-1)==STRING.CUT("&clk", -1))
    ( 
      &match=1
    )
  )	  
  else if ("gcc_ocmem_sys_noc_axi_clk"=="&clk")
  (
    &match=1
  )
  
  if (&match==1)
  (
    &clk_test=&CLK_TEST_GCC_OCMEM_SYS_NOC_AXI_CLK
    &clk_reg=&HWIO_GCC_OCMEM_SYS_NOC_AXI_CBCR_ADDR
    &clk_reg_name="GCC_OCMEM_SYS_NOC_AXI_CBCR"
    &clk_name="gcc_ocmem_sys_noc_axi_clk"
    &clk_reg_cbcr_type="sm_cbc"

    gosub Print_Clk_Info_Line
  )
  
  &match=0
  &wild_head=0
  &wild_tail=0
  &clk_input_length=STRING.LENGTH("&clk")
  &clk_itr_length=STRING.LENGTH("mmss_gcc_dbg_clk")

  if (STRING.SCAN("&clk", "*", 0)==0)
  (
    &wild_head=1
  )
  if (STRING.SCAN("&clk", "*", 1)==(STRING.LENGTH("&clk")-1))
  (
    &wild_tail=1
  )

  if ((&wild_head==1)&&(&wild_tail==1))
  (
    if (STRING.SCAN("mmss_gcc_dbg_clk", STRING.MID("&clk", 1, &clk_input_length-2), 0)!=-1)
    ( 
      &match=1
    )
  )
  else if (&wild_head==1)
  (
    if (STRING.MID("mmss_gcc_dbg_clk", &clk_itr_length-&clk_input_length+1, &clk_input_length-1)==STRING.CUT("&clk", 1))
    ( 
      &match=1
    )
  )
  else if (&wild_tail==1)
  (
    if (STRING.MID("mmss_gcc_dbg_clk", 0, &clk_input_length-1)==STRING.CUT("&clk", -1))
    ( 
      &match=1
    )
  )	  
  else if ("mmss_gcc_dbg_clk"=="&clk")
  (
    &match=1
  )
  
  if (&match==1)
  (
    &clk_test=&CLK_TEST_MMSS_GCC_DBG_CLK
    &clk_reg=0
    &clk_reg_name="No CBCR"
    &clk_name="mmss_gcc_dbg_clk"
    &clk_reg_cbcr_type=""

    gosub Print_Clk_Info_Line
  )
  
  &match=0
  &wild_head=0
  &wild_tail=0
  &clk_input_length=STRING.LENGTH("&clk")
  &clk_itr_length=STRING.LENGTH("gcc_mpm_ahb_clk")

  if (STRING.SCAN("&clk", "*", 0)==0)
  (
    &wild_head=1
  )
  if (STRING.SCAN("&clk", "*", 1)==(STRING.LENGTH("&clk")-1))
  (
    &wild_tail=1
  )

  if ((&wild_head==1)&&(&wild_tail==1))
  (
    if (STRING.SCAN("gcc_mpm_ahb_clk", STRING.MID("&clk", 1, &clk_input_length-2), 0)!=-1)
    ( 
      &match=1
    )
  )
  else if (&wild_head==1)
  (
    if (STRING.MID("gcc_mpm_ahb_clk", &clk_itr_length-&clk_input_length+1, &clk_input_length-1)==STRING.CUT("&clk", 1))
    ( 
      &match=1
    )
  )
  else if (&wild_tail==1)
  (
    if (STRING.MID("gcc_mpm_ahb_clk", 0, &clk_input_length-1)==STRING.CUT("&clk", -1))
    ( 
      &match=1
    )
  )	  
  else if ("gcc_mpm_ahb_clk"=="&clk")
  (
    &match=1
  )
  
  if (&match==1)
  (
    &clk_test=&CLK_TEST_GCC_MPM_AHB_CLK
    &clk_reg=&HWIO_GCC_MPM_AHB_CBCR_ADDR
    &clk_reg_name="GCC_MPM_AHB_CBCR"
    &clk_name="gcc_mpm_ahb_clk"
    &clk_reg_cbcr_type="sm_cbc"

    gosub Print_Clk_Info_Line
  )
  
  &match=0
  &wild_head=0
  &wild_tail=0
  &clk_input_length=STRING.LENGTH("&clk")
  &clk_itr_length=STRING.LENGTH("gcc_msg_ram_ahb_clk")

  if (STRING.SCAN("&clk", "*", 0)==0)
  (
    &wild_head=1
  )
  if (STRING.SCAN("&clk", "*", 1)==(STRING.LENGTH("&clk")-1))
  (
    &wild_tail=1
  )

  if ((&wild_head==1)&&(&wild_tail==1))
  (
    if (STRING.SCAN("gcc_msg_ram_ahb_clk", STRING.MID("&clk", 1, &clk_input_length-2), 0)!=-1)
    ( 
      &match=1
    )
  )
  else if (&wild_head==1)
  (
    if (STRING.MID("gcc_msg_ram_ahb_clk", &clk_itr_length-&clk_input_length+1, &clk_input_length-1)==STRING.CUT("&clk", 1))
    ( 
      &match=1
    )
  )
  else if (&wild_tail==1)
  (
    if (STRING.MID("gcc_msg_ram_ahb_clk", 0, &clk_input_length-1)==STRING.CUT("&clk", -1))
    ( 
      &match=1
    )
  )	  
  else if ("gcc_msg_ram_ahb_clk"=="&clk")
  (
    &match=1
  )
  
  if (&match==1)
  (
    &clk_test=&CLK_TEST_GCC_MSG_RAM_AHB_CLK
    &clk_reg=&HWIO_GCC_MSG_RAM_AHB_CBCR_ADDR
    &clk_reg_name="GCC_MSG_RAM_AHB_CBCR"
    &clk_name="gcc_msg_ram_ahb_clk"
    &clk_reg_cbcr_type="sm_pscbc"

    gosub Print_Clk_Info_Line
  )
  
  &match=0
  &wild_head=0
  &wild_tail=0
  &clk_input_length=STRING.LENGTH("&clk")
  &clk_itr_length=STRING.LENGTH("gcc_noc_conf_xpu_ahb_clk")

  if (STRING.SCAN("&clk", "*", 0)==0)
  (
    &wild_head=1
  )
  if (STRING.SCAN("&clk", "*", 1)==(STRING.LENGTH("&clk")-1))
  (
    &wild_tail=1
  )

  if ((&wild_head==1)&&(&wild_tail==1))
  (
    if (STRING.SCAN("gcc_noc_conf_xpu_ahb_clk", STRING.MID("&clk", 1, &clk_input_length-2), 0)!=-1)
    ( 
      &match=1
    )
  )
  else if (&wild_head==1)
  (
    if (STRING.MID("gcc_noc_conf_xpu_ahb_clk", &clk_itr_length-&clk_input_length+1, &clk_input_length-1)==STRING.CUT("&clk", 1))
    ( 
      &match=1
    )
  )
  else if (&wild_tail==1)
  (
    if (STRING.MID("gcc_noc_conf_xpu_ahb_clk", 0, &clk_input_length-1)==STRING.CUT("&clk", -1))
    ( 
      &match=1
    )
  )	  
  else if ("gcc_noc_conf_xpu_ahb_clk"=="&clk")
  (
    &match=1
  )
  
  if (&match==1)
  (
    &clk_test=&CLK_TEST_GCC_NOC_CONF_XPU_AHB_CLK
    &clk_reg=&HWIO_GCC_NOC_CONF_XPU_AHB_CBCR_ADDR
    &clk_reg_name="GCC_NOC_CONF_XPU_AHB_CBCR"
    &clk_name="gcc_noc_conf_xpu_ahb_clk"
    &clk_reg_cbcr_type="sm_cbc"

    gosub Print_Clk_Info_Line
  )
  
  &match=0
  &wild_head=0
  &wild_tail=0
  &clk_input_length=STRING.LENGTH("&clk")
  &clk_itr_length=STRING.LENGTH("gcc_obt_odt_clk")

  if (STRING.SCAN("&clk", "*", 0)==0)
  (
    &wild_head=1
  )
  if (STRING.SCAN("&clk", "*", 1)==(STRING.LENGTH("&clk")-1))
  (
    &wild_tail=1
  )

  if ((&wild_head==1)&&(&wild_tail==1))
  (
    if (STRING.SCAN("gcc_obt_odt_clk", STRING.MID("&clk", 1, &clk_input_length-2), 0)!=-1)
    ( 
      &match=1
    )
  )
  else if (&wild_head==1)
  (
    if (STRING.MID("gcc_obt_odt_clk", &clk_itr_length-&clk_input_length+1, &clk_input_length-1)==STRING.CUT("&clk", 1))
    ( 
      &match=1
    )
  )
  else if (&wild_tail==1)
  (
    if (STRING.MID("gcc_obt_odt_clk", 0, &clk_input_length-1)==STRING.CUT("&clk", -1))
    ( 
      &match=1
    )
  )	  
  else if ("gcc_obt_odt_clk"=="&clk")
  (
    &match=1
  )
  
  if (&match==1)
  (
    &clk_test=&CLK_TEST_GCC_OBT_ODT_CLK
    &clk_reg=&HWIO_GCC_OBT_ODT_CBCR_ADDR
    &clk_reg_name="GCC_OBT_ODT_CBCR"
    &clk_name="gcc_obt_odt_clk"
    &clk_reg_cbcr_type="sm_cbc"

    gosub Print_Clk_Info_Line
  )
  
  &match=0
  &wild_head=0
  &wild_tail=0
  &clk_input_length=STRING.LENGTH("&clk")
  &clk_itr_length=STRING.LENGTH("ch0_dll0_dtest")

  if (STRING.SCAN("&clk", "*", 0)==0)
  (
    &wild_head=1
  )
  if (STRING.SCAN("&clk", "*", 1)==(STRING.LENGTH("&clk")-1))
  (
    &wild_tail=1
  )

  if ((&wild_head==1)&&(&wild_tail==1))
  (
    if (STRING.SCAN("ch0_dll0_dtest", STRING.MID("&clk", 1, &clk_input_length-2), 0)!=-1)
    ( 
      &match=1
    )
  )
  else if (&wild_head==1)
  (
    if (STRING.MID("ch0_dll0_dtest", &clk_itr_length-&clk_input_length+1, &clk_input_length-1)==STRING.CUT("&clk", 1))
    ( 
      &match=1
    )
  )
  else if (&wild_tail==1)
  (
    if (STRING.MID("ch0_dll0_dtest", 0, &clk_input_length-1)==STRING.CUT("&clk", -1))
    ( 
      &match=1
    )
  )	  
  else if ("ch0_dll0_dtest"=="&clk")
  (
    &match=1
  )
  
  if (&match==1)
  (
    &clk_test=&CLK_TEST_CH0_DLL0_DTEST
    &clk_reg=0
    &clk_reg_name="No CBCR"
    &clk_name="ch0_dll0_dtest"
    &clk_reg_cbcr_type=""

    gosub Print_Clk_Info_Line
  )
  
  &match=0
  &wild_head=0
  &wild_tail=0
  &clk_input_length=STRING.LENGTH("&clk")
  &clk_itr_length=STRING.LENGTH("ch0_dll0_lock")

  if (STRING.SCAN("&clk", "*", 0)==0)
  (
    &wild_head=1
  )
  if (STRING.SCAN("&clk", "*", 1)==(STRING.LENGTH("&clk")-1))
  (
    &wild_tail=1
  )

  if ((&wild_head==1)&&(&wild_tail==1))
  (
    if (STRING.SCAN("ch0_dll0_lock", STRING.MID("&clk", 1, &clk_input_length-2), 0)!=-1)
    ( 
      &match=1
    )
  )
  else if (&wild_head==1)
  (
    if (STRING.MID("ch0_dll0_lock", &clk_itr_length-&clk_input_length+1, &clk_input_length-1)==STRING.CUT("&clk", 1))
    ( 
      &match=1
    )
  )
  else if (&wild_tail==1)
  (
    if (STRING.MID("ch0_dll0_lock", 0, &clk_input_length-1)==STRING.CUT("&clk", -1))
    ( 
      &match=1
    )
  )	  
  else if ("ch0_dll0_lock"=="&clk")
  (
    &match=1
  )
  
  if (&match==1)
  (
    &clk_test=&CLK_TEST_CH0_DLL0_LOCK
    &clk_reg=0
    &clk_reg_name="No CBCR"
    &clk_name="ch0_dll0_lock"
    &clk_reg_cbcr_type=""

    gosub Print_Clk_Info_Line
  )
  
  &match=0
  &wild_head=0
  &wild_tail=0
  &clk_input_length=STRING.LENGTH("&clk")
  &clk_itr_length=STRING.LENGTH("ch0_dll1_dtest")

  if (STRING.SCAN("&clk", "*", 0)==0)
  (
    &wild_head=1
  )
  if (STRING.SCAN("&clk", "*", 1)==(STRING.LENGTH("&clk")-1))
  (
    &wild_tail=1
  )

  if ((&wild_head==1)&&(&wild_tail==1))
  (
    if (STRING.SCAN("ch0_dll1_dtest", STRING.MID("&clk", 1, &clk_input_length-2), 0)!=-1)
    ( 
      &match=1
    )
  )
  else if (&wild_head==1)
  (
    if (STRING.MID("ch0_dll1_dtest", &clk_itr_length-&clk_input_length+1, &clk_input_length-1)==STRING.CUT("&clk", 1))
    ( 
      &match=1
    )
  )
  else if (&wild_tail==1)
  (
    if (STRING.MID("ch0_dll1_dtest", 0, &clk_input_length-1)==STRING.CUT("&clk", -1))
    ( 
      &match=1
    )
  )	  
  else if ("ch0_dll1_dtest"=="&clk")
  (
    &match=1
  )
  
  if (&match==1)
  (
    &clk_test=&CLK_TEST_CH0_DLL1_DTEST
    &clk_reg=0
    &clk_reg_name="No CBCR"
    &clk_name="ch0_dll1_dtest"
    &clk_reg_cbcr_type=""

    gosub Print_Clk_Info_Line
  )
  
  &match=0
  &wild_head=0
  &wild_tail=0
  &clk_input_length=STRING.LENGTH("&clk")
  &clk_itr_length=STRING.LENGTH("ch0_dll1_lock")

  if (STRING.SCAN("&clk", "*", 0)==0)
  (
    &wild_head=1
  )
  if (STRING.SCAN("&clk", "*", 1)==(STRING.LENGTH("&clk")-1))
  (
    &wild_tail=1
  )

  if ((&wild_head==1)&&(&wild_tail==1))
  (
    if (STRING.SCAN("ch0_dll1_lock", STRING.MID("&clk", 1, &clk_input_length-2), 0)!=-1)
    ( 
      &match=1
    )
  )
  else if (&wild_head==1)
  (
    if (STRING.MID("ch0_dll1_lock", &clk_itr_length-&clk_input_length+1, &clk_input_length-1)==STRING.CUT("&clk", 1))
    ( 
      &match=1
    )
  )
  else if (&wild_tail==1)
  (
    if (STRING.MID("ch0_dll1_lock", 0, &clk_input_length-1)==STRING.CUT("&clk", -1))
    ( 
      &match=1
    )
  )	  
  else if ("ch0_dll1_lock"=="&clk")
  (
    &match=1
  )
  
  if (&match==1)
  (
    &clk_test=&CLK_TEST_CH0_DLL1_LOCK
    &clk_reg=0
    &clk_reg_name="No CBCR"
    &clk_name="ch0_dll1_lock"
    &clk_reg_cbcr_type=""

    gosub Print_Clk_Info_Line
  )
  
  &match=0
  &wild_head=0
  &wild_tail=0
  &clk_input_length=STRING.LENGTH("&clk")
  &clk_itr_length=STRING.LENGTH("ch1_dll0_dtest")

  if (STRING.SCAN("&clk", "*", 0)==0)
  (
    &wild_head=1
  )
  if (STRING.SCAN("&clk", "*", 1)==(STRING.LENGTH("&clk")-1))
  (
    &wild_tail=1
  )

  if ((&wild_head==1)&&(&wild_tail==1))
  (
    if (STRING.SCAN("ch1_dll0_dtest", STRING.MID("&clk", 1, &clk_input_length-2), 0)!=-1)
    ( 
      &match=1
    )
  )
  else if (&wild_head==1)
  (
    if (STRING.MID("ch1_dll0_dtest", &clk_itr_length-&clk_input_length+1, &clk_input_length-1)==STRING.CUT("&clk", 1))
    ( 
      &match=1
    )
  )
  else if (&wild_tail==1)
  (
    if (STRING.MID("ch1_dll0_dtest", 0, &clk_input_length-1)==STRING.CUT("&clk", -1))
    ( 
      &match=1
    )
  )	  
  else if ("ch1_dll0_dtest"=="&clk")
  (
    &match=1
  )
  
  if (&match==1)
  (
    &clk_test=&CLK_TEST_CH1_DLL0_DTEST
    &clk_reg=0
    &clk_reg_name="No CBCR"
    &clk_name="ch1_dll0_dtest"
    &clk_reg_cbcr_type=""

    gosub Print_Clk_Info_Line
  )
  
  &match=0
  &wild_head=0
  &wild_tail=0
  &clk_input_length=STRING.LENGTH("&clk")
  &clk_itr_length=STRING.LENGTH("ch1_dll0_lock")

  if (STRING.SCAN("&clk", "*", 0)==0)
  (
    &wild_head=1
  )
  if (STRING.SCAN("&clk", "*", 1)==(STRING.LENGTH("&clk")-1))
  (
    &wild_tail=1
  )

  if ((&wild_head==1)&&(&wild_tail==1))
  (
    if (STRING.SCAN("ch1_dll0_lock", STRING.MID("&clk", 1, &clk_input_length-2), 0)!=-1)
    ( 
      &match=1
    )
  )
  else if (&wild_head==1)
  (
    if (STRING.MID("ch1_dll0_lock", &clk_itr_length-&clk_input_length+1, &clk_input_length-1)==STRING.CUT("&clk", 1))
    ( 
      &match=1
    )
  )
  else if (&wild_tail==1)
  (
    if (STRING.MID("ch1_dll0_lock", 0, &clk_input_length-1)==STRING.CUT("&clk", -1))
    ( 
      &match=1
    )
  )	  
  else if ("ch1_dll0_lock"=="&clk")
  (
    &match=1
  )
  
  if (&match==1)
  (
    &clk_test=&CLK_TEST_CH1_DLL0_LOCK
    &clk_reg=0
    &clk_reg_name="No CBCR"
    &clk_name="ch1_dll0_lock"
    &clk_reg_cbcr_type=""

    gosub Print_Clk_Info_Line
  )
  
  &match=0
  &wild_head=0
  &wild_tail=0
  &clk_input_length=STRING.LENGTH("&clk")
  &clk_itr_length=STRING.LENGTH("ch1_dll1_dtest")

  if (STRING.SCAN("&clk", "*", 0)==0)
  (
    &wild_head=1
  )
  if (STRING.SCAN("&clk", "*", 1)==(STRING.LENGTH("&clk")-1))
  (
    &wild_tail=1
  )

  if ((&wild_head==1)&&(&wild_tail==1))
  (
    if (STRING.SCAN("ch1_dll1_dtest", STRING.MID("&clk", 1, &clk_input_length-2), 0)!=-1)
    ( 
      &match=1
    )
  )
  else if (&wild_head==1)
  (
    if (STRING.MID("ch1_dll1_dtest", &clk_itr_length-&clk_input_length+1, &clk_input_length-1)==STRING.CUT("&clk", 1))
    ( 
      &match=1
    )
  )
  else if (&wild_tail==1)
  (
    if (STRING.MID("ch1_dll1_dtest", 0, &clk_input_length-1)==STRING.CUT("&clk", -1))
    ( 
      &match=1
    )
  )	  
  else if ("ch1_dll1_dtest"=="&clk")
  (
    &match=1
  )
  
  if (&match==1)
  (
    &clk_test=&CLK_TEST_CH1_DLL1_DTEST
    &clk_reg=0
    &clk_reg_name="No CBCR"
    &clk_name="ch1_dll1_dtest"
    &clk_reg_cbcr_type=""

    gosub Print_Clk_Info_Line
  )
  
  &match=0
  &wild_head=0
  &wild_tail=0
  &clk_input_length=STRING.LENGTH("&clk")
  &clk_itr_length=STRING.LENGTH("ch1_dll1_lock")

  if (STRING.SCAN("&clk", "*", 0)==0)
  (
    &wild_head=1
  )
  if (STRING.SCAN("&clk", "*", 1)==(STRING.LENGTH("&clk")-1))
  (
    &wild_tail=1
  )

  if ((&wild_head==1)&&(&wild_tail==1))
  (
    if (STRING.SCAN("ch1_dll1_lock", STRING.MID("&clk", 1, &clk_input_length-2), 0)!=-1)
    ( 
      &match=1
    )
  )
  else if (&wild_head==1)
  (
    if (STRING.MID("ch1_dll1_lock", &clk_itr_length-&clk_input_length+1, &clk_input_length-1)==STRING.CUT("&clk", 1))
    ( 
      &match=1
    )
  )
  else if (&wild_tail==1)
  (
    if (STRING.MID("ch1_dll1_lock", 0, &clk_input_length-1)==STRING.CUT("&clk", -1))
    ( 
      &match=1
    )
  )	  
  else if ("ch1_dll1_lock"=="&clk")
  (
    &match=1
  )
  
  if (&match==1)
  (
    &clk_test=&CLK_TEST_CH1_DLL1_LOCK
    &clk_reg=0
    &clk_reg_name="No CBCR"
    &clk_name="ch1_dll1_lock"
    &clk_reg_cbcr_type=""

    gosub Print_Clk_Info_Line
  )
  
  &match=0
  &wild_head=0
  &wild_tail=0
  &clk_input_length=STRING.LENGTH("&clk")
  &clk_itr_length=STRING.LENGTH("gpll0_dtest")

  if (STRING.SCAN("&clk", "*", 0)==0)
  (
    &wild_head=1
  )
  if (STRING.SCAN("&clk", "*", 1)==(STRING.LENGTH("&clk")-1))
  (
    &wild_tail=1
  )

  if ((&wild_head==1)&&(&wild_tail==1))
  (
    if (STRING.SCAN("gpll0_dtest", STRING.MID("&clk", 1, &clk_input_length-2), 0)!=-1)
    ( 
      &match=1
    )
  )
  else if (&wild_head==1)
  (
    if (STRING.MID("gpll0_dtest", &clk_itr_length-&clk_input_length+1, &clk_input_length-1)==STRING.CUT("&clk", 1))
    ( 
      &match=1
    )
  )
  else if (&wild_tail==1)
  (
    if (STRING.MID("gpll0_dtest", 0, &clk_input_length-1)==STRING.CUT("&clk", -1))
    ( 
      &match=1
    )
  )	  
  else if ("gpll0_dtest"=="&clk")
  (
    &match=1
  )
  
  if (&match==1)
  (
    &clk_test=&CLK_TEST_GPLL0_DTEST
    &clk_reg=0
    &clk_reg_name="No CBCR"
    &clk_name="gpll0_dtest"
    &clk_reg_cbcr_type=""

    gosub Print_Clk_Info_Line
  )
  
  &match=0
  &wild_head=0
  &wild_tail=0
  &clk_input_length=STRING.LENGTH("&clk")
  &clk_itr_length=STRING.LENGTH("gpll0_lock_det")

  if (STRING.SCAN("&clk", "*", 0)==0)
  (
    &wild_head=1
  )
  if (STRING.SCAN("&clk", "*", 1)==(STRING.LENGTH("&clk")-1))
  (
    &wild_tail=1
  )

  if ((&wild_head==1)&&(&wild_tail==1))
  (
    if (STRING.SCAN("gpll0_lock_det", STRING.MID("&clk", 1, &clk_input_length-2), 0)!=-1)
    ( 
      &match=1
    )
  )
  else if (&wild_head==1)
  (
    if (STRING.MID("gpll0_lock_det", &clk_itr_length-&clk_input_length+1, &clk_input_length-1)==STRING.CUT("&clk", 1))
    ( 
      &match=1
    )
  )
  else if (&wild_tail==1)
  (
    if (STRING.MID("gpll0_lock_det", 0, &clk_input_length-1)==STRING.CUT("&clk", -1))
    ( 
      &match=1
    )
  )	  
  else if ("gpll0_lock_det"=="&clk")
  (
    &match=1
  )
  
  if (&match==1)
  (
    &clk_test=&CLK_TEST_GPLL0_LOCK_DET
    &clk_reg=0
    &clk_reg_name="No CBCR"
    &clk_name="gpll0_lock_det"
    &clk_reg_cbcr_type=""

    gosub Print_Clk_Info_Line
  )
  
  &match=0
  &wild_head=0
  &wild_tail=0
  &clk_input_length=STRING.LENGTH("&clk")
  &clk_itr_length=STRING.LENGTH("gpll1_dtest")

  if (STRING.SCAN("&clk", "*", 0)==0)
  (
    &wild_head=1
  )
  if (STRING.SCAN("&clk", "*", 1)==(STRING.LENGTH("&clk")-1))
  (
    &wild_tail=1
  )

  if ((&wild_head==1)&&(&wild_tail==1))
  (
    if (STRING.SCAN("gpll1_dtest", STRING.MID("&clk", 1, &clk_input_length-2), 0)!=-1)
    ( 
      &match=1
    )
  )
  else if (&wild_head==1)
  (
    if (STRING.MID("gpll1_dtest", &clk_itr_length-&clk_input_length+1, &clk_input_length-1)==STRING.CUT("&clk", 1))
    ( 
      &match=1
    )
  )
  else if (&wild_tail==1)
  (
    if (STRING.MID("gpll1_dtest", 0, &clk_input_length-1)==STRING.CUT("&clk", -1))
    ( 
      &match=1
    )
  )	  
  else if ("gpll1_dtest"=="&clk")
  (
    &match=1
  )
  
  if (&match==1)
  (
    &clk_test=&CLK_TEST_GPLL1_DTEST
    &clk_reg=0
    &clk_reg_name="No CBCR"
    &clk_name="gpll1_dtest"
    &clk_reg_cbcr_type=""

    gosub Print_Clk_Info_Line
  )
  
  &match=0
  &wild_head=0
  &wild_tail=0
  &clk_input_length=STRING.LENGTH("&clk")
  &clk_itr_length=STRING.LENGTH("gpll1_lock_det")

  if (STRING.SCAN("&clk", "*", 0)==0)
  (
    &wild_head=1
  )
  if (STRING.SCAN("&clk", "*", 1)==(STRING.LENGTH("&clk")-1))
  (
    &wild_tail=1
  )

  if ((&wild_head==1)&&(&wild_tail==1))
  (
    if (STRING.SCAN("gpll1_lock_det", STRING.MID("&clk", 1, &clk_input_length-2), 0)!=-1)
    ( 
      &match=1
    )
  )
  else if (&wild_head==1)
  (
    if (STRING.MID("gpll1_lock_det", &clk_itr_length-&clk_input_length+1, &clk_input_length-1)==STRING.CUT("&clk", 1))
    ( 
      &match=1
    )
  )
  else if (&wild_tail==1)
  (
    if (STRING.MID("gpll1_lock_det", 0, &clk_input_length-1)==STRING.CUT("&clk", -1))
    ( 
      &match=1
    )
  )	  
  else if ("gpll1_lock_det"=="&clk")
  (
    &match=1
  )
  
  if (&match==1)
  (
    &clk_test=&CLK_TEST_GPLL1_LOCK_DET
    &clk_reg=0
    &clk_reg_name="No CBCR"
    &clk_name="gpll1_lock_det"
    &clk_reg_cbcr_type=""

    gosub Print_Clk_Info_Line
  )
  
  &match=0
  &wild_head=0
  &wild_tail=0
  &clk_input_length=STRING.LENGTH("&clk")
  &clk_itr_length=STRING.LENGTH("gpll2_dtest")

  if (STRING.SCAN("&clk", "*", 0)==0)
  (
    &wild_head=1
  )
  if (STRING.SCAN("&clk", "*", 1)==(STRING.LENGTH("&clk")-1))
  (
    &wild_tail=1
  )

  if ((&wild_head==1)&&(&wild_tail==1))
  (
    if (STRING.SCAN("gpll2_dtest", STRING.MID("&clk", 1, &clk_input_length-2), 0)!=-1)
    ( 
      &match=1
    )
  )
  else if (&wild_head==1)
  (
    if (STRING.MID("gpll2_dtest", &clk_itr_length-&clk_input_length+1, &clk_input_length-1)==STRING.CUT("&clk", 1))
    ( 
      &match=1
    )
  )
  else if (&wild_tail==1)
  (
    if (STRING.MID("gpll2_dtest", 0, &clk_input_length-1)==STRING.CUT("&clk", -1))
    ( 
      &match=1
    )
  )	  
  else if ("gpll2_dtest"=="&clk")
  (
    &match=1
  )
  
  if (&match==1)
  (
    &clk_test=&CLK_TEST_GPLL2_DTEST
    &clk_reg=0
    &clk_reg_name="No CBCR"
    &clk_name="gpll2_dtest"
    &clk_reg_cbcr_type=""

    gosub Print_Clk_Info_Line
  )
  
  &match=0
  &wild_head=0
  &wild_tail=0
  &clk_input_length=STRING.LENGTH("&clk")
  &clk_itr_length=STRING.LENGTH("gpll2_lock_det")

  if (STRING.SCAN("&clk", "*", 0)==0)
  (
    &wild_head=1
  )
  if (STRING.SCAN("&clk", "*", 1)==(STRING.LENGTH("&clk")-1))
  (
    &wild_tail=1
  )

  if ((&wild_head==1)&&(&wild_tail==1))
  (
    if (STRING.SCAN("gpll2_lock_det", STRING.MID("&clk", 1, &clk_input_length-2), 0)!=-1)
    ( 
      &match=1
    )
  )
  else if (&wild_head==1)
  (
    if (STRING.MID("gpll2_lock_det", &clk_itr_length-&clk_input_length+1, &clk_input_length-1)==STRING.CUT("&clk", 1))
    ( 
      &match=1
    )
  )
  else if (&wild_tail==1)
  (
    if (STRING.MID("gpll2_lock_det", 0, &clk_input_length-1)==STRING.CUT("&clk", -1))
    ( 
      &match=1
    )
  )	  
  else if ("gpll2_lock_det"=="&clk")
  (
    &match=1
  )
  
  if (&match==1)
  (
    &clk_test=&CLK_TEST_GPLL2_LOCK_DET
    &clk_reg=0
    &clk_reg_name="No CBCR"
    &clk_name="gpll2_lock_det"
    &clk_reg_cbcr_type=""

    gosub Print_Clk_Info_Line
  )
  
  &match=0
  &wild_head=0
  &wild_tail=0
  &clk_input_length=STRING.LENGTH("&clk")
  &clk_itr_length=STRING.LENGTH("gpll3_dtest")

  if (STRING.SCAN("&clk", "*", 0)==0)
  (
    &wild_head=1
  )
  if (STRING.SCAN("&clk", "*", 1)==(STRING.LENGTH("&clk")-1))
  (
    &wild_tail=1
  )

  if ((&wild_head==1)&&(&wild_tail==1))
  (
    if (STRING.SCAN("gpll3_dtest", STRING.MID("&clk", 1, &clk_input_length-2), 0)!=-1)
    ( 
      &match=1
    )
  )
  else if (&wild_head==1)
  (
    if (STRING.MID("gpll3_dtest", &clk_itr_length-&clk_input_length+1, &clk_input_length-1)==STRING.CUT("&clk", 1))
    ( 
      &match=1
    )
  )
  else if (&wild_tail==1)
  (
    if (STRING.MID("gpll3_dtest", 0, &clk_input_length-1)==STRING.CUT("&clk", -1))
    ( 
      &match=1
    )
  )	  
  else if ("gpll3_dtest"=="&clk")
  (
    &match=1
  )
  
  if (&match==1)
  (
    &clk_test=&CLK_TEST_GPLL3_DTEST
    &clk_reg=0
    &clk_reg_name="No CBCR"
    &clk_name="gpll3_dtest"
    &clk_reg_cbcr_type=""

    gosub Print_Clk_Info_Line
  )
  
  &match=0
  &wild_head=0
  &wild_tail=0
  &clk_input_length=STRING.LENGTH("&clk")
  &clk_itr_length=STRING.LENGTH("gpll3_lock_det")

  if (STRING.SCAN("&clk", "*", 0)==0)
  (
    &wild_head=1
  )
  if (STRING.SCAN("&clk", "*", 1)==(STRING.LENGTH("&clk")-1))
  (
    &wild_tail=1
  )

  if ((&wild_head==1)&&(&wild_tail==1))
  (
    if (STRING.SCAN("gpll3_lock_det", STRING.MID("&clk", 1, &clk_input_length-2), 0)!=-1)
    ( 
      &match=1
    )
  )
  else if (&wild_head==1)
  (
    if (STRING.MID("gpll3_lock_det", &clk_itr_length-&clk_input_length+1, &clk_input_length-1)==STRING.CUT("&clk", 1))
    ( 
      &match=1
    )
  )
  else if (&wild_tail==1)
  (
    if (STRING.MID("gpll3_lock_det", 0, &clk_input_length-1)==STRING.CUT("&clk", -1))
    ( 
      &match=1
    )
  )	  
  else if ("gpll3_lock_det"=="&clk")
  (
    &match=1
  )
  
  if (&match==1)
  (
    &clk_test=&CLK_TEST_GPLL3_LOCK_DET
    &clk_reg=0
    &clk_reg_name="No CBCR"
    &clk_name="gpll3_lock_det"
    &clk_reg_cbcr_type=""

    gosub Print_Clk_Info_Line
  )
  
  &match=0
  &wild_head=0
  &wild_tail=0
  &clk_input_length=STRING.LENGTH("&clk")
  &clk_itr_length=STRING.LENGTH("gpll4_dtest")

  if (STRING.SCAN("&clk", "*", 0)==0)
  (
    &wild_head=1
  )
  if (STRING.SCAN("&clk", "*", 1)==(STRING.LENGTH("&clk")-1))
  (
    &wild_tail=1
  )

  if ((&wild_head==1)&&(&wild_tail==1))
  (
    if (STRING.SCAN("gpll4_dtest", STRING.MID("&clk", 1, &clk_input_length-2), 0)!=-1)
    ( 
      &match=1
    )
  )
  else if (&wild_head==1)
  (
    if (STRING.MID("gpll4_dtest", &clk_itr_length-&clk_input_length+1, &clk_input_length-1)==STRING.CUT("&clk", 1))
    ( 
      &match=1
    )
  )
  else if (&wild_tail==1)
  (
    if (STRING.MID("gpll4_dtest", 0, &clk_input_length-1)==STRING.CUT("&clk", -1))
    ( 
      &match=1
    )
  )	  
  else if ("gpll4_dtest"=="&clk")
  (
    &match=1
  )
  
  if (&match==1)
  (
    &clk_test=&CLK_TEST_GPLL4_DTEST
    &clk_reg=0
    &clk_reg_name="No CBCR"
    &clk_name="gpll4_dtest"
    &clk_reg_cbcr_type=""

    gosub Print_Clk_Info_Line
  )
  
  &match=0
  &wild_head=0
  &wild_tail=0
  &clk_input_length=STRING.LENGTH("&clk")
  &clk_itr_length=STRING.LENGTH("gpll4_lock_det")

  if (STRING.SCAN("&clk", "*", 0)==0)
  (
    &wild_head=1
  )
  if (STRING.SCAN("&clk", "*", 1)==(STRING.LENGTH("&clk")-1))
  (
    &wild_tail=1
  )

  if ((&wild_head==1)&&(&wild_tail==1))
  (
    if (STRING.SCAN("gpll4_lock_det", STRING.MID("&clk", 1, &clk_input_length-2), 0)!=-1)
    ( 
      &match=1
    )
  )
  else if (&wild_head==1)
  (
    if (STRING.MID("gpll4_lock_det", &clk_itr_length-&clk_input_length+1, &clk_input_length-1)==STRING.CUT("&clk", 1))
    ( 
      &match=1
    )
  )
  else if (&wild_tail==1)
  (
    if (STRING.MID("gpll4_lock_det", 0, &clk_input_length-1)==STRING.CUT("&clk", -1))
    ( 
      &match=1
    )
  )	  
  else if ("gpll4_lock_det"=="&clk")
  (
    &match=1
  )
  
  if (&match==1)
  (
    &clk_test=&CLK_TEST_GPLL4_LOCK_DET
    &clk_reg=0
    &clk_reg_name="No CBCR"
    &clk_name="gpll4_lock_det"
    &clk_reg_cbcr_type=""

    gosub Print_Clk_Info_Line
  )
  
  &match=0
  &wild_head=0
  &wild_tail=0
  &clk_input_length=STRING.LENGTH("&clk")
  &clk_itr_length=STRING.LENGTH("kpss_gcc_ringosc_clk")

  if (STRING.SCAN("&clk", "*", 0)==0)
  (
    &wild_head=1
  )
  if (STRING.SCAN("&clk", "*", 1)==(STRING.LENGTH("&clk")-1))
  (
    &wild_tail=1
  )

  if ((&wild_head==1)&&(&wild_tail==1))
  (
    if (STRING.SCAN("kpss_gcc_ringosc_clk", STRING.MID("&clk", 1, &clk_input_length-2), 0)!=-1)
    ( 
      &match=1
    )
  )
  else if (&wild_head==1)
  (
    if (STRING.MID("kpss_gcc_ringosc_clk", &clk_itr_length-&clk_input_length+1, &clk_input_length-1)==STRING.CUT("&clk", 1))
    ( 
      &match=1
    )
  )
  else if (&wild_tail==1)
  (
    if (STRING.MID("kpss_gcc_ringosc_clk", 0, &clk_input_length-1)==STRING.CUT("&clk", -1))
    ( 
      &match=1
    )
  )	  
  else if ("kpss_gcc_ringosc_clk"=="&clk")
  (
    &match=1
  )
  
  if (&match==1)
  (
    &clk_test=&CLK_TEST_KPSS_GCC_RINGOSC_CLK
    &clk_reg=0
    &clk_reg_name="No CBCR"
    &clk_name="kpss_gcc_ringosc_clk"
    &clk_reg_cbcr_type=""

    gosub Print_Clk_Info_Line
  )
  
  &match=0
  &wild_head=0
  &wild_tail=0
  &clk_input_length=STRING.LENGTH("&clk")
  &clk_itr_length=STRING.LENGTH("mpm_gcc_temp_sensor_ringosc_clk")

  if (STRING.SCAN("&clk", "*", 0)==0)
  (
    &wild_head=1
  )
  if (STRING.SCAN("&clk", "*", 1)==(STRING.LENGTH("&clk")-1))
  (
    &wild_tail=1
  )

  if ((&wild_head==1)&&(&wild_tail==1))
  (
    if (STRING.SCAN("mpm_gcc_temp_sensor_ringosc_clk", STRING.MID("&clk", 1, &clk_input_length-2), 0)!=-1)
    ( 
      &match=1
    )
  )
  else if (&wild_head==1)
  (
    if (STRING.MID("mpm_gcc_temp_sensor_ringosc_clk", &clk_itr_length-&clk_input_length+1, &clk_input_length-1)==STRING.CUT("&clk", 1))
    ( 
      &match=1
    )
  )
  else if (&wild_tail==1)
  (
    if (STRING.MID("mpm_gcc_temp_sensor_ringosc_clk", 0, &clk_input_length-1)==STRING.CUT("&clk", -1))
    ( 
      &match=1
    )
  )	  
  else if ("mpm_gcc_temp_sensor_ringosc_clk"=="&clk")
  (
    &match=1
  )
  
  if (&match==1)
  (
    &clk_test=&CLK_TEST_MPM_GCC_TEMP_SENSOR_RINGOSC_CLK
    &clk_reg=0
    &clk_reg_name="No CBCR"
    &clk_name="mpm_gcc_temp_sensor_ringosc_clk"
    &clk_reg_cbcr_type=""

    gosub Print_Clk_Info_Line
  )
  
  &match=0
  &wild_head=0
  &wild_tail=0
  &clk_input_length=STRING.LENGTH("&clk")
  &clk_itr_length=STRING.LENGTH("usb2_phy_gcc_atest_ulpi_0_clk")

  if (STRING.SCAN("&clk", "*", 0)==0)
  (
    &wild_head=1
  )
  if (STRING.SCAN("&clk", "*", 1)==(STRING.LENGTH("&clk")-1))
  (
    &wild_tail=1
  )

  if ((&wild_head==1)&&(&wild_tail==1))
  (
    if (STRING.SCAN("usb2_phy_gcc_atest_ulpi_0_clk", STRING.MID("&clk", 1, &clk_input_length-2), 0)!=-1)
    ( 
      &match=1
    )
  )
  else if (&wild_head==1)
  (
    if (STRING.MID("usb2_phy_gcc_atest_ulpi_0_clk", &clk_itr_length-&clk_input_length+1, &clk_input_length-1)==STRING.CUT("&clk", 1))
    ( 
      &match=1
    )
  )
  else if (&wild_tail==1)
  (
    if (STRING.MID("usb2_phy_gcc_atest_ulpi_0_clk", 0, &clk_input_length-1)==STRING.CUT("&clk", -1))
    ( 
      &match=1
    )
  )	  
  else if ("usb2_phy_gcc_atest_ulpi_0_clk"=="&clk")
  (
    &match=1
  )
  
  if (&match==1)
  (
    &clk_test=&CLK_TEST_USB2_PHY_GCC_ATEST_ULPI_0_CLK
    &clk_reg=0
    &clk_reg_name="No CBCR"
    &clk_name="usb2_phy_gcc_atest_ulpi_0_clk"
    &clk_reg_cbcr_type=""

    gosub Print_Clk_Info_Line
  )
  
  &match=0
  &wild_head=0
  &wild_tail=0
  &clk_input_length=STRING.LENGTH("&clk")
  &clk_itr_length=STRING.LENGTH("usb2_phy_gcc_atest_ulpi_1_clk")

  if (STRING.SCAN("&clk", "*", 0)==0)
  (
    &wild_head=1
  )
  if (STRING.SCAN("&clk", "*", 1)==(STRING.LENGTH("&clk")-1))
  (
    &wild_tail=1
  )

  if ((&wild_head==1)&&(&wild_tail==1))
  (
    if (STRING.SCAN("usb2_phy_gcc_atest_ulpi_1_clk", STRING.MID("&clk", 1, &clk_input_length-2), 0)!=-1)
    ( 
      &match=1
    )
  )
  else if (&wild_head==1)
  (
    if (STRING.MID("usb2_phy_gcc_atest_ulpi_1_clk", &clk_itr_length-&clk_input_length+1, &clk_input_length-1)==STRING.CUT("&clk", 1))
    ( 
      &match=1
    )
  )
  else if (&wild_tail==1)
  (
    if (STRING.MID("usb2_phy_gcc_atest_ulpi_1_clk", 0, &clk_input_length-1)==STRING.CUT("&clk", -1))
    ( 
      &match=1
    )
  )	  
  else if ("usb2_phy_gcc_atest_ulpi_1_clk"=="&clk")
  (
    &match=1
  )
  
  if (&match==1)
  (
    &clk_test=&CLK_TEST_USB2_PHY_GCC_ATEST_ULPI_1_CLK
    &clk_reg=0
    &clk_reg_name="No CBCR"
    &clk_name="usb2_phy_gcc_atest_ulpi_1_clk"
    &clk_reg_cbcr_type=""

    gosub Print_Clk_Info_Line
  )
  
  &match=0
  &wild_head=0
  &wild_tail=0
  &clk_input_length=STRING.LENGTH("&clk")
  &clk_itr_length=STRING.LENGTH("usb2_phy_wrapper_gcc_usb30_utmi_clk")

  if (STRING.SCAN("&clk", "*", 0)==0)
  (
    &wild_head=1
  )
  if (STRING.SCAN("&clk", "*", 1)==(STRING.LENGTH("&clk")-1))
  (
    &wild_tail=1
  )

  if ((&wild_head==1)&&(&wild_tail==1))
  (
    if (STRING.SCAN("usb2_phy_wrapper_gcc_usb30_utmi_clk", STRING.MID("&clk", 1, &clk_input_length-2), 0)!=-1)
    ( 
      &match=1
    )
  )
  else if (&wild_head==1)
  (
    if (STRING.MID("usb2_phy_wrapper_gcc_usb30_utmi_clk", &clk_itr_length-&clk_input_length+1, &clk_input_length-1)==STRING.CUT("&clk", 1))
    ( 
      &match=1
    )
  )
  else if (&wild_tail==1)
  (
    if (STRING.MID("usb2_phy_wrapper_gcc_usb30_utmi_clk", 0, &clk_input_length-1)==STRING.CUT("&clk", -1))
    ( 
      &match=1
    )
  )	  
  else if ("usb2_phy_wrapper_gcc_usb30_utmi_clk"=="&clk")
  (
    &match=1
  )
  
  if (&match==1)
  (
    &clk_test=&CLK_TEST_USB2_PHY_WRAPPER_GCC_USB30_UTMI_CLK
    &clk_reg=0
    &clk_reg_name="No CBCR"
    &clk_name="usb2_phy_wrapper_gcc_usb30_utmi_clk"
    &clk_reg_cbcr_type=""

    gosub Print_Clk_Info_Line
  )
  
  &match=0
  &wild_head=0
  &wild_tail=0
  &clk_input_length=STRING.LENGTH("&clk")
  &clk_itr_length=STRING.LENGTH("usb3_phy_wrapper_gcc_usb3_pipe_clk")

  if (STRING.SCAN("&clk", "*", 0)==0)
  (
    &wild_head=1
  )
  if (STRING.SCAN("&clk", "*", 1)==(STRING.LENGTH("&clk")-1))
  (
    &wild_tail=1
  )

  if ((&wild_head==1)&&(&wild_tail==1))
  (
    if (STRING.SCAN("usb3_phy_wrapper_gcc_usb3_pipe_clk", STRING.MID("&clk", 1, &clk_input_length-2), 0)!=-1)
    ( 
      &match=1
    )
  )
  else if (&wild_head==1)
  (
    if (STRING.MID("usb3_phy_wrapper_gcc_usb3_pipe_clk", &clk_itr_length-&clk_input_length+1, &clk_input_length-1)==STRING.CUT("&clk", 1))
    ( 
      &match=1
    )
  )
  else if (&wild_tail==1)
  (
    if (STRING.MID("usb3_phy_wrapper_gcc_usb3_pipe_clk", 0, &clk_input_length-1)==STRING.CUT("&clk", -1))
    ( 
      &match=1
    )
  )	  
  else if ("usb3_phy_wrapper_gcc_usb3_pipe_clk"=="&clk")
  (
    &match=1
  )
  
  if (&match==1)
  (
    &clk_test=&CLK_TEST_USB3_PHY_WRAPPER_GCC_USB3_PIPE_CLK
    &clk_reg=0
    &clk_reg_name="No CBCR"
    &clk_name="usb3_phy_wrapper_gcc_usb3_pipe_clk"
    &clk_reg_cbcr_type=""

    gosub Print_Clk_Info_Line
  )
  
  &match=0
  &wild_head=0
  &wild_tail=0
  &clk_input_length=STRING.LENGTH("&clk")
  &clk_itr_length=STRING.LENGTH("usb_hspw_gcc_480_test_clk")

  if (STRING.SCAN("&clk", "*", 0)==0)
  (
    &wild_head=1
  )
  if (STRING.SCAN("&clk", "*", 1)==(STRING.LENGTH("&clk")-1))
  (
    &wild_tail=1
  )

  if ((&wild_head==1)&&(&wild_tail==1))
  (
    if (STRING.SCAN("usb_hspw_gcc_480_test_clk", STRING.MID("&clk", 1, &clk_input_length-2), 0)!=-1)
    ( 
      &match=1
    )
  )
  else if (&wild_head==1)
  (
    if (STRING.MID("usb_hspw_gcc_480_test_clk", &clk_itr_length-&clk_input_length+1, &clk_input_length-1)==STRING.CUT("&clk", 1))
    ( 
      &match=1
    )
  )
  else if (&wild_tail==1)
  (
    if (STRING.MID("usb_hspw_gcc_480_test_clk", 0, &clk_input_length-1)==STRING.CUT("&clk", -1))
    ( 
      &match=1
    )
  )	  
  else if ("usb_hspw_gcc_480_test_clk"=="&clk")
  (
    &match=1
  )
  
  if (&match==1)
  (
    &clk_test=&CLK_TEST_USB_HSPW_GCC_480_TEST_CLK
    &clk_reg=0
    &clk_reg_name="No CBCR"
    &clk_name="usb_hspw_gcc_480_test_clk"
    &clk_reg_cbcr_type=""

    gosub Print_Clk_Info_Line
  )
  
  &match=0
  &wild_head=0
  &wild_tail=0
  &clk_input_length=STRING.LENGTH("&clk")
  &clk_itr_length=STRING.LENGTH("gcc_pcie_0_aux_clk")

  if (STRING.SCAN("&clk", "*", 0)==0)
  (
    &wild_head=1
  )
  if (STRING.SCAN("&clk", "*", 1)==(STRING.LENGTH("&clk")-1))
  (
    &wild_tail=1
  )

  if ((&wild_head==1)&&(&wild_tail==1))
  (
    if (STRING.SCAN("gcc_pcie_0_aux_clk", STRING.MID("&clk", 1, &clk_input_length-2), 0)!=-1)
    ( 
      &match=1
    )
  )
  else if (&wild_head==1)
  (
    if (STRING.MID("gcc_pcie_0_aux_clk", &clk_itr_length-&clk_input_length+1, &clk_input_length-1)==STRING.CUT("&clk", 1))
    ( 
      &match=1
    )
  )
  else if (&wild_tail==1)
  (
    if (STRING.MID("gcc_pcie_0_aux_clk", 0, &clk_input_length-1)==STRING.CUT("&clk", -1))
    ( 
      &match=1
    )
  )	  
  else if ("gcc_pcie_0_aux_clk"=="&clk")
  (
    &match=1
  )
  
  if (&match==1)
  (
    &clk_test=&CLK_TEST_GCC_PCIE_0_AUX_CLK
    &clk_reg=&HWIO_GCC_PCIE_0_AUX_CBCR_ADDR
    &clk_reg_name="GCC_PCIE_0_AUX_CBCR"
    &clk_name="gcc_pcie_0_aux_clk"
    &clk_reg_cbcr_type="sm_cbc"

    gosub Print_Clk_Info_Line
  )
  
  &match=0
  &wild_head=0
  &wild_tail=0
  &clk_input_length=STRING.LENGTH("&clk")
  &clk_itr_length=STRING.LENGTH("gcc_pcie_0_cfg_ahb_clk")

  if (STRING.SCAN("&clk", "*", 0)==0)
  (
    &wild_head=1
  )
  if (STRING.SCAN("&clk", "*", 1)==(STRING.LENGTH("&clk")-1))
  (
    &wild_tail=1
  )

  if ((&wild_head==1)&&(&wild_tail==1))
  (
    if (STRING.SCAN("gcc_pcie_0_cfg_ahb_clk", STRING.MID("&clk", 1, &clk_input_length-2), 0)!=-1)
    ( 
      &match=1
    )
  )
  else if (&wild_head==1)
  (
    if (STRING.MID("gcc_pcie_0_cfg_ahb_clk", &clk_itr_length-&clk_input_length+1, &clk_input_length-1)==STRING.CUT("&clk", 1))
    ( 
      &match=1
    )
  )
  else if (&wild_tail==1)
  (
    if (STRING.MID("gcc_pcie_0_cfg_ahb_clk", 0, &clk_input_length-1)==STRING.CUT("&clk", -1))
    ( 
      &match=1
    )
  )	  
  else if ("gcc_pcie_0_cfg_ahb_clk"=="&clk")
  (
    &match=1
  )
  
  if (&match==1)
  (
    &clk_test=&CLK_TEST_GCC_PCIE_0_CFG_AHB_CLK
    &clk_reg=&HWIO_GCC_PCIE_0_CFG_AHB_CBCR_ADDR
    &clk_reg_name="GCC_PCIE_0_CFG_AHB_CBCR"
    &clk_name="gcc_pcie_0_cfg_ahb_clk"
    &clk_reg_cbcr_type="sm_cbc"

    gosub Print_Clk_Info_Line
  )
  
  &match=0
  &wild_head=0
  &wild_tail=0
  &clk_input_length=STRING.LENGTH("&clk")
  &clk_itr_length=STRING.LENGTH("gcc_pcie_0_mstr_axi_clk")

  if (STRING.SCAN("&clk", "*", 0)==0)
  (
    &wild_head=1
  )
  if (STRING.SCAN("&clk", "*", 1)==(STRING.LENGTH("&clk")-1))
  (
    &wild_tail=1
  )

  if ((&wild_head==1)&&(&wild_tail==1))
  (
    if (STRING.SCAN("gcc_pcie_0_mstr_axi_clk", STRING.MID("&clk", 1, &clk_input_length-2), 0)!=-1)
    ( 
      &match=1
    )
  )
  else if (&wild_head==1)
  (
    if (STRING.MID("gcc_pcie_0_mstr_axi_clk", &clk_itr_length-&clk_input_length+1, &clk_input_length-1)==STRING.CUT("&clk", 1))
    ( 
      &match=1
    )
  )
  else if (&wild_tail==1)
  (
    if (STRING.MID("gcc_pcie_0_mstr_axi_clk", 0, &clk_input_length-1)==STRING.CUT("&clk", -1))
    ( 
      &match=1
    )
  )	  
  else if ("gcc_pcie_0_mstr_axi_clk"=="&clk")
  (
    &match=1
  )
  
  if (&match==1)
  (
    &clk_test=&CLK_TEST_GCC_PCIE_0_MSTR_AXI_CLK
    &clk_reg=&HWIO_GCC_PCIE_0_MSTR_AXI_CBCR_ADDR
    &clk_reg_name="GCC_PCIE_0_MSTR_AXI_CBCR"
    &clk_name="gcc_pcie_0_mstr_axi_clk"
    &clk_reg_cbcr_type="sm_pscbc"

    gosub Print_Clk_Info_Line
  )
  
  &match=0
  &wild_head=0
  &wild_tail=0
  &clk_input_length=STRING.LENGTH("&clk")
  &clk_itr_length=STRING.LENGTH("gcc_pcie_0_pipe_clk")

  if (STRING.SCAN("&clk", "*", 0)==0)
  (
    &wild_head=1
  )
  if (STRING.SCAN("&clk", "*", 1)==(STRING.LENGTH("&clk")-1))
  (
    &wild_tail=1
  )

  if ((&wild_head==1)&&(&wild_tail==1))
  (
    if (STRING.SCAN("gcc_pcie_0_pipe_clk", STRING.MID("&clk", 1, &clk_input_length-2), 0)!=-1)
    ( 
      &match=1
    )
  )
  else if (&wild_head==1)
  (
    if (STRING.MID("gcc_pcie_0_pipe_clk", &clk_itr_length-&clk_input_length+1, &clk_input_length-1)==STRING.CUT("&clk", 1))
    ( 
      &match=1
    )
  )
  else if (&wild_tail==1)
  (
    if (STRING.MID("gcc_pcie_0_pipe_clk", 0, &clk_input_length-1)==STRING.CUT("&clk", -1))
    ( 
      &match=1
    )
  )	  
  else if ("gcc_pcie_0_pipe_clk"=="&clk")
  (
    &match=1
  )
  
  if (&match==1)
  (
    &clk_test=&CLK_TEST_GCC_PCIE_0_PIPE_CLK
    &clk_reg=&HWIO_GCC_PCIE_0_PIPE_CBCR_ADDR
    &clk_reg_name="GCC_PCIE_0_PIPE_CBCR"
    &clk_name="gcc_pcie_0_pipe_clk"
    &clk_reg_cbcr_type="sm_pscbc"

    gosub Print_Clk_Info_Line
  )
  
  &match=0
  &wild_head=0
  &wild_tail=0
  &clk_input_length=STRING.LENGTH("&clk")
  &clk_itr_length=STRING.LENGTH("gcc_pcie_0_slv_axi_clk")

  if (STRING.SCAN("&clk", "*", 0)==0)
  (
    &wild_head=1
  )
  if (STRING.SCAN("&clk", "*", 1)==(STRING.LENGTH("&clk")-1))
  (
    &wild_tail=1
  )

  if ((&wild_head==1)&&(&wild_tail==1))
  (
    if (STRING.SCAN("gcc_pcie_0_slv_axi_clk", STRING.MID("&clk", 1, &clk_input_length-2), 0)!=-1)
    ( 
      &match=1
    )
  )
  else if (&wild_head==1)
  (
    if (STRING.MID("gcc_pcie_0_slv_axi_clk", &clk_itr_length-&clk_input_length+1, &clk_input_length-1)==STRING.CUT("&clk", 1))
    ( 
      &match=1
    )
  )
  else if (&wild_tail==1)
  (
    if (STRING.MID("gcc_pcie_0_slv_axi_clk", 0, &clk_input_length-1)==STRING.CUT("&clk", -1))
    ( 
      &match=1
    )
  )	  
  else if ("gcc_pcie_0_slv_axi_clk"=="&clk")
  (
    &match=1
  )
  
  if (&match==1)
  (
    &clk_test=&CLK_TEST_GCC_PCIE_0_SLV_AXI_CLK
    &clk_reg=&HWIO_GCC_PCIE_0_SLV_AXI_CBCR_ADDR
    &clk_reg_name="GCC_PCIE_0_SLV_AXI_CBCR"
    &clk_name="gcc_pcie_0_slv_axi_clk"
    &clk_reg_cbcr_type="sm_pscbc"

    gosub Print_Clk_Info_Line
  )
  
  &match=0
  &wild_head=0
  &wild_tail=0
  &clk_input_length=STRING.LENGTH("&clk")
  &clk_itr_length=STRING.LENGTH("pcie_0_pipe_clk")

  if (STRING.SCAN("&clk", "*", 0)==0)
  (
    &wild_head=1
  )
  if (STRING.SCAN("&clk", "*", 1)==(STRING.LENGTH("&clk")-1))
  (
    &wild_tail=1
  )

  if ((&wild_head==1)&&(&wild_tail==1))
  (
    if (STRING.SCAN("pcie_0_pipe_clk", STRING.MID("&clk", 1, &clk_input_length-2), 0)!=-1)
    ( 
      &match=1
    )
  )
  else if (&wild_head==1)
  (
    if (STRING.MID("pcie_0_pipe_clk", &clk_itr_length-&clk_input_length+1, &clk_input_length-1)==STRING.CUT("&clk", 1))
    ( 
      &match=1
    )
  )
  else if (&wild_tail==1)
  (
    if (STRING.MID("pcie_0_pipe_clk", 0, &clk_input_length-1)==STRING.CUT("&clk", -1))
    ( 
      &match=1
    )
  )	  
  else if ("pcie_0_pipe_clk"=="&clk")
  (
    &match=1
  )
  
  if (&match==1)
  (
    &clk_test=&CLK_TEST_PCIE_0_PIPE_CLK
    &clk_reg=&HWIO_GCC_PCIE_0_PIPE_CBCR_ADDR
    &clk_reg_name="GCC_PCIE_0_PIPE_CBCR"
    &clk_name="pcie_0_pipe_clk"
    &clk_reg_cbcr_type=""

    gosub Print_Clk_Info_Line
  )
  
  &match=0
  &wild_head=0
  &wild_tail=0
  &clk_input_length=STRING.LENGTH("&clk")
  &clk_itr_length=STRING.LENGTH("gcc_pcie_1_aux_clk")

  if (STRING.SCAN("&clk", "*", 0)==0)
  (
    &wild_head=1
  )
  if (STRING.SCAN("&clk", "*", 1)==(STRING.LENGTH("&clk")-1))
  (
    &wild_tail=1
  )

  if ((&wild_head==1)&&(&wild_tail==1))
  (
    if (STRING.SCAN("gcc_pcie_1_aux_clk", STRING.MID("&clk", 1, &clk_input_length-2), 0)!=-1)
    ( 
      &match=1
    )
  )
  else if (&wild_head==1)
  (
    if (STRING.MID("gcc_pcie_1_aux_clk", &clk_itr_length-&clk_input_length+1, &clk_input_length-1)==STRING.CUT("&clk", 1))
    ( 
      &match=1
    )
  )
  else if (&wild_tail==1)
  (
    if (STRING.MID("gcc_pcie_1_aux_clk", 0, &clk_input_length-1)==STRING.CUT("&clk", -1))
    ( 
      &match=1
    )
  )	  
  else if ("gcc_pcie_1_aux_clk"=="&clk")
  (
    &match=1
  )
  
  if (&match==1)
  (
    &clk_test=&CLK_TEST_GCC_PCIE_1_AUX_CLK
    &clk_reg=&HWIO_GCC_PCIE_1_AUX_CBCR_ADDR
    &clk_reg_name="GCC_PCIE_1_AUX_CBCR"
    &clk_name="gcc_pcie_1_aux_clk"
    &clk_reg_cbcr_type="sm_cbc"

    gosub Print_Clk_Info_Line
  )
  
  &match=0
  &wild_head=0
  &wild_tail=0
  &clk_input_length=STRING.LENGTH("&clk")
  &clk_itr_length=STRING.LENGTH("gcc_pcie_1_cfg_ahb_clk")

  if (STRING.SCAN("&clk", "*", 0)==0)
  (
    &wild_head=1
  )
  if (STRING.SCAN("&clk", "*", 1)==(STRING.LENGTH("&clk")-1))
  (
    &wild_tail=1
  )

  if ((&wild_head==1)&&(&wild_tail==1))
  (
    if (STRING.SCAN("gcc_pcie_1_cfg_ahb_clk", STRING.MID("&clk", 1, &clk_input_length-2), 0)!=-1)
    ( 
      &match=1
    )
  )
  else if (&wild_head==1)
  (
    if (STRING.MID("gcc_pcie_1_cfg_ahb_clk", &clk_itr_length-&clk_input_length+1, &clk_input_length-1)==STRING.CUT("&clk", 1))
    ( 
      &match=1
    )
  )
  else if (&wild_tail==1)
  (
    if (STRING.MID("gcc_pcie_1_cfg_ahb_clk", 0, &clk_input_length-1)==STRING.CUT("&clk", -1))
    ( 
      &match=1
    )
  )	  
  else if ("gcc_pcie_1_cfg_ahb_clk"=="&clk")
  (
    &match=1
  )
  
  if (&match==1)
  (
    &clk_test=&CLK_TEST_GCC_PCIE_1_CFG_AHB_CLK
    &clk_reg=&HWIO_GCC_PCIE_1_CFG_AHB_CBCR_ADDR
    &clk_reg_name="GCC_PCIE_1_CFG_AHB_CBCR"
    &clk_name="gcc_pcie_1_cfg_ahb_clk"
    &clk_reg_cbcr_type="sm_cbc"

    gosub Print_Clk_Info_Line
  )
  
  &match=0
  &wild_head=0
  &wild_tail=0
  &clk_input_length=STRING.LENGTH("&clk")
  &clk_itr_length=STRING.LENGTH("gcc_pcie_1_mstr_axi_clk")

  if (STRING.SCAN("&clk", "*", 0)==0)
  (
    &wild_head=1
  )
  if (STRING.SCAN("&clk", "*", 1)==(STRING.LENGTH("&clk")-1))
  (
    &wild_tail=1
  )

  if ((&wild_head==1)&&(&wild_tail==1))
  (
    if (STRING.SCAN("gcc_pcie_1_mstr_axi_clk", STRING.MID("&clk", 1, &clk_input_length-2), 0)!=-1)
    ( 
      &match=1
    )
  )
  else if (&wild_head==1)
  (
    if (STRING.MID("gcc_pcie_1_mstr_axi_clk", &clk_itr_length-&clk_input_length+1, &clk_input_length-1)==STRING.CUT("&clk", 1))
    ( 
      &match=1
    )
  )
  else if (&wild_tail==1)
  (
    if (STRING.MID("gcc_pcie_1_mstr_axi_clk", 0, &clk_input_length-1)==STRING.CUT("&clk", -1))
    ( 
      &match=1
    )
  )	  
  else if ("gcc_pcie_1_mstr_axi_clk"=="&clk")
  (
    &match=1
  )
  
  if (&match==1)
  (
    &clk_test=&CLK_TEST_GCC_PCIE_1_MSTR_AXI_CLK
    &clk_reg=&HWIO_GCC_PCIE_1_MSTR_AXI_CBCR_ADDR
    &clk_reg_name="GCC_PCIE_1_MSTR_AXI_CBCR"
    &clk_name="gcc_pcie_1_mstr_axi_clk"
    &clk_reg_cbcr_type="sm_pscbc"

    gosub Print_Clk_Info_Line
  )
  
  &match=0
  &wild_head=0
  &wild_tail=0
  &clk_input_length=STRING.LENGTH("&clk")
  &clk_itr_length=STRING.LENGTH("gcc_pcie_1_pipe_clk")

  if (STRING.SCAN("&clk", "*", 0)==0)
  (
    &wild_head=1
  )
  if (STRING.SCAN("&clk", "*", 1)==(STRING.LENGTH("&clk")-1))
  (
    &wild_tail=1
  )

  if ((&wild_head==1)&&(&wild_tail==1))
  (
    if (STRING.SCAN("gcc_pcie_1_pipe_clk", STRING.MID("&clk", 1, &clk_input_length-2), 0)!=-1)
    ( 
      &match=1
    )
  )
  else if (&wild_head==1)
  (
    if (STRING.MID("gcc_pcie_1_pipe_clk", &clk_itr_length-&clk_input_length+1, &clk_input_length-1)==STRING.CUT("&clk", 1))
    ( 
      &match=1
    )
  )
  else if (&wild_tail==1)
  (
    if (STRING.MID("gcc_pcie_1_pipe_clk", 0, &clk_input_length-1)==STRING.CUT("&clk", -1))
    ( 
      &match=1
    )
  )	  
  else if ("gcc_pcie_1_pipe_clk"=="&clk")
  (
    &match=1
  )
  
  if (&match==1)
  (
    &clk_test=&CLK_TEST_GCC_PCIE_1_PIPE_CLK
    &clk_reg=&HWIO_GCC_PCIE_1_PIPE_CBCR_ADDR
    &clk_reg_name="GCC_PCIE_1_PIPE_CBCR"
    &clk_name="gcc_pcie_1_pipe_clk"
    &clk_reg_cbcr_type="sm_pscbc"

    gosub Print_Clk_Info_Line
  )
  
  &match=0
  &wild_head=0
  &wild_tail=0
  &clk_input_length=STRING.LENGTH("&clk")
  &clk_itr_length=STRING.LENGTH("gcc_pcie_1_slv_axi_clk")

  if (STRING.SCAN("&clk", "*", 0)==0)
  (
    &wild_head=1
  )
  if (STRING.SCAN("&clk", "*", 1)==(STRING.LENGTH("&clk")-1))
  (
    &wild_tail=1
  )

  if ((&wild_head==1)&&(&wild_tail==1))
  (
    if (STRING.SCAN("gcc_pcie_1_slv_axi_clk", STRING.MID("&clk", 1, &clk_input_length-2), 0)!=-1)
    ( 
      &match=1
    )
  )
  else if (&wild_head==1)
  (
    if (STRING.MID("gcc_pcie_1_slv_axi_clk", &clk_itr_length-&clk_input_length+1, &clk_input_length-1)==STRING.CUT("&clk", 1))
    ( 
      &match=1
    )
  )
  else if (&wild_tail==1)
  (
    if (STRING.MID("gcc_pcie_1_slv_axi_clk", 0, &clk_input_length-1)==STRING.CUT("&clk", -1))
    ( 
      &match=1
    )
  )	  
  else if ("gcc_pcie_1_slv_axi_clk"=="&clk")
  (
    &match=1
  )
  
  if (&match==1)
  (
    &clk_test=&CLK_TEST_GCC_PCIE_1_SLV_AXI_CLK
    &clk_reg=&HWIO_GCC_PCIE_1_SLV_AXI_CBCR_ADDR
    &clk_reg_name="GCC_PCIE_1_SLV_AXI_CBCR"
    &clk_name="gcc_pcie_1_slv_axi_clk"
    &clk_reg_cbcr_type="sm_pscbc"

    gosub Print_Clk_Info_Line
  )
  
  &match=0
  &wild_head=0
  &wild_tail=0
  &clk_input_length=STRING.LENGTH("&clk")
  &clk_itr_length=STRING.LENGTH("pcie_1_pipe_clk")

  if (STRING.SCAN("&clk", "*", 0)==0)
  (
    &wild_head=1
  )
  if (STRING.SCAN("&clk", "*", 1)==(STRING.LENGTH("&clk")-1))
  (
    &wild_tail=1
  )

  if ((&wild_head==1)&&(&wild_tail==1))
  (
    if (STRING.SCAN("pcie_1_pipe_clk", STRING.MID("&clk", 1, &clk_input_length-2), 0)!=-1)
    ( 
      &match=1
    )
  )
  else if (&wild_head==1)
  (
    if (STRING.MID("pcie_1_pipe_clk", &clk_itr_length-&clk_input_length+1, &clk_input_length-1)==STRING.CUT("&clk", 1))
    ( 
      &match=1
    )
  )
  else if (&wild_tail==1)
  (
    if (STRING.MID("pcie_1_pipe_clk", 0, &clk_input_length-1)==STRING.CUT("&clk", -1))
    ( 
      &match=1
    )
  )	  
  else if ("pcie_1_pipe_clk"=="&clk")
  (
    &match=1
  )
  
  if (&match==1)
  (
    &clk_test=&CLK_TEST_PCIE_1_PIPE_CLK
    &clk_reg=&HWIO_GCC_PCIE_1_PIPE_CBCR_ADDR
    &clk_reg_name="GCC_PCIE_1_PIPE_CBCR"
    &clk_name="pcie_1_pipe_clk"
    &clk_reg_cbcr_type=""

    gosub Print_Clk_Info_Line
  )
  
  &match=0
  &wild_head=0
  &wild_tail=0
  &clk_input_length=STRING.LENGTH("&clk")
  &clk_itr_length=STRING.LENGTH("gcc_pdm2_clk")

  if (STRING.SCAN("&clk", "*", 0)==0)
  (
    &wild_head=1
  )
  if (STRING.SCAN("&clk", "*", 1)==(STRING.LENGTH("&clk")-1))
  (
    &wild_tail=1
  )

  if ((&wild_head==1)&&(&wild_tail==1))
  (
    if (STRING.SCAN("gcc_pdm2_clk", STRING.MID("&clk", 1, &clk_input_length-2), 0)!=-1)
    ( 
      &match=1
    )
  )
  else if (&wild_head==1)
  (
    if (STRING.MID("gcc_pdm2_clk", &clk_itr_length-&clk_input_length+1, &clk_input_length-1)==STRING.CUT("&clk", 1))
    ( 
      &match=1
    )
  )
  else if (&wild_tail==1)
  (
    if (STRING.MID("gcc_pdm2_clk", 0, &clk_input_length-1)==STRING.CUT("&clk", -1))
    ( 
      &match=1
    )
  )	  
  else if ("gcc_pdm2_clk"=="&clk")
  (
    &match=1
  )
  
  if (&match==1)
  (
    &clk_test=&CLK_TEST_GCC_PDM2_CLK
    &clk_reg=&HWIO_GCC_PDM2_CBCR_ADDR
    &clk_reg_name="GCC_PDM2_CBCR"
    &clk_name="gcc_pdm2_clk"
    &clk_reg_cbcr_type="sm_cbc"

    gosub Print_Clk_Info_Line
  )
  
  &match=0
  &wild_head=0
  &wild_tail=0
  &clk_input_length=STRING.LENGTH("&clk")
  &clk_itr_length=STRING.LENGTH("gcc_pdm_ahb_clk")

  if (STRING.SCAN("&clk", "*", 0)==0)
  (
    &wild_head=1
  )
  if (STRING.SCAN("&clk", "*", 1)==(STRING.LENGTH("&clk")-1))
  (
    &wild_tail=1
  )

  if ((&wild_head==1)&&(&wild_tail==1))
  (
    if (STRING.SCAN("gcc_pdm_ahb_clk", STRING.MID("&clk", 1, &clk_input_length-2), 0)!=-1)
    ( 
      &match=1
    )
  )
  else if (&wild_head==1)
  (
    if (STRING.MID("gcc_pdm_ahb_clk", &clk_itr_length-&clk_input_length+1, &clk_input_length-1)==STRING.CUT("&clk", 1))
    ( 
      &match=1
    )
  )
  else if (&wild_tail==1)
  (
    if (STRING.MID("gcc_pdm_ahb_clk", 0, &clk_input_length-1)==STRING.CUT("&clk", -1))
    ( 
      &match=1
    )
  )	  
  else if ("gcc_pdm_ahb_clk"=="&clk")
  (
    &match=1
  )
  
  if (&match==1)
  (
    &clk_test=&CLK_TEST_GCC_PDM_AHB_CLK
    &clk_reg=&HWIO_GCC_PDM_AHB_CBCR_ADDR
    &clk_reg_name="GCC_PDM_AHB_CBCR"
    &clk_name="gcc_pdm_ahb_clk"
    &clk_reg_cbcr_type="sm_cbc"

    gosub Print_Clk_Info_Line
  )
  
  &match=0
  &wild_head=0
  &wild_tail=0
  &clk_input_length=STRING.LENGTH("&clk")
  &clk_itr_length=STRING.LENGTH("gcc_pdm_xo4_clk")

  if (STRING.SCAN("&clk", "*", 0)==0)
  (
    &wild_head=1
  )
  if (STRING.SCAN("&clk", "*", 1)==(STRING.LENGTH("&clk")-1))
  (
    &wild_tail=1
  )

  if ((&wild_head==1)&&(&wild_tail==1))
  (
    if (STRING.SCAN("gcc_pdm_xo4_clk", STRING.MID("&clk", 1, &clk_input_length-2), 0)!=-1)
    ( 
      &match=1
    )
  )
  else if (&wild_head==1)
  (
    if (STRING.MID("gcc_pdm_xo4_clk", &clk_itr_length-&clk_input_length+1, &clk_input_length-1)==STRING.CUT("&clk", 1))
    ( 
      &match=1
    )
  )
  else if (&wild_tail==1)
  (
    if (STRING.MID("gcc_pdm_xo4_clk", 0, &clk_input_length-1)==STRING.CUT("&clk", -1))
    ( 
      &match=1
    )
  )	  
  else if ("gcc_pdm_xo4_clk"=="&clk")
  (
    &match=1
  )
  
  if (&match==1)
  (
    &clk_test=&CLK_TEST_GCC_PDM_XO4_CLK
    &clk_reg=&HWIO_GCC_PDM_XO4_CBCR_ADDR
    &clk_reg_name="GCC_PDM_XO4_CBCR"
    &clk_name="gcc_pdm_xo4_clk"
    &clk_reg_cbcr_type="sm_cbc"

    gosub Print_Clk_Info_Line
  )
  
  &match=0
  &wild_head=0
  &wild_tail=0
  &clk_input_length=STRING.LENGTH("&clk")
  &clk_itr_length=STRING.LENGTH("gcc_pnoc_bus_timeout0_ahb_clk")

  if (STRING.SCAN("&clk", "*", 0)==0)
  (
    &wild_head=1
  )
  if (STRING.SCAN("&clk", "*", 1)==(STRING.LENGTH("&clk")-1))
  (
    &wild_tail=1
  )

  if ((&wild_head==1)&&(&wild_tail==1))
  (
    if (STRING.SCAN("gcc_pnoc_bus_timeout0_ahb_clk", STRING.MID("&clk", 1, &clk_input_length-2), 0)!=-1)
    ( 
      &match=1
    )
  )
  else if (&wild_head==1)
  (
    if (STRING.MID("gcc_pnoc_bus_timeout0_ahb_clk", &clk_itr_length-&clk_input_length+1, &clk_input_length-1)==STRING.CUT("&clk", 1))
    ( 
      &match=1
    )
  )
  else if (&wild_tail==1)
  (
    if (STRING.MID("gcc_pnoc_bus_timeout0_ahb_clk", 0, &clk_input_length-1)==STRING.CUT("&clk", -1))
    ( 
      &match=1
    )
  )	  
  else if ("gcc_pnoc_bus_timeout0_ahb_clk"=="&clk")
  (
    &match=1
  )
  
  if (&match==1)
  (
    &clk_test=&CLK_TEST_GCC_PNOC_BUS_TIMEOUT0_AHB_CLK
    &clk_reg=&HWIO_GCC_PNOC_BUS_TIMEOUT0_AHB_CBCR_ADDR
    &clk_reg_name="GCC_PNOC_BUS_TIMEOUT0_AHB_CBCR"
    &clk_name="gcc_pnoc_bus_timeout0_ahb_clk"
    &clk_reg_cbcr_type="sm_cbc"

    gosub Print_Clk_Info_Line
  )
  
  &match=0
  &wild_head=0
  &wild_tail=0
  &clk_input_length=STRING.LENGTH("&clk")
  &clk_itr_length=STRING.LENGTH("gcc_pnoc_bus_timeout1_ahb_clk")

  if (STRING.SCAN("&clk", "*", 0)==0)
  (
    &wild_head=1
  )
  if (STRING.SCAN("&clk", "*", 1)==(STRING.LENGTH("&clk")-1))
  (
    &wild_tail=1
  )

  if ((&wild_head==1)&&(&wild_tail==1))
  (
    if (STRING.SCAN("gcc_pnoc_bus_timeout1_ahb_clk", STRING.MID("&clk", 1, &clk_input_length-2), 0)!=-1)
    ( 
      &match=1
    )
  )
  else if (&wild_head==1)
  (
    if (STRING.MID("gcc_pnoc_bus_timeout1_ahb_clk", &clk_itr_length-&clk_input_length+1, &clk_input_length-1)==STRING.CUT("&clk", 1))
    ( 
      &match=1
    )
  )
  else if (&wild_tail==1)
  (
    if (STRING.MID("gcc_pnoc_bus_timeout1_ahb_clk", 0, &clk_input_length-1)==STRING.CUT("&clk", -1))
    ( 
      &match=1
    )
  )	  
  else if ("gcc_pnoc_bus_timeout1_ahb_clk"=="&clk")
  (
    &match=1
  )
  
  if (&match==1)
  (
    &clk_test=&CLK_TEST_GCC_PNOC_BUS_TIMEOUT1_AHB_CLK
    &clk_reg=&HWIO_GCC_PNOC_BUS_TIMEOUT1_AHB_CBCR_ADDR
    &clk_reg_name="GCC_PNOC_BUS_TIMEOUT1_AHB_CBCR"
    &clk_name="gcc_pnoc_bus_timeout1_ahb_clk"
    &clk_reg_cbcr_type="sm_cbc"

    gosub Print_Clk_Info_Line
  )
  
  &match=0
  &wild_head=0
  &wild_tail=0
  &clk_input_length=STRING.LENGTH("&clk")
  &clk_itr_length=STRING.LENGTH("gcc_pnoc_bus_timeout2_ahb_clk")

  if (STRING.SCAN("&clk", "*", 0)==0)
  (
    &wild_head=1
  )
  if (STRING.SCAN("&clk", "*", 1)==(STRING.LENGTH("&clk")-1))
  (
    &wild_tail=1
  )

  if ((&wild_head==1)&&(&wild_tail==1))
  (
    if (STRING.SCAN("gcc_pnoc_bus_timeout2_ahb_clk", STRING.MID("&clk", 1, &clk_input_length-2), 0)!=-1)
    ( 
      &match=1
    )
  )
  else if (&wild_head==1)
  (
    if (STRING.MID("gcc_pnoc_bus_timeout2_ahb_clk", &clk_itr_length-&clk_input_length+1, &clk_input_length-1)==STRING.CUT("&clk", 1))
    ( 
      &match=1
    )
  )
  else if (&wild_tail==1)
  (
    if (STRING.MID("gcc_pnoc_bus_timeout2_ahb_clk", 0, &clk_input_length-1)==STRING.CUT("&clk", -1))
    ( 
      &match=1
    )
  )	  
  else if ("gcc_pnoc_bus_timeout2_ahb_clk"=="&clk")
  (
    &match=1
  )
  
  if (&match==1)
  (
    &clk_test=&CLK_TEST_GCC_PNOC_BUS_TIMEOUT2_AHB_CLK
    &clk_reg=&HWIO_GCC_PNOC_BUS_TIMEOUT2_AHB_CBCR_ADDR
    &clk_reg_name="GCC_PNOC_BUS_TIMEOUT2_AHB_CBCR"
    &clk_name="gcc_pnoc_bus_timeout2_ahb_clk"
    &clk_reg_cbcr_type="sm_cbc"

    gosub Print_Clk_Info_Line
  )
  
  &match=0
  &wild_head=0
  &wild_tail=0
  &clk_input_length=STRING.LENGTH("&clk")
  &clk_itr_length=STRING.LENGTH("gcc_pnoc_bus_timeout3_ahb_clk")

  if (STRING.SCAN("&clk", "*", 0)==0)
  (
    &wild_head=1
  )
  if (STRING.SCAN("&clk", "*", 1)==(STRING.LENGTH("&clk")-1))
  (
    &wild_tail=1
  )

  if ((&wild_head==1)&&(&wild_tail==1))
  (
    if (STRING.SCAN("gcc_pnoc_bus_timeout3_ahb_clk", STRING.MID("&clk", 1, &clk_input_length-2), 0)!=-1)
    ( 
      &match=1
    )
  )
  else if (&wild_head==1)
  (
    if (STRING.MID("gcc_pnoc_bus_timeout3_ahb_clk", &clk_itr_length-&clk_input_length+1, &clk_input_length-1)==STRING.CUT("&clk", 1))
    ( 
      &match=1
    )
  )
  else if (&wild_tail==1)
  (
    if (STRING.MID("gcc_pnoc_bus_timeout3_ahb_clk", 0, &clk_input_length-1)==STRING.CUT("&clk", -1))
    ( 
      &match=1
    )
  )	  
  else if ("gcc_pnoc_bus_timeout3_ahb_clk"=="&clk")
  (
    &match=1
  )
  
  if (&match==1)
  (
    &clk_test=&CLK_TEST_GCC_PNOC_BUS_TIMEOUT3_AHB_CLK
    &clk_reg=&HWIO_GCC_PNOC_BUS_TIMEOUT3_AHB_CBCR_ADDR
    &clk_reg_name="GCC_PNOC_BUS_TIMEOUT3_AHB_CBCR"
    &clk_name="gcc_pnoc_bus_timeout3_ahb_clk"
    &clk_reg_cbcr_type="sm_cbc"

    gosub Print_Clk_Info_Line
  )
  
  &match=0
  &wild_head=0
  &wild_tail=0
  &clk_input_length=STRING.LENGTH("&clk")
  &clk_itr_length=STRING.LENGTH("gcc_pnoc_bus_timeout4_ahb_clk")

  if (STRING.SCAN("&clk", "*", 0)==0)
  (
    &wild_head=1
  )
  if (STRING.SCAN("&clk", "*", 1)==(STRING.LENGTH("&clk")-1))
  (
    &wild_tail=1
  )

  if ((&wild_head==1)&&(&wild_tail==1))
  (
    if (STRING.SCAN("gcc_pnoc_bus_timeout4_ahb_clk", STRING.MID("&clk", 1, &clk_input_length-2), 0)!=-1)
    ( 
      &match=1
    )
  )
  else if (&wild_head==1)
  (
    if (STRING.MID("gcc_pnoc_bus_timeout4_ahb_clk", &clk_itr_length-&clk_input_length+1, &clk_input_length-1)==STRING.CUT("&clk", 1))
    ( 
      &match=1
    )
  )
  else if (&wild_tail==1)
  (
    if (STRING.MID("gcc_pnoc_bus_timeout4_ahb_clk", 0, &clk_input_length-1)==STRING.CUT("&clk", -1))
    ( 
      &match=1
    )
  )	  
  else if ("gcc_pnoc_bus_timeout4_ahb_clk"=="&clk")
  (
    &match=1
  )
  
  if (&match==1)
  (
    &clk_test=&CLK_TEST_GCC_PNOC_BUS_TIMEOUT4_AHB_CLK
    &clk_reg=&HWIO_GCC_PNOC_BUS_TIMEOUT4_AHB_CBCR_ADDR
    &clk_reg_name="GCC_PNOC_BUS_TIMEOUT4_AHB_CBCR"
    &clk_name="gcc_pnoc_bus_timeout4_ahb_clk"
    &clk_reg_cbcr_type="sm_cbc"

    gosub Print_Clk_Info_Line
  )
  
  &match=0
  &wild_head=0
  &wild_tail=0
  &clk_input_length=STRING.LENGTH("&clk")
  &clk_itr_length=STRING.LENGTH("gcc_prng_ahb_clk")

  if (STRING.SCAN("&clk", "*", 0)==0)
  (
    &wild_head=1
  )
  if (STRING.SCAN("&clk", "*", 1)==(STRING.LENGTH("&clk")-1))
  (
    &wild_tail=1
  )

  if ((&wild_head==1)&&(&wild_tail==1))
  (
    if (STRING.SCAN("gcc_prng_ahb_clk", STRING.MID("&clk", 1, &clk_input_length-2), 0)!=-1)
    ( 
      &match=1
    )
  )
  else if (&wild_head==1)
  (
    if (STRING.MID("gcc_prng_ahb_clk", &clk_itr_length-&clk_input_length+1, &clk_input_length-1)==STRING.CUT("&clk", 1))
    ( 
      &match=1
    )
  )
  else if (&wild_tail==1)
  (
    if (STRING.MID("gcc_prng_ahb_clk", 0, &clk_input_length-1)==STRING.CUT("&clk", -1))
    ( 
      &match=1
    )
  )	  
  else if ("gcc_prng_ahb_clk"=="&clk")
  (
    &match=1
  )
  
  if (&match==1)
  (
    &clk_test=&CLK_TEST_GCC_PRNG_AHB_CLK
    &clk_reg=&HWIO_GCC_PRNG_AHB_CBCR_ADDR
    &clk_reg_name="GCC_PRNG_AHB_CBCR"
    &clk_name="gcc_prng_ahb_clk"
    &clk_reg_cbcr_type="sm_cbc"

    gosub Print_Clk_Info_Line
  )
  
  &match=0
  &wild_head=0
  &wild_tail=0
  &clk_input_length=STRING.LENGTH("&clk")
  &clk_itr_length=STRING.LENGTH("gcc_periph_noc_ahb_clk")

  if (STRING.SCAN("&clk", "*", 0)==0)
  (
    &wild_head=1
  )
  if (STRING.SCAN("&clk", "*", 1)==(STRING.LENGTH("&clk")-1))
  (
    &wild_tail=1
  )

  if ((&wild_head==1)&&(&wild_tail==1))
  (
    if (STRING.SCAN("gcc_periph_noc_ahb_clk", STRING.MID("&clk", 1, &clk_input_length-2), 0)!=-1)
    ( 
      &match=1
    )
  )
  else if (&wild_head==1)
  (
    if (STRING.MID("gcc_periph_noc_ahb_clk", &clk_itr_length-&clk_input_length+1, &clk_input_length-1)==STRING.CUT("&clk", 1))
    ( 
      &match=1
    )
  )
  else if (&wild_tail==1)
  (
    if (STRING.MID("gcc_periph_noc_ahb_clk", 0, &clk_input_length-1)==STRING.CUT("&clk", -1))
    ( 
      &match=1
    )
  )	  
  else if ("gcc_periph_noc_ahb_clk"=="&clk")
  (
    &match=1
  )
  
  ; This clock belongs to the 'buses' display group.
  if ("buses"=="&clk")
  (
    &match=1	  
  )
  
  if (&match==1)
  (
    &clk_test=&CLK_TEST_GCC_PERIPH_NOC_AHB_CLK
    &clk_reg=&HWIO_GCC_PERIPH_NOC_AHB_CBCR_ADDR
    &clk_reg_name="GCC_PERIPH_NOC_AHB_CBCR"
    &clk_name="gcc_periph_noc_ahb_clk"
    &clk_reg_cbcr_type="sm_cbc"

    gosub Print_Clk_Info_Line
  )
  
  &match=0
  &wild_head=0
  &wild_tail=0
  &clk_input_length=STRING.LENGTH("&clk")
  &clk_itr_length=STRING.LENGTH("gcc_periph_noc_at_clk")

  if (STRING.SCAN("&clk", "*", 0)==0)
  (
    &wild_head=1
  )
  if (STRING.SCAN("&clk", "*", 1)==(STRING.LENGTH("&clk")-1))
  (
    &wild_tail=1
  )

  if ((&wild_head==1)&&(&wild_tail==1))
  (
    if (STRING.SCAN("gcc_periph_noc_at_clk", STRING.MID("&clk", 1, &clk_input_length-2), 0)!=-1)
    ( 
      &match=1
    )
  )
  else if (&wild_head==1)
  (
    if (STRING.MID("gcc_periph_noc_at_clk", &clk_itr_length-&clk_input_length+1, &clk_input_length-1)==STRING.CUT("&clk", 1))
    ( 
      &match=1
    )
  )
  else if (&wild_tail==1)
  (
    if (STRING.MID("gcc_periph_noc_at_clk", 0, &clk_input_length-1)==STRING.CUT("&clk", -1))
    ( 
      &match=1
    )
  )	  
  else if ("gcc_periph_noc_at_clk"=="&clk")
  (
    &match=1
  )
  
  if (&match==1)
  (
    &clk_test=&CLK_TEST_GCC_PERIPH_NOC_AT_CLK
    &clk_reg=&HWIO_GCC_PERIPH_NOC_AT_CBCR_ADDR
    &clk_reg_name="GCC_PERIPH_NOC_AT_CBCR"
    &clk_name="gcc_periph_noc_at_clk"
    &clk_reg_cbcr_type="sm_cbc"

    gosub Print_Clk_Info_Line
  )
  
  &match=0
  &wild_head=0
  &wild_tail=0
  &clk_input_length=STRING.LENGTH("&clk")
  &clk_itr_length=STRING.LENGTH("gcc_periph_noc_cfg_ahb_clk")

  if (STRING.SCAN("&clk", "*", 0)==0)
  (
    &wild_head=1
  )
  if (STRING.SCAN("&clk", "*", 1)==(STRING.LENGTH("&clk")-1))
  (
    &wild_tail=1
  )

  if ((&wild_head==1)&&(&wild_tail==1))
  (
    if (STRING.SCAN("gcc_periph_noc_cfg_ahb_clk", STRING.MID("&clk", 1, &clk_input_length-2), 0)!=-1)
    ( 
      &match=1
    )
  )
  else if (&wild_head==1)
  (
    if (STRING.MID("gcc_periph_noc_cfg_ahb_clk", &clk_itr_length-&clk_input_length+1, &clk_input_length-1)==STRING.CUT("&clk", 1))
    ( 
      &match=1
    )
  )
  else if (&wild_tail==1)
  (
    if (STRING.MID("gcc_periph_noc_cfg_ahb_clk", 0, &clk_input_length-1)==STRING.CUT("&clk", -1))
    ( 
      &match=1
    )
  )	  
  else if ("gcc_periph_noc_cfg_ahb_clk"=="&clk")
  (
    &match=1
  )
  
  if (&match==1)
  (
    &clk_test=&CLK_TEST_GCC_PERIPH_NOC_CFG_AHB_CLK
    &clk_reg=&HWIO_GCC_PERIPH_NOC_CFG_AHB_CBCR_ADDR
    &clk_reg_name="GCC_PERIPH_NOC_CFG_AHB_CBCR"
    &clk_name="gcc_periph_noc_cfg_ahb_clk"
    &clk_reg_cbcr_type="sm_cbc"

    gosub Print_Clk_Info_Line
  )
  
  &match=0
  &wild_head=0
  &wild_tail=0
  &clk_input_length=STRING.LENGTH("&clk")
  &clk_itr_length=STRING.LENGTH("gcc_periph_noc_usb_hsic_ahb_clk")

  if (STRING.SCAN("&clk", "*", 0)==0)
  (
    &wild_head=1
  )
  if (STRING.SCAN("&clk", "*", 1)==(STRING.LENGTH("&clk")-1))
  (
    &wild_tail=1
  )

  if ((&wild_head==1)&&(&wild_tail==1))
  (
    if (STRING.SCAN("gcc_periph_noc_usb_hsic_ahb_clk", STRING.MID("&clk", 1, &clk_input_length-2), 0)!=-1)
    ( 
      &match=1
    )
  )
  else if (&wild_head==1)
  (
    if (STRING.MID("gcc_periph_noc_usb_hsic_ahb_clk", &clk_itr_length-&clk_input_length+1, &clk_input_length-1)==STRING.CUT("&clk", 1))
    ( 
      &match=1
    )
  )
  else if (&wild_tail==1)
  (
    if (STRING.MID("gcc_periph_noc_usb_hsic_ahb_clk", 0, &clk_input_length-1)==STRING.CUT("&clk", -1))
    ( 
      &match=1
    )
  )	  
  else if ("gcc_periph_noc_usb_hsic_ahb_clk"=="&clk")
  (
    &match=1
  )
  
  if (&match==1)
  (
    &clk_test=&CLK_TEST_GCC_PERIPH_NOC_USB_HSIC_AHB_CLK
    &clk_reg=&HWIO_GCC_PERIPH_NOC_USB_HSIC_AHB_CBCR_ADDR
    &clk_reg_name="GCC_PERIPH_NOC_USB_HSIC_AHB_CBCR"
    &clk_name="gcc_periph_noc_usb_hsic_ahb_clk"
    &clk_reg_cbcr_type="sm_cbc"

    gosub Print_Clk_Info_Line
  )
  
  &match=0
  &wild_head=0
  &wild_tail=0
  &clk_input_length=STRING.LENGTH("&clk")
  &clk_itr_length=STRING.LENGTH("gcc_qdss_at_clk")

  if (STRING.SCAN("&clk", "*", 0)==0)
  (
    &wild_head=1
  )
  if (STRING.SCAN("&clk", "*", 1)==(STRING.LENGTH("&clk")-1))
  (
    &wild_tail=1
  )

  if ((&wild_head==1)&&(&wild_tail==1))
  (
    if (STRING.SCAN("gcc_qdss_at_clk", STRING.MID("&clk", 1, &clk_input_length-2), 0)!=-1)
    ( 
      &match=1
    )
  )
  else if (&wild_head==1)
  (
    if (STRING.MID("gcc_qdss_at_clk", &clk_itr_length-&clk_input_length+1, &clk_input_length-1)==STRING.CUT("&clk", 1))
    ( 
      &match=1
    )
  )
  else if (&wild_tail==1)
  (
    if (STRING.MID("gcc_qdss_at_clk", 0, &clk_input_length-1)==STRING.CUT("&clk", -1))
    ( 
      &match=1
    )
  )	  
  else if ("gcc_qdss_at_clk"=="&clk")
  (
    &match=1
  )
  
  if (&match==1)
  (
    &clk_test=&CLK_TEST_GCC_QDSS_AT_CLK
    &clk_reg=&HWIO_GCC_QDSS_AT_CBCR_ADDR
    &clk_reg_name="GCC_QDSS_AT_CBCR"
    &clk_name="gcc_qdss_at_clk"
    &clk_reg_cbcr_type="sm_pscbc"

    gosub Print_Clk_Info_Line
  )
  
  &match=0
  &wild_head=0
  &wild_tail=0
  &clk_input_length=STRING.LENGTH("&clk")
  &clk_itr_length=STRING.LENGTH("gcc_qdss_cfg_ahb_clk")

  if (STRING.SCAN("&clk", "*", 0)==0)
  (
    &wild_head=1
  )
  if (STRING.SCAN("&clk", "*", 1)==(STRING.LENGTH("&clk")-1))
  (
    &wild_tail=1
  )

  if ((&wild_head==1)&&(&wild_tail==1))
  (
    if (STRING.SCAN("gcc_qdss_cfg_ahb_clk", STRING.MID("&clk", 1, &clk_input_length-2), 0)!=-1)
    ( 
      &match=1
    )
  )
  else if (&wild_head==1)
  (
    if (STRING.MID("gcc_qdss_cfg_ahb_clk", &clk_itr_length-&clk_input_length+1, &clk_input_length-1)==STRING.CUT("&clk", 1))
    ( 
      &match=1
    )
  )
  else if (&wild_tail==1)
  (
    if (STRING.MID("gcc_qdss_cfg_ahb_clk", 0, &clk_input_length-1)==STRING.CUT("&clk", -1))
    ( 
      &match=1
    )
  )	  
  else if ("gcc_qdss_cfg_ahb_clk"=="&clk")
  (
    &match=1
  )
  
  if (&match==1)
  (
    &clk_test=&CLK_TEST_GCC_QDSS_CFG_AHB_CLK
    &clk_reg=&HWIO_GCC_QDSS_CFG_AHB_CBCR_ADDR
    &clk_reg_name="GCC_QDSS_CFG_AHB_CBCR"
    &clk_name="gcc_qdss_cfg_ahb_clk"
    &clk_reg_cbcr_type="sm_cbc"

    gosub Print_Clk_Info_Line
  )
  
  &match=0
  &wild_head=0
  &wild_tail=0
  &clk_input_length=STRING.LENGTH("&clk")
  &clk_itr_length=STRING.LENGTH("gcc_qdss_dap_ahb_clk")

  if (STRING.SCAN("&clk", "*", 0)==0)
  (
    &wild_head=1
  )
  if (STRING.SCAN("&clk", "*", 1)==(STRING.LENGTH("&clk")-1))
  (
    &wild_tail=1
  )

  if ((&wild_head==1)&&(&wild_tail==1))
  (
    if (STRING.SCAN("gcc_qdss_dap_ahb_clk", STRING.MID("&clk", 1, &clk_input_length-2), 0)!=-1)
    ( 
      &match=1
    )
  )
  else if (&wild_head==1)
  (
    if (STRING.MID("gcc_qdss_dap_ahb_clk", &clk_itr_length-&clk_input_length+1, &clk_input_length-1)==STRING.CUT("&clk", 1))
    ( 
      &match=1
    )
  )
  else if (&wild_tail==1)
  (
    if (STRING.MID("gcc_qdss_dap_ahb_clk", 0, &clk_input_length-1)==STRING.CUT("&clk", -1))
    ( 
      &match=1
    )
  )	  
  else if ("gcc_qdss_dap_ahb_clk"=="&clk")
  (
    &match=1
  )
  
  if (&match==1)
  (
    &clk_test=&CLK_TEST_GCC_QDSS_DAP_AHB_CLK
    &clk_reg=&HWIO_GCC_QDSS_DAP_AHB_CBCR_ADDR
    &clk_reg_name="GCC_QDSS_DAP_AHB_CBCR"
    &clk_name="gcc_qdss_dap_ahb_clk"
    &clk_reg_cbcr_type="sm_cbc"

    gosub Print_Clk_Info_Line
  )
  
  &match=0
  &wild_head=0
  &wild_tail=0
  &clk_input_length=STRING.LENGTH("&clk")
  &clk_itr_length=STRING.LENGTH("gcc_qdss_dap_clk")

  if (STRING.SCAN("&clk", "*", 0)==0)
  (
    &wild_head=1
  )
  if (STRING.SCAN("&clk", "*", 1)==(STRING.LENGTH("&clk")-1))
  (
    &wild_tail=1
  )

  if ((&wild_head==1)&&(&wild_tail==1))
  (
    if (STRING.SCAN("gcc_qdss_dap_clk", STRING.MID("&clk", 1, &clk_input_length-2), 0)!=-1)
    ( 
      &match=1
    )
  )
  else if (&wild_head==1)
  (
    if (STRING.MID("gcc_qdss_dap_clk", &clk_itr_length-&clk_input_length+1, &clk_input_length-1)==STRING.CUT("&clk", 1))
    ( 
      &match=1
    )
  )
  else if (&wild_tail==1)
  (
    if (STRING.MID("gcc_qdss_dap_clk", 0, &clk_input_length-1)==STRING.CUT("&clk", -1))
    ( 
      &match=1
    )
  )	  
  else if ("gcc_qdss_dap_clk"=="&clk")
  (
    &match=1
  )
  
  if (&match==1)
  (
    &clk_test=&CLK_TEST_GCC_QDSS_DAP_CLK
    &clk_reg=&HWIO_GCC_QDSS_DAP_CBCR_ADDR
    &clk_reg_name="GCC_QDSS_DAP_CBCR"
    &clk_name="gcc_qdss_dap_clk"
    &clk_reg_cbcr_type="sm_cbc"

    gosub Print_Clk_Info_Line
  )
  
  &match=0
  &wild_head=0
  &wild_tail=0
  &clk_input_length=STRING.LENGTH("&clk")
  &clk_itr_length=STRING.LENGTH("gcc_qdss_etr_usb_clk")

  if (STRING.SCAN("&clk", "*", 0)==0)
  (
    &wild_head=1
  )
  if (STRING.SCAN("&clk", "*", 1)==(STRING.LENGTH("&clk")-1))
  (
    &wild_tail=1
  )

  if ((&wild_head==1)&&(&wild_tail==1))
  (
    if (STRING.SCAN("gcc_qdss_etr_usb_clk", STRING.MID("&clk", 1, &clk_input_length-2), 0)!=-1)
    ( 
      &match=1
    )
  )
  else if (&wild_head==1)
  (
    if (STRING.MID("gcc_qdss_etr_usb_clk", &clk_itr_length-&clk_input_length+1, &clk_input_length-1)==STRING.CUT("&clk", 1))
    ( 
      &match=1
    )
  )
  else if (&wild_tail==1)
  (
    if (STRING.MID("gcc_qdss_etr_usb_clk", 0, &clk_input_length-1)==STRING.CUT("&clk", -1))
    ( 
      &match=1
    )
  )	  
  else if ("gcc_qdss_etr_usb_clk"=="&clk")
  (
    &match=1
  )
  
  if (&match==1)
  (
    &clk_test=&CLK_TEST_GCC_QDSS_ETR_USB_CLK
    &clk_reg=&HWIO_GCC_QDSS_ETR_USB_CBCR_ADDR
    &clk_reg_name="GCC_QDSS_ETR_USB_CBCR"
    &clk_name="gcc_qdss_etr_usb_clk"
    &clk_reg_cbcr_type="sm_cbc"

    gosub Print_Clk_Info_Line
  )
  
  &match=0
  &wild_head=0
  &wild_tail=0
  &clk_input_length=STRING.LENGTH("&clk")
  &clk_itr_length=STRING.LENGTH("gcc_qdss_stm_clk")

  if (STRING.SCAN("&clk", "*", 0)==0)
  (
    &wild_head=1
  )
  if (STRING.SCAN("&clk", "*", 1)==(STRING.LENGTH("&clk")-1))
  (
    &wild_tail=1
  )

  if ((&wild_head==1)&&(&wild_tail==1))
  (
    if (STRING.SCAN("gcc_qdss_stm_clk", STRING.MID("&clk", 1, &clk_input_length-2), 0)!=-1)
    ( 
      &match=1
    )
  )
  else if (&wild_head==1)
  (
    if (STRING.MID("gcc_qdss_stm_clk", &clk_itr_length-&clk_input_length+1, &clk_input_length-1)==STRING.CUT("&clk", 1))
    ( 
      &match=1
    )
  )
  else if (&wild_tail==1)
  (
    if (STRING.MID("gcc_qdss_stm_clk", 0, &clk_input_length-1)==STRING.CUT("&clk", -1))
    ( 
      &match=1
    )
  )	  
  else if ("gcc_qdss_stm_clk"=="&clk")
  (
    &match=1
  )
  
  if (&match==1)
  (
    &clk_test=&CLK_TEST_GCC_QDSS_STM_CLK
    &clk_reg=&HWIO_GCC_QDSS_STM_CBCR_ADDR
    &clk_reg_name="GCC_QDSS_STM_CBCR"
    &clk_name="gcc_qdss_stm_clk"
    &clk_reg_cbcr_type="sm_cbc"

    gosub Print_Clk_Info_Line
  )
  
  &match=0
  &wild_head=0
  &wild_tail=0
  &clk_input_length=STRING.LENGTH("&clk")
  &clk_itr_length=STRING.LENGTH("gcc_qdss_traceclkin_clk")

  if (STRING.SCAN("&clk", "*", 0)==0)
  (
    &wild_head=1
  )
  if (STRING.SCAN("&clk", "*", 1)==(STRING.LENGTH("&clk")-1))
  (
    &wild_tail=1
  )

  if ((&wild_head==1)&&(&wild_tail==1))
  (
    if (STRING.SCAN("gcc_qdss_traceclkin_clk", STRING.MID("&clk", 1, &clk_input_length-2), 0)!=-1)
    ( 
      &match=1
    )
  )
  else if (&wild_head==1)
  (
    if (STRING.MID("gcc_qdss_traceclkin_clk", &clk_itr_length-&clk_input_length+1, &clk_input_length-1)==STRING.CUT("&clk", 1))
    ( 
      &match=1
    )
  )
  else if (&wild_tail==1)
  (
    if (STRING.MID("gcc_qdss_traceclkin_clk", 0, &clk_input_length-1)==STRING.CUT("&clk", -1))
    ( 
      &match=1
    )
  )	  
  else if ("gcc_qdss_traceclkin_clk"=="&clk")
  (
    &match=1
  )
  
  if (&match==1)
  (
    &clk_test=&CLK_TEST_GCC_QDSS_TRACECLKIN_CLK
    &clk_reg=&HWIO_GCC_QDSS_TRACECLKIN_CBCR_ADDR
    &clk_reg_name="GCC_QDSS_TRACECLKIN_CBCR"
    &clk_name="gcc_qdss_traceclkin_clk"
    &clk_reg_cbcr_type="sm_cbc"

    gosub Print_Clk_Info_Line
  )
  
  &match=0
  &wild_head=0
  &wild_tail=0
  &clk_input_length=STRING.LENGTH("&clk")
  &clk_itr_length=STRING.LENGTH("gcc_qdss_tsctr_div16_clk")

  if (STRING.SCAN("&clk", "*", 0)==0)
  (
    &wild_head=1
  )
  if (STRING.SCAN("&clk", "*", 1)==(STRING.LENGTH("&clk")-1))
  (
    &wild_tail=1
  )

  if ((&wild_head==1)&&(&wild_tail==1))
  (
    if (STRING.SCAN("gcc_qdss_tsctr_div16_clk", STRING.MID("&clk", 1, &clk_input_length-2), 0)!=-1)
    ( 
      &match=1
    )
  )
  else if (&wild_head==1)
  (
    if (STRING.MID("gcc_qdss_tsctr_div16_clk", &clk_itr_length-&clk_input_length+1, &clk_input_length-1)==STRING.CUT("&clk", 1))
    ( 
      &match=1
    )
  )
  else if (&wild_tail==1)
  (
    if (STRING.MID("gcc_qdss_tsctr_div16_clk", 0, &clk_input_length-1)==STRING.CUT("&clk", -1))
    ( 
      &match=1
    )
  )	  
  else if ("gcc_qdss_tsctr_div16_clk"=="&clk")
  (
    &match=1
  )
  
  if (&match==1)
  (
    &clk_test=&CLK_TEST_GCC_QDSS_TSCTR_DIV16_CLK
    &clk_reg=&HWIO_GCC_QDSS_TSCTR_DIV16_CBCR_ADDR
    &clk_reg_name="GCC_QDSS_TSCTR_DIV16_CBCR"
    &clk_name="gcc_qdss_tsctr_div16_clk"
    &clk_reg_cbcr_type="sm_cbc"

    gosub Print_Clk_Info_Line
  )
  
  &match=0
  &wild_head=0
  &wild_tail=0
  &clk_input_length=STRING.LENGTH("&clk")
  &clk_itr_length=STRING.LENGTH("gcc_qdss_tsctr_div2_clk")

  if (STRING.SCAN("&clk", "*", 0)==0)
  (
    &wild_head=1
  )
  if (STRING.SCAN("&clk", "*", 1)==(STRING.LENGTH("&clk")-1))
  (
    &wild_tail=1
  )

  if ((&wild_head==1)&&(&wild_tail==1))
  (
    if (STRING.SCAN("gcc_qdss_tsctr_div2_clk", STRING.MID("&clk", 1, &clk_input_length-2), 0)!=-1)
    ( 
      &match=1
    )
  )
  else if (&wild_head==1)
  (
    if (STRING.MID("gcc_qdss_tsctr_div2_clk", &clk_itr_length-&clk_input_length+1, &clk_input_length-1)==STRING.CUT("&clk", 1))
    ( 
      &match=1
    )
  )
  else if (&wild_tail==1)
  (
    if (STRING.MID("gcc_qdss_tsctr_div2_clk", 0, &clk_input_length-1)==STRING.CUT("&clk", -1))
    ( 
      &match=1
    )
  )	  
  else if ("gcc_qdss_tsctr_div2_clk"=="&clk")
  (
    &match=1
  )
  
  if (&match==1)
  (
    &clk_test=&CLK_TEST_GCC_QDSS_TSCTR_DIV2_CLK
    &clk_reg=&HWIO_GCC_QDSS_TSCTR_DIV2_CBCR_ADDR
    &clk_reg_name="GCC_QDSS_TSCTR_DIV2_CBCR"
    &clk_name="gcc_qdss_tsctr_div2_clk"
    &clk_reg_cbcr_type="sm_cbc"

    gosub Print_Clk_Info_Line
  )
  
  &match=0
  &wild_head=0
  &wild_tail=0
  &clk_input_length=STRING.LENGTH("&clk")
  &clk_itr_length=STRING.LENGTH("gcc_qdss_tsctr_div3_clk")

  if (STRING.SCAN("&clk", "*", 0)==0)
  (
    &wild_head=1
  )
  if (STRING.SCAN("&clk", "*", 1)==(STRING.LENGTH("&clk")-1))
  (
    &wild_tail=1
  )

  if ((&wild_head==1)&&(&wild_tail==1))
  (
    if (STRING.SCAN("gcc_qdss_tsctr_div3_clk", STRING.MID("&clk", 1, &clk_input_length-2), 0)!=-1)
    ( 
      &match=1
    )
  )
  else if (&wild_head==1)
  (
    if (STRING.MID("gcc_qdss_tsctr_div3_clk", &clk_itr_length-&clk_input_length+1, &clk_input_length-1)==STRING.CUT("&clk", 1))
    ( 
      &match=1
    )
  )
  else if (&wild_tail==1)
  (
    if (STRING.MID("gcc_qdss_tsctr_div3_clk", 0, &clk_input_length-1)==STRING.CUT("&clk", -1))
    ( 
      &match=1
    )
  )	  
  else if ("gcc_qdss_tsctr_div3_clk"=="&clk")
  (
    &match=1
  )
  
  if (&match==1)
  (
    &clk_test=&CLK_TEST_GCC_QDSS_TSCTR_DIV3_CLK
    &clk_reg=&HWIO_GCC_QDSS_TSCTR_DIV3_CBCR_ADDR
    &clk_reg_name="GCC_QDSS_TSCTR_DIV3_CBCR"
    &clk_name="gcc_qdss_tsctr_div3_clk"
    &clk_reg_cbcr_type="sm_cbc"

    gosub Print_Clk_Info_Line
  )
  
  &match=0
  &wild_head=0
  &wild_tail=0
  &clk_input_length=STRING.LENGTH("&clk")
  &clk_itr_length=STRING.LENGTH("gcc_qdss_tsctr_div4_clk")

  if (STRING.SCAN("&clk", "*", 0)==0)
  (
    &wild_head=1
  )
  if (STRING.SCAN("&clk", "*", 1)==(STRING.LENGTH("&clk")-1))
  (
    &wild_tail=1
  )

  if ((&wild_head==1)&&(&wild_tail==1))
  (
    if (STRING.SCAN("gcc_qdss_tsctr_div4_clk", STRING.MID("&clk", 1, &clk_input_length-2), 0)!=-1)
    ( 
      &match=1
    )
  )
  else if (&wild_head==1)
  (
    if (STRING.MID("gcc_qdss_tsctr_div4_clk", &clk_itr_length-&clk_input_length+1, &clk_input_length-1)==STRING.CUT("&clk", 1))
    ( 
      &match=1
    )
  )
  else if (&wild_tail==1)
  (
    if (STRING.MID("gcc_qdss_tsctr_div4_clk", 0, &clk_input_length-1)==STRING.CUT("&clk", -1))
    ( 
      &match=1
    )
  )	  
  else if ("gcc_qdss_tsctr_div4_clk"=="&clk")
  (
    &match=1
  )
  
  if (&match==1)
  (
    &clk_test=&CLK_TEST_GCC_QDSS_TSCTR_DIV4_CLK
    &clk_reg=&HWIO_GCC_QDSS_TSCTR_DIV4_CBCR_ADDR
    &clk_reg_name="GCC_QDSS_TSCTR_DIV4_CBCR"
    &clk_name="gcc_qdss_tsctr_div4_clk"
    &clk_reg_cbcr_type="sm_cbc"

    gosub Print_Clk_Info_Line
  )
  
  &match=0
  &wild_head=0
  &wild_tail=0
  &clk_input_length=STRING.LENGTH("&clk")
  &clk_itr_length=STRING.LENGTH("gcc_qdss_tsctr_div8_clk")

  if (STRING.SCAN("&clk", "*", 0)==0)
  (
    &wild_head=1
  )
  if (STRING.SCAN("&clk", "*", 1)==(STRING.LENGTH("&clk")-1))
  (
    &wild_tail=1
  )

  if ((&wild_head==1)&&(&wild_tail==1))
  (
    if (STRING.SCAN("gcc_qdss_tsctr_div8_clk", STRING.MID("&clk", 1, &clk_input_length-2), 0)!=-1)
    ( 
      &match=1
    )
  )
  else if (&wild_head==1)
  (
    if (STRING.MID("gcc_qdss_tsctr_div8_clk", &clk_itr_length-&clk_input_length+1, &clk_input_length-1)==STRING.CUT("&clk", 1))
    ( 
      &match=1
    )
  )
  else if (&wild_tail==1)
  (
    if (STRING.MID("gcc_qdss_tsctr_div8_clk", 0, &clk_input_length-1)==STRING.CUT("&clk", -1))
    ( 
      &match=1
    )
  )	  
  else if ("gcc_qdss_tsctr_div8_clk"=="&clk")
  (
    &match=1
  )
  
  if (&match==1)
  (
    &clk_test=&CLK_TEST_GCC_QDSS_TSCTR_DIV8_CLK
    &clk_reg=&HWIO_GCC_QDSS_TSCTR_DIV8_CBCR_ADDR
    &clk_reg_name="GCC_QDSS_TSCTR_DIV8_CBCR"
    &clk_name="gcc_qdss_tsctr_div8_clk"
    &clk_reg_cbcr_type="sm_cbc"

    gosub Print_Clk_Info_Line
  )
  
  &match=0
  &wild_head=0
  &wild_tail=0
  &clk_input_length=STRING.LENGTH("&clk")
  &clk_itr_length=STRING.LENGTH("gcc_qdss_rbcpr_xpu_ahb_clk")

  if (STRING.SCAN("&clk", "*", 0)==0)
  (
    &wild_head=1
  )
  if (STRING.SCAN("&clk", "*", 1)==(STRING.LENGTH("&clk")-1))
  (
    &wild_tail=1
  )

  if ((&wild_head==1)&&(&wild_tail==1))
  (
    if (STRING.SCAN("gcc_qdss_rbcpr_xpu_ahb_clk", STRING.MID("&clk", 1, &clk_input_length-2), 0)!=-1)
    ( 
      &match=1
    )
  )
  else if (&wild_head==1)
  (
    if (STRING.MID("gcc_qdss_rbcpr_xpu_ahb_clk", &clk_itr_length-&clk_input_length+1, &clk_input_length-1)==STRING.CUT("&clk", 1))
    ( 
      &match=1
    )
  )
  else if (&wild_tail==1)
  (
    if (STRING.MID("gcc_qdss_rbcpr_xpu_ahb_clk", 0, &clk_input_length-1)==STRING.CUT("&clk", -1))
    ( 
      &match=1
    )
  )	  
  else if ("gcc_qdss_rbcpr_xpu_ahb_clk"=="&clk")
  (
    &match=1
  )
  
  if (&match==1)
  (
    &clk_test=&CLK_TEST_GCC_QDSS_RBCPR_XPU_AHB_CLK
    &clk_reg=&HWIO_GCC_QDSS_RBCPR_XPU_AHB_CBCR_ADDR
    &clk_reg_name="GCC_QDSS_RBCPR_XPU_AHB_CBCR"
    &clk_name="gcc_qdss_rbcpr_xpu_ahb_clk"
    &clk_reg_cbcr_type="sm_cbc"

    gosub Print_Clk_Info_Line
  )
  
  &match=0
  &wild_head=0
  &wild_tail=0
  &clk_input_length=STRING.LENGTH("&clk")
  &clk_itr_length=STRING.LENGTH("gcc_rbcpr_ahb_clk")

  if (STRING.SCAN("&clk", "*", 0)==0)
  (
    &wild_head=1
  )
  if (STRING.SCAN("&clk", "*", 1)==(STRING.LENGTH("&clk")-1))
  (
    &wild_tail=1
  )

  if ((&wild_head==1)&&(&wild_tail==1))
  (
    if (STRING.SCAN("gcc_rbcpr_ahb_clk", STRING.MID("&clk", 1, &clk_input_length-2), 0)!=-1)
    ( 
      &match=1
    )
  )
  else if (&wild_head==1)
  (
    if (STRING.MID("gcc_rbcpr_ahb_clk", &clk_itr_length-&clk_input_length+1, &clk_input_length-1)==STRING.CUT("&clk", 1))
    ( 
      &match=1
    )
  )
  else if (&wild_tail==1)
  (
    if (STRING.MID("gcc_rbcpr_ahb_clk", 0, &clk_input_length-1)==STRING.CUT("&clk", -1))
    ( 
      &match=1
    )
  )	  
  else if ("gcc_rbcpr_ahb_clk"=="&clk")
  (
    &match=1
  )
  
  if (&match==1)
  (
    &clk_test=&CLK_TEST_GCC_RBCPR_AHB_CLK
    &clk_reg=&HWIO_GCC_RBCPR_AHB_CBCR_ADDR
    &clk_reg_name="GCC_RBCPR_AHB_CBCR"
    &clk_name="gcc_rbcpr_ahb_clk"
    &clk_reg_cbcr_type="sm_cbc"

    gosub Print_Clk_Info_Line
  )
  
  &match=0
  &wild_head=0
  &wild_tail=0
  &clk_input_length=STRING.LENGTH("&clk")
  &clk_itr_length=STRING.LENGTH("gcc_rbcpr_clk")

  if (STRING.SCAN("&clk", "*", 0)==0)
  (
    &wild_head=1
  )
  if (STRING.SCAN("&clk", "*", 1)==(STRING.LENGTH("&clk")-1))
  (
    &wild_tail=1
  )

  if ((&wild_head==1)&&(&wild_tail==1))
  (
    if (STRING.SCAN("gcc_rbcpr_clk", STRING.MID("&clk", 1, &clk_input_length-2), 0)!=-1)
    ( 
      &match=1
    )
  )
  else if (&wild_head==1)
  (
    if (STRING.MID("gcc_rbcpr_clk", &clk_itr_length-&clk_input_length+1, &clk_input_length-1)==STRING.CUT("&clk", 1))
    ( 
      &match=1
    )
  )
  else if (&wild_tail==1)
  (
    if (STRING.MID("gcc_rbcpr_clk", 0, &clk_input_length-1)==STRING.CUT("&clk", -1))
    ( 
      &match=1
    )
  )	  
  else if ("gcc_rbcpr_clk"=="&clk")
  (
    &match=1
  )
  
  if (&match==1)
  (
    &clk_test=&CLK_TEST_GCC_RBCPR_CLK
    &clk_reg=&HWIO_GCC_RBCPR_CBCR_ADDR
    &clk_reg_name="GCC_RBCPR_CBCR"
    &clk_name="gcc_rbcpr_clk"
    &clk_reg_cbcr_type="sm_cbc"

    gosub Print_Clk_Info_Line
  )
  
  &match=0
  &wild_head=0
  &wild_tail=0
  &clk_input_length=STRING.LENGTH("&clk")
  &clk_itr_length=STRING.LENGTH("gcc_rpm_bus_ahb_clk")

  if (STRING.SCAN("&clk", "*", 0)==0)
  (
    &wild_head=1
  )
  if (STRING.SCAN("&clk", "*", 1)==(STRING.LENGTH("&clk")-1))
  (
    &wild_tail=1
  )

  if ((&wild_head==1)&&(&wild_tail==1))
  (
    if (STRING.SCAN("gcc_rpm_bus_ahb_clk", STRING.MID("&clk", 1, &clk_input_length-2), 0)!=-1)
    ( 
      &match=1
    )
  )
  else if (&wild_head==1)
  (
    if (STRING.MID("gcc_rpm_bus_ahb_clk", &clk_itr_length-&clk_input_length+1, &clk_input_length-1)==STRING.CUT("&clk", 1))
    ( 
      &match=1
    )
  )
  else if (&wild_tail==1)
  (
    if (STRING.MID("gcc_rpm_bus_ahb_clk", 0, &clk_input_length-1)==STRING.CUT("&clk", -1))
    ( 
      &match=1
    )
  )	  
  else if ("gcc_rpm_bus_ahb_clk"=="&clk")
  (
    &match=1
  )
  
  if (&match==1)
  (
    &clk_test=&CLK_TEST_GCC_RPM_BUS_AHB_CLK
    &clk_reg=&HWIO_GCC_RPM_BUS_AHB_CBCR_ADDR
    &clk_reg_name="GCC_RPM_BUS_AHB_CBCR"
    &clk_name="gcc_rpm_bus_ahb_clk"
    &clk_reg_cbcr_type="sm_pscbc"

    gosub Print_Clk_Info_Line
  )
  
  &match=0
  &wild_head=0
  &wild_tail=0
  &clk_input_length=STRING.LENGTH("&clk")
  &clk_itr_length=STRING.LENGTH("gcc_rpm_proc_fclk")

  if (STRING.SCAN("&clk", "*", 0)==0)
  (
    &wild_head=1
  )
  if (STRING.SCAN("&clk", "*", 1)==(STRING.LENGTH("&clk")-1))
  (
    &wild_tail=1
  )

  if ((&wild_head==1)&&(&wild_tail==1))
  (
    if (STRING.SCAN("gcc_rpm_proc_fclk", STRING.MID("&clk", 1, &clk_input_length-2), 0)!=-1)
    ( 
      &match=1
    )
  )
  else if (&wild_head==1)
  (
    if (STRING.MID("gcc_rpm_proc_fclk", &clk_itr_length-&clk_input_length+1, &clk_input_length-1)==STRING.CUT("&clk", 1))
    ( 
      &match=1
    )
  )
  else if (&wild_tail==1)
  (
    if (STRING.MID("gcc_rpm_proc_fclk", 0, &clk_input_length-1)==STRING.CUT("&clk", -1))
    ( 
      &match=1
    )
  )	  
  else if ("gcc_rpm_proc_fclk"=="&clk")
  (
    &match=1
  )
  
  ; This clock belongs to the 'cpus' display group.
  if ("cpus"=="&clk")
  (
    &match=1	  
  )
  
  if (&match==1)
  (
    &clk_test=&CLK_TEST_GCC_RPM_PROC_FCLK
    &clk_reg=0
    &clk_reg_name="No CBCR"
    &clk_name="gcc_rpm_proc_fclk"
    &clk_reg_cbcr_type="sm_cbc"

    gosub Print_Clk_Info_Line
  )
  
  &match=0
  &wild_head=0
  &wild_tail=0
  &clk_input_length=STRING.LENGTH("&clk")
  &clk_itr_length=STRING.LENGTH("gcc_rpm_proc_hclk")

  if (STRING.SCAN("&clk", "*", 0)==0)
  (
    &wild_head=1
  )
  if (STRING.SCAN("&clk", "*", 1)==(STRING.LENGTH("&clk")-1))
  (
    &wild_tail=1
  )

  if ((&wild_head==1)&&(&wild_tail==1))
  (
    if (STRING.SCAN("gcc_rpm_proc_hclk", STRING.MID("&clk", 1, &clk_input_length-2), 0)!=-1)
    ( 
      &match=1
    )
  )
  else if (&wild_head==1)
  (
    if (STRING.MID("gcc_rpm_proc_hclk", &clk_itr_length-&clk_input_length+1, &clk_input_length-1)==STRING.CUT("&clk", 1))
    ( 
      &match=1
    )
  )
  else if (&wild_tail==1)
  (
    if (STRING.MID("gcc_rpm_proc_hclk", 0, &clk_input_length-1)==STRING.CUT("&clk", -1))
    ( 
      &match=1
    )
  )	  
  else if ("gcc_rpm_proc_hclk"=="&clk")
  (
    &match=1
  )
  
  if (&match==1)
  (
    &clk_test=&CLK_TEST_GCC_RPM_PROC_HCLK
    &clk_reg=&HWIO_GCC_RPM_PROC_HCLK_CBCR_ADDR
    &clk_reg_name="GCC_RPM_PROC_HCLK_CBCR"
    &clk_name="gcc_rpm_proc_hclk"
    &clk_reg_cbcr_type="sm_cbc"

    gosub Print_Clk_Info_Line
  )
  
  &match=0
  &wild_head=0
  &wild_tail=0
  &clk_input_length=STRING.LENGTH("&clk")
  &clk_itr_length=STRING.LENGTH("gcc_rpm_sleep_clk")

  if (STRING.SCAN("&clk", "*", 0)==0)
  (
    &wild_head=1
  )
  if (STRING.SCAN("&clk", "*", 1)==(STRING.LENGTH("&clk")-1))
  (
    &wild_tail=1
  )

  if ((&wild_head==1)&&(&wild_tail==1))
  (
    if (STRING.SCAN("gcc_rpm_sleep_clk", STRING.MID("&clk", 1, &clk_input_length-2), 0)!=-1)
    ( 
      &match=1
    )
  )
  else if (&wild_head==1)
  (
    if (STRING.MID("gcc_rpm_sleep_clk", &clk_itr_length-&clk_input_length+1, &clk_input_length-1)==STRING.CUT("&clk", 1))
    ( 
      &match=1
    )
  )
  else if (&wild_tail==1)
  (
    if (STRING.MID("gcc_rpm_sleep_clk", 0, &clk_input_length-1)==STRING.CUT("&clk", -1))
    ( 
      &match=1
    )
  )	  
  else if ("gcc_rpm_sleep_clk"=="&clk")
  (
    &match=1
  )
  
  if (&match==1)
  (
    &clk_test=&CLK_TEST_GCC_RPM_SLEEP_CLK
    &clk_reg=&HWIO_GCC_RPM_SLEEP_CBCR_ADDR
    &clk_reg_name="GCC_RPM_SLEEP_CBCR"
    &clk_name="gcc_rpm_sleep_clk"
    &clk_reg_cbcr_type="sm_cbc"

    gosub Print_Clk_Info_Line
  )
  
  &match=0
  &wild_head=0
  &wild_tail=0
  &clk_input_length=STRING.LENGTH("&clk")
  &clk_itr_length=STRING.LENGTH("gcc_rpm_timer_clk")

  if (STRING.SCAN("&clk", "*", 0)==0)
  (
    &wild_head=1
  )
  if (STRING.SCAN("&clk", "*", 1)==(STRING.LENGTH("&clk")-1))
  (
    &wild_tail=1
  )

  if ((&wild_head==1)&&(&wild_tail==1))
  (
    if (STRING.SCAN("gcc_rpm_timer_clk", STRING.MID("&clk", 1, &clk_input_length-2), 0)!=-1)
    ( 
      &match=1
    )
  )
  else if (&wild_head==1)
  (
    if (STRING.MID("gcc_rpm_timer_clk", &clk_itr_length-&clk_input_length+1, &clk_input_length-1)==STRING.CUT("&clk", 1))
    ( 
      &match=1
    )
  )
  else if (&wild_tail==1)
  (
    if (STRING.MID("gcc_rpm_timer_clk", 0, &clk_input_length-1)==STRING.CUT("&clk", -1))
    ( 
      &match=1
    )
  )	  
  else if ("gcc_rpm_timer_clk"=="&clk")
  (
    &match=1
  )
  
  if (&match==1)
  (
    &clk_test=&CLK_TEST_GCC_RPM_TIMER_CLK
    &clk_reg=&HWIO_GCC_RPM_TIMER_CBCR_ADDR
    &clk_reg_name="GCC_RPM_TIMER_CBCR"
    &clk_name="gcc_rpm_timer_clk"
    &clk_reg_cbcr_type="sm_cbc"

    gosub Print_Clk_Info_Line
  )
  
  &match=0
  &wild_head=0
  &wild_tail=0
  &clk_input_length=STRING.LENGTH("&clk")
  &clk_itr_length=STRING.LENGTH("gcc_sata_asic0_clk")

  if (STRING.SCAN("&clk", "*", 0)==0)
  (
    &wild_head=1
  )
  if (STRING.SCAN("&clk", "*", 1)==(STRING.LENGTH("&clk")-1))
  (
    &wild_tail=1
  )

  if ((&wild_head==1)&&(&wild_tail==1))
  (
    if (STRING.SCAN("gcc_sata_asic0_clk", STRING.MID("&clk", 1, &clk_input_length-2), 0)!=-1)
    ( 
      &match=1
    )
  )
  else if (&wild_head==1)
  (
    if (STRING.MID("gcc_sata_asic0_clk", &clk_itr_length-&clk_input_length+1, &clk_input_length-1)==STRING.CUT("&clk", 1))
    ( 
      &match=1
    )
  )
  else if (&wild_tail==1)
  (
    if (STRING.MID("gcc_sata_asic0_clk", 0, &clk_input_length-1)==STRING.CUT("&clk", -1))
    ( 
      &match=1
    )
  )	  
  else if ("gcc_sata_asic0_clk"=="&clk")
  (
    &match=1
  )
  
  if (&match==1)
  (
    &clk_test=&CLK_TEST_GCC_SATA_ASIC0_CLK
    &clk_reg=&HWIO_GCC_SATA_ASIC0_CBCR_ADDR
    &clk_reg_name="GCC_SATA_ASIC0_CBCR"
    &clk_name="gcc_sata_asic0_clk"
    &clk_reg_cbcr_type="sm_pscbc"

    gosub Print_Clk_Info_Line
  )
  
  &match=0
  &wild_head=0
  &wild_tail=0
  &clk_input_length=STRING.LENGTH("&clk")
  &clk_itr_length=STRING.LENGTH("gcc_sata_axi_clk")

  if (STRING.SCAN("&clk", "*", 0)==0)
  (
    &wild_head=1
  )
  if (STRING.SCAN("&clk", "*", 1)==(STRING.LENGTH("&clk")-1))
  (
    &wild_tail=1
  )

  if ((&wild_head==1)&&(&wild_tail==1))
  (
    if (STRING.SCAN("gcc_sata_axi_clk", STRING.MID("&clk", 1, &clk_input_length-2), 0)!=-1)
    ( 
      &match=1
    )
  )
  else if (&wild_head==1)
  (
    if (STRING.MID("gcc_sata_axi_clk", &clk_itr_length-&clk_input_length+1, &clk_input_length-1)==STRING.CUT("&clk", 1))
    ( 
      &match=1
    )
  )
  else if (&wild_tail==1)
  (
    if (STRING.MID("gcc_sata_axi_clk", 0, &clk_input_length-1)==STRING.CUT("&clk", -1))
    ( 
      &match=1
    )
  )	  
  else if ("gcc_sata_axi_clk"=="&clk")
  (
    &match=1
  )
  
  if (&match==1)
  (
    &clk_test=&CLK_TEST_GCC_SATA_AXI_CLK
    &clk_reg=&HWIO_GCC_SATA_AXI_CBCR_ADDR
    &clk_reg_name="GCC_SATA_AXI_CBCR"
    &clk_name="gcc_sata_axi_clk"
    &clk_reg_cbcr_type="sm_pscbc"

    gosub Print_Clk_Info_Line
  )
  
  &match=0
  &wild_head=0
  &wild_tail=0
  &clk_input_length=STRING.LENGTH("&clk")
  &clk_itr_length=STRING.LENGTH("gcc_sata_cfg_ahb_clk")

  if (STRING.SCAN("&clk", "*", 0)==0)
  (
    &wild_head=1
  )
  if (STRING.SCAN("&clk", "*", 1)==(STRING.LENGTH("&clk")-1))
  (
    &wild_tail=1
  )

  if ((&wild_head==1)&&(&wild_tail==1))
  (
    if (STRING.SCAN("gcc_sata_cfg_ahb_clk", STRING.MID("&clk", 1, &clk_input_length-2), 0)!=-1)
    ( 
      &match=1
    )
  )
  else if (&wild_head==1)
  (
    if (STRING.MID("gcc_sata_cfg_ahb_clk", &clk_itr_length-&clk_input_length+1, &clk_input_length-1)==STRING.CUT("&clk", 1))
    ( 
      &match=1
    )
  )
  else if (&wild_tail==1)
  (
    if (STRING.MID("gcc_sata_cfg_ahb_clk", 0, &clk_input_length-1)==STRING.CUT("&clk", -1))
    ( 
      &match=1
    )
  )	  
  else if ("gcc_sata_cfg_ahb_clk"=="&clk")
  (
    &match=1
  )
  
  if (&match==1)
  (
    &clk_test=&CLK_TEST_GCC_SATA_CFG_AHB_CLK
    &clk_reg=&HWIO_GCC_SATA_CFG_AHB_CBCR_ADDR
    &clk_reg_name="GCC_SATA_CFG_AHB_CBCR"
    &clk_name="gcc_sata_cfg_ahb_clk"
    &clk_reg_cbcr_type="sm_cbc"

    gosub Print_Clk_Info_Line
  )
  
  &match=0
  &wild_head=0
  &wild_tail=0
  &clk_input_length=STRING.LENGTH("&clk")
  &clk_itr_length=STRING.LENGTH("gcc_sata_pmalive_clk")

  if (STRING.SCAN("&clk", "*", 0)==0)
  (
    &wild_head=1
  )
  if (STRING.SCAN("&clk", "*", 1)==(STRING.LENGTH("&clk")-1))
  (
    &wild_tail=1
  )

  if ((&wild_head==1)&&(&wild_tail==1))
  (
    if (STRING.SCAN("gcc_sata_pmalive_clk", STRING.MID("&clk", 1, &clk_input_length-2), 0)!=-1)
    ( 
      &match=1
    )
  )
  else if (&wild_head==1)
  (
    if (STRING.MID("gcc_sata_pmalive_clk", &clk_itr_length-&clk_input_length+1, &clk_input_length-1)==STRING.CUT("&clk", 1))
    ( 
      &match=1
    )
  )
  else if (&wild_tail==1)
  (
    if (STRING.MID("gcc_sata_pmalive_clk", 0, &clk_input_length-1)==STRING.CUT("&clk", -1))
    ( 
      &match=1
    )
  )	  
  else if ("gcc_sata_pmalive_clk"=="&clk")
  (
    &match=1
  )
  
  if (&match==1)
  (
    &clk_test=&CLK_TEST_GCC_SATA_PMALIVE_CLK
    &clk_reg=&HWIO_GCC_SATA_PMALIVE_CBCR_ADDR
    &clk_reg_name="GCC_SATA_PMALIVE_CBCR"
    &clk_name="gcc_sata_pmalive_clk"
    &clk_reg_cbcr_type="sm_pscbc"

    gosub Print_Clk_Info_Line
  )
  
  &match=0
  &wild_head=0
  &wild_tail=0
  &clk_input_length=STRING.LENGTH("&clk")
  &clk_itr_length=STRING.LENGTH("gcc_sata_rx_clk")

  if (STRING.SCAN("&clk", "*", 0)==0)
  (
    &wild_head=1
  )
  if (STRING.SCAN("&clk", "*", 1)==(STRING.LENGTH("&clk")-1))
  (
    &wild_tail=1
  )

  if ((&wild_head==1)&&(&wild_tail==1))
  (
    if (STRING.SCAN("gcc_sata_rx_clk", STRING.MID("&clk", 1, &clk_input_length-2), 0)!=-1)
    ( 
      &match=1
    )
  )
  else if (&wild_head==1)
  (
    if (STRING.MID("gcc_sata_rx_clk", &clk_itr_length-&clk_input_length+1, &clk_input_length-1)==STRING.CUT("&clk", 1))
    ( 
      &match=1
    )
  )
  else if (&wild_tail==1)
  (
    if (STRING.MID("gcc_sata_rx_clk", 0, &clk_input_length-1)==STRING.CUT("&clk", -1))
    ( 
      &match=1
    )
  )	  
  else if ("gcc_sata_rx_clk"=="&clk")
  (
    &match=1
  )
  
  if (&match==1)
  (
    &clk_test=&CLK_TEST_GCC_SATA_RX_CLK
    &clk_reg=&HWIO_GCC_SATA_RX_CBCR_ADDR
    &clk_reg_name="GCC_SATA_RX_CBCR"
    &clk_name="gcc_sata_rx_clk"
    &clk_reg_cbcr_type="sm_cbc"

    gosub Print_Clk_Info_Line
  )
  
  &match=0
  &wild_head=0
  &wild_tail=0
  &clk_input_length=STRING.LENGTH("&clk")
  &clk_itr_length=STRING.LENGTH("gcc_sata_rx_oob_clk")

  if (STRING.SCAN("&clk", "*", 0)==0)
  (
    &wild_head=1
  )
  if (STRING.SCAN("&clk", "*", 1)==(STRING.LENGTH("&clk")-1))
  (
    &wild_tail=1
  )

  if ((&wild_head==1)&&(&wild_tail==1))
  (
    if (STRING.SCAN("gcc_sata_rx_oob_clk", STRING.MID("&clk", 1, &clk_input_length-2), 0)!=-1)
    ( 
      &match=1
    )
  )
  else if (&wild_head==1)
  (
    if (STRING.MID("gcc_sata_rx_oob_clk", &clk_itr_length-&clk_input_length+1, &clk_input_length-1)==STRING.CUT("&clk", 1))
    ( 
      &match=1
    )
  )
  else if (&wild_tail==1)
  (
    if (STRING.MID("gcc_sata_rx_oob_clk", 0, &clk_input_length-1)==STRING.CUT("&clk", -1))
    ( 
      &match=1
    )
  )	  
  else if ("gcc_sata_rx_oob_clk"=="&clk")
  (
    &match=1
  )
  
  if (&match==1)
  (
    &clk_test=&CLK_TEST_GCC_SATA_RX_OOB_CLK
    &clk_reg=&HWIO_GCC_SATA_RX_OOB_CBCR_ADDR
    &clk_reg_name="GCC_SATA_RX_OOB_CBCR"
    &clk_name="gcc_sata_rx_oob_clk"
    &clk_reg_cbcr_type="sm_cbc"

    gosub Print_Clk_Info_Line
  )
  
  &match=0
  &wild_head=0
  &wild_tail=0
  &clk_input_length=STRING.LENGTH("&clk")
  &clk_itr_length=STRING.LENGTH("gcc_sdcc1_ahb_clk")

  if (STRING.SCAN("&clk", "*", 0)==0)
  (
    &wild_head=1
  )
  if (STRING.SCAN("&clk", "*", 1)==(STRING.LENGTH("&clk")-1))
  (
    &wild_tail=1
  )

  if ((&wild_head==1)&&(&wild_tail==1))
  (
    if (STRING.SCAN("gcc_sdcc1_ahb_clk", STRING.MID("&clk", 1, &clk_input_length-2), 0)!=-1)
    ( 
      &match=1
    )
  )
  else if (&wild_head==1)
  (
    if (STRING.MID("gcc_sdcc1_ahb_clk", &clk_itr_length-&clk_input_length+1, &clk_input_length-1)==STRING.CUT("&clk", 1))
    ( 
      &match=1
    )
  )
  else if (&wild_tail==1)
  (
    if (STRING.MID("gcc_sdcc1_ahb_clk", 0, &clk_input_length-1)==STRING.CUT("&clk", -1))
    ( 
      &match=1
    )
  )	  
  else if ("gcc_sdcc1_ahb_clk"=="&clk")
  (
    &match=1
  )
  
  if (&match==1)
  (
    &clk_test=&CLK_TEST_GCC_SDCC1_AHB_CLK
    &clk_reg=&HWIO_GCC_SDCC1_AHB_CBCR_ADDR
    &clk_reg_name="GCC_SDCC1_AHB_CBCR"
    &clk_name="gcc_sdcc1_ahb_clk"
    &clk_reg_cbcr_type="sm_pscbc"

    gosub Print_Clk_Info_Line
  )
  
  &match=0
  &wild_head=0
  &wild_tail=0
  &clk_input_length=STRING.LENGTH("&clk")
  &clk_itr_length=STRING.LENGTH("gcc_sdcc1_apps_clk")

  if (STRING.SCAN("&clk", "*", 0)==0)
  (
    &wild_head=1
  )
  if (STRING.SCAN("&clk", "*", 1)==(STRING.LENGTH("&clk")-1))
  (
    &wild_tail=1
  )

  if ((&wild_head==1)&&(&wild_tail==1))
  (
    if (STRING.SCAN("gcc_sdcc1_apps_clk", STRING.MID("&clk", 1, &clk_input_length-2), 0)!=-1)
    ( 
      &match=1
    )
  )
  else if (&wild_head==1)
  (
    if (STRING.MID("gcc_sdcc1_apps_clk", &clk_itr_length-&clk_input_length+1, &clk_input_length-1)==STRING.CUT("&clk", 1))
    ( 
      &match=1
    )
  )
  else if (&wild_tail==1)
  (
    if (STRING.MID("gcc_sdcc1_apps_clk", 0, &clk_input_length-1)==STRING.CUT("&clk", -1))
    ( 
      &match=1
    )
  )	  
  else if ("gcc_sdcc1_apps_clk"=="&clk")
  (
    &match=1
  )
  
  if (&match==1)
  (
    &clk_test=&CLK_TEST_GCC_SDCC1_APPS_CLK
    &clk_reg=&HWIO_GCC_SDCC1_APPS_CBCR_ADDR
    &clk_reg_name="GCC_SDCC1_APPS_CBCR"
    &clk_name="gcc_sdcc1_apps_clk"
    &clk_reg_cbcr_type="sm_pscbc"

    gosub Print_Clk_Info_Line
  )
  
  &match=0
  &wild_head=0
  &wild_tail=0
  &clk_input_length=STRING.LENGTH("&clk")
  &clk_itr_length=STRING.LENGTH("gcc_sdcc1_cdccal_ff_clk")

  if (STRING.SCAN("&clk", "*", 0)==0)
  (
    &wild_head=1
  )
  if (STRING.SCAN("&clk", "*", 1)==(STRING.LENGTH("&clk")-1))
  (
    &wild_tail=1
  )

  if ((&wild_head==1)&&(&wild_tail==1))
  (
    if (STRING.SCAN("gcc_sdcc1_cdccal_ff_clk", STRING.MID("&clk", 1, &clk_input_length-2), 0)!=-1)
    ( 
      &match=1
    )
  )
  else if (&wild_head==1)
  (
    if (STRING.MID("gcc_sdcc1_cdccal_ff_clk", &clk_itr_length-&clk_input_length+1, &clk_input_length-1)==STRING.CUT("&clk", 1))
    ( 
      &match=1
    )
  )
  else if (&wild_tail==1)
  (
    if (STRING.MID("gcc_sdcc1_cdccal_ff_clk", 0, &clk_input_length-1)==STRING.CUT("&clk", -1))
    ( 
      &match=1
    )
  )	  
  else if ("gcc_sdcc1_cdccal_ff_clk"=="&clk")
  (
    &match=1
  )
  
  if (&match==1)
  (
    &clk_test=&CLK_TEST_GCC_SDCC1_CDCCAL_FF_CLK
    &clk_reg=&HWIO_GCC_SDCC1_CDCCAL_FF_CBCR_ADDR
    &clk_reg_name="GCC_SDCC1_CDCCAL_FF_CBCR"
    &clk_name="gcc_sdcc1_cdccal_ff_clk"
    &clk_reg_cbcr_type="sm_cbc"

    gosub Print_Clk_Info_Line
  )
  
  &match=0
  &wild_head=0
  &wild_tail=0
  &clk_input_length=STRING.LENGTH("&clk")
  &clk_itr_length=STRING.LENGTH("gcc_sdcc1_cdccal_sleep_clk")

  if (STRING.SCAN("&clk", "*", 0)==0)
  (
    &wild_head=1
  )
  if (STRING.SCAN("&clk", "*", 1)==(STRING.LENGTH("&clk")-1))
  (
    &wild_tail=1
  )

  if ((&wild_head==1)&&(&wild_tail==1))
  (
    if (STRING.SCAN("gcc_sdcc1_cdccal_sleep_clk", STRING.MID("&clk", 1, &clk_input_length-2), 0)!=-1)
    ( 
      &match=1
    )
  )
  else if (&wild_head==1)
  (
    if (STRING.MID("gcc_sdcc1_cdccal_sleep_clk", &clk_itr_length-&clk_input_length+1, &clk_input_length-1)==STRING.CUT("&clk", 1))
    ( 
      &match=1
    )
  )
  else if (&wild_tail==1)
  (
    if (STRING.MID("gcc_sdcc1_cdccal_sleep_clk", 0, &clk_input_length-1)==STRING.CUT("&clk", -1))
    ( 
      &match=1
    )
  )	  
  else if ("gcc_sdcc1_cdccal_sleep_clk"=="&clk")
  (
    &match=1
  )
  
  if (&match==1)
  (
    &clk_test=&CLK_TEST_GCC_SDCC1_CDCCAL_SLEEP_CLK
    &clk_reg=&HWIO_GCC_SDCC1_CDCCAL_SLEEP_CBCR_ADDR
    &clk_reg_name="GCC_SDCC1_CDCCAL_SLEEP_CBCR"
    &clk_name="gcc_sdcc1_cdccal_sleep_clk"
    &clk_reg_cbcr_type="sm_cbc"

    gosub Print_Clk_Info_Line
  )
  
  &match=0
  &wild_head=0
  &wild_tail=0
  &clk_input_length=STRING.LENGTH("&clk")
  &clk_itr_length=STRING.LENGTH("gcc_sdcc2_ahb_clk")

  if (STRING.SCAN("&clk", "*", 0)==0)
  (
    &wild_head=1
  )
  if (STRING.SCAN("&clk", "*", 1)==(STRING.LENGTH("&clk")-1))
  (
    &wild_tail=1
  )

  if ((&wild_head==1)&&(&wild_tail==1))
  (
    if (STRING.SCAN("gcc_sdcc2_ahb_clk", STRING.MID("&clk", 1, &clk_input_length-2), 0)!=-1)
    ( 
      &match=1
    )
  )
  else if (&wild_head==1)
  (
    if (STRING.MID("gcc_sdcc2_ahb_clk", &clk_itr_length-&clk_input_length+1, &clk_input_length-1)==STRING.CUT("&clk", 1))
    ( 
      &match=1
    )
  )
  else if (&wild_tail==1)
  (
    if (STRING.MID("gcc_sdcc2_ahb_clk", 0, &clk_input_length-1)==STRING.CUT("&clk", -1))
    ( 
      &match=1
    )
  )	  
  else if ("gcc_sdcc2_ahb_clk"=="&clk")
  (
    &match=1
  )
  
  if (&match==1)
  (
    &clk_test=&CLK_TEST_GCC_SDCC2_AHB_CLK
    &clk_reg=&HWIO_GCC_SDCC2_AHB_CBCR_ADDR
    &clk_reg_name="GCC_SDCC2_AHB_CBCR"
    &clk_name="gcc_sdcc2_ahb_clk"
    &clk_reg_cbcr_type="sm_pscbc"

    gosub Print_Clk_Info_Line
  )
  
  &match=0
  &wild_head=0
  &wild_tail=0
  &clk_input_length=STRING.LENGTH("&clk")
  &clk_itr_length=STRING.LENGTH("gcc_sdcc2_apps_clk")

  if (STRING.SCAN("&clk", "*", 0)==0)
  (
    &wild_head=1
  )
  if (STRING.SCAN("&clk", "*", 1)==(STRING.LENGTH("&clk")-1))
  (
    &wild_tail=1
  )

  if ((&wild_head==1)&&(&wild_tail==1))
  (
    if (STRING.SCAN("gcc_sdcc2_apps_clk", STRING.MID("&clk", 1, &clk_input_length-2), 0)!=-1)
    ( 
      &match=1
    )
  )
  else if (&wild_head==1)
  (
    if (STRING.MID("gcc_sdcc2_apps_clk", &clk_itr_length-&clk_input_length+1, &clk_input_length-1)==STRING.CUT("&clk", 1))
    ( 
      &match=1
    )
  )
  else if (&wild_tail==1)
  (
    if (STRING.MID("gcc_sdcc2_apps_clk", 0, &clk_input_length-1)==STRING.CUT("&clk", -1))
    ( 
      &match=1
    )
  )	  
  else if ("gcc_sdcc2_apps_clk"=="&clk")
  (
    &match=1
  )
  
  if (&match==1)
  (
    &clk_test=&CLK_TEST_GCC_SDCC2_APPS_CLK
    &clk_reg=&HWIO_GCC_SDCC2_APPS_CBCR_ADDR
    &clk_reg_name="GCC_SDCC2_APPS_CBCR"
    &clk_name="gcc_sdcc2_apps_clk"
    &clk_reg_cbcr_type="sm_pscbc"

    gosub Print_Clk_Info_Line
  )
  
  &match=0
  &wild_head=0
  &wild_tail=0
  &clk_input_length=STRING.LENGTH("&clk")
  &clk_itr_length=STRING.LENGTH("gcc_sdcc2_inactivity_timers_clk")

  if (STRING.SCAN("&clk", "*", 0)==0)
  (
    &wild_head=1
  )
  if (STRING.SCAN("&clk", "*", 1)==(STRING.LENGTH("&clk")-1))
  (
    &wild_tail=1
  )

  if ((&wild_head==1)&&(&wild_tail==1))
  (
    if (STRING.SCAN("gcc_sdcc2_inactivity_timers_clk", STRING.MID("&clk", 1, &clk_input_length-2), 0)!=-1)
    ( 
      &match=1
    )
  )
  else if (&wild_head==1)
  (
    if (STRING.MID("gcc_sdcc2_inactivity_timers_clk", &clk_itr_length-&clk_input_length+1, &clk_input_length-1)==STRING.CUT("&clk", 1))
    ( 
      &match=1
    )
  )
  else if (&wild_tail==1)
  (
    if (STRING.MID("gcc_sdcc2_inactivity_timers_clk", 0, &clk_input_length-1)==STRING.CUT("&clk", -1))
    ( 
      &match=1
    )
  )	  
  else if ("gcc_sdcc2_inactivity_timers_clk"=="&clk")
  (
    &match=1
  )
  
  if (&match==1)
  (
    &clk_test=&CLK_TEST_GCC_SDCC2_INACTIVITY_TIMERS_CLK
    &clk_reg=&HWIO_GCC_SDCC2_INACTIVITY_TIMERS_CBCR_ADDR
    &clk_reg_name="GCC_SDCC2_INACTIVITY_TIMERS_CBCR"
    &clk_name="gcc_sdcc2_inactivity_timers_clk"
    &clk_reg_cbcr_type="sm_cbc"

    gosub Print_Clk_Info_Line
  )
  
  &match=0
  &wild_head=0
  &wild_tail=0
  &clk_input_length=STRING.LENGTH("&clk")
  &clk_itr_length=STRING.LENGTH("gcc_sdcc3_ahb_clk")

  if (STRING.SCAN("&clk", "*", 0)==0)
  (
    &wild_head=1
  )
  if (STRING.SCAN("&clk", "*", 1)==(STRING.LENGTH("&clk")-1))
  (
    &wild_tail=1
  )

  if ((&wild_head==1)&&(&wild_tail==1))
  (
    if (STRING.SCAN("gcc_sdcc3_ahb_clk", STRING.MID("&clk", 1, &clk_input_length-2), 0)!=-1)
    ( 
      &match=1
    )
  )
  else if (&wild_head==1)
  (
    if (STRING.MID("gcc_sdcc3_ahb_clk", &clk_itr_length-&clk_input_length+1, &clk_input_length-1)==STRING.CUT("&clk", 1))
    ( 
      &match=1
    )
  )
  else if (&wild_tail==1)
  (
    if (STRING.MID("gcc_sdcc3_ahb_clk", 0, &clk_input_length-1)==STRING.CUT("&clk", -1))
    ( 
      &match=1
    )
  )	  
  else if ("gcc_sdcc3_ahb_clk"=="&clk")
  (
    &match=1
  )
  
  if (&match==1)
  (
    &clk_test=&CLK_TEST_GCC_SDCC3_AHB_CLK
    &clk_reg=&HWIO_GCC_SDCC3_AHB_CBCR_ADDR
    &clk_reg_name="GCC_SDCC3_AHB_CBCR"
    &clk_name="gcc_sdcc3_ahb_clk"
    &clk_reg_cbcr_type="sm_pscbc"

    gosub Print_Clk_Info_Line
  )
  
  &match=0
  &wild_head=0
  &wild_tail=0
  &clk_input_length=STRING.LENGTH("&clk")
  &clk_itr_length=STRING.LENGTH("gcc_sdcc3_apps_clk")

  if (STRING.SCAN("&clk", "*", 0)==0)
  (
    &wild_head=1
  )
  if (STRING.SCAN("&clk", "*", 1)==(STRING.LENGTH("&clk")-1))
  (
    &wild_tail=1
  )

  if ((&wild_head==1)&&(&wild_tail==1))
  (
    if (STRING.SCAN("gcc_sdcc3_apps_clk", STRING.MID("&clk", 1, &clk_input_length-2), 0)!=-1)
    ( 
      &match=1
    )
  )
  else if (&wild_head==1)
  (
    if (STRING.MID("gcc_sdcc3_apps_clk", &clk_itr_length-&clk_input_length+1, &clk_input_length-1)==STRING.CUT("&clk", 1))
    ( 
      &match=1
    )
  )
  else if (&wild_tail==1)
  (
    if (STRING.MID("gcc_sdcc3_apps_clk", 0, &clk_input_length-1)==STRING.CUT("&clk", -1))
    ( 
      &match=1
    )
  )	  
  else if ("gcc_sdcc3_apps_clk"=="&clk")
  (
    &match=1
  )
  
  if (&match==1)
  (
    &clk_test=&CLK_TEST_GCC_SDCC3_APPS_CLK
    &clk_reg=&HWIO_GCC_SDCC3_APPS_CBCR_ADDR
    &clk_reg_name="GCC_SDCC3_APPS_CBCR"
    &clk_name="gcc_sdcc3_apps_clk"
    &clk_reg_cbcr_type="sm_pscbc"

    gosub Print_Clk_Info_Line
  )
  
  &match=0
  &wild_head=0
  &wild_tail=0
  &clk_input_length=STRING.LENGTH("&clk")
  &clk_itr_length=STRING.LENGTH("gcc_sdcc3_inactivity_timers_clk")

  if (STRING.SCAN("&clk", "*", 0)==0)
  (
    &wild_head=1
  )
  if (STRING.SCAN("&clk", "*", 1)==(STRING.LENGTH("&clk")-1))
  (
    &wild_tail=1
  )

  if ((&wild_head==1)&&(&wild_tail==1))
  (
    if (STRING.SCAN("gcc_sdcc3_inactivity_timers_clk", STRING.MID("&clk", 1, &clk_input_length-2), 0)!=-1)
    ( 
      &match=1
    )
  )
  else if (&wild_head==1)
  (
    if (STRING.MID("gcc_sdcc3_inactivity_timers_clk", &clk_itr_length-&clk_input_length+1, &clk_input_length-1)==STRING.CUT("&clk", 1))
    ( 
      &match=1
    )
  )
  else if (&wild_tail==1)
  (
    if (STRING.MID("gcc_sdcc3_inactivity_timers_clk", 0, &clk_input_length-1)==STRING.CUT("&clk", -1))
    ( 
      &match=1
    )
  )	  
  else if ("gcc_sdcc3_inactivity_timers_clk"=="&clk")
  (
    &match=1
  )
  
  if (&match==1)
  (
    &clk_test=&CLK_TEST_GCC_SDCC3_INACTIVITY_TIMERS_CLK
    &clk_reg=&HWIO_GCC_SDCC3_INACTIVITY_TIMERS_CBCR_ADDR
    &clk_reg_name="GCC_SDCC3_INACTIVITY_TIMERS_CBCR"
    &clk_name="gcc_sdcc3_inactivity_timers_clk"
    &clk_reg_cbcr_type="sm_cbc"

    gosub Print_Clk_Info_Line
  )
  
  &match=0
  &wild_head=0
  &wild_tail=0
  &clk_input_length=STRING.LENGTH("&clk")
  &clk_itr_length=STRING.LENGTH("gcc_sdcc4_ahb_clk")

  if (STRING.SCAN("&clk", "*", 0)==0)
  (
    &wild_head=1
  )
  if (STRING.SCAN("&clk", "*", 1)==(STRING.LENGTH("&clk")-1))
  (
    &wild_tail=1
  )

  if ((&wild_head==1)&&(&wild_tail==1))
  (
    if (STRING.SCAN("gcc_sdcc4_ahb_clk", STRING.MID("&clk", 1, &clk_input_length-2), 0)!=-1)
    ( 
      &match=1
    )
  )
  else if (&wild_head==1)
  (
    if (STRING.MID("gcc_sdcc4_ahb_clk", &clk_itr_length-&clk_input_length+1, &clk_input_length-1)==STRING.CUT("&clk", 1))
    ( 
      &match=1
    )
  )
  else if (&wild_tail==1)
  (
    if (STRING.MID("gcc_sdcc4_ahb_clk", 0, &clk_input_length-1)==STRING.CUT("&clk", -1))
    ( 
      &match=1
    )
  )	  
  else if ("gcc_sdcc4_ahb_clk"=="&clk")
  (
    &match=1
  )
  
  if (&match==1)
  (
    &clk_test=&CLK_TEST_GCC_SDCC4_AHB_CLK
    &clk_reg=&HWIO_GCC_SDCC4_AHB_CBCR_ADDR
    &clk_reg_name="GCC_SDCC4_AHB_CBCR"
    &clk_name="gcc_sdcc4_ahb_clk"
    &clk_reg_cbcr_type="sm_pscbc"

    gosub Print_Clk_Info_Line
  )
  
  &match=0
  &wild_head=0
  &wild_tail=0
  &clk_input_length=STRING.LENGTH("&clk")
  &clk_itr_length=STRING.LENGTH("gcc_sdcc4_apps_clk")

  if (STRING.SCAN("&clk", "*", 0)==0)
  (
    &wild_head=1
  )
  if (STRING.SCAN("&clk", "*", 1)==(STRING.LENGTH("&clk")-1))
  (
    &wild_tail=1
  )

  if ((&wild_head==1)&&(&wild_tail==1))
  (
    if (STRING.SCAN("gcc_sdcc4_apps_clk", STRING.MID("&clk", 1, &clk_input_length-2), 0)!=-1)
    ( 
      &match=1
    )
  )
  else if (&wild_head==1)
  (
    if (STRING.MID("gcc_sdcc4_apps_clk", &clk_itr_length-&clk_input_length+1, &clk_input_length-1)==STRING.CUT("&clk", 1))
    ( 
      &match=1
    )
  )
  else if (&wild_tail==1)
  (
    if (STRING.MID("gcc_sdcc4_apps_clk", 0, &clk_input_length-1)==STRING.CUT("&clk", -1))
    ( 
      &match=1
    )
  )	  
  else if ("gcc_sdcc4_apps_clk"=="&clk")
  (
    &match=1
  )
  
  if (&match==1)
  (
    &clk_test=&CLK_TEST_GCC_SDCC4_APPS_CLK
    &clk_reg=&HWIO_GCC_SDCC4_APPS_CBCR_ADDR
    &clk_reg_name="GCC_SDCC4_APPS_CBCR"
    &clk_name="gcc_sdcc4_apps_clk"
    &clk_reg_cbcr_type="sm_pscbc"

    gosub Print_Clk_Info_Line
  )
  
  &match=0
  &wild_head=0
  &wild_tail=0
  &clk_input_length=STRING.LENGTH("&clk")
  &clk_itr_length=STRING.LENGTH("gcc_sdcc4_inactivity_timers_clk")

  if (STRING.SCAN("&clk", "*", 0)==0)
  (
    &wild_head=1
  )
  if (STRING.SCAN("&clk", "*", 1)==(STRING.LENGTH("&clk")-1))
  (
    &wild_tail=1
  )

  if ((&wild_head==1)&&(&wild_tail==1))
  (
    if (STRING.SCAN("gcc_sdcc4_inactivity_timers_clk", STRING.MID("&clk", 1, &clk_input_length-2), 0)!=-1)
    ( 
      &match=1
    )
  )
  else if (&wild_head==1)
  (
    if (STRING.MID("gcc_sdcc4_inactivity_timers_clk", &clk_itr_length-&clk_input_length+1, &clk_input_length-1)==STRING.CUT("&clk", 1))
    ( 
      &match=1
    )
  )
  else if (&wild_tail==1)
  (
    if (STRING.MID("gcc_sdcc4_inactivity_timers_clk", 0, &clk_input_length-1)==STRING.CUT("&clk", -1))
    ( 
      &match=1
    )
  )	  
  else if ("gcc_sdcc4_inactivity_timers_clk"=="&clk")
  (
    &match=1
  )
  
  if (&match==1)
  (
    &clk_test=&CLK_TEST_GCC_SDCC4_INACTIVITY_TIMERS_CLK
    &clk_reg=&HWIO_GCC_SDCC4_INACTIVITY_TIMERS_CBCR_ADDR
    &clk_reg_name="GCC_SDCC4_INACTIVITY_TIMERS_CBCR"
    &clk_name="gcc_sdcc4_inactivity_timers_clk"
    &clk_reg_cbcr_type="sm_cbc"

    gosub Print_Clk_Info_Line
  )
  
  &match=0
  &wild_head=0
  &wild_tail=0
  &clk_input_length=STRING.LENGTH("&clk")
  &clk_itr_length=STRING.LENGTH("gcc_snoc_bus_timeout0_ahb_clk")

  if (STRING.SCAN("&clk", "*", 0)==0)
  (
    &wild_head=1
  )
  if (STRING.SCAN("&clk", "*", 1)==(STRING.LENGTH("&clk")-1))
  (
    &wild_tail=1
  )

  if ((&wild_head==1)&&(&wild_tail==1))
  (
    if (STRING.SCAN("gcc_snoc_bus_timeout0_ahb_clk", STRING.MID("&clk", 1, &clk_input_length-2), 0)!=-1)
    ( 
      &match=1
    )
  )
  else if (&wild_head==1)
  (
    if (STRING.MID("gcc_snoc_bus_timeout0_ahb_clk", &clk_itr_length-&clk_input_length+1, &clk_input_length-1)==STRING.CUT("&clk", 1))
    ( 
      &match=1
    )
  )
  else if (&wild_tail==1)
  (
    if (STRING.MID("gcc_snoc_bus_timeout0_ahb_clk", 0, &clk_input_length-1)==STRING.CUT("&clk", -1))
    ( 
      &match=1
    )
  )	  
  else if ("gcc_snoc_bus_timeout0_ahb_clk"=="&clk")
  (
    &match=1
  )
  
  if (&match==1)
  (
    &clk_test=&CLK_TEST_GCC_SNOC_BUS_TIMEOUT0_AHB_CLK
    &clk_reg=&HWIO_GCC_SNOC_BUS_TIMEOUT0_AHB_CBCR_ADDR
    &clk_reg_name="GCC_SNOC_BUS_TIMEOUT0_AHB_CBCR"
    &clk_name="gcc_snoc_bus_timeout0_ahb_clk"
    &clk_reg_cbcr_type="sm_cbc"

    gosub Print_Clk_Info_Line
  )
  
  &match=0
  &wild_head=0
  &wild_tail=0
  &clk_input_length=STRING.LENGTH("&clk")
  &clk_itr_length=STRING.LENGTH("gcc_snoc_bus_timeout2_ahb_clk")

  if (STRING.SCAN("&clk", "*", 0)==0)
  (
    &wild_head=1
  )
  if (STRING.SCAN("&clk", "*", 1)==(STRING.LENGTH("&clk")-1))
  (
    &wild_tail=1
  )

  if ((&wild_head==1)&&(&wild_tail==1))
  (
    if (STRING.SCAN("gcc_snoc_bus_timeout2_ahb_clk", STRING.MID("&clk", 1, &clk_input_length-2), 0)!=-1)
    ( 
      &match=1
    )
  )
  else if (&wild_head==1)
  (
    if (STRING.MID("gcc_snoc_bus_timeout2_ahb_clk", &clk_itr_length-&clk_input_length+1, &clk_input_length-1)==STRING.CUT("&clk", 1))
    ( 
      &match=1
    )
  )
  else if (&wild_tail==1)
  (
    if (STRING.MID("gcc_snoc_bus_timeout2_ahb_clk", 0, &clk_input_length-1)==STRING.CUT("&clk", -1))
    ( 
      &match=1
    )
  )	  
  else if ("gcc_snoc_bus_timeout2_ahb_clk"=="&clk")
  (
    &match=1
  )
  
  if (&match==1)
  (
    &clk_test=&CLK_TEST_GCC_SNOC_BUS_TIMEOUT2_AHB_CLK
    &clk_reg=&HWIO_GCC_SNOC_BUS_TIMEOUT2_AHB_CBCR_ADDR
    &clk_reg_name="GCC_SNOC_BUS_TIMEOUT2_AHB_CBCR"
    &clk_name="gcc_snoc_bus_timeout2_ahb_clk"
    &clk_reg_cbcr_type="sm_cbc"

    gosub Print_Clk_Info_Line
  )
  
  &match=0
  &wild_head=0
  &wild_tail=0
  &clk_input_length=STRING.LENGTH("&clk")
  &clk_itr_length=STRING.LENGTH("gcc_snoc_bus_timeout3_ahb_clk")

  if (STRING.SCAN("&clk", "*", 0)==0)
  (
    &wild_head=1
  )
  if (STRING.SCAN("&clk", "*", 1)==(STRING.LENGTH("&clk")-1))
  (
    &wild_tail=1
  )

  if ((&wild_head==1)&&(&wild_tail==1))
  (
    if (STRING.SCAN("gcc_snoc_bus_timeout3_ahb_clk", STRING.MID("&clk", 1, &clk_input_length-2), 0)!=-1)
    ( 
      &match=1
    )
  )
  else if (&wild_head==1)
  (
    if (STRING.MID("gcc_snoc_bus_timeout3_ahb_clk", &clk_itr_length-&clk_input_length+1, &clk_input_length-1)==STRING.CUT("&clk", 1))
    ( 
      &match=1
    )
  )
  else if (&wild_tail==1)
  (
    if (STRING.MID("gcc_snoc_bus_timeout3_ahb_clk", 0, &clk_input_length-1)==STRING.CUT("&clk", -1))
    ( 
      &match=1
    )
  )	  
  else if ("gcc_snoc_bus_timeout3_ahb_clk"=="&clk")
  (
    &match=1
  )
  
  if (&match==1)
  (
    &clk_test=&CLK_TEST_GCC_SNOC_BUS_TIMEOUT3_AHB_CLK
    &clk_reg=&HWIO_GCC_SNOC_BUS_TIMEOUT3_AHB_CBCR_ADDR
    &clk_reg_name="GCC_SNOC_BUS_TIMEOUT3_AHB_CBCR"
    &clk_name="gcc_snoc_bus_timeout3_ahb_clk"
    &clk_reg_cbcr_type="sm_cbc"

    gosub Print_Clk_Info_Line
  )
  
  &match=0
  &wild_head=0
  &wild_tail=0
  &clk_input_length=STRING.LENGTH("&clk")
  &clk_itr_length=STRING.LENGTH("gcc_spdm_bimc_cy_clk")

  if (STRING.SCAN("&clk", "*", 0)==0)
  (
    &wild_head=1
  )
  if (STRING.SCAN("&clk", "*", 1)==(STRING.LENGTH("&clk")-1))
  (
    &wild_tail=1
  )

  if ((&wild_head==1)&&(&wild_tail==1))
  (
    if (STRING.SCAN("gcc_spdm_bimc_cy_clk", STRING.MID("&clk", 1, &clk_input_length-2), 0)!=-1)
    ( 
      &match=1
    )
  )
  else if (&wild_head==1)
  (
    if (STRING.MID("gcc_spdm_bimc_cy_clk", &clk_itr_length-&clk_input_length+1, &clk_input_length-1)==STRING.CUT("&clk", 1))
    ( 
      &match=1
    )
  )
  else if (&wild_tail==1)
  (
    if (STRING.MID("gcc_spdm_bimc_cy_clk", 0, &clk_input_length-1)==STRING.CUT("&clk", -1))
    ( 
      &match=1
    )
  )	  
  else if ("gcc_spdm_bimc_cy_clk"=="&clk")
  (
    &match=1
  )
  
  if (&match==1)
  (
    &clk_test=&CLK_TEST_GCC_SPDM_BIMC_CY_CLK
    &clk_reg=&HWIO_GCC_SPDM_BIMC_CY_CBCR_ADDR
    &clk_reg_name="GCC_SPDM_BIMC_CY_CBCR"
    &clk_name="gcc_spdm_bimc_cy_clk"
    &clk_reg_cbcr_type="sm_cbc"

    gosub Print_Clk_Info_Line
  )
  
  &match=0
  &wild_head=0
  &wild_tail=0
  &clk_input_length=STRING.LENGTH("&clk")
  &clk_itr_length=STRING.LENGTH("gcc_spdm_cfg_ahb_clk")

  if (STRING.SCAN("&clk", "*", 0)==0)
  (
    &wild_head=1
  )
  if (STRING.SCAN("&clk", "*", 1)==(STRING.LENGTH("&clk")-1))
  (
    &wild_tail=1
  )

  if ((&wild_head==1)&&(&wild_tail==1))
  (
    if (STRING.SCAN("gcc_spdm_cfg_ahb_clk", STRING.MID("&clk", 1, &clk_input_length-2), 0)!=-1)
    ( 
      &match=1
    )
  )
  else if (&wild_head==1)
  (
    if (STRING.MID("gcc_spdm_cfg_ahb_clk", &clk_itr_length-&clk_input_length+1, &clk_input_length-1)==STRING.CUT("&clk", 1))
    ( 
      &match=1
    )
  )
  else if (&wild_tail==1)
  (
    if (STRING.MID("gcc_spdm_cfg_ahb_clk", 0, &clk_input_length-1)==STRING.CUT("&clk", -1))
    ( 
      &match=1
    )
  )	  
  else if ("gcc_spdm_cfg_ahb_clk"=="&clk")
  (
    &match=1
  )
  
  if (&match==1)
  (
    &clk_test=&CLK_TEST_GCC_SPDM_CFG_AHB_CLK
    &clk_reg=&HWIO_GCC_SPDM_CFG_AHB_CBCR_ADDR
    &clk_reg_name="GCC_SPDM_CFG_AHB_CBCR"
    &clk_name="gcc_spdm_cfg_ahb_clk"
    &clk_reg_cbcr_type="sm_cbc"

    gosub Print_Clk_Info_Line
  )
  
  &match=0
  &wild_head=0
  &wild_tail=0
  &clk_input_length=STRING.LENGTH("&clk")
  &clk_itr_length=STRING.LENGTH("gcc_spdm_ff_clk")

  if (STRING.SCAN("&clk", "*", 0)==0)
  (
    &wild_head=1
  )
  if (STRING.SCAN("&clk", "*", 1)==(STRING.LENGTH("&clk")-1))
  (
    &wild_tail=1
  )

  if ((&wild_head==1)&&(&wild_tail==1))
  (
    if (STRING.SCAN("gcc_spdm_ff_clk", STRING.MID("&clk", 1, &clk_input_length-2), 0)!=-1)
    ( 
      &match=1
    )
  )
  else if (&wild_head==1)
  (
    if (STRING.MID("gcc_spdm_ff_clk", &clk_itr_length-&clk_input_length+1, &clk_input_length-1)==STRING.CUT("&clk", 1))
    ( 
      &match=1
    )
  )
  else if (&wild_tail==1)
  (
    if (STRING.MID("gcc_spdm_ff_clk", 0, &clk_input_length-1)==STRING.CUT("&clk", -1))
    ( 
      &match=1
    )
  )	  
  else if ("gcc_spdm_ff_clk"=="&clk")
  (
    &match=1
  )
  
  if (&match==1)
  (
    &clk_test=&CLK_TEST_GCC_SPDM_FF_CLK
    &clk_reg=&HWIO_GCC_SPDM_FF_CBCR_ADDR
    &clk_reg_name="GCC_SPDM_FF_CBCR"
    &clk_name="gcc_spdm_ff_clk"
    &clk_reg_cbcr_type="sm_cbc"

    gosub Print_Clk_Info_Line
  )
  
  &match=0
  &wild_head=0
  &wild_tail=0
  &clk_input_length=STRING.LENGTH("&clk")
  &clk_itr_length=STRING.LENGTH("gcc_spdm_mstr_ahb_clk")

  if (STRING.SCAN("&clk", "*", 0)==0)
  (
    &wild_head=1
  )
  if (STRING.SCAN("&clk", "*", 1)==(STRING.LENGTH("&clk")-1))
  (
    &wild_tail=1
  )

  if ((&wild_head==1)&&(&wild_tail==1))
  (
    if (STRING.SCAN("gcc_spdm_mstr_ahb_clk", STRING.MID("&clk", 1, &clk_input_length-2), 0)!=-1)
    ( 
      &match=1
    )
  )
  else if (&wild_head==1)
  (
    if (STRING.MID("gcc_spdm_mstr_ahb_clk", &clk_itr_length-&clk_input_length+1, &clk_input_length-1)==STRING.CUT("&clk", 1))
    ( 
      &match=1
    )
  )
  else if (&wild_tail==1)
  (
    if (STRING.MID("gcc_spdm_mstr_ahb_clk", 0, &clk_input_length-1)==STRING.CUT("&clk", -1))
    ( 
      &match=1
    )
  )	  
  else if ("gcc_spdm_mstr_ahb_clk"=="&clk")
  (
    &match=1
  )
  
  if (&match==1)
  (
    &clk_test=&CLK_TEST_GCC_SPDM_MSTR_AHB_CLK
    &clk_reg=&HWIO_GCC_SPDM_MSTR_AHB_CBCR_ADDR
    &clk_reg_name="GCC_SPDM_MSTR_AHB_CBCR"
    &clk_name="gcc_spdm_mstr_ahb_clk"
    &clk_reg_cbcr_type="sm_cbc"

    gosub Print_Clk_Info_Line
  )
  
  &match=0
  &wild_head=0
  &wild_tail=0
  &clk_input_length=STRING.LENGTH("&clk")
  &clk_itr_length=STRING.LENGTH("gcc_spdm_pnoc_cy_clk")

  if (STRING.SCAN("&clk", "*", 0)==0)
  (
    &wild_head=1
  )
  if (STRING.SCAN("&clk", "*", 1)==(STRING.LENGTH("&clk")-1))
  (
    &wild_tail=1
  )

  if ((&wild_head==1)&&(&wild_tail==1))
  (
    if (STRING.SCAN("gcc_spdm_pnoc_cy_clk", STRING.MID("&clk", 1, &clk_input_length-2), 0)!=-1)
    ( 
      &match=1
    )
  )
  else if (&wild_head==1)
  (
    if (STRING.MID("gcc_spdm_pnoc_cy_clk", &clk_itr_length-&clk_input_length+1, &clk_input_length-1)==STRING.CUT("&clk", 1))
    ( 
      &match=1
    )
  )
  else if (&wild_tail==1)
  (
    if (STRING.MID("gcc_spdm_pnoc_cy_clk", 0, &clk_input_length-1)==STRING.CUT("&clk", -1))
    ( 
      &match=1
    )
  )	  
  else if ("gcc_spdm_pnoc_cy_clk"=="&clk")
  (
    &match=1
  )
  
  if (&match==1)
  (
    &clk_test=&CLK_TEST_GCC_SPDM_PNOC_CY_CLK
    &clk_reg=&HWIO_GCC_SPDM_PNOC_CY_CBCR_ADDR
    &clk_reg_name="GCC_SPDM_PNOC_CY_CBCR"
    &clk_name="gcc_spdm_pnoc_cy_clk"
    &clk_reg_cbcr_type="sm_cbc"

    gosub Print_Clk_Info_Line
  )
  
  &match=0
  &wild_head=0
  &wild_tail=0
  &clk_input_length=STRING.LENGTH("&clk")
  &clk_itr_length=STRING.LENGTH("gcc_spdm_rpm_cy_clk")

  if (STRING.SCAN("&clk", "*", 0)==0)
  (
    &wild_head=1
  )
  if (STRING.SCAN("&clk", "*", 1)==(STRING.LENGTH("&clk")-1))
  (
    &wild_tail=1
  )

  if ((&wild_head==1)&&(&wild_tail==1))
  (
    if (STRING.SCAN("gcc_spdm_rpm_cy_clk", STRING.MID("&clk", 1, &clk_input_length-2), 0)!=-1)
    ( 
      &match=1
    )
  )
  else if (&wild_head==1)
  (
    if (STRING.MID("gcc_spdm_rpm_cy_clk", &clk_itr_length-&clk_input_length+1, &clk_input_length-1)==STRING.CUT("&clk", 1))
    ( 
      &match=1
    )
  )
  else if (&wild_tail==1)
  (
    if (STRING.MID("gcc_spdm_rpm_cy_clk", 0, &clk_input_length-1)==STRING.CUT("&clk", -1))
    ( 
      &match=1
    )
  )	  
  else if ("gcc_spdm_rpm_cy_clk"=="&clk")
  (
    &match=1
  )
  
  if (&match==1)
  (
    &clk_test=&CLK_TEST_GCC_SPDM_RPM_CY_CLK
    &clk_reg=&HWIO_GCC_SPDM_RPM_CY_CBCR_ADDR
    &clk_reg_name="GCC_SPDM_RPM_CY_CBCR"
    &clk_name="gcc_spdm_rpm_cy_clk"
    &clk_reg_cbcr_type="sm_cbc"

    gosub Print_Clk_Info_Line
  )
  
  &match=0
  &wild_head=0
  &wild_tail=0
  &clk_input_length=STRING.LENGTH("&clk")
  &clk_itr_length=STRING.LENGTH("gcc_spdm_snoc_cy_clk")

  if (STRING.SCAN("&clk", "*", 0)==0)
  (
    &wild_head=1
  )
  if (STRING.SCAN("&clk", "*", 1)==(STRING.LENGTH("&clk")-1))
  (
    &wild_tail=1
  )

  if ((&wild_head==1)&&(&wild_tail==1))
  (
    if (STRING.SCAN("gcc_spdm_snoc_cy_clk", STRING.MID("&clk", 1, &clk_input_length-2), 0)!=-1)
    ( 
      &match=1
    )
  )
  else if (&wild_head==1)
  (
    if (STRING.MID("gcc_spdm_snoc_cy_clk", &clk_itr_length-&clk_input_length+1, &clk_input_length-1)==STRING.CUT("&clk", 1))
    ( 
      &match=1
    )
  )
  else if (&wild_tail==1)
  (
    if (STRING.MID("gcc_spdm_snoc_cy_clk", 0, &clk_input_length-1)==STRING.CUT("&clk", -1))
    ( 
      &match=1
    )
  )	  
  else if ("gcc_spdm_snoc_cy_clk"=="&clk")
  (
    &match=1
  )
  
  if (&match==1)
  (
    &clk_test=&CLK_TEST_GCC_SPDM_SNOC_CY_CLK
    &clk_reg=&HWIO_GCC_SPDM_SNOC_CY_CBCR_ADDR
    &clk_reg_name="GCC_SPDM_SNOC_CY_CBCR"
    &clk_name="gcc_spdm_snoc_cy_clk"
    &clk_reg_cbcr_type="sm_cbc"

    gosub Print_Clk_Info_Line
  )
  
  &match=0
  &wild_head=0
  &wild_tail=0
  &clk_input_length=STRING.LENGTH("&clk")
  &clk_itr_length=STRING.LENGTH("gcc_spmi_ahb_clk")

  if (STRING.SCAN("&clk", "*", 0)==0)
  (
    &wild_head=1
  )
  if (STRING.SCAN("&clk", "*", 1)==(STRING.LENGTH("&clk")-1))
  (
    &wild_tail=1
  )

  if ((&wild_head==1)&&(&wild_tail==1))
  (
    if (STRING.SCAN("gcc_spmi_ahb_clk", STRING.MID("&clk", 1, &clk_input_length-2), 0)!=-1)
    ( 
      &match=1
    )
  )
  else if (&wild_head==1)
  (
    if (STRING.MID("gcc_spmi_ahb_clk", &clk_itr_length-&clk_input_length+1, &clk_input_length-1)==STRING.CUT("&clk", 1))
    ( 
      &match=1
    )
  )
  else if (&wild_tail==1)
  (
    if (STRING.MID("gcc_spmi_ahb_clk", 0, &clk_input_length-1)==STRING.CUT("&clk", -1))
    ( 
      &match=1
    )
  )	  
  else if ("gcc_spmi_ahb_clk"=="&clk")
  (
    &match=1
  )
  
  if (&match==1)
  (
    &clk_test=&CLK_TEST_GCC_SPMI_AHB_CLK
    &clk_reg=&HWIO_GCC_SPMI_AHB_CBCR_ADDR
    &clk_reg_name="GCC_SPMI_AHB_CBCR"
    &clk_name="gcc_spmi_ahb_clk"
    &clk_reg_cbcr_type="sm_pscbc"

    gosub Print_Clk_Info_Line
  )
  
  &match=0
  &wild_head=0
  &wild_tail=0
  &clk_input_length=STRING.LENGTH("&clk")
  &clk_itr_length=STRING.LENGTH("gcc_spmi_cnoc_ahb_clk")

  if (STRING.SCAN("&clk", "*", 0)==0)
  (
    &wild_head=1
  )
  if (STRING.SCAN("&clk", "*", 1)==(STRING.LENGTH("&clk")-1))
  (
    &wild_tail=1
  )

  if ((&wild_head==1)&&(&wild_tail==1))
  (
    if (STRING.SCAN("gcc_spmi_cnoc_ahb_clk", STRING.MID("&clk", 1, &clk_input_length-2), 0)!=-1)
    ( 
      &match=1
    )
  )
  else if (&wild_head==1)
  (
    if (STRING.MID("gcc_spmi_cnoc_ahb_clk", &clk_itr_length-&clk_input_length+1, &clk_input_length-1)==STRING.CUT("&clk", 1))
    ( 
      &match=1
    )
  )
  else if (&wild_tail==1)
  (
    if (STRING.MID("gcc_spmi_cnoc_ahb_clk", 0, &clk_input_length-1)==STRING.CUT("&clk", -1))
    ( 
      &match=1
    )
  )	  
  else if ("gcc_spmi_cnoc_ahb_clk"=="&clk")
  (
    &match=1
  )
  
  if (&match==1)
  (
    &clk_test=&CLK_TEST_GCC_SPMI_CNOC_AHB_CLK
    &clk_reg=&HWIO_GCC_SPMI_CNOC_AHB_CBCR_ADDR
    &clk_reg_name="GCC_SPMI_CNOC_AHB_CBCR"
    &clk_name="gcc_spmi_cnoc_ahb_clk"
    &clk_reg_cbcr_type="sm_cbc"

    gosub Print_Clk_Info_Line
  )
  
  &match=0
  &wild_head=0
  &wild_tail=0
  &clk_input_length=STRING.LENGTH("&clk")
  &clk_itr_length=STRING.LENGTH("gcc_spmi_ser_clk")

  if (STRING.SCAN("&clk", "*", 0)==0)
  (
    &wild_head=1
  )
  if (STRING.SCAN("&clk", "*", 1)==(STRING.LENGTH("&clk")-1))
  (
    &wild_tail=1
  )

  if ((&wild_head==1)&&(&wild_tail==1))
  (
    if (STRING.SCAN("gcc_spmi_ser_clk", STRING.MID("&clk", 1, &clk_input_length-2), 0)!=-1)
    ( 
      &match=1
    )
  )
  else if (&wild_head==1)
  (
    if (STRING.MID("gcc_spmi_ser_clk", &clk_itr_length-&clk_input_length+1, &clk_input_length-1)==STRING.CUT("&clk", 1))
    ( 
      &match=1
    )
  )
  else if (&wild_tail==1)
  (
    if (STRING.MID("gcc_spmi_ser_clk", 0, &clk_input_length-1)==STRING.CUT("&clk", -1))
    ( 
      &match=1
    )
  )	  
  else if ("gcc_spmi_ser_clk"=="&clk")
  (
    &match=1
  )
  
  if (&match==1)
  (
    &clk_test=&CLK_TEST_GCC_SPMI_SER_CLK
    &clk_reg=&HWIO_GCC_SPMI_SER_CBCR_ADDR
    &clk_reg_name="GCC_SPMI_SER_CBCR"
    &clk_name="gcc_spmi_ser_clk"
    &clk_reg_cbcr_type="sm_pscbc"

    gosub Print_Clk_Info_Line
  )
  
  &match=0
  &wild_head=0
  &wild_tail=0
  &clk_input_length=STRING.LENGTH("&clk")
  &clk_itr_length=STRING.LENGTH("gcc_spss_ahb_clk")

  if (STRING.SCAN("&clk", "*", 0)==0)
  (
    &wild_head=1
  )
  if (STRING.SCAN("&clk", "*", 1)==(STRING.LENGTH("&clk")-1))
  (
    &wild_tail=1
  )

  if ((&wild_head==1)&&(&wild_tail==1))
  (
    if (STRING.SCAN("gcc_spss_ahb_clk", STRING.MID("&clk", 1, &clk_input_length-2), 0)!=-1)
    ( 
      &match=1
    )
  )
  else if (&wild_head==1)
  (
    if (STRING.MID("gcc_spss_ahb_clk", &clk_itr_length-&clk_input_length+1, &clk_input_length-1)==STRING.CUT("&clk", 1))
    ( 
      &match=1
    )
  )
  else if (&wild_tail==1)
  (
    if (STRING.MID("gcc_spss_ahb_clk", 0, &clk_input_length-1)==STRING.CUT("&clk", -1))
    ( 
      &match=1
    )
  )	  
  else if ("gcc_spss_ahb_clk"=="&clk")
  (
    &match=1
  )
  
  if (&match==1)
  (
    &clk_test=&CLK_TEST_GCC_SPSS_AHB_CLK
    &clk_reg=&HWIO_GCC_SPSS_AHB_CBCR_ADDR
    &clk_reg_name="GCC_SPSS_AHB_CBCR"
    &clk_name="gcc_spss_ahb_clk"
    &clk_reg_cbcr_type="sm_cbc"

    gosub Print_Clk_Info_Line
  )
  
  &match=0
  &wild_head=0
  &wild_tail=0
  &clk_input_length=STRING.LENGTH("&clk")
  &clk_itr_length=STRING.LENGTH("spss_gcc_dbg_clk")

  if (STRING.SCAN("&clk", "*", 0)==0)
  (
    &wild_head=1
  )
  if (STRING.SCAN("&clk", "*", 1)==(STRING.LENGTH("&clk")-1))
  (
    &wild_tail=1
  )

  if ((&wild_head==1)&&(&wild_tail==1))
  (
    if (STRING.SCAN("spss_gcc_dbg_clk", STRING.MID("&clk", 1, &clk_input_length-2), 0)!=-1)
    ( 
      &match=1
    )
  )
  else if (&wild_head==1)
  (
    if (STRING.MID("spss_gcc_dbg_clk", &clk_itr_length-&clk_input_length+1, &clk_input_length-1)==STRING.CUT("&clk", 1))
    ( 
      &match=1
    )
  )
  else if (&wild_tail==1)
  (
    if (STRING.MID("spss_gcc_dbg_clk", 0, &clk_input_length-1)==STRING.CUT("&clk", -1))
    ( 
      &match=1
    )
  )	  
  else if ("spss_gcc_dbg_clk"=="&clk")
  (
    &match=1
  )
  
  if (&match==1)
  (
    &clk_test=&CLK_TEST_SPSS_GCC_DBG_CLK
    &clk_reg=0
    &clk_reg_name="No CBCR"
    &clk_name="spss_gcc_dbg_clk"
    &clk_reg_cbcr_type=""

    gosub Print_Clk_Info_Line
  )
  
  &match=0
  &wild_head=0
  &wild_tail=0
  &clk_input_length=STRING.LENGTH("&clk")
  &clk_itr_length=STRING.LENGTH("gcc_sec_ctrl_acc_clk")

  if (STRING.SCAN("&clk", "*", 0)==0)
  (
    &wild_head=1
  )
  if (STRING.SCAN("&clk", "*", 1)==(STRING.LENGTH("&clk")-1))
  (
    &wild_tail=1
  )

  if ((&wild_head==1)&&(&wild_tail==1))
  (
    if (STRING.SCAN("gcc_sec_ctrl_acc_clk", STRING.MID("&clk", 1, &clk_input_length-2), 0)!=-1)
    ( 
      &match=1
    )
  )
  else if (&wild_head==1)
  (
    if (STRING.MID("gcc_sec_ctrl_acc_clk", &clk_itr_length-&clk_input_length+1, &clk_input_length-1)==STRING.CUT("&clk", 1))
    ( 
      &match=1
    )
  )
  else if (&wild_tail==1)
  (
    if (STRING.MID("gcc_sec_ctrl_acc_clk", 0, &clk_input_length-1)==STRING.CUT("&clk", -1))
    ( 
      &match=1
    )
  )	  
  else if ("gcc_sec_ctrl_acc_clk"=="&clk")
  (
    &match=1
  )
  
  if (&match==1)
  (
    &clk_test=&CLK_TEST_GCC_SEC_CTRL_ACC_CLK
    &clk_reg=&HWIO_GCC_SEC_CTRL_ACC_CBCR_ADDR
    &clk_reg_name="GCC_SEC_CTRL_ACC_CBCR"
    &clk_name="gcc_sec_ctrl_acc_clk"
    &clk_reg_cbcr_type="sm_pscbc"

    gosub Print_Clk_Info_Line
  )
  
  &match=0
  &wild_head=0
  &wild_tail=0
  &clk_input_length=STRING.LENGTH("&clk")
  &clk_itr_length=STRING.LENGTH("gcc_sec_ctrl_ahb_clk")

  if (STRING.SCAN("&clk", "*", 0)==0)
  (
    &wild_head=1
  )
  if (STRING.SCAN("&clk", "*", 1)==(STRING.LENGTH("&clk")-1))
  (
    &wild_tail=1
  )

  if ((&wild_head==1)&&(&wild_tail==1))
  (
    if (STRING.SCAN("gcc_sec_ctrl_ahb_clk", STRING.MID("&clk", 1, &clk_input_length-2), 0)!=-1)
    ( 
      &match=1
    )
  )
  else if (&wild_head==1)
  (
    if (STRING.MID("gcc_sec_ctrl_ahb_clk", &clk_itr_length-&clk_input_length+1, &clk_input_length-1)==STRING.CUT("&clk", 1))
    ( 
      &match=1
    )
  )
  else if (&wild_tail==1)
  (
    if (STRING.MID("gcc_sec_ctrl_ahb_clk", 0, &clk_input_length-1)==STRING.CUT("&clk", -1))
    ( 
      &match=1
    )
  )	  
  else if ("gcc_sec_ctrl_ahb_clk"=="&clk")
  (
    &match=1
  )
  
  if (&match==1)
  (
    &clk_test=&CLK_TEST_GCC_SEC_CTRL_AHB_CLK
    &clk_reg=&HWIO_GCC_SEC_CTRL_AHB_CBCR_ADDR
    &clk_reg_name="GCC_SEC_CTRL_AHB_CBCR"
    &clk_name="gcc_sec_ctrl_ahb_clk"
    &clk_reg_cbcr_type="sm_cbc"

    gosub Print_Clk_Info_Line
  )
  
  &match=0
  &wild_head=0
  &wild_tail=0
  &clk_input_length=STRING.LENGTH("&clk")
  &clk_itr_length=STRING.LENGTH("gcc_sec_ctrl_boot_rom_patch_clk")

  if (STRING.SCAN("&clk", "*", 0)==0)
  (
    &wild_head=1
  )
  if (STRING.SCAN("&clk", "*", 1)==(STRING.LENGTH("&clk")-1))
  (
    &wild_tail=1
  )

  if ((&wild_head==1)&&(&wild_tail==1))
  (
    if (STRING.SCAN("gcc_sec_ctrl_boot_rom_patch_clk", STRING.MID("&clk", 1, &clk_input_length-2), 0)!=-1)
    ( 
      &match=1
    )
  )
  else if (&wild_head==1)
  (
    if (STRING.MID("gcc_sec_ctrl_boot_rom_patch_clk", &clk_itr_length-&clk_input_length+1, &clk_input_length-1)==STRING.CUT("&clk", 1))
    ( 
      &match=1
    )
  )
  else if (&wild_tail==1)
  (
    if (STRING.MID("gcc_sec_ctrl_boot_rom_patch_clk", 0, &clk_input_length-1)==STRING.CUT("&clk", -1))
    ( 
      &match=1
    )
  )	  
  else if ("gcc_sec_ctrl_boot_rom_patch_clk"=="&clk")
  (
    &match=1
  )
  
  if (&match==1)
  (
    &clk_test=&CLK_TEST_GCC_SEC_CTRL_BOOT_ROM_PATCH_CLK
    &clk_reg=&HWIO_GCC_SEC_CTRL_BOOT_ROM_PATCH_CBCR_ADDR
    &clk_reg_name="GCC_SEC_CTRL_BOOT_ROM_PATCH_CBCR"
    &clk_name="gcc_sec_ctrl_boot_rom_patch_clk"
    &clk_reg_cbcr_type="sm_cbc"

    gosub Print_Clk_Info_Line
  )
  
  &match=0
  &wild_head=0
  &wild_tail=0
  &clk_input_length=STRING.LENGTH("&clk")
  &clk_itr_length=STRING.LENGTH("gcc_sec_ctrl_clk")

  if (STRING.SCAN("&clk", "*", 0)==0)
  (
    &wild_head=1
  )
  if (STRING.SCAN("&clk", "*", 1)==(STRING.LENGTH("&clk")-1))
  (
    &wild_tail=1
  )

  if ((&wild_head==1)&&(&wild_tail==1))
  (
    if (STRING.SCAN("gcc_sec_ctrl_clk", STRING.MID("&clk", 1, &clk_input_length-2), 0)!=-1)
    ( 
      &match=1
    )
  )
  else if (&wild_head==1)
  (
    if (STRING.MID("gcc_sec_ctrl_clk", &clk_itr_length-&clk_input_length+1, &clk_input_length-1)==STRING.CUT("&clk", 1))
    ( 
      &match=1
    )
  )
  else if (&wild_tail==1)
  (
    if (STRING.MID("gcc_sec_ctrl_clk", 0, &clk_input_length-1)==STRING.CUT("&clk", -1))
    ( 
      &match=1
    )
  )	  
  else if ("gcc_sec_ctrl_clk"=="&clk")
  (
    &match=1
  )
  
  if (&match==1)
  (
    &clk_test=&CLK_TEST_GCC_SEC_CTRL_CLK
    &clk_reg=&HWIO_GCC_SEC_CTRL_CBCR_ADDR
    &clk_reg_name="GCC_SEC_CTRL_CBCR"
    &clk_name="gcc_sec_ctrl_clk"
    &clk_reg_cbcr_type="sm_pscbc"

    gosub Print_Clk_Info_Line
  )
  
  &match=0
  &wild_head=0
  &wild_tail=0
  &clk_input_length=STRING.LENGTH("&clk")
  &clk_itr_length=STRING.LENGTH("gcc_sec_ctrl_sense_clk")

  if (STRING.SCAN("&clk", "*", 0)==0)
  (
    &wild_head=1
  )
  if (STRING.SCAN("&clk", "*", 1)==(STRING.LENGTH("&clk")-1))
  (
    &wild_tail=1
  )

  if ((&wild_head==1)&&(&wild_tail==1))
  (
    if (STRING.SCAN("gcc_sec_ctrl_sense_clk", STRING.MID("&clk", 1, &clk_input_length-2), 0)!=-1)
    ( 
      &match=1
    )
  )
  else if (&wild_head==1)
  (
    if (STRING.MID("gcc_sec_ctrl_sense_clk", &clk_itr_length-&clk_input_length+1, &clk_input_length-1)==STRING.CUT("&clk", 1))
    ( 
      &match=1
    )
  )
  else if (&wild_tail==1)
  (
    if (STRING.MID("gcc_sec_ctrl_sense_clk", 0, &clk_input_length-1)==STRING.CUT("&clk", -1))
    ( 
      &match=1
    )
  )	  
  else if ("gcc_sec_ctrl_sense_clk"=="&clk")
  (
    &match=1
  )
  
  if (&match==1)
  (
    &clk_test=&CLK_TEST_GCC_SEC_CTRL_SENSE_CLK
    &clk_reg=&HWIO_GCC_SEC_CTRL_SENSE_CBCR_ADDR
    &clk_reg_name="GCC_SEC_CTRL_SENSE_CBCR"
    &clk_name="gcc_sec_ctrl_sense_clk"
    &clk_reg_cbcr_type="sm_cbc"

    gosub Print_Clk_Info_Line
  )
  
  &match=0
  &wild_head=0
  &wild_tail=0
  &clk_input_length=STRING.LENGTH("&clk")
  &clk_itr_length=STRING.LENGTH("gcc_snoc_cnoc_ahb_clk")

  if (STRING.SCAN("&clk", "*", 0)==0)
  (
    &wild_head=1
  )
  if (STRING.SCAN("&clk", "*", 1)==(STRING.LENGTH("&clk")-1))
  (
    &wild_tail=1
  )

  if ((&wild_head==1)&&(&wild_tail==1))
  (
    if (STRING.SCAN("gcc_snoc_cnoc_ahb_clk", STRING.MID("&clk", 1, &clk_input_length-2), 0)!=-1)
    ( 
      &match=1
    )
  )
  else if (&wild_head==1)
  (
    if (STRING.MID("gcc_snoc_cnoc_ahb_clk", &clk_itr_length-&clk_input_length+1, &clk_input_length-1)==STRING.CUT("&clk", 1))
    ( 
      &match=1
    )
  )
  else if (&wild_tail==1)
  (
    if (STRING.MID("gcc_snoc_cnoc_ahb_clk", 0, &clk_input_length-1)==STRING.CUT("&clk", -1))
    ( 
      &match=1
    )
  )	  
  else if ("gcc_snoc_cnoc_ahb_clk"=="&clk")
  (
    &match=1
  )
  
  if (&match==1)
  (
    &clk_test=&CLK_TEST_GCC_SNOC_CNOC_AHB_CLK
    &clk_reg=&HWIO_GCC_SNOC_CNOC_AHB_CBCR_ADDR
    &clk_reg_name="GCC_SNOC_CNOC_AHB_CBCR"
    &clk_name="gcc_snoc_cnoc_ahb_clk"
    &clk_reg_cbcr_type="sm_cbc"

    gosub Print_Clk_Info_Line
  )
  
  &match=0
  &wild_head=0
  &wild_tail=0
  &clk_input_length=STRING.LENGTH("&clk")
  &clk_itr_length=STRING.LENGTH("gcc_snoc_pnoc_ahb_clk")

  if (STRING.SCAN("&clk", "*", 0)==0)
  (
    &wild_head=1
  )
  if (STRING.SCAN("&clk", "*", 1)==(STRING.LENGTH("&clk")-1))
  (
    &wild_tail=1
  )

  if ((&wild_head==1)&&(&wild_tail==1))
  (
    if (STRING.SCAN("gcc_snoc_pnoc_ahb_clk", STRING.MID("&clk", 1, &clk_input_length-2), 0)!=-1)
    ( 
      &match=1
    )
  )
  else if (&wild_head==1)
  (
    if (STRING.MID("gcc_snoc_pnoc_ahb_clk", &clk_itr_length-&clk_input_length+1, &clk_input_length-1)==STRING.CUT("&clk", 1))
    ( 
      &match=1
    )
  )
  else if (&wild_tail==1)
  (
    if (STRING.MID("gcc_snoc_pnoc_ahb_clk", 0, &clk_input_length-1)==STRING.CUT("&clk", -1))
    ( 
      &match=1
    )
  )	  
  else if ("gcc_snoc_pnoc_ahb_clk"=="&clk")
  (
    &match=1
  )
  
  if (&match==1)
  (
    &clk_test=&CLK_TEST_GCC_SNOC_PNOC_AHB_CLK
    &clk_reg=&HWIO_GCC_SNOC_PNOC_AHB_CBCR_ADDR
    &clk_reg_name="GCC_SNOC_PNOC_AHB_CBCR"
    &clk_name="gcc_snoc_pnoc_ahb_clk"
    &clk_reg_cbcr_type="sm_cbc"

    gosub Print_Clk_Info_Line
  )
  
  &match=0
  &wild_head=0
  &wild_tail=0
  &clk_input_length=STRING.LENGTH("&clk")
  &clk_itr_length=STRING.LENGTH("gcc_sys_noc_at_clk")

  if (STRING.SCAN("&clk", "*", 0)==0)
  (
    &wild_head=1
  )
  if (STRING.SCAN("&clk", "*", 1)==(STRING.LENGTH("&clk")-1))
  (
    &wild_tail=1
  )

  if ((&wild_head==1)&&(&wild_tail==1))
  (
    if (STRING.SCAN("gcc_sys_noc_at_clk", STRING.MID("&clk", 1, &clk_input_length-2), 0)!=-1)
    ( 
      &match=1
    )
  )
  else if (&wild_head==1)
  (
    if (STRING.MID("gcc_sys_noc_at_clk", &clk_itr_length-&clk_input_length+1, &clk_input_length-1)==STRING.CUT("&clk", 1))
    ( 
      &match=1
    )
  )
  else if (&wild_tail==1)
  (
    if (STRING.MID("gcc_sys_noc_at_clk", 0, &clk_input_length-1)==STRING.CUT("&clk", -1))
    ( 
      &match=1
    )
  )	  
  else if ("gcc_sys_noc_at_clk"=="&clk")
  (
    &match=1
  )
  
  if (&match==1)
  (
    &clk_test=&CLK_TEST_GCC_SYS_NOC_AT_CLK
    &clk_reg=&HWIO_GCC_SYS_NOC_AT_CBCR_ADDR
    &clk_reg_name="GCC_SYS_NOC_AT_CBCR"
    &clk_name="gcc_sys_noc_at_clk"
    &clk_reg_cbcr_type="sm_cbc"

    gosub Print_Clk_Info_Line
  )
  
  &match=0
  &wild_head=0
  &wild_tail=0
  &clk_input_length=STRING.LENGTH("&clk")
  &clk_itr_length=STRING.LENGTH("gcc_sys_noc_axi_clk")

  if (STRING.SCAN("&clk", "*", 0)==0)
  (
    &wild_head=1
  )
  if (STRING.SCAN("&clk", "*", 1)==(STRING.LENGTH("&clk")-1))
  (
    &wild_tail=1
  )

  if ((&wild_head==1)&&(&wild_tail==1))
  (
    if (STRING.SCAN("gcc_sys_noc_axi_clk", STRING.MID("&clk", 1, &clk_input_length-2), 0)!=-1)
    ( 
      &match=1
    )
  )
  else if (&wild_head==1)
  (
    if (STRING.MID("gcc_sys_noc_axi_clk", &clk_itr_length-&clk_input_length+1, &clk_input_length-1)==STRING.CUT("&clk", 1))
    ( 
      &match=1
    )
  )
  else if (&wild_tail==1)
  (
    if (STRING.MID("gcc_sys_noc_axi_clk", 0, &clk_input_length-1)==STRING.CUT("&clk", -1))
    ( 
      &match=1
    )
  )	  
  else if ("gcc_sys_noc_axi_clk"=="&clk")
  (
    &match=1
  )
  
  ; This clock belongs to the 'buses' display group.
  if ("buses"=="&clk")
  (
    &match=1	  
  )
  
  if (&match==1)
  (
    &clk_test=&CLK_TEST_GCC_SYS_NOC_AXI_CLK
    &clk_reg=&HWIO_GCC_SYS_NOC_AXI_CBCR_ADDR
    &clk_reg_name="GCC_SYS_NOC_AXI_CBCR"
    &clk_name="gcc_sys_noc_axi_clk"
    &clk_reg_cbcr_type="sm_cbc"

    gosub Print_Clk_Info_Line
  )
  
  &match=0
  &wild_head=0
  &wild_tail=0
  &clk_input_length=STRING.LENGTH("&clk")
  &clk_itr_length=STRING.LENGTH("gcc_sys_noc_kpss_ahb_clk")

  if (STRING.SCAN("&clk", "*", 0)==0)
  (
    &wild_head=1
  )
  if (STRING.SCAN("&clk", "*", 1)==(STRING.LENGTH("&clk")-1))
  (
    &wild_tail=1
  )

  if ((&wild_head==1)&&(&wild_tail==1))
  (
    if (STRING.SCAN("gcc_sys_noc_kpss_ahb_clk", STRING.MID("&clk", 1, &clk_input_length-2), 0)!=-1)
    ( 
      &match=1
    )
  )
  else if (&wild_head==1)
  (
    if (STRING.MID("gcc_sys_noc_kpss_ahb_clk", &clk_itr_length-&clk_input_length+1, &clk_input_length-1)==STRING.CUT("&clk", 1))
    ( 
      &match=1
    )
  )
  else if (&wild_tail==1)
  (
    if (STRING.MID("gcc_sys_noc_kpss_ahb_clk", 0, &clk_input_length-1)==STRING.CUT("&clk", -1))
    ( 
      &match=1
    )
  )	  
  else if ("gcc_sys_noc_kpss_ahb_clk"=="&clk")
  (
    &match=1
  )
  
  if (&match==1)
  (
    &clk_test=&CLK_TEST_GCC_SYS_NOC_KPSS_AHB_CLK
    &clk_reg=&HWIO_GCC_SYS_NOC_KPSS_AHB_CBCR_ADDR
    &clk_reg_name="GCC_SYS_NOC_KPSS_AHB_CBCR"
    &clk_name="gcc_sys_noc_kpss_ahb_clk"
    &clk_reg_cbcr_type="sm_cbc"

    gosub Print_Clk_Info_Line
  )
  
  &match=0
  &wild_head=0
  &wild_tail=0
  &clk_input_length=STRING.LENGTH("&clk")
  &clk_itr_length=STRING.LENGTH("gcc_sys_noc_qdss_stm_axi_clk")

  if (STRING.SCAN("&clk", "*", 0)==0)
  (
    &wild_head=1
  )
  if (STRING.SCAN("&clk", "*", 1)==(STRING.LENGTH("&clk")-1))
  (
    &wild_tail=1
  )

  if ((&wild_head==1)&&(&wild_tail==1))
  (
    if (STRING.SCAN("gcc_sys_noc_qdss_stm_axi_clk", STRING.MID("&clk", 1, &clk_input_length-2), 0)!=-1)
    ( 
      &match=1
    )
  )
  else if (&wild_head==1)
  (
    if (STRING.MID("gcc_sys_noc_qdss_stm_axi_clk", &clk_itr_length-&clk_input_length+1, &clk_input_length-1)==STRING.CUT("&clk", 1))
    ( 
      &match=1
    )
  )
  else if (&wild_tail==1)
  (
    if (STRING.MID("gcc_sys_noc_qdss_stm_axi_clk", 0, &clk_input_length-1)==STRING.CUT("&clk", -1))
    ( 
      &match=1
    )
  )	  
  else if ("gcc_sys_noc_qdss_stm_axi_clk"=="&clk")
  (
    &match=1
  )
  
  if (&match==1)
  (
    &clk_test=&CLK_TEST_GCC_SYS_NOC_QDSS_STM_AXI_CLK
    &clk_reg=&HWIO_GCC_SYS_NOC_QDSS_STM_AXI_CBCR_ADDR
    &clk_reg_name="GCC_SYS_NOC_QDSS_STM_AXI_CBCR"
    &clk_name="gcc_sys_noc_qdss_stm_axi_clk"
    &clk_reg_cbcr_type="sm_cbc"

    gosub Print_Clk_Info_Line
  )
  
  &match=0
  &wild_head=0
  &wild_tail=0
  &clk_input_length=STRING.LENGTH("&clk")
  &clk_itr_length=STRING.LENGTH("gcc_sys_noc_ufs_axi_clk")

  if (STRING.SCAN("&clk", "*", 0)==0)
  (
    &wild_head=1
  )
  if (STRING.SCAN("&clk", "*", 1)==(STRING.LENGTH("&clk")-1))
  (
    &wild_tail=1
  )

  if ((&wild_head==1)&&(&wild_tail==1))
  (
    if (STRING.SCAN("gcc_sys_noc_ufs_axi_clk", STRING.MID("&clk", 1, &clk_input_length-2), 0)!=-1)
    ( 
      &match=1
    )
  )
  else if (&wild_head==1)
  (
    if (STRING.MID("gcc_sys_noc_ufs_axi_clk", &clk_itr_length-&clk_input_length+1, &clk_input_length-1)==STRING.CUT("&clk", 1))
    ( 
      &match=1
    )
  )
  else if (&wild_tail==1)
  (
    if (STRING.MID("gcc_sys_noc_ufs_axi_clk", 0, &clk_input_length-1)==STRING.CUT("&clk", -1))
    ( 
      &match=1
    )
  )	  
  else if ("gcc_sys_noc_ufs_axi_clk"=="&clk")
  (
    &match=1
  )
  
  if (&match==1)
  (
    &clk_test=&CLK_TEST_GCC_SYS_NOC_UFS_AXI_CLK
    &clk_reg=&HWIO_GCC_SYS_NOC_UFS_AXI_CBCR_ADDR
    &clk_reg_name="GCC_SYS_NOC_UFS_AXI_CBCR"
    &clk_name="gcc_sys_noc_ufs_axi_clk"
    &clk_reg_cbcr_type="sm_cbc"

    gosub Print_Clk_Info_Line
  )
  
  &match=0
  &wild_head=0
  &wild_tail=0
  &clk_input_length=STRING.LENGTH("&clk")
  &clk_itr_length=STRING.LENGTH("gcc_sys_noc_usb3_axi_clk")

  if (STRING.SCAN("&clk", "*", 0)==0)
  (
    &wild_head=1
  )
  if (STRING.SCAN("&clk", "*", 1)==(STRING.LENGTH("&clk")-1))
  (
    &wild_tail=1
  )

  if ((&wild_head==1)&&(&wild_tail==1))
  (
    if (STRING.SCAN("gcc_sys_noc_usb3_axi_clk", STRING.MID("&clk", 1, &clk_input_length-2), 0)!=-1)
    ( 
      &match=1
    )
  )
  else if (&wild_head==1)
  (
    if (STRING.MID("gcc_sys_noc_usb3_axi_clk", &clk_itr_length-&clk_input_length+1, &clk_input_length-1)==STRING.CUT("&clk", 1))
    ( 
      &match=1
    )
  )
  else if (&wild_tail==1)
  (
    if (STRING.MID("gcc_sys_noc_usb3_axi_clk", 0, &clk_input_length-1)==STRING.CUT("&clk", -1))
    ( 
      &match=1
    )
  )	  
  else if ("gcc_sys_noc_usb3_axi_clk"=="&clk")
  (
    &match=1
  )
  
  if (&match==1)
  (
    &clk_test=&CLK_TEST_GCC_SYS_NOC_USB3_AXI_CLK
    &clk_reg=&HWIO_GCC_SYS_NOC_USB3_AXI_CBCR_ADDR
    &clk_reg_name="GCC_SYS_NOC_USB3_AXI_CBCR"
    &clk_name="gcc_sys_noc_usb3_axi_clk"
    &clk_reg_cbcr_type="sm_cbc"

    gosub Print_Clk_Info_Line
  )
  
  &match=0
  &wild_head=0
  &wild_tail=0
  &clk_input_length=STRING.LENGTH("&clk")
  &clk_itr_length=STRING.LENGTH("gcc_sys_noc_usb3_sec_axi_clk")

  if (STRING.SCAN("&clk", "*", 0)==0)
  (
    &wild_head=1
  )
  if (STRING.SCAN("&clk", "*", 1)==(STRING.LENGTH("&clk")-1))
  (
    &wild_tail=1
  )

  if ((&wild_head==1)&&(&wild_tail==1))
  (
    if (STRING.SCAN("gcc_sys_noc_usb3_sec_axi_clk", STRING.MID("&clk", 1, &clk_input_length-2), 0)!=-1)
    ( 
      &match=1
    )
  )
  else if (&wild_head==1)
  (
    if (STRING.MID("gcc_sys_noc_usb3_sec_axi_clk", &clk_itr_length-&clk_input_length+1, &clk_input_length-1)==STRING.CUT("&clk", 1))
    ( 
      &match=1
    )
  )
  else if (&wild_tail==1)
  (
    if (STRING.MID("gcc_sys_noc_usb3_sec_axi_clk", 0, &clk_input_length-1)==STRING.CUT("&clk", -1))
    ( 
      &match=1
    )
  )	  
  else if ("gcc_sys_noc_usb3_sec_axi_clk"=="&clk")
  (
    &match=1
  )
  
  if (&match==1)
  (
    &clk_test=&CLK_TEST_GCC_SYS_NOC_USB3_SEC_AXI_CLK
    &clk_reg=&HWIO_GCC_SYS_NOC_USB3_SEC_AXI_CBCR_ADDR
    &clk_reg_name="GCC_SYS_NOC_USB3_SEC_AXI_CBCR"
    &clk_name="gcc_sys_noc_usb3_sec_axi_clk"
    &clk_reg_cbcr_type="sm_cbc"

    gosub Print_Clk_Info_Line
  )
  
  &match=0
  &wild_head=0
  &wild_tail=0
  &clk_input_length=STRING.LENGTH("&clk")
  &clk_itr_length=STRING.LENGTH("gcc_tcsr_ahb_clk")

  if (STRING.SCAN("&clk", "*", 0)==0)
  (
    &wild_head=1
  )
  if (STRING.SCAN("&clk", "*", 1)==(STRING.LENGTH("&clk")-1))
  (
    &wild_tail=1
  )

  if ((&wild_head==1)&&(&wild_tail==1))
  (
    if (STRING.SCAN("gcc_tcsr_ahb_clk", STRING.MID("&clk", 1, &clk_input_length-2), 0)!=-1)
    ( 
      &match=1
    )
  )
  else if (&wild_head==1)
  (
    if (STRING.MID("gcc_tcsr_ahb_clk", &clk_itr_length-&clk_input_length+1, &clk_input_length-1)==STRING.CUT("&clk", 1))
    ( 
      &match=1
    )
  )
  else if (&wild_tail==1)
  (
    if (STRING.MID("gcc_tcsr_ahb_clk", 0, &clk_input_length-1)==STRING.CUT("&clk", -1))
    ( 
      &match=1
    )
  )	  
  else if ("gcc_tcsr_ahb_clk"=="&clk")
  (
    &match=1
  )
  
  if (&match==1)
  (
    &clk_test=&CLK_TEST_GCC_TCSR_AHB_CLK
    &clk_reg=&HWIO_GCC_TCSR_AHB_CBCR_ADDR
    &clk_reg_name="GCC_TCSR_AHB_CBCR"
    &clk_name="gcc_tcsr_ahb_clk"
    &clk_reg_cbcr_type="sm_cbc"

    gosub Print_Clk_Info_Line
  )
  
  &match=0
  &wild_head=0
  &wild_tail=0
  &clk_input_length=STRING.LENGTH("&clk")
  &clk_itr_length=STRING.LENGTH("gcc_tlmm_ahb_clk")

  if (STRING.SCAN("&clk", "*", 0)==0)
  (
    &wild_head=1
  )
  if (STRING.SCAN("&clk", "*", 1)==(STRING.LENGTH("&clk")-1))
  (
    &wild_tail=1
  )

  if ((&wild_head==1)&&(&wild_tail==1))
  (
    if (STRING.SCAN("gcc_tlmm_ahb_clk", STRING.MID("&clk", 1, &clk_input_length-2), 0)!=-1)
    ( 
      &match=1
    )
  )
  else if (&wild_head==1)
  (
    if (STRING.MID("gcc_tlmm_ahb_clk", &clk_itr_length-&clk_input_length+1, &clk_input_length-1)==STRING.CUT("&clk", 1))
    ( 
      &match=1
    )
  )
  else if (&wild_tail==1)
  (
    if (STRING.MID("gcc_tlmm_ahb_clk", 0, &clk_input_length-1)==STRING.CUT("&clk", -1))
    ( 
      &match=1
    )
  )	  
  else if ("gcc_tlmm_ahb_clk"=="&clk")
  (
    &match=1
  )
  
  if (&match==1)
  (
    &clk_test=&CLK_TEST_GCC_TLMM_AHB_CLK
    &clk_reg=&HWIO_GCC_TLMM_AHB_CBCR_ADDR
    &clk_reg_name="GCC_TLMM_AHB_CBCR"
    &clk_name="gcc_tlmm_ahb_clk"
    &clk_reg_cbcr_type="sm_cbc"

    gosub Print_Clk_Info_Line
  )
  
  &match=0
  &wild_head=0
  &wild_tail=0
  &clk_input_length=STRING.LENGTH("&clk")
  &clk_itr_length=STRING.LENGTH("gcc_tlmm_clk")

  if (STRING.SCAN("&clk", "*", 0)==0)
  (
    &wild_head=1
  )
  if (STRING.SCAN("&clk", "*", 1)==(STRING.LENGTH("&clk")-1))
  (
    &wild_tail=1
  )

  if ((&wild_head==1)&&(&wild_tail==1))
  (
    if (STRING.SCAN("gcc_tlmm_clk", STRING.MID("&clk", 1, &clk_input_length-2), 0)!=-1)
    ( 
      &match=1
    )
  )
  else if (&wild_head==1)
  (
    if (STRING.MID("gcc_tlmm_clk", &clk_itr_length-&clk_input_length+1, &clk_input_length-1)==STRING.CUT("&clk", 1))
    ( 
      &match=1
    )
  )
  else if (&wild_tail==1)
  (
    if (STRING.MID("gcc_tlmm_clk", 0, &clk_input_length-1)==STRING.CUT("&clk", -1))
    ( 
      &match=1
    )
  )	  
  else if ("gcc_tlmm_clk"=="&clk")
  (
    &match=1
  )
  
  if (&match==1)
  (
    &clk_test=&CLK_TEST_GCC_TLMM_CLK
    &clk_reg=&HWIO_GCC_TLMM_CBCR_ADDR
    &clk_reg_name="GCC_TLMM_CBCR"
    &clk_name="gcc_tlmm_clk"
    &clk_reg_cbcr_type="sm_cbc"

    gosub Print_Clk_Info_Line
  )
  
  &match=0
  &wild_head=0
  &wild_tail=0
  &clk_input_length=STRING.LENGTH("&clk")
  &clk_itr_length=STRING.LENGTH("gcc_tsif_ahb_clk")

  if (STRING.SCAN("&clk", "*", 0)==0)
  (
    &wild_head=1
  )
  if (STRING.SCAN("&clk", "*", 1)==(STRING.LENGTH("&clk")-1))
  (
    &wild_tail=1
  )

  if ((&wild_head==1)&&(&wild_tail==1))
  (
    if (STRING.SCAN("gcc_tsif_ahb_clk", STRING.MID("&clk", 1, &clk_input_length-2), 0)!=-1)
    ( 
      &match=1
    )
  )
  else if (&wild_head==1)
  (
    if (STRING.MID("gcc_tsif_ahb_clk", &clk_itr_length-&clk_input_length+1, &clk_input_length-1)==STRING.CUT("&clk", 1))
    ( 
      &match=1
    )
  )
  else if (&wild_tail==1)
  (
    if (STRING.MID("gcc_tsif_ahb_clk", 0, &clk_input_length-1)==STRING.CUT("&clk", -1))
    ( 
      &match=1
    )
  )	  
  else if ("gcc_tsif_ahb_clk"=="&clk")
  (
    &match=1
  )
  
  if (&match==1)
  (
    &clk_test=&CLK_TEST_GCC_TSIF_AHB_CLK
    &clk_reg=&HWIO_GCC_TSIF_AHB_CBCR_ADDR
    &clk_reg_name="GCC_TSIF_AHB_CBCR"
    &clk_name="gcc_tsif_ahb_clk"
    &clk_reg_cbcr_type="sm_pscbc"

    gosub Print_Clk_Info_Line
  )
  
  &match=0
  &wild_head=0
  &wild_tail=0
  &clk_input_length=STRING.LENGTH("&clk")
  &clk_itr_length=STRING.LENGTH("gcc_tsif_inactivity_timers_clk")

  if (STRING.SCAN("&clk", "*", 0)==0)
  (
    &wild_head=1
  )
  if (STRING.SCAN("&clk", "*", 1)==(STRING.LENGTH("&clk")-1))
  (
    &wild_tail=1
  )

  if ((&wild_head==1)&&(&wild_tail==1))
  (
    if (STRING.SCAN("gcc_tsif_inactivity_timers_clk", STRING.MID("&clk", 1, &clk_input_length-2), 0)!=-1)
    ( 
      &match=1
    )
  )
  else if (&wild_head==1)
  (
    if (STRING.MID("gcc_tsif_inactivity_timers_clk", &clk_itr_length-&clk_input_length+1, &clk_input_length-1)==STRING.CUT("&clk", 1))
    ( 
      &match=1
    )
  )
  else if (&wild_tail==1)
  (
    if (STRING.MID("gcc_tsif_inactivity_timers_clk", 0, &clk_input_length-1)==STRING.CUT("&clk", -1))
    ( 
      &match=1
    )
  )	  
  else if ("gcc_tsif_inactivity_timers_clk"=="&clk")
  (
    &match=1
  )
  
  if (&match==1)
  (
    &clk_test=&CLK_TEST_GCC_TSIF_INACTIVITY_TIMERS_CLK
    &clk_reg=&HWIO_GCC_TSIF_INACTIVITY_TIMERS_CBCR_ADDR
    &clk_reg_name="GCC_TSIF_INACTIVITY_TIMERS_CBCR"
    &clk_name="gcc_tsif_inactivity_timers_clk"
    &clk_reg_cbcr_type="sm_cbc"

    gosub Print_Clk_Info_Line
  )
  
  &match=0
  &wild_head=0
  &wild_tail=0
  &clk_input_length=STRING.LENGTH("&clk")
  &clk_itr_length=STRING.LENGTH("gcc_tsif_ref_clk")

  if (STRING.SCAN("&clk", "*", 0)==0)
  (
    &wild_head=1
  )
  if (STRING.SCAN("&clk", "*", 1)==(STRING.LENGTH("&clk")-1))
  (
    &wild_tail=1
  )

  if ((&wild_head==1)&&(&wild_tail==1))
  (
    if (STRING.SCAN("gcc_tsif_ref_clk", STRING.MID("&clk", 1, &clk_input_length-2), 0)!=-1)
    ( 
      &match=1
    )
  )
  else if (&wild_head==1)
  (
    if (STRING.MID("gcc_tsif_ref_clk", &clk_itr_length-&clk_input_length+1, &clk_input_length-1)==STRING.CUT("&clk", 1))
    ( 
      &match=1
    )
  )
  else if (&wild_tail==1)
  (
    if (STRING.MID("gcc_tsif_ref_clk", 0, &clk_input_length-1)==STRING.CUT("&clk", -1))
    ( 
      &match=1
    )
  )	  
  else if ("gcc_tsif_ref_clk"=="&clk")
  (
    &match=1
  )
  
  if (&match==1)
  (
    &clk_test=&CLK_TEST_GCC_TSIF_REF_CLK
    &clk_reg=&HWIO_GCC_TSIF_REF_CBCR_ADDR
    &clk_reg_name="GCC_TSIF_REF_CBCR"
    &clk_name="gcc_tsif_ref_clk"
    &clk_reg_cbcr_type="sm_cbc"

    gosub Print_Clk_Info_Line
  )
  
  &match=0
  &wild_head=0
  &wild_tail=0
  &clk_input_length=STRING.LENGTH("&clk")
  &clk_itr_length=STRING.LENGTH("gcc_ufs_ahb_clk")

  if (STRING.SCAN("&clk", "*", 0)==0)
  (
    &wild_head=1
  )
  if (STRING.SCAN("&clk", "*", 1)==(STRING.LENGTH("&clk")-1))
  (
    &wild_tail=1
  )

  if ((&wild_head==1)&&(&wild_tail==1))
  (
    if (STRING.SCAN("gcc_ufs_ahb_clk", STRING.MID("&clk", 1, &clk_input_length-2), 0)!=-1)
    ( 
      &match=1
    )
  )
  else if (&wild_head==1)
  (
    if (STRING.MID("gcc_ufs_ahb_clk", &clk_itr_length-&clk_input_length+1, &clk_input_length-1)==STRING.CUT("&clk", 1))
    ( 
      &match=1
    )
  )
  else if (&wild_tail==1)
  (
    if (STRING.MID("gcc_ufs_ahb_clk", 0, &clk_input_length-1)==STRING.CUT("&clk", -1))
    ( 
      &match=1
    )
  )	  
  else if ("gcc_ufs_ahb_clk"=="&clk")
  (
    &match=1
  )
  
  if (&match==1)
  (
    &clk_test=&CLK_TEST_GCC_UFS_AHB_CLK
    &clk_reg=&HWIO_GCC_UFS_AHB_CBCR_ADDR
    &clk_reg_name="GCC_UFS_AHB_CBCR"
    &clk_name="gcc_ufs_ahb_clk"
    &clk_reg_cbcr_type="sm_cbc"

    gosub Print_Clk_Info_Line
  )
  
  &match=0
  &wild_head=0
  &wild_tail=0
  &clk_input_length=STRING.LENGTH("&clk")
  &clk_itr_length=STRING.LENGTH("gcc_ufs_axi_clk")

  if (STRING.SCAN("&clk", "*", 0)==0)
  (
    &wild_head=1
  )
  if (STRING.SCAN("&clk", "*", 1)==(STRING.LENGTH("&clk")-1))
  (
    &wild_tail=1
  )

  if ((&wild_head==1)&&(&wild_tail==1))
  (
    if (STRING.SCAN("gcc_ufs_axi_clk", STRING.MID("&clk", 1, &clk_input_length-2), 0)!=-1)
    ( 
      &match=1
    )
  )
  else if (&wild_head==1)
  (
    if (STRING.MID("gcc_ufs_axi_clk", &clk_itr_length-&clk_input_length+1, &clk_input_length-1)==STRING.CUT("&clk", 1))
    ( 
      &match=1
    )
  )
  else if (&wild_tail==1)
  (
    if (STRING.MID("gcc_ufs_axi_clk", 0, &clk_input_length-1)==STRING.CUT("&clk", -1))
    ( 
      &match=1
    )
  )	  
  else if ("gcc_ufs_axi_clk"=="&clk")
  (
    &match=1
  )
  
  if (&match==1)
  (
    &clk_test=&CLK_TEST_GCC_UFS_AXI_CLK
    &clk_reg=&HWIO_GCC_UFS_AXI_CBCR_ADDR
    &clk_reg_name="GCC_UFS_AXI_CBCR"
    &clk_name="gcc_ufs_axi_clk"
    &clk_reg_cbcr_type="sm_pscbc"

    gosub Print_Clk_Info_Line
  )
  
  &match=0
  &wild_head=0
  &wild_tail=0
  &clk_input_length=STRING.LENGTH("&clk")
  &clk_itr_length=STRING.LENGTH("gcc_ufs_rx_cfg_clk")

  if (STRING.SCAN("&clk", "*", 0)==0)
  (
    &wild_head=1
  )
  if (STRING.SCAN("&clk", "*", 1)==(STRING.LENGTH("&clk")-1))
  (
    &wild_tail=1
  )

  if ((&wild_head==1)&&(&wild_tail==1))
  (
    if (STRING.SCAN("gcc_ufs_rx_cfg_clk", STRING.MID("&clk", 1, &clk_input_length-2), 0)!=-1)
    ( 
      &match=1
    )
  )
  else if (&wild_head==1)
  (
    if (STRING.MID("gcc_ufs_rx_cfg_clk", &clk_itr_length-&clk_input_length+1, &clk_input_length-1)==STRING.CUT("&clk", 1))
    ( 
      &match=1
    )
  )
  else if (&wild_tail==1)
  (
    if (STRING.MID("gcc_ufs_rx_cfg_clk", 0, &clk_input_length-1)==STRING.CUT("&clk", -1))
    ( 
      &match=1
    )
  )	  
  else if ("gcc_ufs_rx_cfg_clk"=="&clk")
  (
    &match=1
  )
  
  if (&match==1)
  (
    &clk_test=&CLK_TEST_GCC_UFS_RX_CFG_CLK
    &clk_reg=&HWIO_GCC_UFS_RX_CFG_CBCR_ADDR
    &clk_reg_name="GCC_UFS_RX_CFG_CBCR"
    &clk_name="gcc_ufs_rx_cfg_clk"
    &clk_reg_cbcr_type="sm_cbc"

    gosub Print_Clk_Info_Line
  )
  
  &match=0
  &wild_head=0
  &wild_tail=0
  &clk_input_length=STRING.LENGTH("&clk")
  &clk_itr_length=STRING.LENGTH("gcc_ufs_rx_symbol_0_clk")

  if (STRING.SCAN("&clk", "*", 0)==0)
  (
    &wild_head=1
  )
  if (STRING.SCAN("&clk", "*", 1)==(STRING.LENGTH("&clk")-1))
  (
    &wild_tail=1
  )

  if ((&wild_head==1)&&(&wild_tail==1))
  (
    if (STRING.SCAN("gcc_ufs_rx_symbol_0_clk", STRING.MID("&clk", 1, &clk_input_length-2), 0)!=-1)
    ( 
      &match=1
    )
  )
  else if (&wild_head==1)
  (
    if (STRING.MID("gcc_ufs_rx_symbol_0_clk", &clk_itr_length-&clk_input_length+1, &clk_input_length-1)==STRING.CUT("&clk", 1))
    ( 
      &match=1
    )
  )
  else if (&wild_tail==1)
  (
    if (STRING.MID("gcc_ufs_rx_symbol_0_clk", 0, &clk_input_length-1)==STRING.CUT("&clk", -1))
    ( 
      &match=1
    )
  )	  
  else if ("gcc_ufs_rx_symbol_0_clk"=="&clk")
  (
    &match=1
  )
  
  if (&match==1)
  (
    &clk_test=&CLK_TEST_GCC_UFS_RX_SYMBOL_0_CLK
    &clk_reg=&HWIO_GCC_UFS_RX_SYMBOL_0_CBCR_ADDR
    &clk_reg_name="GCC_UFS_RX_SYMBOL_0_CBCR"
    &clk_name="gcc_ufs_rx_symbol_0_clk"
    &clk_reg_cbcr_type="sm_pscbc"

    gosub Print_Clk_Info_Line
  )
  
  &match=0
  &wild_head=0
  &wild_tail=0
  &clk_input_length=STRING.LENGTH("&clk")
  &clk_itr_length=STRING.LENGTH("gcc_ufs_rx_symbol_1_clk")

  if (STRING.SCAN("&clk", "*", 0)==0)
  (
    &wild_head=1
  )
  if (STRING.SCAN("&clk", "*", 1)==(STRING.LENGTH("&clk")-1))
  (
    &wild_tail=1
  )

  if ((&wild_head==1)&&(&wild_tail==1))
  (
    if (STRING.SCAN("gcc_ufs_rx_symbol_1_clk", STRING.MID("&clk", 1, &clk_input_length-2), 0)!=-1)
    ( 
      &match=1
    )
  )
  else if (&wild_head==1)
  (
    if (STRING.MID("gcc_ufs_rx_symbol_1_clk", &clk_itr_length-&clk_input_length+1, &clk_input_length-1)==STRING.CUT("&clk", 1))
    ( 
      &match=1
    )
  )
  else if (&wild_tail==1)
  (
    if (STRING.MID("gcc_ufs_rx_symbol_1_clk", 0, &clk_input_length-1)==STRING.CUT("&clk", -1))
    ( 
      &match=1
    )
  )	  
  else if ("gcc_ufs_rx_symbol_1_clk"=="&clk")
  (
    &match=1
  )
  
  if (&match==1)
  (
    &clk_test=&CLK_TEST_GCC_UFS_RX_SYMBOL_1_CLK
    &clk_reg=&HWIO_GCC_UFS_RX_SYMBOL_1_CBCR_ADDR
    &clk_reg_name="GCC_UFS_RX_SYMBOL_1_CBCR"
    &clk_name="gcc_ufs_rx_symbol_1_clk"
    &clk_reg_cbcr_type="sm_cbc"

    gosub Print_Clk_Info_Line
  )
  
  &match=0
  &wild_head=0
  &wild_tail=0
  &clk_input_length=STRING.LENGTH("&clk")
  &clk_itr_length=STRING.LENGTH("gcc_ufs_tx_cfg_clk")

  if (STRING.SCAN("&clk", "*", 0)==0)
  (
    &wild_head=1
  )
  if (STRING.SCAN("&clk", "*", 1)==(STRING.LENGTH("&clk")-1))
  (
    &wild_tail=1
  )

  if ((&wild_head==1)&&(&wild_tail==1))
  (
    if (STRING.SCAN("gcc_ufs_tx_cfg_clk", STRING.MID("&clk", 1, &clk_input_length-2), 0)!=-1)
    ( 
      &match=1
    )
  )
  else if (&wild_head==1)
  (
    if (STRING.MID("gcc_ufs_tx_cfg_clk", &clk_itr_length-&clk_input_length+1, &clk_input_length-1)==STRING.CUT("&clk", 1))
    ( 
      &match=1
    )
  )
  else if (&wild_tail==1)
  (
    if (STRING.MID("gcc_ufs_tx_cfg_clk", 0, &clk_input_length-1)==STRING.CUT("&clk", -1))
    ( 
      &match=1
    )
  )	  
  else if ("gcc_ufs_tx_cfg_clk"=="&clk")
  (
    &match=1
  )
  
  if (&match==1)
  (
    &clk_test=&CLK_TEST_GCC_UFS_TX_CFG_CLK
    &clk_reg=&HWIO_GCC_UFS_TX_CFG_CBCR_ADDR
    &clk_reg_name="GCC_UFS_TX_CFG_CBCR"
    &clk_name="gcc_ufs_tx_cfg_clk"
    &clk_reg_cbcr_type="sm_cbc"

    gosub Print_Clk_Info_Line
  )
  
  &match=0
  &wild_head=0
  &wild_tail=0
  &clk_input_length=STRING.LENGTH("&clk")
  &clk_itr_length=STRING.LENGTH("gcc_ufs_tx_symbol_0_clk")

  if (STRING.SCAN("&clk", "*", 0)==0)
  (
    &wild_head=1
  )
  if (STRING.SCAN("&clk", "*", 1)==(STRING.LENGTH("&clk")-1))
  (
    &wild_tail=1
  )

  if ((&wild_head==1)&&(&wild_tail==1))
  (
    if (STRING.SCAN("gcc_ufs_tx_symbol_0_clk", STRING.MID("&clk", 1, &clk_input_length-2), 0)!=-1)
    ( 
      &match=1
    )
  )
  else if (&wild_head==1)
  (
    if (STRING.MID("gcc_ufs_tx_symbol_0_clk", &clk_itr_length-&clk_input_length+1, &clk_input_length-1)==STRING.CUT("&clk", 1))
    ( 
      &match=1
    )
  )
  else if (&wild_tail==1)
  (
    if (STRING.MID("gcc_ufs_tx_symbol_0_clk", 0, &clk_input_length-1)==STRING.CUT("&clk", -1))
    ( 
      &match=1
    )
  )	  
  else if ("gcc_ufs_tx_symbol_0_clk"=="&clk")
  (
    &match=1
  )
  
  if (&match==1)
  (
    &clk_test=&CLK_TEST_GCC_UFS_TX_SYMBOL_0_CLK
    &clk_reg=&HWIO_GCC_UFS_TX_SYMBOL_0_CBCR_ADDR
    &clk_reg_name="GCC_UFS_TX_SYMBOL_0_CBCR"
    &clk_name="gcc_ufs_tx_symbol_0_clk"
    &clk_reg_cbcr_type="sm_pscbc"

    gosub Print_Clk_Info_Line
  )
  
  &match=0
  &wild_head=0
  &wild_tail=0
  &clk_input_length=STRING.LENGTH("&clk")
  &clk_itr_length=STRING.LENGTH("gcc_ufs_tx_symbol_1_clk")

  if (STRING.SCAN("&clk", "*", 0)==0)
  (
    &wild_head=1
  )
  if (STRING.SCAN("&clk", "*", 1)==(STRING.LENGTH("&clk")-1))
  (
    &wild_tail=1
  )

  if ((&wild_head==1)&&(&wild_tail==1))
  (
    if (STRING.SCAN("gcc_ufs_tx_symbol_1_clk", STRING.MID("&clk", 1, &clk_input_length-2), 0)!=-1)
    ( 
      &match=1
    )
  )
  else if (&wild_head==1)
  (
    if (STRING.MID("gcc_ufs_tx_symbol_1_clk", &clk_itr_length-&clk_input_length+1, &clk_input_length-1)==STRING.CUT("&clk", 1))
    ( 
      &match=1
    )
  )
  else if (&wild_tail==1)
  (
    if (STRING.MID("gcc_ufs_tx_symbol_1_clk", 0, &clk_input_length-1)==STRING.CUT("&clk", -1))
    ( 
      &match=1
    )
  )	  
  else if ("gcc_ufs_tx_symbol_1_clk"=="&clk")
  (
    &match=1
  )
  
  if (&match==1)
  (
    &clk_test=&CLK_TEST_GCC_UFS_TX_SYMBOL_1_CLK
    &clk_reg=&HWIO_GCC_UFS_TX_SYMBOL_1_CBCR_ADDR
    &clk_reg_name="GCC_UFS_TX_SYMBOL_1_CBCR"
    &clk_name="gcc_ufs_tx_symbol_1_clk"
    &clk_reg_cbcr_type="sm_cbc"

    gosub Print_Clk_Info_Line
  )
  
  &match=0
  &wild_head=0
  &wild_tail=0
  &clk_input_length=STRING.LENGTH("&clk")
  &clk_itr_length=STRING.LENGTH("gcc_usb2a_phy_sleep_clk")

  if (STRING.SCAN("&clk", "*", 0)==0)
  (
    &wild_head=1
  )
  if (STRING.SCAN("&clk", "*", 1)==(STRING.LENGTH("&clk")-1))
  (
    &wild_tail=1
  )

  if ((&wild_head==1)&&(&wild_tail==1))
  (
    if (STRING.SCAN("gcc_usb2a_phy_sleep_clk", STRING.MID("&clk", 1, &clk_input_length-2), 0)!=-1)
    ( 
      &match=1
    )
  )
  else if (&wild_head==1)
  (
    if (STRING.MID("gcc_usb2a_phy_sleep_clk", &clk_itr_length-&clk_input_length+1, &clk_input_length-1)==STRING.CUT("&clk", 1))
    ( 
      &match=1
    )
  )
  else if (&wild_tail==1)
  (
    if (STRING.MID("gcc_usb2a_phy_sleep_clk", 0, &clk_input_length-1)==STRING.CUT("&clk", -1))
    ( 
      &match=1
    )
  )	  
  else if ("gcc_usb2a_phy_sleep_clk"=="&clk")
  (
    &match=1
  )
  
  if (&match==1)
  (
    &clk_test=&CLK_TEST_GCC_USB2A_PHY_SLEEP_CLK
    &clk_reg=&HWIO_GCC_USB2A_PHY_SLEEP_CBCR_ADDR
    &clk_reg_name="GCC_USB2A_PHY_SLEEP_CBCR"
    &clk_name="gcc_usb2a_phy_sleep_clk"
    &clk_reg_cbcr_type="sm_cbc"

    gosub Print_Clk_Info_Line
  )
  
  &match=0
  &wild_head=0
  &wild_tail=0
  &clk_input_length=STRING.LENGTH("&clk")
  &clk_itr_length=STRING.LENGTH("gcc_usb2b_phy_sleep_clk")

  if (STRING.SCAN("&clk", "*", 0)==0)
  (
    &wild_head=1
  )
  if (STRING.SCAN("&clk", "*", 1)==(STRING.LENGTH("&clk")-1))
  (
    &wild_tail=1
  )

  if ((&wild_head==1)&&(&wild_tail==1))
  (
    if (STRING.SCAN("gcc_usb2b_phy_sleep_clk", STRING.MID("&clk", 1, &clk_input_length-2), 0)!=-1)
    ( 
      &match=1
    )
  )
  else if (&wild_head==1)
  (
    if (STRING.MID("gcc_usb2b_phy_sleep_clk", &clk_itr_length-&clk_input_length+1, &clk_input_length-1)==STRING.CUT("&clk", 1))
    ( 
      &match=1
    )
  )
  else if (&wild_tail==1)
  (
    if (STRING.MID("gcc_usb2b_phy_sleep_clk", 0, &clk_input_length-1)==STRING.CUT("&clk", -1))
    ( 
      &match=1
    )
  )	  
  else if ("gcc_usb2b_phy_sleep_clk"=="&clk")
  (
    &match=1
  )
  
  if (&match==1)
  (
    &clk_test=&CLK_TEST_GCC_USB2B_PHY_SLEEP_CLK
    &clk_reg=&HWIO_GCC_USB2B_PHY_SLEEP_CBCR_ADDR
    &clk_reg_name="GCC_USB2B_PHY_SLEEP_CBCR"
    &clk_name="gcc_usb2b_phy_sleep_clk"
    &clk_reg_cbcr_type="sm_cbc"

    gosub Print_Clk_Info_Line
  )
  
  &match=0
  &wild_head=0
  &wild_tail=0
  &clk_input_length=STRING.LENGTH("&clk")
  &clk_itr_length=STRING.LENGTH("gcc_usb30_master_clk")

  if (STRING.SCAN("&clk", "*", 0)==0)
  (
    &wild_head=1
  )
  if (STRING.SCAN("&clk", "*", 1)==(STRING.LENGTH("&clk")-1))
  (
    &wild_tail=1
  )

  if ((&wild_head==1)&&(&wild_tail==1))
  (
    if (STRING.SCAN("gcc_usb30_master_clk", STRING.MID("&clk", 1, &clk_input_length-2), 0)!=-1)
    ( 
      &match=1
    )
  )
  else if (&wild_head==1)
  (
    if (STRING.MID("gcc_usb30_master_clk", &clk_itr_length-&clk_input_length+1, &clk_input_length-1)==STRING.CUT("&clk", 1))
    ( 
      &match=1
    )
  )
  else if (&wild_tail==1)
  (
    if (STRING.MID("gcc_usb30_master_clk", 0, &clk_input_length-1)==STRING.CUT("&clk", -1))
    ( 
      &match=1
    )
  )	  
  else if ("gcc_usb30_master_clk"=="&clk")
  (
    &match=1
  )
  
  if (&match==1)
  (
    &clk_test=&CLK_TEST_GCC_USB30_MASTER_CLK
    &clk_reg=&HWIO_GCC_USB30_MASTER_CBCR_ADDR
    &clk_reg_name="GCC_USB30_MASTER_CBCR"
    &clk_name="gcc_usb30_master_clk"
    &clk_reg_cbcr_type="sm_pscbc"

    gosub Print_Clk_Info_Line
  )
  
  &match=0
  &wild_head=0
  &wild_tail=0
  &clk_input_length=STRING.LENGTH("&clk")
  &clk_itr_length=STRING.LENGTH("gcc_usb30_mock_utmi_clk")

  if (STRING.SCAN("&clk", "*", 0)==0)
  (
    &wild_head=1
  )
  if (STRING.SCAN("&clk", "*", 1)==(STRING.LENGTH("&clk")-1))
  (
    &wild_tail=1
  )

  if ((&wild_head==1)&&(&wild_tail==1))
  (
    if (STRING.SCAN("gcc_usb30_mock_utmi_clk", STRING.MID("&clk", 1, &clk_input_length-2), 0)!=-1)
    ( 
      &match=1
    )
  )
  else if (&wild_head==1)
  (
    if (STRING.MID("gcc_usb30_mock_utmi_clk", &clk_itr_length-&clk_input_length+1, &clk_input_length-1)==STRING.CUT("&clk", 1))
    ( 
      &match=1
    )
  )
  else if (&wild_tail==1)
  (
    if (STRING.MID("gcc_usb30_mock_utmi_clk", 0, &clk_input_length-1)==STRING.CUT("&clk", -1))
    ( 
      &match=1
    )
  )	  
  else if ("gcc_usb30_mock_utmi_clk"=="&clk")
  (
    &match=1
  )
  
  if (&match==1)
  (
    &clk_test=&CLK_TEST_GCC_USB30_MOCK_UTMI_CLK
    &clk_reg=&HWIO_GCC_USB30_MOCK_UTMI_CBCR_ADDR
    &clk_reg_name="GCC_USB30_MOCK_UTMI_CBCR"
    &clk_name="gcc_usb30_mock_utmi_clk"
    &clk_reg_cbcr_type="sm_cbc"

    gosub Print_Clk_Info_Line
  )
  
  &match=0
  &wild_head=0
  &wild_tail=0
  &clk_input_length=STRING.LENGTH("&clk")
  &clk_itr_length=STRING.LENGTH("gcc_usb30_sleep_clk")

  if (STRING.SCAN("&clk", "*", 0)==0)
  (
    &wild_head=1
  )
  if (STRING.SCAN("&clk", "*", 1)==(STRING.LENGTH("&clk")-1))
  (
    &wild_tail=1
  )

  if ((&wild_head==1)&&(&wild_tail==1))
  (
    if (STRING.SCAN("gcc_usb30_sleep_clk", STRING.MID("&clk", 1, &clk_input_length-2), 0)!=-1)
    ( 
      &match=1
    )
  )
  else if (&wild_head==1)
  (
    if (STRING.MID("gcc_usb30_sleep_clk", &clk_itr_length-&clk_input_length+1, &clk_input_length-1)==STRING.CUT("&clk", 1))
    ( 
      &match=1
    )
  )
  else if (&wild_tail==1)
  (
    if (STRING.MID("gcc_usb30_sleep_clk", 0, &clk_input_length-1)==STRING.CUT("&clk", -1))
    ( 
      &match=1
    )
  )	  
  else if ("gcc_usb30_sleep_clk"=="&clk")
  (
    &match=1
  )
  
  if (&match==1)
  (
    &clk_test=&CLK_TEST_GCC_USB30_SLEEP_CLK
    &clk_reg=&HWIO_GCC_USB30_SLEEP_CBCR_ADDR
    &clk_reg_name="GCC_USB30_SLEEP_CBCR"
    &clk_name="gcc_usb30_sleep_clk"
    &clk_reg_cbcr_type="sm_cbc"

    gosub Print_Clk_Info_Line
  )
  
  &match=0
  &wild_head=0
  &wild_tail=0
  &clk_input_length=STRING.LENGTH("&clk")
  &clk_itr_length=STRING.LENGTH("usb2_phy_wrapper_cc_usb3_utmi_3_clk")

  if (STRING.SCAN("&clk", "*", 0)==0)
  (
    &wild_head=1
  )
  if (STRING.SCAN("&clk", "*", 1)==(STRING.LENGTH("&clk")-1))
  (
    &wild_tail=1
  )

  if ((&wild_head==1)&&(&wild_tail==1))
  (
    if (STRING.SCAN("usb2_phy_wrapper_cc_usb3_utmi_3_clk", STRING.MID("&clk", 1, &clk_input_length-2), 0)!=-1)
    ( 
      &match=1
    )
  )
  else if (&wild_head==1)
  (
    if (STRING.MID("usb2_phy_wrapper_cc_usb3_utmi_3_clk", &clk_itr_length-&clk_input_length+1, &clk_input_length-1)==STRING.CUT("&clk", 1))
    ( 
      &match=1
    )
  )
  else if (&wild_tail==1)
  (
    if (STRING.MID("usb2_phy_wrapper_cc_usb3_utmi_3_clk", 0, &clk_input_length-1)==STRING.CUT("&clk", -1))
    ( 
      &match=1
    )
  )	  
  else if ("usb2_phy_wrapper_cc_usb3_utmi_3_clk"=="&clk")
  (
    &match=1
  )
  
  if (&match==1)
  (
    &clk_test=&CLK_TEST_USB2_PHY_WRAPPER_CC_USB3_UTMI_3_CLK
    &clk_reg=0
    &clk_reg_name="No CBCR"
    &clk_name="usb2_phy_wrapper_cc_usb3_utmi_3_clk"
    &clk_reg_cbcr_type=""

    gosub Print_Clk_Info_Line
  )
  
  &match=0
  &wild_head=0
  &wild_tail=0
  &clk_input_length=STRING.LENGTH("&clk")
  &clk_itr_length=STRING.LENGTH("usb2_phy_wrapper_gcc_usb3_utmi_2_clk")

  if (STRING.SCAN("&clk", "*", 0)==0)
  (
    &wild_head=1
  )
  if (STRING.SCAN("&clk", "*", 1)==(STRING.LENGTH("&clk")-1))
  (
    &wild_tail=1
  )

  if ((&wild_head==1)&&(&wild_tail==1))
  (
    if (STRING.SCAN("usb2_phy_wrapper_gcc_usb3_utmi_2_clk", STRING.MID("&clk", 1, &clk_input_length-2), 0)!=-1)
    ( 
      &match=1
    )
  )
  else if (&wild_head==1)
  (
    if (STRING.MID("usb2_phy_wrapper_gcc_usb3_utmi_2_clk", &clk_itr_length-&clk_input_length+1, &clk_input_length-1)==STRING.CUT("&clk", 1))
    ( 
      &match=1
    )
  )
  else if (&wild_tail==1)
  (
    if (STRING.MID("usb2_phy_wrapper_gcc_usb3_utmi_2_clk", 0, &clk_input_length-1)==STRING.CUT("&clk", -1))
    ( 
      &match=1
    )
  )	  
  else if ("usb2_phy_wrapper_gcc_usb3_utmi_2_clk"=="&clk")
  (
    &match=1
  )
  
  if (&match==1)
  (
    &clk_test=&CLK_TEST_USB2_PHY_WRAPPER_GCC_USB3_UTMI_2_CLK
    &clk_reg=0
    &clk_reg_name="No CBCR"
    &clk_name="usb2_phy_wrapper_gcc_usb3_utmi_2_clk"
    &clk_reg_cbcr_type=""

    gosub Print_Clk_Info_Line
  )
  
  &match=0
  &wild_head=0
  &wild_tail=0
  &clk_input_length=STRING.LENGTH("&clk")
  &clk_itr_length=STRING.LENGTH("gcc_usb30_sec_master_clk")

  if (STRING.SCAN("&clk", "*", 0)==0)
  (
    &wild_head=1
  )
  if (STRING.SCAN("&clk", "*", 1)==(STRING.LENGTH("&clk")-1))
  (
    &wild_tail=1
  )

  if ((&wild_head==1)&&(&wild_tail==1))
  (
    if (STRING.SCAN("gcc_usb30_sec_master_clk", STRING.MID("&clk", 1, &clk_input_length-2), 0)!=-1)
    ( 
      &match=1
    )
  )
  else if (&wild_head==1)
  (
    if (STRING.MID("gcc_usb30_sec_master_clk", &clk_itr_length-&clk_input_length+1, &clk_input_length-1)==STRING.CUT("&clk", 1))
    ( 
      &match=1
    )
  )
  else if (&wild_tail==1)
  (
    if (STRING.MID("gcc_usb30_sec_master_clk", 0, &clk_input_length-1)==STRING.CUT("&clk", -1))
    ( 
      &match=1
    )
  )	  
  else if ("gcc_usb30_sec_master_clk"=="&clk")
  (
    &match=1
  )
  
  if (&match==1)
  (
    &clk_test=&CLK_TEST_GCC_USB30_SEC_MASTER_CLK
    &clk_reg=&HWIO_GCC_USB30_SEC_MASTER_CBCR_ADDR
    &clk_reg_name="GCC_USB30_SEC_MASTER_CBCR"
    &clk_name="gcc_usb30_sec_master_clk"
    &clk_reg_cbcr_type="sm_pscbc"

    gosub Print_Clk_Info_Line
  )
  
  &match=0
  &wild_head=0
  &wild_tail=0
  &clk_input_length=STRING.LENGTH("&clk")
  &clk_itr_length=STRING.LENGTH("gcc_usb30_sec_mock_utmi_clk")

  if (STRING.SCAN("&clk", "*", 0)==0)
  (
    &wild_head=1
  )
  if (STRING.SCAN("&clk", "*", 1)==(STRING.LENGTH("&clk")-1))
  (
    &wild_tail=1
  )

  if ((&wild_head==1)&&(&wild_tail==1))
  (
    if (STRING.SCAN("gcc_usb30_sec_mock_utmi_clk", STRING.MID("&clk", 1, &clk_input_length-2), 0)!=-1)
    ( 
      &match=1
    )
  )
  else if (&wild_head==1)
  (
    if (STRING.MID("gcc_usb30_sec_mock_utmi_clk", &clk_itr_length-&clk_input_length+1, &clk_input_length-1)==STRING.CUT("&clk", 1))
    ( 
      &match=1
    )
  )
  else if (&wild_tail==1)
  (
    if (STRING.MID("gcc_usb30_sec_mock_utmi_clk", 0, &clk_input_length-1)==STRING.CUT("&clk", -1))
    ( 
      &match=1
    )
  )	  
  else if ("gcc_usb30_sec_mock_utmi_clk"=="&clk")
  (
    &match=1
  )
  
  if (&match==1)
  (
    &clk_test=&CLK_TEST_GCC_USB30_SEC_MOCK_UTMI_CLK
    &clk_reg=&HWIO_GCC_USB30_SEC_MOCK_UTMI_CBCR_ADDR
    &clk_reg_name="GCC_USB30_SEC_MOCK_UTMI_CBCR"
    &clk_name="gcc_usb30_sec_mock_utmi_clk"
    &clk_reg_cbcr_type="sm_cbc"

    gosub Print_Clk_Info_Line
  )
  
  &match=0
  &wild_head=0
  &wild_tail=0
  &clk_input_length=STRING.LENGTH("&clk")
  &clk_itr_length=STRING.LENGTH("gcc_usb30_sec_sleep_clk")

  if (STRING.SCAN("&clk", "*", 0)==0)
  (
    &wild_head=1
  )
  if (STRING.SCAN("&clk", "*", 1)==(STRING.LENGTH("&clk")-1))
  (
    &wild_tail=1
  )

  if ((&wild_head==1)&&(&wild_tail==1))
  (
    if (STRING.SCAN("gcc_usb30_sec_sleep_clk", STRING.MID("&clk", 1, &clk_input_length-2), 0)!=-1)
    ( 
      &match=1
    )
  )
  else if (&wild_head==1)
  (
    if (STRING.MID("gcc_usb30_sec_sleep_clk", &clk_itr_length-&clk_input_length+1, &clk_input_length-1)==STRING.CUT("&clk", 1))
    ( 
      &match=1
    )
  )
  else if (&wild_tail==1)
  (
    if (STRING.MID("gcc_usb30_sec_sleep_clk", 0, &clk_input_length-1)==STRING.CUT("&clk", -1))
    ( 
      &match=1
    )
  )	  
  else if ("gcc_usb30_sec_sleep_clk"=="&clk")
  (
    &match=1
  )
  
  if (&match==1)
  (
    &clk_test=&CLK_TEST_GCC_USB30_SEC_SLEEP_CLK
    &clk_reg=&HWIO_GCC_USB30_SEC_SLEEP_CBCR_ADDR
    &clk_reg_name="GCC_USB30_SEC_SLEEP_CBCR"
    &clk_name="gcc_usb30_sec_sleep_clk"
    &clk_reg_cbcr_type="sm_cbc"

    gosub Print_Clk_Info_Line
  )
  
  &match=0
  &wild_head=0
  &wild_tail=0
  &clk_input_length=STRING.LENGTH("&clk")
  &clk_itr_length=STRING.LENGTH("usb2_phy_wrapper_gcc_usb30_sec_utmi_clk")

  if (STRING.SCAN("&clk", "*", 0)==0)
  (
    &wild_head=1
  )
  if (STRING.SCAN("&clk", "*", 1)==(STRING.LENGTH("&clk")-1))
  (
    &wild_tail=1
  )

  if ((&wild_head==1)&&(&wild_tail==1))
  (
    if (STRING.SCAN("usb2_phy_wrapper_gcc_usb30_sec_utmi_clk", STRING.MID("&clk", 1, &clk_input_length-2), 0)!=-1)
    ( 
      &match=1
    )
  )
  else if (&wild_head==1)
  (
    if (STRING.MID("usb2_phy_wrapper_gcc_usb30_sec_utmi_clk", &clk_itr_length-&clk_input_length+1, &clk_input_length-1)==STRING.CUT("&clk", 1))
    ( 
      &match=1
    )
  )
  else if (&wild_tail==1)
  (
    if (STRING.MID("usb2_phy_wrapper_gcc_usb30_sec_utmi_clk", 0, &clk_input_length-1)==STRING.CUT("&clk", -1))
    ( 
      &match=1
    )
  )	  
  else if ("usb2_phy_wrapper_gcc_usb30_sec_utmi_clk"=="&clk")
  (
    &match=1
  )
  
  if (&match==1)
  (
    &clk_test=&CLK_TEST_USB2_PHY_WRAPPER_GCC_USB30_SEC_UTMI_CLK
    &clk_reg=0
    &clk_reg_name="No CBCR"
    &clk_name="usb2_phy_wrapper_gcc_usb30_sec_utmi_clk"
    &clk_reg_cbcr_type=""

    gosub Print_Clk_Info_Line
  )
  
  &match=0
  &wild_head=0
  &wild_tail=0
  &clk_input_length=STRING.LENGTH("&clk")
  &clk_itr_length=STRING.LENGTH("usb3_phy_wrapper_gcc_usb3_sec_pipe_clk")

  if (STRING.SCAN("&clk", "*", 0)==0)
  (
    &wild_head=1
  )
  if (STRING.SCAN("&clk", "*", 1)==(STRING.LENGTH("&clk")-1))
  (
    &wild_tail=1
  )

  if ((&wild_head==1)&&(&wild_tail==1))
  (
    if (STRING.SCAN("usb3_phy_wrapper_gcc_usb3_sec_pipe_clk", STRING.MID("&clk", 1, &clk_input_length-2), 0)!=-1)
    ( 
      &match=1
    )
  )
  else if (&wild_head==1)
  (
    if (STRING.MID("usb3_phy_wrapper_gcc_usb3_sec_pipe_clk", &clk_itr_length-&clk_input_length+1, &clk_input_length-1)==STRING.CUT("&clk", 1))
    ( 
      &match=1
    )
  )
  else if (&wild_tail==1)
  (
    if (STRING.MID("usb3_phy_wrapper_gcc_usb3_sec_pipe_clk", 0, &clk_input_length-1)==STRING.CUT("&clk", -1))
    ( 
      &match=1
    )
  )	  
  else if ("usb3_phy_wrapper_gcc_usb3_sec_pipe_clk"=="&clk")
  (
    &match=1
  )
  
  if (&match==1)
  (
    &clk_test=&CLK_TEST_USB3_PHY_WRAPPER_GCC_USB3_SEC_PIPE_CLK
    &clk_reg=0
    &clk_reg_name="No CBCR"
    &clk_name="usb3_phy_wrapper_gcc_usb3_sec_pipe_clk"
    &clk_reg_cbcr_type=""

    gosub Print_Clk_Info_Line
  )
  
  &match=0
  &wild_head=0
  &wild_tail=0
  &clk_input_length=STRING.LENGTH("&clk")
  &clk_itr_length=STRING.LENGTH("gcc_usb_hs_ahb_clk")

  if (STRING.SCAN("&clk", "*", 0)==0)
  (
    &wild_head=1
  )
  if (STRING.SCAN("&clk", "*", 1)==(STRING.LENGTH("&clk")-1))
  (
    &wild_tail=1
  )

  if ((&wild_head==1)&&(&wild_tail==1))
  (
    if (STRING.SCAN("gcc_usb_hs_ahb_clk", STRING.MID("&clk", 1, &clk_input_length-2), 0)!=-1)
    ( 
      &match=1
    )
  )
  else if (&wild_head==1)
  (
    if (STRING.MID("gcc_usb_hs_ahb_clk", &clk_itr_length-&clk_input_length+1, &clk_input_length-1)==STRING.CUT("&clk", 1))
    ( 
      &match=1
    )
  )
  else if (&wild_tail==1)
  (
    if (STRING.MID("gcc_usb_hs_ahb_clk", 0, &clk_input_length-1)==STRING.CUT("&clk", -1))
    ( 
      &match=1
    )
  )	  
  else if ("gcc_usb_hs_ahb_clk"=="&clk")
  (
    &match=1
  )
  
  if (&match==1)
  (
    &clk_test=&CLK_TEST_GCC_USB_HS_AHB_CLK
    &clk_reg=&HWIO_GCC_USB_HS_AHB_CBCR_ADDR
    &clk_reg_name="GCC_USB_HS_AHB_CBCR"
    &clk_name="gcc_usb_hs_ahb_clk"
    &clk_reg_cbcr_type="sm_pscbc"

    gosub Print_Clk_Info_Line
  )
  
  &match=0
  &wild_head=0
  &wild_tail=0
  &clk_input_length=STRING.LENGTH("&clk")
  &clk_itr_length=STRING.LENGTH("gcc_usb_hs_inactivity_timers_clk")

  if (STRING.SCAN("&clk", "*", 0)==0)
  (
    &wild_head=1
  )
  if (STRING.SCAN("&clk", "*", 1)==(STRING.LENGTH("&clk")-1))
  (
    &wild_tail=1
  )

  if ((&wild_head==1)&&(&wild_tail==1))
  (
    if (STRING.SCAN("gcc_usb_hs_inactivity_timers_clk", STRING.MID("&clk", 1, &clk_input_length-2), 0)!=-1)
    ( 
      &match=1
    )
  )
  else if (&wild_head==1)
  (
    if (STRING.MID("gcc_usb_hs_inactivity_timers_clk", &clk_itr_length-&clk_input_length+1, &clk_input_length-1)==STRING.CUT("&clk", 1))
    ( 
      &match=1
    )
  )
  else if (&wild_tail==1)
  (
    if (STRING.MID("gcc_usb_hs_inactivity_timers_clk", 0, &clk_input_length-1)==STRING.CUT("&clk", -1))
    ( 
      &match=1
    )
  )	  
  else if ("gcc_usb_hs_inactivity_timers_clk"=="&clk")
  (
    &match=1
  )
  
  if (&match==1)
  (
    &clk_test=&CLK_TEST_GCC_USB_HS_INACTIVITY_TIMERS_CLK
    &clk_reg=&HWIO_GCC_USB_HS_INACTIVITY_TIMERS_CBCR_ADDR
    &clk_reg_name="GCC_USB_HS_INACTIVITY_TIMERS_CBCR"
    &clk_name="gcc_usb_hs_inactivity_timers_clk"
    &clk_reg_cbcr_type="sm_cbc"

    gosub Print_Clk_Info_Line
  )
  
  &match=0
  &wild_head=0
  &wild_tail=0
  &clk_input_length=STRING.LENGTH("&clk")
  &clk_itr_length=STRING.LENGTH("gcc_usb_hs_system_clk")

  if (STRING.SCAN("&clk", "*", 0)==0)
  (
    &wild_head=1
  )
  if (STRING.SCAN("&clk", "*", 1)==(STRING.LENGTH("&clk")-1))
  (
    &wild_tail=1
  )

  if ((&wild_head==1)&&(&wild_tail==1))
  (
    if (STRING.SCAN("gcc_usb_hs_system_clk", STRING.MID("&clk", 1, &clk_input_length-2), 0)!=-1)
    ( 
      &match=1
    )
  )
  else if (&wild_head==1)
  (
    if (STRING.MID("gcc_usb_hs_system_clk", &clk_itr_length-&clk_input_length+1, &clk_input_length-1)==STRING.CUT("&clk", 1))
    ( 
      &match=1
    )
  )
  else if (&wild_tail==1)
  (
    if (STRING.MID("gcc_usb_hs_system_clk", 0, &clk_input_length-1)==STRING.CUT("&clk", -1))
    ( 
      &match=1
    )
  )	  
  else if ("gcc_usb_hs_system_clk"=="&clk")
  (
    &match=1
  )
  
  if (&match==1)
  (
    &clk_test=&CLK_TEST_GCC_USB_HS_SYSTEM_CLK
    &clk_reg=&HWIO_GCC_USB_HS_SYSTEM_CBCR_ADDR
    &clk_reg_name="GCC_USB_HS_SYSTEM_CBCR"
    &clk_name="gcc_usb_hs_system_clk"
    &clk_reg_cbcr_type="sm_pscbc"

    gosub Print_Clk_Info_Line
  )
  
  &match=0
  &wild_head=0
  &wild_tail=0
  &clk_input_length=STRING.LENGTH("&clk")
  &clk_itr_length=STRING.LENGTH("gcc_usb_hsic_ahb_clk")

  if (STRING.SCAN("&clk", "*", 0)==0)
  (
    &wild_head=1
  )
  if (STRING.SCAN("&clk", "*", 1)==(STRING.LENGTH("&clk")-1))
  (
    &wild_tail=1
  )

  if ((&wild_head==1)&&(&wild_tail==1))
  (
    if (STRING.SCAN("gcc_usb_hsic_ahb_clk", STRING.MID("&clk", 1, &clk_input_length-2), 0)!=-1)
    ( 
      &match=1
    )
  )
  else if (&wild_head==1)
  (
    if (STRING.MID("gcc_usb_hsic_ahb_clk", &clk_itr_length-&clk_input_length+1, &clk_input_length-1)==STRING.CUT("&clk", 1))
    ( 
      &match=1
    )
  )
  else if (&wild_tail==1)
  (
    if (STRING.MID("gcc_usb_hsic_ahb_clk", 0, &clk_input_length-1)==STRING.CUT("&clk", -1))
    ( 
      &match=1
    )
  )	  
  else if ("gcc_usb_hsic_ahb_clk"=="&clk")
  (
    &match=1
  )
  
  if (&match==1)
  (
    &clk_test=&CLK_TEST_GCC_USB_HSIC_AHB_CLK
    &clk_reg=&HWIO_GCC_USB_HSIC_AHB_CBCR_ADDR
    &clk_reg_name="GCC_USB_HSIC_AHB_CBCR"
    &clk_name="gcc_usb_hsic_ahb_clk"
    &clk_reg_cbcr_type="sm_pscbc"

    gosub Print_Clk_Info_Line
  )
  
  &match=0
  &wild_head=0
  &wild_tail=0
  &clk_input_length=STRING.LENGTH("&clk")
  &clk_itr_length=STRING.LENGTH("gcc_usb_hsic_clk")

  if (STRING.SCAN("&clk", "*", 0)==0)
  (
    &wild_head=1
  )
  if (STRING.SCAN("&clk", "*", 1)==(STRING.LENGTH("&clk")-1))
  (
    &wild_tail=1
  )

  if ((&wild_head==1)&&(&wild_tail==1))
  (
    if (STRING.SCAN("gcc_usb_hsic_clk", STRING.MID("&clk", 1, &clk_input_length-2), 0)!=-1)
    ( 
      &match=1
    )
  )
  else if (&wild_head==1)
  (
    if (STRING.MID("gcc_usb_hsic_clk", &clk_itr_length-&clk_input_length+1, &clk_input_length-1)==STRING.CUT("&clk", 1))
    ( 
      &match=1
    )
  )
  else if (&wild_tail==1)
  (
    if (STRING.MID("gcc_usb_hsic_clk", 0, &clk_input_length-1)==STRING.CUT("&clk", -1))
    ( 
      &match=1
    )
  )	  
  else if ("gcc_usb_hsic_clk"=="&clk")
  (
    &match=1
  )
  
  if (&match==1)
  (
    &clk_test=&CLK_TEST_GCC_USB_HSIC_CLK
    &clk_reg=&HWIO_GCC_USB_HSIC_CBCR_ADDR
    &clk_reg_name="GCC_USB_HSIC_CBCR"
    &clk_name="gcc_usb_hsic_clk"
    &clk_reg_cbcr_type="sm_cbc"

    gosub Print_Clk_Info_Line
  )
  
  &match=0
  &wild_head=0
  &wild_tail=0
  &clk_input_length=STRING.LENGTH("&clk")
  &clk_itr_length=STRING.LENGTH("gcc_usb_hsic_io_cal_clk")

  if (STRING.SCAN("&clk", "*", 0)==0)
  (
    &wild_head=1
  )
  if (STRING.SCAN("&clk", "*", 1)==(STRING.LENGTH("&clk")-1))
  (
    &wild_tail=1
  )

  if ((&wild_head==1)&&(&wild_tail==1))
  (
    if (STRING.SCAN("gcc_usb_hsic_io_cal_clk", STRING.MID("&clk", 1, &clk_input_length-2), 0)!=-1)
    ( 
      &match=1
    )
  )
  else if (&wild_head==1)
  (
    if (STRING.MID("gcc_usb_hsic_io_cal_clk", &clk_itr_length-&clk_input_length+1, &clk_input_length-1)==STRING.CUT("&clk", 1))
    ( 
      &match=1
    )
  )
  else if (&wild_tail==1)
  (
    if (STRING.MID("gcc_usb_hsic_io_cal_clk", 0, &clk_input_length-1)==STRING.CUT("&clk", -1))
    ( 
      &match=1
    )
  )	  
  else if ("gcc_usb_hsic_io_cal_clk"=="&clk")
  (
    &match=1
  )
  
  if (&match==1)
  (
    &clk_test=&CLK_TEST_GCC_USB_HSIC_IO_CAL_CLK
    &clk_reg=&HWIO_GCC_USB_HSIC_IO_CAL_CBCR_ADDR
    &clk_reg_name="GCC_USB_HSIC_IO_CAL_CBCR"
    &clk_name="gcc_usb_hsic_io_cal_clk"
    &clk_reg_cbcr_type="sm_cbc"

    gosub Print_Clk_Info_Line
  )
  
  &match=0
  &wild_head=0
  &wild_tail=0
  &clk_input_length=STRING.LENGTH("&clk")
  &clk_itr_length=STRING.LENGTH("gcc_usb_hsic_io_cal_sleep_clk")

  if (STRING.SCAN("&clk", "*", 0)==0)
  (
    &wild_head=1
  )
  if (STRING.SCAN("&clk", "*", 1)==(STRING.LENGTH("&clk")-1))
  (
    &wild_tail=1
  )

  if ((&wild_head==1)&&(&wild_tail==1))
  (
    if (STRING.SCAN("gcc_usb_hsic_io_cal_sleep_clk", STRING.MID("&clk", 1, &clk_input_length-2), 0)!=-1)
    ( 
      &match=1
    )
  )
  else if (&wild_head==1)
  (
    if (STRING.MID("gcc_usb_hsic_io_cal_sleep_clk", &clk_itr_length-&clk_input_length+1, &clk_input_length-1)==STRING.CUT("&clk", 1))
    ( 
      &match=1
    )
  )
  else if (&wild_tail==1)
  (
    if (STRING.MID("gcc_usb_hsic_io_cal_sleep_clk", 0, &clk_input_length-1)==STRING.CUT("&clk", -1))
    ( 
      &match=1
    )
  )	  
  else if ("gcc_usb_hsic_io_cal_sleep_clk"=="&clk")
  (
    &match=1
  )
  
  if (&match==1)
  (
    &clk_test=&CLK_TEST_GCC_USB_HSIC_IO_CAL_SLEEP_CLK
    &clk_reg=&HWIO_GCC_USB_HSIC_IO_CAL_SLEEP_CBCR_ADDR
    &clk_reg_name="GCC_USB_HSIC_IO_CAL_SLEEP_CBCR"
    &clk_name="gcc_usb_hsic_io_cal_sleep_clk"
    &clk_reg_cbcr_type="sm_cbc"

    gosub Print_Clk_Info_Line
  )
  
  &match=0
  &wild_head=0
  &wild_tail=0
  &clk_input_length=STRING.LENGTH("&clk")
  &clk_itr_length=STRING.LENGTH("gcc_usb_hsic_mock_utmi_clk")

  if (STRING.SCAN("&clk", "*", 0)==0)
  (
    &wild_head=1
  )
  if (STRING.SCAN("&clk", "*", 1)==(STRING.LENGTH("&clk")-1))
  (
    &wild_tail=1
  )

  if ((&wild_head==1)&&(&wild_tail==1))
  (
    if (STRING.SCAN("gcc_usb_hsic_mock_utmi_clk", STRING.MID("&clk", 1, &clk_input_length-2), 0)!=-1)
    ( 
      &match=1
    )
  )
  else if (&wild_head==1)
  (
    if (STRING.MID("gcc_usb_hsic_mock_utmi_clk", &clk_itr_length-&clk_input_length+1, &clk_input_length-1)==STRING.CUT("&clk", 1))
    ( 
      &match=1
    )
  )
  else if (&wild_tail==1)
  (
    if (STRING.MID("gcc_usb_hsic_mock_utmi_clk", 0, &clk_input_length-1)==STRING.CUT("&clk", -1))
    ( 
      &match=1
    )
  )	  
  else if ("gcc_usb_hsic_mock_utmi_clk"=="&clk")
  (
    &match=1
  )
  
  if (&match==1)
  (
    &clk_test=&CLK_TEST_GCC_USB_HSIC_MOCK_UTMI_CLK
    &clk_reg=&HWIO_GCC_USB_HSIC_MOCK_UTMI_CBCR_ADDR
    &clk_reg_name="GCC_USB_HSIC_MOCK_UTMI_CBCR"
    &clk_name="gcc_usb_hsic_mock_utmi_clk"
    &clk_reg_cbcr_type="sm_cbc"

    gosub Print_Clk_Info_Line
  )
  
  &match=0
  &wild_head=0
  &wild_tail=0
  &clk_input_length=STRING.LENGTH("&clk")
  &clk_itr_length=STRING.LENGTH("gcc_usb_hsic_system_clk")

  if (STRING.SCAN("&clk", "*", 0)==0)
  (
    &wild_head=1
  )
  if (STRING.SCAN("&clk", "*", 1)==(STRING.LENGTH("&clk")-1))
  (
    &wild_tail=1
  )

  if ((&wild_head==1)&&(&wild_tail==1))
  (
    if (STRING.SCAN("gcc_usb_hsic_system_clk", STRING.MID("&clk", 1, &clk_input_length-2), 0)!=-1)
    ( 
      &match=1
    )
  )
  else if (&wild_head==1)
  (
    if (STRING.MID("gcc_usb_hsic_system_clk", &clk_itr_length-&clk_input_length+1, &clk_input_length-1)==STRING.CUT("&clk", 1))
    ( 
      &match=1
    )
  )
  else if (&wild_tail==1)
  (
    if (STRING.MID("gcc_usb_hsic_system_clk", 0, &clk_input_length-1)==STRING.CUT("&clk", -1))
    ( 
      &match=1
    )
  )	  
  else if ("gcc_usb_hsic_system_clk"=="&clk")
  (
    &match=1
  )
  
  if (&match==1)
  (
    &clk_test=&CLK_TEST_GCC_USB_HSIC_SYSTEM_CLK
    &clk_reg=&HWIO_GCC_USB_HSIC_SYSTEM_CBCR_ADDR
    &clk_reg_name="GCC_USB_HSIC_SYSTEM_CBCR"
    &clk_name="gcc_usb_hsic_system_clk"
    &clk_reg_cbcr_type="sm_pscbc"

    gosub Print_Clk_Info_Line
  )
  
  &match=0
  &wild_head=0
  &wild_tail=0
  &clk_input_length=STRING.LENGTH("&clk")
  &clk_itr_length=STRING.LENGTH("gcc_periph_noc_mpu_cfg_ahb_clk")

  if (STRING.SCAN("&clk", "*", 0)==0)
  (
    &wild_head=1
  )
  if (STRING.SCAN("&clk", "*", 1)==(STRING.LENGTH("&clk")-1))
  (
    &wild_tail=1
  )

  if ((&wild_head==1)&&(&wild_tail==1))
  (
    if (STRING.SCAN("gcc_periph_noc_mpu_cfg_ahb_clk", STRING.MID("&clk", 1, &clk_input_length-2), 0)!=-1)
    ( 
      &match=1
    )
  )
  else if (&wild_head==1)
  (
    if (STRING.MID("gcc_periph_noc_mpu_cfg_ahb_clk", &clk_itr_length-&clk_input_length+1, &clk_input_length-1)==STRING.CUT("&clk", 1))
    ( 
      &match=1
    )
  )
  else if (&wild_tail==1)
  (
    if (STRING.MID("gcc_periph_noc_mpu_cfg_ahb_clk", 0, &clk_input_length-1)==STRING.CUT("&clk", -1))
    ( 
      &match=1
    )
  )	  
  else if ("gcc_periph_noc_mpu_cfg_ahb_clk"=="&clk")
  (
    &match=1
  )
  
  if (&match==1)
  (
    &clk_test=&CLK_TEST_GCC_PERIPH_NOC_MPU_CFG_AHB_CLK
    &clk_reg=&HWIO_GCC_PERIPH_NOC_MPU_CFG_AHB_CBCR_ADDR
    &clk_reg_name="GCC_PERIPH_NOC_MPU_CFG_AHB_CBCR"
    &clk_name="gcc_periph_noc_mpu_cfg_ahb_clk"
    &clk_reg_cbcr_type="sm_cbc"

    gosub Print_Clk_Info_Line
  )
  
  &match=0
  &wild_head=0
  &wild_tail=0
  &clk_input_length=STRING.LENGTH("&clk")
  &clk_itr_length=STRING.LENGTH("gcc_periph_xpu_ahb_clk")

  if (STRING.SCAN("&clk", "*", 0)==0)
  (
    &wild_head=1
  )
  if (STRING.SCAN("&clk", "*", 1)==(STRING.LENGTH("&clk")-1))
  (
    &wild_tail=1
  )

  if ((&wild_head==1)&&(&wild_tail==1))
  (
    if (STRING.SCAN("gcc_periph_xpu_ahb_clk", STRING.MID("&clk", 1, &clk_input_length-2), 0)!=-1)
    ( 
      &match=1
    )
  )
  else if (&wild_head==1)
  (
    if (STRING.MID("gcc_periph_xpu_ahb_clk", &clk_itr_length-&clk_input_length+1, &clk_input_length-1)==STRING.CUT("&clk", 1))
    ( 
      &match=1
    )
  )
  else if (&wild_tail==1)
  (
    if (STRING.MID("gcc_periph_xpu_ahb_clk", 0, &clk_input_length-1)==STRING.CUT("&clk", -1))
    ( 
      &match=1
    )
  )	  
  else if ("gcc_periph_xpu_ahb_clk"=="&clk")
  (
    &match=1
  )
  
  if (&match==1)
  (
    &clk_test=&CLK_TEST_GCC_PERIPH_XPU_AHB_CLK
    &clk_reg=&HWIO_GCC_PERIPH_XPU_AHB_CBCR_ADDR
    &clk_reg_name="GCC_PERIPH_XPU_AHB_CBCR"
    &clk_name="gcc_periph_xpu_ahb_clk"
    &clk_reg_cbcr_type="sm_cbc"

    gosub Print_Clk_Info_Line
  )
  
; Setting appropriate access mode for non-MSS clocks
&clk_access_mod="eahb:"

  &match=0
  &wild_head=0
  &wild_tail=0
  &clk_input_length=STRING.LENGTH("&clk")
  &clk_itr_length=STRING.LENGTH("atime_clk_src")

  if (STRING.SCAN("&clk", "*", 0)==0)
  (
    &wild_head=1
  )
  if (STRING.SCAN("&clk", "*", 1)==(STRING.LENGTH("&clk")-1))
  (
    &wild_tail=1
  )

  if ((&wild_head==1)&&(&wild_tail==1))
  (
    if (STRING.SCAN("atime_clk_src", STRING.MID("&clk", 1, &clk_input_length-2), 0)!=-1)
    ( 
      &match=1
    )
  )
  else if (&wild_head==1)
  (
    if (STRING.MID("atime_clk_src", &clk_itr_length-&clk_input_length+1, &clk_input_length-1)==STRING.CUT("&clk", 1))
    ( 
      &match=1
    )
  )
  else if (&wild_tail==1)
  (
    if (STRING.MID("atime_clk_src", 0, &clk_input_length-1)==STRING.CUT("&clk", -1))
    ( 
      &match=1
    )
  )	  
  else if ("atime_clk_src"=="&clk")
  (
    &match=1
  )
  
  if (&match==1)
  (
    &clk_test=&CLK_TEST_ATIME_CLK_SRC
    &clk_reg=0
    &clk_reg_name="No CBCR"
    &clk_name="atime_clk_src"
    &clk_reg_cbcr_type=""

    gosub Print_Clk_Info_Line
  )
  
  &match=0
  &wild_head=0
  &wild_tail=0
  &clk_input_length=STRING.LENGTH("&clk")
  &clk_itr_length=STRING.LENGTH("lpass_core_avsync_atime_clk")

  if (STRING.SCAN("&clk", "*", 0)==0)
  (
    &wild_head=1
  )
  if (STRING.SCAN("&clk", "*", 1)==(STRING.LENGTH("&clk")-1))
  (
    &wild_tail=1
  )

  if ((&wild_head==1)&&(&wild_tail==1))
  (
    if (STRING.SCAN("lpass_core_avsync_atime_clk", STRING.MID("&clk", 1, &clk_input_length-2), 0)!=-1)
    ( 
      &match=1
    )
  )
  else if (&wild_head==1)
  (
    if (STRING.MID("lpass_core_avsync_atime_clk", &clk_itr_length-&clk_input_length+1, &clk_input_length-1)==STRING.CUT("&clk", 1))
    ( 
      &match=1
    )
  )
  else if (&wild_tail==1)
  (
    if (STRING.MID("lpass_core_avsync_atime_clk", 0, &clk_input_length-1)==STRING.CUT("&clk", -1))
    ( 
      &match=1
    )
  )	  
  else if ("lpass_core_avsync_atime_clk"=="&clk")
  (
    &match=1
  )
  
  if (&match==1)
  (
    &clk_test=&CLK_TEST_LPASS_CORE_AVSYNC_ATIME_CLK
    &clk_reg=0
    &clk_reg_name="No CBCR"
    &clk_name="lpass_core_avsync_atime_clk"
    &clk_reg_cbcr_type="sm_cbc"

    gosub Print_Clk_Info_Line
  )
  
  &match=0
  &wild_head=0
  &wild_tail=0
  &clk_input_length=STRING.LENGTH("&clk")
  &clk_itr_length=STRING.LENGTH("ahb_spdmtm_clk")

  if (STRING.SCAN("&clk", "*", 0)==0)
  (
    &wild_head=1
  )
  if (STRING.SCAN("&clk", "*", 1)==(STRING.LENGTH("&clk")-1))
  (
    &wild_tail=1
  )

  if ((&wild_head==1)&&(&wild_tail==1))
  (
    if (STRING.SCAN("ahb_spdmtm_clk", STRING.MID("&clk", 1, &clk_input_length-2), 0)!=-1)
    ( 
      &match=1
    )
  )
  else if (&wild_head==1)
  (
    if (STRING.MID("ahb_spdmtm_clk", &clk_itr_length-&clk_input_length+1, &clk_input_length-1)==STRING.CUT("&clk", 1))
    ( 
      &match=1
    )
  )
  else if (&wild_tail==1)
  (
    if (STRING.MID("ahb_spdmtm_clk", 0, &clk_input_length-1)==STRING.CUT("&clk", -1))
    ( 
      &match=1
    )
  )	  
  else if ("ahb_spdmtm_clk"=="&clk")
  (
    &match=1
  )
  
  if (&match==1)
  (
    &clk_test=&CLK_TEST_AHB_SPDMTM_CLK
    &clk_reg=0
    &clk_reg_name="No CBCR"
    &clk_name="ahb_spdmtm_clk"
    &clk_reg_cbcr_type="sm_cbc"

    gosub Print_Clk_Info_Line
  )
  
  &match=0
  &wild_head=0
  &wild_tail=0
  &clk_input_length=STRING.LENGTH("&clk")
  &clk_itr_length=STRING.LENGTH("ahbfabric_clk_src")

  if (STRING.SCAN("&clk", "*", 0)==0)
  (
    &wild_head=1
  )
  if (STRING.SCAN("&clk", "*", 1)==(STRING.LENGTH("&clk")-1))
  (
    &wild_tail=1
  )

  if ((&wild_head==1)&&(&wild_tail==1))
  (
    if (STRING.SCAN("ahbfabric_clk_src", STRING.MID("&clk", 1, &clk_input_length-2), 0)!=-1)
    ( 
      &match=1
    )
  )
  else if (&wild_head==1)
  (
    if (STRING.MID("ahbfabric_clk_src", &clk_itr_length-&clk_input_length+1, &clk_input_length-1)==STRING.CUT("&clk", 1))
    ( 
      &match=1
    )
  )
  else if (&wild_tail==1)
  (
    if (STRING.MID("ahbfabric_clk_src", 0, &clk_input_length-1)==STRING.CUT("&clk", -1))
    ( 
      &match=1
    )
  )	  
  else if ("ahbfabric_clk_src"=="&clk")
  (
    &match=1
  )
  
  if (&match==1)
  (
    &clk_test=&CLK_TEST_AHBFABRIC_CLK_SRC
    &clk_reg=0
    &clk_reg_name="No CBCR"
    &clk_name="ahbfabric_clk_src"
    &clk_reg_cbcr_type=""

    gosub Print_Clk_Info_Line
  )
  
  &match=0
  &wild_head=0
  &wild_tail=0
  &clk_input_length=STRING.LENGTH("&clk")
  &clk_itr_length=STRING.LENGTH("audio_core_aon_clk")

  if (STRING.SCAN("&clk", "*", 0)==0)
  (
    &wild_head=1
  )
  if (STRING.SCAN("&clk", "*", 1)==(STRING.LENGTH("&clk")-1))
  (
    &wild_tail=1
  )

  if ((&wild_head==1)&&(&wild_tail==1))
  (
    if (STRING.SCAN("audio_core_aon_clk", STRING.MID("&clk", 1, &clk_input_length-2), 0)!=-1)
    ( 
      &match=1
    )
  )
  else if (&wild_head==1)
  (
    if (STRING.MID("audio_core_aon_clk", &clk_itr_length-&clk_input_length+1, &clk_input_length-1)==STRING.CUT("&clk", 1))
    ( 
      &match=1
    )
  )
  else if (&wild_tail==1)
  (
    if (STRING.MID("audio_core_aon_clk", 0, &clk_input_length-1)==STRING.CUT("&clk", -1))
    ( 
      &match=1
    )
  )	  
  else if ("audio_core_aon_clk"=="&clk")
  (
    &match=1
  )
  
  if (&match==1)
  (
    &clk_test=&CLK_TEST_AUDIO_CORE_AON_CLK
    &clk_reg=0
    &clk_reg_name="No CBCR"
    &clk_name="audio_core_aon_clk"
    &clk_reg_cbcr_type="sm_cbc"

    gosub Print_Clk_Info_Line
  )
  
  &match=0
  &wild_head=0
  &wild_tail=0
  &clk_input_length=STRING.LENGTH("&clk")
  &clk_itr_length=STRING.LENGTH("audio_core_avsync_csr_clk")

  if (STRING.SCAN("&clk", "*", 0)==0)
  (
    &wild_head=1
  )
  if (STRING.SCAN("&clk", "*", 1)==(STRING.LENGTH("&clk")-1))
  (
    &wild_tail=1
  )

  if ((&wild_head==1)&&(&wild_tail==1))
  (
    if (STRING.SCAN("audio_core_avsync_csr_clk", STRING.MID("&clk", 1, &clk_input_length-2), 0)!=-1)
    ( 
      &match=1
    )
  )
  else if (&wild_head==1)
  (
    if (STRING.MID("audio_core_avsync_csr_clk", &clk_itr_length-&clk_input_length+1, &clk_input_length-1)==STRING.CUT("&clk", 1))
    ( 
      &match=1
    )
  )
  else if (&wild_tail==1)
  (
    if (STRING.MID("audio_core_avsync_csr_clk", 0, &clk_input_length-1)==STRING.CUT("&clk", -1))
    ( 
      &match=1
    )
  )	  
  else if ("audio_core_avsync_csr_clk"=="&clk")
  (
    &match=1
  )
  
  if (&match==1)
  (
    &clk_test=&CLK_TEST_AUDIO_CORE_AVSYNC_CSR_CLK
    &clk_reg=&HWIO_LPASS_AUDIO_CORE_AVSYNC_CSR_CBCR_ADDR
    &clk_reg_name="LPASS_AUDIO_CORE_AVSYNC_CSR_CBCR"
    &clk_name="audio_core_avsync_csr_clk"
    &clk_reg_cbcr_type="sm_cbc"

    gosub Print_Clk_Info_Line
  )
  
  &match=0
  &wild_head=0
  &wild_tail=0
  &clk_input_length=STRING.LENGTH("&clk")
  &clk_itr_length=STRING.LENGTH("audio_core_bstc_clk")

  if (STRING.SCAN("&clk", "*", 0)==0)
  (
    &wild_head=1
  )
  if (STRING.SCAN("&clk", "*", 1)==(STRING.LENGTH("&clk")-1))
  (
    &wild_tail=1
  )

  if ((&wild_head==1)&&(&wild_tail==1))
  (
    if (STRING.SCAN("audio_core_bstc_clk", STRING.MID("&clk", 1, &clk_input_length-2), 0)!=-1)
    ( 
      &match=1
    )
  )
  else if (&wild_head==1)
  (
    if (STRING.MID("audio_core_bstc_clk", &clk_itr_length-&clk_input_length+1, &clk_input_length-1)==STRING.CUT("&clk", 1))
    ( 
      &match=1
    )
  )
  else if (&wild_tail==1)
  (
    if (STRING.MID("audio_core_bstc_clk", 0, &clk_input_length-1)==STRING.CUT("&clk", -1))
    ( 
      &match=1
    )
  )	  
  else if ("audio_core_bstc_clk"=="&clk")
  (
    &match=1
  )
  
  if (&match==1)
  (
    &clk_test=&CLK_TEST_AUDIO_CORE_BSTC_CLK
    &clk_reg=&HWIO_LPASS_AUDIO_CORE_BSTC_CBCR_ADDR
    &clk_reg_name="LPASS_AUDIO_CORE_BSTC_CBCR"
    &clk_name="audio_core_bstc_clk"
    &clk_reg_cbcr_type="sm_pscbc"

    gosub Print_Clk_Info_Line
  )
  
  &match=0
  &wild_head=0
  &wild_tail=0
  &clk_input_length=STRING.LENGTH("&clk")
  &clk_itr_length=STRING.LENGTH("audio_core_csr_clk")

  if (STRING.SCAN("&clk", "*", 0)==0)
  (
    &wild_head=1
  )
  if (STRING.SCAN("&clk", "*", 1)==(STRING.LENGTH("&clk")-1))
  (
    &wild_tail=1
  )

  if ((&wild_head==1)&&(&wild_tail==1))
  (
    if (STRING.SCAN("audio_core_csr_clk", STRING.MID("&clk", 1, &clk_input_length-2), 0)!=-1)
    ( 
      &match=1
    )
  )
  else if (&wild_head==1)
  (
    if (STRING.MID("audio_core_csr_clk", &clk_itr_length-&clk_input_length+1, &clk_input_length-1)==STRING.CUT("&clk", 1))
    ( 
      &match=1
    )
  )
  else if (&wild_tail==1)
  (
    if (STRING.MID("audio_core_csr_clk", 0, &clk_input_length-1)==STRING.CUT("&clk", -1))
    ( 
      &match=1
    )
  )	  
  else if ("audio_core_csr_clk"=="&clk")
  (
    &match=1
  )
  
  if (&match==1)
  (
    &clk_test=&CLK_TEST_AUDIO_CORE_CSR_CLK
    &clk_reg=&HWIO_LPASS_AUDIO_CORE_CSR_CBCR_ADDR
    &clk_reg_name="LPASS_AUDIO_CORE_CSR_CBCR"
    &clk_name="audio_core_csr_clk"
    &clk_reg_cbcr_type="sm_cbc"

    gosub Print_Clk_Info_Line
  )
  
  &match=0
  &wild_head=0
  &wild_tail=0
  &clk_input_length=STRING.LENGTH("&clk")
  &clk_itr_length=STRING.LENGTH("audio_core_dml_clk")

  if (STRING.SCAN("&clk", "*", 0)==0)
  (
    &wild_head=1
  )
  if (STRING.SCAN("&clk", "*", 1)==(STRING.LENGTH("&clk")-1))
  (
    &wild_tail=1
  )

  if ((&wild_head==1)&&(&wild_tail==1))
  (
    if (STRING.SCAN("audio_core_dml_clk", STRING.MID("&clk", 1, &clk_input_length-2), 0)!=-1)
    ( 
      &match=1
    )
  )
  else if (&wild_head==1)
  (
    if (STRING.MID("audio_core_dml_clk", &clk_itr_length-&clk_input_length+1, &clk_input_length-1)==STRING.CUT("&clk", 1))
    ( 
      &match=1
    )
  )
  else if (&wild_tail==1)
  (
    if (STRING.MID("audio_core_dml_clk", 0, &clk_input_length-1)==STRING.CUT("&clk", -1))
    ( 
      &match=1
    )
  )	  
  else if ("audio_core_dml_clk"=="&clk")
  (
    &match=1
  )
  
  if (&match==1)
  (
    &clk_test=&CLK_TEST_AUDIO_CORE_DML_CLK
    &clk_reg=&HWIO_LPASS_AUDIO_CORE_DML_CBCR_ADDR
    &clk_reg_name="LPASS_AUDIO_CORE_DML_CBCR"
    &clk_name="audio_core_dml_clk"
    &clk_reg_cbcr_type="sm_cbc"

    gosub Print_Clk_Info_Line
  )
  
  &match=0
  &wild_head=0
  &wild_tail=0
  &clk_input_length=STRING.LENGTH("&clk")
  &clk_itr_length=STRING.LENGTH("audio_core_ixfabric_clk")

  if (STRING.SCAN("&clk", "*", 0)==0)
  (
    &wild_head=1
  )
  if (STRING.SCAN("&clk", "*", 1)==(STRING.LENGTH("&clk")-1))
  (
    &wild_tail=1
  )

  if ((&wild_head==1)&&(&wild_tail==1))
  (
    if (STRING.SCAN("audio_core_ixfabric_clk", STRING.MID("&clk", 1, &clk_input_length-2), 0)!=-1)
    ( 
      &match=1
    )
  )
  else if (&wild_head==1)
  (
    if (STRING.MID("audio_core_ixfabric_clk", &clk_itr_length-&clk_input_length+1, &clk_input_length-1)==STRING.CUT("&clk", 1))
    ( 
      &match=1
    )
  )
  else if (&wild_tail==1)
  (
    if (STRING.MID("audio_core_ixfabric_clk", 0, &clk_input_length-1)==STRING.CUT("&clk", -1))
    ( 
      &match=1
    )
  )	  
  else if ("audio_core_ixfabric_clk"=="&clk")
  (
    &match=1
  )
  
  if (&match==1)
  (
    &clk_test=&CLK_TEST_AUDIO_CORE_IXFABRIC_CLK
    &clk_reg=&HWIO_LPASS_AUDIO_CORE_IXFABRIC_CBCR_ADDR
    &clk_reg_name="LPASS_AUDIO_CORE_IXFABRIC_CBCR"
    &clk_name="audio_core_ixfabric_clk"
    &clk_reg_cbcr_type="sm_cbc"

    gosub Print_Clk_Info_Line
  )
  
  &match=0
  &wild_head=0
  &wild_tail=0
  &clk_input_length=STRING.LENGTH("&clk")
  &clk_itr_length=STRING.LENGTH("audio_core_ixfabric_spdmtm_csr_clk")

  if (STRING.SCAN("&clk", "*", 0)==0)
  (
    &wild_head=1
  )
  if (STRING.SCAN("&clk", "*", 1)==(STRING.LENGTH("&clk")-1))
  (
    &wild_tail=1
  )

  if ((&wild_head==1)&&(&wild_tail==1))
  (
    if (STRING.SCAN("audio_core_ixfabric_spdmtm_csr_clk", STRING.MID("&clk", 1, &clk_input_length-2), 0)!=-1)
    ( 
      &match=1
    )
  )
  else if (&wild_head==1)
  (
    if (STRING.MID("audio_core_ixfabric_spdmtm_csr_clk", &clk_itr_length-&clk_input_length+1, &clk_input_length-1)==STRING.CUT("&clk", 1))
    ( 
      &match=1
    )
  )
  else if (&wild_tail==1)
  (
    if (STRING.MID("audio_core_ixfabric_spdmtm_csr_clk", 0, &clk_input_length-1)==STRING.CUT("&clk", -1))
    ( 
      &match=1
    )
  )	  
  else if ("audio_core_ixfabric_spdmtm_csr_clk"=="&clk")
  (
    &match=1
  )
  
  if (&match==1)
  (
    &clk_test=&CLK_TEST_AUDIO_CORE_IXFABRIC_SPDMTM_CSR_CLK
    &clk_reg=&HWIO_LPASS_AUDIO_CORE_IXFABRIC_SPDMTM_CSR_CBCR_ADDR
    &clk_reg_name="LPASS_AUDIO_CORE_IXFABRIC_SPDMTM_CSR_CBCR"
    &clk_name="audio_core_ixfabric_spdmtm_csr_clk"
    &clk_reg_cbcr_type="sm_cbc"

    gosub Print_Clk_Info_Line
  )
  
  &match=0
  &wild_head=0
  &wild_tail=0
  &clk_input_length=STRING.LENGTH("&clk")
  &clk_itr_length=STRING.LENGTH("audio_core_lpaif_csr_clk")

  if (STRING.SCAN("&clk", "*", 0)==0)
  (
    &wild_head=1
  )
  if (STRING.SCAN("&clk", "*", 1)==(STRING.LENGTH("&clk")-1))
  (
    &wild_tail=1
  )

  if ((&wild_head==1)&&(&wild_tail==1))
  (
    if (STRING.SCAN("audio_core_lpaif_csr_clk", STRING.MID("&clk", 1, &clk_input_length-2), 0)!=-1)
    ( 
      &match=1
    )
  )
  else if (&wild_head==1)
  (
    if (STRING.MID("audio_core_lpaif_csr_clk", &clk_itr_length-&clk_input_length+1, &clk_input_length-1)==STRING.CUT("&clk", 1))
    ( 
      &match=1
    )
  )
  else if (&wild_tail==1)
  (
    if (STRING.MID("audio_core_lpaif_csr_clk", 0, &clk_input_length-1)==STRING.CUT("&clk", -1))
    ( 
      &match=1
    )
  )	  
  else if ("audio_core_lpaif_csr_clk"=="&clk")
  (
    &match=1
  )
  
  if (&match==1)
  (
    &clk_test=&CLK_TEST_AUDIO_CORE_LPAIF_CSR_CLK
    &clk_reg=&HWIO_LPASS_AUDIO_CORE_LPAIF_CSR_CBCR_ADDR
    &clk_reg_name="LPASS_AUDIO_CORE_LPAIF_CSR_CBCR"
    &clk_name="audio_core_lpaif_csr_clk"
    &clk_reg_cbcr_type="sm_cbc"

    gosub Print_Clk_Info_Line
  )
  
  &match=0
  &wild_head=0
  &wild_tail=0
  &clk_input_length=STRING.LENGTH("&clk")
  &clk_itr_length=STRING.LENGTH("audio_core_lpaif_dma_clk")

  if (STRING.SCAN("&clk", "*", 0)==0)
  (
    &wild_head=1
  )
  if (STRING.SCAN("&clk", "*", 1)==(STRING.LENGTH("&clk")-1))
  (
    &wild_tail=1
  )

  if ((&wild_head==1)&&(&wild_tail==1))
  (
    if (STRING.SCAN("audio_core_lpaif_dma_clk", STRING.MID("&clk", 1, &clk_input_length-2), 0)!=-1)
    ( 
      &match=1
    )
  )
  else if (&wild_head==1)
  (
    if (STRING.MID("audio_core_lpaif_dma_clk", &clk_itr_length-&clk_input_length+1, &clk_input_length-1)==STRING.CUT("&clk", 1))
    ( 
      &match=1
    )
  )
  else if (&wild_tail==1)
  (
    if (STRING.MID("audio_core_lpaif_dma_clk", 0, &clk_input_length-1)==STRING.CUT("&clk", -1))
    ( 
      &match=1
    )
  )	  
  else if ("audio_core_lpaif_dma_clk"=="&clk")
  (
    &match=1
  )
  
  if (&match==1)
  (
    &clk_test=&CLK_TEST_AUDIO_CORE_LPAIF_DMA_CLK
    &clk_reg=&HWIO_LPASS_AUDIO_CORE_LPAIF_DMA_CBCR_ADDR
    &clk_reg_name="LPASS_AUDIO_CORE_LPAIF_DMA_CBCR"
    &clk_name="audio_core_lpaif_dma_clk"
    &clk_reg_cbcr_type="sm_cbc"

    gosub Print_Clk_Info_Line
  )
  
  &match=0
  &wild_head=0
  &wild_tail=0
  &clk_input_length=STRING.LENGTH("&clk")
  &clk_itr_length=STRING.LENGTH("audio_core_lpm_clk")

  if (STRING.SCAN("&clk", "*", 0)==0)
  (
    &wild_head=1
  )
  if (STRING.SCAN("&clk", "*", 1)==(STRING.LENGTH("&clk")-1))
  (
    &wild_tail=1
  )

  if ((&wild_head==1)&&(&wild_tail==1))
  (
    if (STRING.SCAN("audio_core_lpm_clk", STRING.MID("&clk", 1, &clk_input_length-2), 0)!=-1)
    ( 
      &match=1
    )
  )
  else if (&wild_head==1)
  (
    if (STRING.MID("audio_core_lpm_clk", &clk_itr_length-&clk_input_length+1, &clk_input_length-1)==STRING.CUT("&clk", 1))
    ( 
      &match=1
    )
  )
  else if (&wild_tail==1)
  (
    if (STRING.MID("audio_core_lpm_clk", 0, &clk_input_length-1)==STRING.CUT("&clk", -1))
    ( 
      &match=1
    )
  )	  
  else if ("audio_core_lpm_clk"=="&clk")
  (
    &match=1
  )
  
  if (&match==1)
  (
    &clk_test=&CLK_TEST_AUDIO_CORE_LPM_CLK
    &clk_reg=&HWIO_LPASS_AUDIO_CORE_LPM_CBCR_ADDR
    &clk_reg_name="LPASS_AUDIO_CORE_LPM_CBCR"
    &clk_name="audio_core_lpm_clk"
    &clk_reg_cbcr_type="sm_pscbc"

    gosub Print_Clk_Info_Line
  )
  
  &match=0
  &wild_head=0
  &wild_tail=0
  &clk_input_length=STRING.LENGTH("&clk")
  &clk_itr_length=STRING.LENGTH("audio_core_midi_lfabif_clk")

  if (STRING.SCAN("&clk", "*", 0)==0)
  (
    &wild_head=1
  )
  if (STRING.SCAN("&clk", "*", 1)==(STRING.LENGTH("&clk")-1))
  (
    &wild_tail=1
  )

  if ((&wild_head==1)&&(&wild_tail==1))
  (
    if (STRING.SCAN("audio_core_midi_lfabif_clk", STRING.MID("&clk", 1, &clk_input_length-2), 0)!=-1)
    ( 
      &match=1
    )
  )
  else if (&wild_head==1)
  (
    if (STRING.MID("audio_core_midi_lfabif_clk", &clk_itr_length-&clk_input_length+1, &clk_input_length-1)==STRING.CUT("&clk", 1))
    ( 
      &match=1
    )
  )
  else if (&wild_tail==1)
  (
    if (STRING.MID("audio_core_midi_lfabif_clk", 0, &clk_input_length-1)==STRING.CUT("&clk", -1))
    ( 
      &match=1
    )
  )	  
  else if ("audio_core_midi_lfabif_clk"=="&clk")
  (
    &match=1
  )
  
  if (&match==1)
  (
    &clk_test=&CLK_TEST_AUDIO_CORE_MIDI_LFABIF_CLK
    &clk_reg=&HWIO_LPASS_AUDIO_CORE_MIDI_LFABIF_CBCR_ADDR
    &clk_reg_name="LPASS_AUDIO_CORE_MIDI_LFABIF_CBCR"
    &clk_name="audio_core_midi_lfabif_clk"
    &clk_reg_cbcr_type="sm_pscbc"

    gosub Print_Clk_Info_Line
  )
  
  &match=0
  &wild_head=0
  &wild_tail=0
  &clk_input_length=STRING.LENGTH("&clk")
  &clk_itr_length=STRING.LENGTH("audio_core_resampler_lfabif_clk")

  if (STRING.SCAN("&clk", "*", 0)==0)
  (
    &wild_head=1
  )
  if (STRING.SCAN("&clk", "*", 1)==(STRING.LENGTH("&clk")-1))
  (
    &wild_tail=1
  )

  if ((&wild_head==1)&&(&wild_tail==1))
  (
    if (STRING.SCAN("audio_core_resampler_lfabif_clk", STRING.MID("&clk", 1, &clk_input_length-2), 0)!=-1)
    ( 
      &match=1
    )
  )
  else if (&wild_head==1)
  (
    if (STRING.MID("audio_core_resampler_lfabif_clk", &clk_itr_length-&clk_input_length+1, &clk_input_length-1)==STRING.CUT("&clk", 1))
    ( 
      &match=1
    )
  )
  else if (&wild_tail==1)
  (
    if (STRING.MID("audio_core_resampler_lfabif_clk", 0, &clk_input_length-1)==STRING.CUT("&clk", -1))
    ( 
      &match=1
    )
  )	  
  else if ("audio_core_resampler_lfabif_clk"=="&clk")
  (
    &match=1
  )
  
  if (&match==1)
  (
    &clk_test=&CLK_TEST_AUDIO_CORE_RESAMPLER_LFABIF_CLK
    &clk_reg=&HWIO_LPASS_AUDIO_CORE_RESAMPLER_LFABIF_CBCR_ADDR
    &clk_reg_name="LPASS_AUDIO_CORE_RESAMPLER_LFABIF_CBCR"
    &clk_name="audio_core_resampler_lfabif_clk"
    &clk_reg_cbcr_type="sm_pscbc"

    gosub Print_Clk_Info_Line
  )
  
  &match=0
  &wild_head=0
  &wild_tail=0
  &clk_input_length=STRING.LENGTH("&clk")
  &clk_itr_length=STRING.LENGTH("audio_core_security_clk")

  if (STRING.SCAN("&clk", "*", 0)==0)
  (
    &wild_head=1
  )
  if (STRING.SCAN("&clk", "*", 1)==(STRING.LENGTH("&clk")-1))
  (
    &wild_tail=1
  )

  if ((&wild_head==1)&&(&wild_tail==1))
  (
    if (STRING.SCAN("audio_core_security_clk", STRING.MID("&clk", 1, &clk_input_length-2), 0)!=-1)
    ( 
      &match=1
    )
  )
  else if (&wild_head==1)
  (
    if (STRING.MID("audio_core_security_clk", &clk_itr_length-&clk_input_length+1, &clk_input_length-1)==STRING.CUT("&clk", 1))
    ( 
      &match=1
    )
  )
  else if (&wild_tail==1)
  (
    if (STRING.MID("audio_core_security_clk", 0, &clk_input_length-1)==STRING.CUT("&clk", -1))
    ( 
      &match=1
    )
  )	  
  else if ("audio_core_security_clk"=="&clk")
  (
    &match=1
  )
  
  if (&match==1)
  (
    &clk_test=&CLK_TEST_AUDIO_CORE_SECURITY_CLK
    &clk_reg=&HWIO_LPASS_AUDIO_CORE_SECURITY_CBCR_ADDR
    &clk_reg_name="LPASS_AUDIO_CORE_SECURITY_CBCR"
    &clk_name="audio_core_security_clk"
    &clk_reg_cbcr_type="sm_cbc"

    gosub Print_Clk_Info_Line
  )
  
  &match=0
  &wild_head=0
  &wild_tail=0
  &clk_input_length=STRING.LENGTH("&clk")
  &clk_itr_length=STRING.LENGTH("audio_core_slimbus_lfabif_clk")

  if (STRING.SCAN("&clk", "*", 0)==0)
  (
    &wild_head=1
  )
  if (STRING.SCAN("&clk", "*", 1)==(STRING.LENGTH("&clk")-1))
  (
    &wild_tail=1
  )

  if ((&wild_head==1)&&(&wild_tail==1))
  (
    if (STRING.SCAN("audio_core_slimbus_lfabif_clk", STRING.MID("&clk", 1, &clk_input_length-2), 0)!=-1)
    ( 
      &match=1
    )
  )
  else if (&wild_head==1)
  (
    if (STRING.MID("audio_core_slimbus_lfabif_clk", &clk_itr_length-&clk_input_length+1, &clk_input_length-1)==STRING.CUT("&clk", 1))
    ( 
      &match=1
    )
  )
  else if (&wild_tail==1)
  (
    if (STRING.MID("audio_core_slimbus_lfabif_clk", 0, &clk_input_length-1)==STRING.CUT("&clk", -1))
    ( 
      &match=1
    )
  )	  
  else if ("audio_core_slimbus_lfabif_clk"=="&clk")
  (
    &match=1
  )
  
  if (&match==1)
  (
    &clk_test=&CLK_TEST_AUDIO_CORE_SLIMBUS_LFABIF_CLK
    &clk_reg=&HWIO_LPASS_AUDIO_CORE_SLIMBUS_LFABIF_CBCR_ADDR
    &clk_reg_name="LPASS_AUDIO_CORE_SLIMBUS_LFABIF_CBCR"
    &clk_name="audio_core_slimbus_lfabif_clk"
    &clk_reg_cbcr_type="sm_pscbc"

    gosub Print_Clk_Info_Line
  )
  
  &match=0
  &wild_head=0
  &wild_tail=0
  &clk_input_length=STRING.LENGTH("&clk")
  &clk_itr_length=STRING.LENGTH("audio_core_sysnoc_mport_clk")

  if (STRING.SCAN("&clk", "*", 0)==0)
  (
    &wild_head=1
  )
  if (STRING.SCAN("&clk", "*", 1)==(STRING.LENGTH("&clk")-1))
  (
    &wild_tail=1
  )

  if ((&wild_head==1)&&(&wild_tail==1))
  (
    if (STRING.SCAN("audio_core_sysnoc_mport_clk", STRING.MID("&clk", 1, &clk_input_length-2), 0)!=-1)
    ( 
      &match=1
    )
  )
  else if (&wild_head==1)
  (
    if (STRING.MID("audio_core_sysnoc_mport_clk", &clk_itr_length-&clk_input_length+1, &clk_input_length-1)==STRING.CUT("&clk", 1))
    ( 
      &match=1
    )
  )
  else if (&wild_tail==1)
  (
    if (STRING.MID("audio_core_sysnoc_mport_clk", 0, &clk_input_length-1)==STRING.CUT("&clk", -1))
    ( 
      &match=1
    )
  )	  
  else if ("audio_core_sysnoc_mport_clk"=="&clk")
  (
    &match=1
  )
  
  if (&match==1)
  (
    &clk_test=&CLK_TEST_AUDIO_CORE_SYSNOC_MPORT_CLK
    &clk_reg=0
    &clk_reg_name="No CBCR"
    &clk_name="audio_core_sysnoc_mport_clk"
    &clk_reg_cbcr_type="sm_cbc"

    gosub Print_Clk_Info_Line
  )
  
  &match=0
  &wild_head=0
  &wild_tail=0
  &clk_input_length=STRING.LENGTH("&clk")
  &clk_itr_length=STRING.LENGTH("audio_core_timeout_clk")

  if (STRING.SCAN("&clk", "*", 0)==0)
  (
    &wild_head=1
  )
  if (STRING.SCAN("&clk", "*", 1)==(STRING.LENGTH("&clk")-1))
  (
    &wild_tail=1
  )

  if ((&wild_head==1)&&(&wild_tail==1))
  (
    if (STRING.SCAN("audio_core_timeout_clk", STRING.MID("&clk", 1, &clk_input_length-2), 0)!=-1)
    ( 
      &match=1
    )
  )
  else if (&wild_head==1)
  (
    if (STRING.MID("audio_core_timeout_clk", &clk_itr_length-&clk_input_length+1, &clk_input_length-1)==STRING.CUT("&clk", 1))
    ( 
      &match=1
    )
  )
  else if (&wild_tail==1)
  (
    if (STRING.MID("audio_core_timeout_clk", 0, &clk_input_length-1)==STRING.CUT("&clk", -1))
    ( 
      &match=1
    )
  )	  
  else if ("audio_core_timeout_clk"=="&clk")
  (
    &match=1
  )
  
  if (&match==1)
  (
    &clk_test=&CLK_TEST_AUDIO_CORE_TIMEOUT_CLK
    &clk_reg=&HWIO_LPASS_AUDIO_CORE_TIMEOUT_CBCR_ADDR
    &clk_reg_name="LPASS_AUDIO_CORE_TIMEOUT_CBCR"
    &clk_name="audio_core_timeout_clk"
    &clk_reg_cbcr_type="sm_cbc"

    gosub Print_Clk_Info_Line
  )
  
  &match=0
  &wild_head=0
  &wild_tail=0
  &clk_input_length=STRING.LENGTH("&clk")
  &clk_itr_length=STRING.LENGTH("audio_wrapper_aon_clk")

  if (STRING.SCAN("&clk", "*", 0)==0)
  (
    &wild_head=1
  )
  if (STRING.SCAN("&clk", "*", 1)==(STRING.LENGTH("&clk")-1))
  (
    &wild_tail=1
  )

  if ((&wild_head==1)&&(&wild_tail==1))
  (
    if (STRING.SCAN("audio_wrapper_aon_clk", STRING.MID("&clk", 1, &clk_input_length-2), 0)!=-1)
    ( 
      &match=1
    )
  )
  else if (&wild_head==1)
  (
    if (STRING.MID("audio_wrapper_aon_clk", &clk_itr_length-&clk_input_length+1, &clk_input_length-1)==STRING.CUT("&clk", 1))
    ( 
      &match=1
    )
  )
  else if (&wild_tail==1)
  (
    if (STRING.MID("audio_wrapper_aon_clk", 0, &clk_input_length-1)==STRING.CUT("&clk", -1))
    ( 
      &match=1
    )
  )	  
  else if ("audio_wrapper_aon_clk"=="&clk")
  (
    &match=1
  )
  
  if (&match==1)
  (
    &clk_test=&CLK_TEST_AUDIO_WRAPPER_AON_CLK
    &clk_reg=0
    &clk_reg_name="No CBCR"
    &clk_name="audio_wrapper_aon_clk"
    &clk_reg_cbcr_type="sm_cbc"

    gosub Print_Clk_Info_Line
  )
  
  &match=0
  &wild_head=0
  &wild_tail=0
  &clk_input_length=STRING.LENGTH("&clk")
  &clk_itr_length=STRING.LENGTH("audio_wrapper_br_clk")

  if (STRING.SCAN("&clk", "*", 0)==0)
  (
    &wild_head=1
  )
  if (STRING.SCAN("&clk", "*", 1)==(STRING.LENGTH("&clk")-1))
  (
    &wild_tail=1
  )

  if ((&wild_head==1)&&(&wild_tail==1))
  (
    if (STRING.SCAN("audio_wrapper_br_clk", STRING.MID("&clk", 1, &clk_input_length-2), 0)!=-1)
    ( 
      &match=1
    )
  )
  else if (&wild_head==1)
  (
    if (STRING.MID("audio_wrapper_br_clk", &clk_itr_length-&clk_input_length+1, &clk_input_length-1)==STRING.CUT("&clk", 1))
    ( 
      &match=1
    )
  )
  else if (&wild_tail==1)
  (
    if (STRING.MID("audio_wrapper_br_clk", 0, &clk_input_length-1)==STRING.CUT("&clk", -1))
    ( 
      &match=1
    )
  )	  
  else if ("audio_wrapper_br_clk"=="&clk")
  (
    &match=1
  )
  
  if (&match==1)
  (
    &clk_test=&CLK_TEST_AUDIO_WRAPPER_BR_CLK
    &clk_reg=&HWIO_LPASS_AUDIO_WRAPPER_BR_CBCR_ADDR
    &clk_reg_name="LPASS_AUDIO_WRAPPER_BR_CBCR"
    &clk_name="audio_wrapper_br_clk"
    &clk_reg_cbcr_type="sm_cbc"

    gosub Print_Clk_Info_Line
  )
  
  &match=0
  &wild_head=0
  &wild_tail=0
  &clk_input_length=STRING.LENGTH("&clk")
  &clk_itr_length=STRING.LENGTH("audio_wrapper_efabric_clk")

  if (STRING.SCAN("&clk", "*", 0)==0)
  (
    &wild_head=1
  )
  if (STRING.SCAN("&clk", "*", 1)==(STRING.LENGTH("&clk")-1))
  (
    &wild_tail=1
  )

  if ((&wild_head==1)&&(&wild_tail==1))
  (
    if (STRING.SCAN("audio_wrapper_efabric_clk", STRING.MID("&clk", 1, &clk_input_length-2), 0)!=-1)
    ( 
      &match=1
    )
  )
  else if (&wild_head==1)
  (
    if (STRING.MID("audio_wrapper_efabric_clk", &clk_itr_length-&clk_input_length+1, &clk_input_length-1)==STRING.CUT("&clk", 1))
    ( 
      &match=1
    )
  )
  else if (&wild_tail==1)
  (
    if (STRING.MID("audio_wrapper_efabric_clk", 0, &clk_input_length-1)==STRING.CUT("&clk", -1))
    ( 
      &match=1
    )
  )	  
  else if ("audio_wrapper_efabric_clk"=="&clk")
  (
    &match=1
  )
  
  if (&match==1)
  (
    &clk_test=&CLK_TEST_AUDIO_WRAPPER_EFABRIC_CLK
    &clk_reg=&HWIO_LPASS_AUDIO_WRAPPER_EFABRIC_CBCR_ADDR
    &clk_reg_name="LPASS_AUDIO_WRAPPER_EFABRIC_CBCR"
    &clk_name="audio_wrapper_efabric_clk"
    &clk_reg_cbcr_type="sm_cbc"

    gosub Print_Clk_Info_Line
  )
  
  &match=0
  &wild_head=0
  &wild_tail=0
  &clk_input_length=STRING.LENGTH("&clk")
  &clk_itr_length=STRING.LENGTH("audio_wrapper_efabric_spdmtm_csr_clk")

  if (STRING.SCAN("&clk", "*", 0)==0)
  (
    &wild_head=1
  )
  if (STRING.SCAN("&clk", "*", 1)==(STRING.LENGTH("&clk")-1))
  (
    &wild_tail=1
  )

  if ((&wild_head==1)&&(&wild_tail==1))
  (
    if (STRING.SCAN("audio_wrapper_efabric_spdmtm_csr_clk", STRING.MID("&clk", 1, &clk_input_length-2), 0)!=-1)
    ( 
      &match=1
    )
  )
  else if (&wild_head==1)
  (
    if (STRING.MID("audio_wrapper_efabric_spdmtm_csr_clk", &clk_itr_length-&clk_input_length+1, &clk_input_length-1)==STRING.CUT("&clk", 1))
    ( 
      &match=1
    )
  )
  else if (&wild_tail==1)
  (
    if (STRING.MID("audio_wrapper_efabric_spdmtm_csr_clk", 0, &clk_input_length-1)==STRING.CUT("&clk", -1))
    ( 
      &match=1
    )
  )	  
  else if ("audio_wrapper_efabric_spdmtm_csr_clk"=="&clk")
  (
    &match=1
  )
  
  if (&match==1)
  (
    &clk_test=&CLK_TEST_AUDIO_WRAPPER_EFABRIC_SPDMTM_CSR_CLK
    &clk_reg=&HWIO_LPASS_AUDIO_WRAPPER_EFABRIC_SPDMTM_CSR_CBCR_ADDR
    &clk_reg_name="LPASS_AUDIO_WRAPPER_EFABRIC_SPDMTM_CSR_CBCR"
    &clk_name="audio_wrapper_efabric_spdmtm_csr_clk"
    &clk_reg_cbcr_type="sm_cbc"

    gosub Print_Clk_Info_Line
  )
  
  &match=0
  &wild_head=0
  &wild_tail=0
  &clk_input_length=STRING.LENGTH("&clk")
  &clk_itr_length=STRING.LENGTH("audio_wrapper_lcc_csr_clk")

  if (STRING.SCAN("&clk", "*", 0)==0)
  (
    &wild_head=1
  )
  if (STRING.SCAN("&clk", "*", 1)==(STRING.LENGTH("&clk")-1))
  (
    &wild_tail=1
  )

  if ((&wild_head==1)&&(&wild_tail==1))
  (
    if (STRING.SCAN("audio_wrapper_lcc_csr_clk", STRING.MID("&clk", 1, &clk_input_length-2), 0)!=-1)
    ( 
      &match=1
    )
  )
  else if (&wild_head==1)
  (
    if (STRING.MID("audio_wrapper_lcc_csr_clk", &clk_itr_length-&clk_input_length+1, &clk_input_length-1)==STRING.CUT("&clk", 1))
    ( 
      &match=1
    )
  )
  else if (&wild_tail==1)
  (
    if (STRING.MID("audio_wrapper_lcc_csr_clk", 0, &clk_input_length-1)==STRING.CUT("&clk", -1))
    ( 
      &match=1
    )
  )	  
  else if ("audio_wrapper_lcc_csr_clk"=="&clk")
  (
    &match=1
  )
  
  if (&match==1)
  (
    &clk_test=&CLK_TEST_AUDIO_WRAPPER_LCC_CSR_CLK
    &clk_reg=&HWIO_LPASS_AUDIO_WRAPPER_LCC_CSR_CBCR_ADDR
    &clk_reg_name="LPASS_AUDIO_WRAPPER_LCC_CSR_CBCR"
    &clk_name="audio_wrapper_lcc_csr_clk"
    &clk_reg_cbcr_type="sm_cbc"

    gosub Print_Clk_Info_Line
  )
  
  &match=0
  &wild_head=0
  &wild_tail=0
  &clk_input_length=STRING.LENGTH("&clk")
  &clk_itr_length=STRING.LENGTH("audio_wrapper_security_clk")

  if (STRING.SCAN("&clk", "*", 0)==0)
  (
    &wild_head=1
  )
  if (STRING.SCAN("&clk", "*", 1)==(STRING.LENGTH("&clk")-1))
  (
    &wild_tail=1
  )

  if ((&wild_head==1)&&(&wild_tail==1))
  (
    if (STRING.SCAN("audio_wrapper_security_clk", STRING.MID("&clk", 1, &clk_input_length-2), 0)!=-1)
    ( 
      &match=1
    )
  )
  else if (&wild_head==1)
  (
    if (STRING.MID("audio_wrapper_security_clk", &clk_itr_length-&clk_input_length+1, &clk_input_length-1)==STRING.CUT("&clk", 1))
    ( 
      &match=1
    )
  )
  else if (&wild_tail==1)
  (
    if (STRING.MID("audio_wrapper_security_clk", 0, &clk_input_length-1)==STRING.CUT("&clk", -1))
    ( 
      &match=1
    )
  )	  
  else if ("audio_wrapper_security_clk"=="&clk")
  (
    &match=1
  )
  
  if (&match==1)
  (
    &clk_test=&CLK_TEST_AUDIO_WRAPPER_SECURITY_CLK
    &clk_reg=&HWIO_LPASS_AUDIO_WRAPPER_SECURITY_CBCR_ADDR
    &clk_reg_name="LPASS_AUDIO_WRAPPER_SECURITY_CBCR"
    &clk_name="audio_wrapper_security_clk"
    &clk_reg_cbcr_type="sm_cbc"

    gosub Print_Clk_Info_Line
  )
  
  &match=0
  &wild_head=0
  &wild_tail=0
  &clk_input_length=STRING.LENGTH("&clk")
  &clk_itr_length=STRING.LENGTH("audio_wrapper_smem_clk")

  if (STRING.SCAN("&clk", "*", 0)==0)
  (
    &wild_head=1
  )
  if (STRING.SCAN("&clk", "*", 1)==(STRING.LENGTH("&clk")-1))
  (
    &wild_tail=1
  )

  if ((&wild_head==1)&&(&wild_tail==1))
  (
    if (STRING.SCAN("audio_wrapper_smem_clk", STRING.MID("&clk", 1, &clk_input_length-2), 0)!=-1)
    ( 
      &match=1
    )
  )
  else if (&wild_head==1)
  (
    if (STRING.MID("audio_wrapper_smem_clk", &clk_itr_length-&clk_input_length+1, &clk_input_length-1)==STRING.CUT("&clk", 1))
    ( 
      &match=1
    )
  )
  else if (&wild_tail==1)
  (
    if (STRING.MID("audio_wrapper_smem_clk", 0, &clk_input_length-1)==STRING.CUT("&clk", -1))
    ( 
      &match=1
    )
  )	  
  else if ("audio_wrapper_smem_clk"=="&clk")
  (
    &match=1
  )
  
  if (&match==1)
  (
    &clk_test=&CLK_TEST_AUDIO_WRAPPER_SMEM_CLK
    &clk_reg=&HWIO_LPASS_AUDIO_WRAPPER_SMEM_CBCR_ADDR
    &clk_reg_name="LPASS_AUDIO_WRAPPER_SMEM_CBCR"
    &clk_name="audio_wrapper_smem_clk"
    &clk_reg_cbcr_type="sm_pscbc"

    gosub Print_Clk_Info_Line
  )
  
  &match=0
  &wild_head=0
  &wild_tail=0
  &clk_input_length=STRING.LENGTH("&clk")
  &clk_itr_length=STRING.LENGTH("audio_wrapper_sysnoc_sway_clk")

  if (STRING.SCAN("&clk", "*", 0)==0)
  (
    &wild_head=1
  )
  if (STRING.SCAN("&clk", "*", 1)==(STRING.LENGTH("&clk")-1))
  (
    &wild_tail=1
  )

  if ((&wild_head==1)&&(&wild_tail==1))
  (
    if (STRING.SCAN("audio_wrapper_sysnoc_sway_clk", STRING.MID("&clk", 1, &clk_input_length-2), 0)!=-1)
    ( 
      &match=1
    )
  )
  else if (&wild_head==1)
  (
    if (STRING.MID("audio_wrapper_sysnoc_sway_clk", &clk_itr_length-&clk_input_length+1, &clk_input_length-1)==STRING.CUT("&clk", 1))
    ( 
      &match=1
    )
  )
  else if (&wild_tail==1)
  (
    if (STRING.MID("audio_wrapper_sysnoc_sway_clk", 0, &clk_input_length-1)==STRING.CUT("&clk", -1))
    ( 
      &match=1
    )
  )	  
  else if ("audio_wrapper_sysnoc_sway_clk"=="&clk")
  (
    &match=1
  )
  
  if (&match==1)
  (
    &clk_test=0
    &clk_reg=&HWIO_LPASS_AUDIO_WRAPPER_SYSNOC_SWAY_CBCR_ADDR
    &clk_reg_name="LPASS_AUDIO_WRAPPER_SYSNOC_SWAY_CBCR"
    &clk_name="audio_wrapper_sysnoc_sway_clk"
    &clk_reg_cbcr_type="sm_cbc"

    gosub Print_Clk_Info_Line
  )
  
  &match=0
  &wild_head=0
  &wild_tail=0
  &clk_input_length=STRING.LENGTH("&clk")
  &clk_itr_length=STRING.LENGTH("audio_wrapper_timeout_clk")

  if (STRING.SCAN("&clk", "*", 0)==0)
  (
    &wild_head=1
  )
  if (STRING.SCAN("&clk", "*", 1)==(STRING.LENGTH("&clk")-1))
  (
    &wild_tail=1
  )

  if ((&wild_head==1)&&(&wild_tail==1))
  (
    if (STRING.SCAN("audio_wrapper_timeout_clk", STRING.MID("&clk", 1, &clk_input_length-2), 0)!=-1)
    ( 
      &match=1
    )
  )
  else if (&wild_head==1)
  (
    if (STRING.MID("audio_wrapper_timeout_clk", &clk_itr_length-&clk_input_length+1, &clk_input_length-1)==STRING.CUT("&clk", 1))
    ( 
      &match=1
    )
  )
  else if (&wild_tail==1)
  (
    if (STRING.MID("audio_wrapper_timeout_clk", 0, &clk_input_length-1)==STRING.CUT("&clk", -1))
    ( 
      &match=1
    )
  )	  
  else if ("audio_wrapper_timeout_clk"=="&clk")
  (
    &match=1
  )
  
  if (&match==1)
  (
    &clk_test=&CLK_TEST_AUDIO_WRAPPER_TIMEOUT_CLK
    &clk_reg=&HWIO_LPASS_AUDIO_WRAPPER_TIMEOUT_CBCR_ADDR
    &clk_reg_name="LPASS_AUDIO_WRAPPER_TIMEOUT_CBCR"
    &clk_name="audio_wrapper_timeout_clk"
    &clk_reg_cbcr_type="sm_cbc"

    gosub Print_Clk_Info_Line
  )
  
  &match=0
  &wild_head=0
  &wild_tail=0
  &clk_input_length=STRING.LENGTH("&clk")
  &clk_itr_length=STRING.LENGTH("core_smmu_cfg_clk")

  if (STRING.SCAN("&clk", "*", 0)==0)
  (
    &wild_head=1
  )
  if (STRING.SCAN("&clk", "*", 1)==(STRING.LENGTH("&clk")-1))
  (
    &wild_tail=1
  )

  if ((&wild_head==1)&&(&wild_tail==1))
  (
    if (STRING.SCAN("core_smmu_cfg_clk", STRING.MID("&clk", 1, &clk_input_length-2), 0)!=-1)
    ( 
      &match=1
    )
  )
  else if (&wild_head==1)
  (
    if (STRING.MID("core_smmu_cfg_clk", &clk_itr_length-&clk_input_length+1, &clk_input_length-1)==STRING.CUT("&clk", 1))
    ( 
      &match=1
    )
  )
  else if (&wild_tail==1)
  (
    if (STRING.MID("core_smmu_cfg_clk", 0, &clk_input_length-1)==STRING.CUT("&clk", -1))
    ( 
      &match=1
    )
  )	  
  else if ("core_smmu_cfg_clk"=="&clk")
  (
    &match=1
  )
  
  if (&match==1)
  (
    &clk_test=&CLK_TEST_CORE_SMMU_CFG_CLK
    &clk_reg=0
    &clk_reg_name="No CBCR"
    &clk_name="core_smmu_cfg_clk"
    &clk_reg_cbcr_type="sm_cbc"

    gosub Print_Clk_Info_Line
  )
  
  &match=0
  &wild_head=0
  &wild_tail=0
  &clk_input_length=STRING.LENGTH("&clk")
  &clk_itr_length=STRING.LENGTH("digcodec_ahb_clk")

  if (STRING.SCAN("&clk", "*", 0)==0)
  (
    &wild_head=1
  )
  if (STRING.SCAN("&clk", "*", 1)==(STRING.LENGTH("&clk")-1))
  (
    &wild_tail=1
  )

  if ((&wild_head==1)&&(&wild_tail==1))
  (
    if (STRING.SCAN("digcodec_ahb_clk", STRING.MID("&clk", 1, &clk_input_length-2), 0)!=-1)
    ( 
      &match=1
    )
  )
  else if (&wild_head==1)
  (
    if (STRING.MID("digcodec_ahb_clk", &clk_itr_length-&clk_input_length+1, &clk_input_length-1)==STRING.CUT("&clk", 1))
    ( 
      &match=1
    )
  )
  else if (&wild_tail==1)
  (
    if (STRING.MID("digcodec_ahb_clk", 0, &clk_input_length-1)==STRING.CUT("&clk", -1))
    ( 
      &match=1
    )
  )	  
  else if ("digcodec_ahb_clk"=="&clk")
  (
    &match=1
  )
  
  if (&match==1)
  (
    &clk_test=&CLK_TEST_DIGCODEC_AHB_CLK
    &clk_reg=&HWIO_LPASS_DIGCODEC_AHB_CBCR_ADDR
    &clk_reg_name="LPASS_DIGCODEC_AHB_CBCR"
    &clk_name="digcodec_ahb_clk"
    &clk_reg_cbcr_type="sm_cbc"

    gosub Print_Clk_Info_Line
  )
  
  &match=0
  &wild_head=0
  &wild_tail=0
  &clk_input_length=STRING.LENGTH("&clk")
  &clk_itr_length=STRING.LENGTH("hdmirx_ahb_clk")

  if (STRING.SCAN("&clk", "*", 0)==0)
  (
    &wild_head=1
  )
  if (STRING.SCAN("&clk", "*", 1)==(STRING.LENGTH("&clk")-1))
  (
    &wild_tail=1
  )

  if ((&wild_head==1)&&(&wild_tail==1))
  (
    if (STRING.SCAN("hdmirx_ahb_clk", STRING.MID("&clk", 1, &clk_input_length-2), 0)!=-1)
    ( 
      &match=1
    )
  )
  else if (&wild_head==1)
  (
    if (STRING.MID("hdmirx_ahb_clk", &clk_itr_length-&clk_input_length+1, &clk_input_length-1)==STRING.CUT("&clk", 1))
    ( 
      &match=1
    )
  )
  else if (&wild_tail==1)
  (
    if (STRING.MID("hdmirx_ahb_clk", 0, &clk_input_length-1)==STRING.CUT("&clk", -1))
    ( 
      &match=1
    )
  )	  
  else if ("hdmirx_ahb_clk"=="&clk")
  (
    &match=1
  )
  
  if (&match==1)
  (
    &clk_test=&CLK_TEST_HDMIRX_AHB_CLK
    &clk_reg=&HWIO_LPASS_HDMIRX_AHB_CBCR_ADDR
    &clk_reg_name="LPASS_HDMIRX_AHB_CBCR"
    &clk_name="hdmirx_ahb_clk"
    &clk_reg_cbcr_type="sm_cbc"

    gosub Print_Clk_Info_Line
  )
  
  &match=0
  &wild_head=0
  &wild_tail=0
  &clk_input_length=STRING.LENGTH("&clk")
  &clk_itr_length=STRING.LENGTH("q6_smmu_cfg_clk")

  if (STRING.SCAN("&clk", "*", 0)==0)
  (
    &wild_head=1
  )
  if (STRING.SCAN("&clk", "*", 1)==(STRING.LENGTH("&clk")-1))
  (
    &wild_tail=1
  )

  if ((&wild_head==1)&&(&wild_tail==1))
  (
    if (STRING.SCAN("q6_smmu_cfg_clk", STRING.MID("&clk", 1, &clk_input_length-2), 0)!=-1)
    ( 
      &match=1
    )
  )
  else if (&wild_head==1)
  (
    if (STRING.MID("q6_smmu_cfg_clk", &clk_itr_length-&clk_input_length+1, &clk_input_length-1)==STRING.CUT("&clk", 1))
    ( 
      &match=1
    )
  )
  else if (&wild_tail==1)
  (
    if (STRING.MID("q6_smmu_cfg_clk", 0, &clk_input_length-1)==STRING.CUT("&clk", -1))
    ( 
      &match=1
    )
  )	  
  else if ("q6_smmu_cfg_clk"=="&clk")
  (
    &match=1
  )
  
  if (&match==1)
  (
    &clk_test=&CLK_TEST_Q6_SMMU_CFG_CLK
    &clk_reg=0
    &clk_reg_name="No CBCR"
    &clk_name="q6_smmu_cfg_clk"
    &clk_reg_cbcr_type="sm_cbc"

    gosub Print_Clk_Info_Line
  )
  
  &match=0
  &wild_head=0
  &wild_tail=0
  &clk_input_length=STRING.LENGTH("&clk")
  &clk_itr_length=STRING.LENGTH("q6_tcm_slave_clk")

  if (STRING.SCAN("&clk", "*", 0)==0)
  (
    &wild_head=1
  )
  if (STRING.SCAN("&clk", "*", 1)==(STRING.LENGTH("&clk")-1))
  (
    &wild_tail=1
  )

  if ((&wild_head==1)&&(&wild_tail==1))
  (
    if (STRING.SCAN("q6_tcm_slave_clk", STRING.MID("&clk", 1, &clk_input_length-2), 0)!=-1)
    ( 
      &match=1
    )
  )
  else if (&wild_head==1)
  (
    if (STRING.MID("q6_tcm_slave_clk", &clk_itr_length-&clk_input_length+1, &clk_input_length-1)==STRING.CUT("&clk", 1))
    ( 
      &match=1
    )
  )
  else if (&wild_tail==1)
  (
    if (STRING.MID("q6_tcm_slave_clk", 0, &clk_input_length-1)==STRING.CUT("&clk", -1))
    ( 
      &match=1
    )
  )	  
  else if ("q6_tcm_slave_clk"=="&clk")
  (
    &match=1
  )
  
  if (&match==1)
  (
    &clk_test=&CLK_TEST_Q6_TCM_SLAVE_CLK
    &clk_reg=0
    &clk_reg_name="No CBCR"
    &clk_name="q6_tcm_slave_clk"
    &clk_reg_cbcr_type="sm_cbc"

    gosub Print_Clk_Info_Line
  )
  
  &match=0
  &wild_head=0
  &wild_tail=0
  &clk_input_length=STRING.LENGTH("&clk")
  &clk_itr_length=STRING.LENGTH("q6ss_ahb_lfabif_clk")

  if (STRING.SCAN("&clk", "*", 0)==0)
  (
    &wild_head=1
  )
  if (STRING.SCAN("&clk", "*", 1)==(STRING.LENGTH("&clk")-1))
  (
    &wild_tail=1
  )

  if ((&wild_head==1)&&(&wild_tail==1))
  (
    if (STRING.SCAN("q6ss_ahb_lfabif_clk", STRING.MID("&clk", 1, &clk_input_length-2), 0)!=-1)
    ( 
      &match=1
    )
  )
  else if (&wild_head==1)
  (
    if (STRING.MID("q6ss_ahb_lfabif_clk", &clk_itr_length-&clk_input_length+1, &clk_input_length-1)==STRING.CUT("&clk", 1))
    ( 
      &match=1
    )
  )
  else if (&wild_tail==1)
  (
    if (STRING.MID("q6ss_ahb_lfabif_clk", 0, &clk_input_length-1)==STRING.CUT("&clk", -1))
    ( 
      &match=1
    )
  )	  
  else if ("q6ss_ahb_lfabif_clk"=="&clk")
  (
    &match=1
  )
  
  if (&match==1)
  (
    &clk_test=&CLK_TEST_Q6SS_AHB_LFABIF_CLK
    &clk_reg=&HWIO_LPASS_Q6SS_AHB_LFABIF_CBCR_ADDR
    &clk_reg_name="LPASS_Q6SS_AHB_LFABIF_CBCR"
    &clk_name="q6ss_ahb_lfabif_clk"
    &clk_reg_cbcr_type="sm_cbc"

    gosub Print_Clk_Info_Line
  )
  
  &match=0
  &wild_head=0
  &wild_tail=0
  &clk_input_length=STRING.LENGTH("&clk")
  &clk_itr_length=STRING.LENGTH("q6ss_ahbm_clk")

  if (STRING.SCAN("&clk", "*", 0)==0)
  (
    &wild_head=1
  )
  if (STRING.SCAN("&clk", "*", 1)==(STRING.LENGTH("&clk")-1))
  (
    &wild_tail=1
  )

  if ((&wild_head==1)&&(&wild_tail==1))
  (
    if (STRING.SCAN("q6ss_ahbm_clk", STRING.MID("&clk", 1, &clk_input_length-2), 0)!=-1)
    ( 
      &match=1
    )
  )
  else if (&wild_head==1)
  (
    if (STRING.MID("q6ss_ahbm_clk", &clk_itr_length-&clk_input_length+1, &clk_input_length-1)==STRING.CUT("&clk", 1))
    ( 
      &match=1
    )
  )
  else if (&wild_tail==1)
  (
    if (STRING.MID("q6ss_ahbm_clk", 0, &clk_input_length-1)==STRING.CUT("&clk", -1))
    ( 
      &match=1
    )
  )	  
  else if ("q6ss_ahbm_clk"=="&clk")
  (
    &match=1
  )
  
  if (&match==1)
  (
    &clk_test=&CLK_TEST_Q6SS_AHBM_CLK
    &clk_reg=&HWIO_LPASS_Q6SS_AHBM_CBCR_ADDR
    &clk_reg_name="LPASS_Q6SS_AHBM_CBCR"
    &clk_name="q6ss_ahbm_clk"
    &clk_reg_cbcr_type="sm_cbc"

    gosub Print_Clk_Info_Line
  )
  
  &match=0
  &wild_head=0
  &wild_tail=0
  &clk_input_length=STRING.LENGTH("&clk")
  &clk_itr_length=STRING.LENGTH("sif_ahb_clk")

  if (STRING.SCAN("&clk", "*", 0)==0)
  (
    &wild_head=1
  )
  if (STRING.SCAN("&clk", "*", 1)==(STRING.LENGTH("&clk")-1))
  (
    &wild_tail=1
  )

  if ((&wild_head==1)&&(&wild_tail==1))
  (
    if (STRING.SCAN("sif_ahb_clk", STRING.MID("&clk", 1, &clk_input_length-2), 0)!=-1)
    ( 
      &match=1
    )
  )
  else if (&wild_head==1)
  (
    if (STRING.MID("sif_ahb_clk", &clk_itr_length-&clk_input_length+1, &clk_input_length-1)==STRING.CUT("&clk", 1))
    ( 
      &match=1
    )
  )
  else if (&wild_tail==1)
  (
    if (STRING.MID("sif_ahb_clk", 0, &clk_input_length-1)==STRING.CUT("&clk", -1))
    ( 
      &match=1
    )
  )	  
  else if ("sif_ahb_clk"=="&clk")
  (
    &match=1
  )
  
  if (&match==1)
  (
    &clk_test=&CLK_TEST_SIF_AHB_CLK
    &clk_reg=&HWIO_LPASS_SIF_AHB_CBCR_ADDR
    &clk_reg_name="LPASS_SIF_AHB_CBCR"
    &clk_name="sif_ahb_clk"
    &clk_reg_cbcr_type="sm_cbc"

    gosub Print_Clk_Info_Line
  )
  
  &match=0
  &wild_head=0
  &wild_tail=0
  &clk_input_length=STRING.LENGTH("&clk")
  &clk_itr_length=STRING.LENGTH("spdiftx_ahbm_clk")

  if (STRING.SCAN("&clk", "*", 0)==0)
  (
    &wild_head=1
  )
  if (STRING.SCAN("&clk", "*", 1)==(STRING.LENGTH("&clk")-1))
  (
    &wild_tail=1
  )

  if ((&wild_head==1)&&(&wild_tail==1))
  (
    if (STRING.SCAN("spdiftx_ahbm_clk", STRING.MID("&clk", 1, &clk_input_length-2), 0)!=-1)
    ( 
      &match=1
    )
  )
  else if (&wild_head==1)
  (
    if (STRING.MID("spdiftx_ahbm_clk", &clk_itr_length-&clk_input_length+1, &clk_input_length-1)==STRING.CUT("&clk", 1))
    ( 
      &match=1
    )
  )
  else if (&wild_tail==1)
  (
    if (STRING.MID("spdiftx_ahbm_clk", 0, &clk_input_length-1)==STRING.CUT("&clk", -1))
    ( 
      &match=1
    )
  )	  
  else if ("spdiftx_ahbm_clk"=="&clk")
  (
    &match=1
  )
  
  if (&match==1)
  (
    &clk_test=&CLK_TEST_SPDIFTX_AHBM_CLK
    &clk_reg=&HWIO_LPASS_SPDIFTX_AHBM_CBCR_ADDR
    &clk_reg_name="LPASS_SPDIFTX_AHBM_CBCR"
    &clk_name="spdiftx_ahbm_clk"
    &clk_reg_cbcr_type="sm_cbc"

    gosub Print_Clk_Info_Line
  )
  
  &match=0
  &wild_head=0
  &wild_tail=0
  &clk_input_length=STRING.LENGTH("&clk")
  &clk_itr_length=STRING.LENGTH("spdiftx_ahbs_clk")

  if (STRING.SCAN("&clk", "*", 0)==0)
  (
    &wild_head=1
  )
  if (STRING.SCAN("&clk", "*", 1)==(STRING.LENGTH("&clk")-1))
  (
    &wild_tail=1
  )

  if ((&wild_head==1)&&(&wild_tail==1))
  (
    if (STRING.SCAN("spdiftx_ahbs_clk", STRING.MID("&clk", 1, &clk_input_length-2), 0)!=-1)
    ( 
      &match=1
    )
  )
  else if (&wild_head==1)
  (
    if (STRING.MID("spdiftx_ahbs_clk", &clk_itr_length-&clk_input_length+1, &clk_input_length-1)==STRING.CUT("&clk", 1))
    ( 
      &match=1
    )
  )
  else if (&wild_tail==1)
  (
    if (STRING.MID("spdiftx_ahbs_clk", 0, &clk_input_length-1)==STRING.CUT("&clk", -1))
    ( 
      &match=1
    )
  )	  
  else if ("spdiftx_ahbs_clk"=="&clk")
  (
    &match=1
  )
  
  if (&match==1)
  (
    &clk_test=&CLK_TEST_SPDIFTX_AHBS_CLK
    &clk_reg=&HWIO_LPASS_SPDIFTX_AHBS_CBCR_ADDR
    &clk_reg_name="LPASS_SPDIFTX_AHBS_CBCR"
    &clk_name="spdiftx_ahbs_clk"
    &clk_reg_cbcr_type="sm_cbc"

    gosub Print_Clk_Info_Line
  )
  
  &match=0
  &wild_head=0
  &wild_tail=0
  &clk_input_length=STRING.LENGTH("&clk")
  &clk_itr_length=STRING.LENGTH("audio_core_avsync_bt_xo_clk")

  if (STRING.SCAN("&clk", "*", 0)==0)
  (
    &wild_head=1
  )
  if (STRING.SCAN("&clk", "*", 1)==(STRING.LENGTH("&clk")-1))
  (
    &wild_tail=1
  )

  if ((&wild_head==1)&&(&wild_tail==1))
  (
    if (STRING.SCAN("audio_core_avsync_bt_xo_clk", STRING.MID("&clk", 1, &clk_input_length-2), 0)!=-1)
    ( 
      &match=1
    )
  )
  else if (&wild_head==1)
  (
    if (STRING.MID("audio_core_avsync_bt_xo_clk", &clk_itr_length-&clk_input_length+1, &clk_input_length-1)==STRING.CUT("&clk", 1))
    ( 
      &match=1
    )
  )
  else if (&wild_tail==1)
  (
    if (STRING.MID("audio_core_avsync_bt_xo_clk", 0, &clk_input_length-1)==STRING.CUT("&clk", -1))
    ( 
      &match=1
    )
  )	  
  else if ("audio_core_avsync_bt_xo_clk"=="&clk")
  (
    &match=1
  )
  
  if (&match==1)
  (
    &clk_test=&CLK_TEST_AUDIO_CORE_AVSYNC_BT_XO_CLK
    &clk_reg=&HWIO_LPASS_AUDIO_CORE_AVSYNC_BT_XO_CBCR_ADDR
    &clk_reg_name="LPASS_AUDIO_CORE_AVSYNC_BT_XO_CBCR"
    &clk_name="audio_core_avsync_bt_xo_clk"
    &clk_reg_cbcr_type="sm_cbc"

    gosub Print_Clk_Info_Line
  )
  
  &match=0
  &wild_head=0
  &wild_tail=0
  &clk_input_length=STRING.LENGTH("&clk")
  &clk_itr_length=STRING.LENGTH("audio_core_avsync_fm_xo_clk")

  if (STRING.SCAN("&clk", "*", 0)==0)
  (
    &wild_head=1
  )
  if (STRING.SCAN("&clk", "*", 1)==(STRING.LENGTH("&clk")-1))
  (
    &wild_tail=1
  )

  if ((&wild_head==1)&&(&wild_tail==1))
  (
    if (STRING.SCAN("audio_core_avsync_fm_xo_clk", STRING.MID("&clk", 1, &clk_input_length-2), 0)!=-1)
    ( 
      &match=1
    )
  )
  else if (&wild_head==1)
  (
    if (STRING.MID("audio_core_avsync_fm_xo_clk", &clk_itr_length-&clk_input_length+1, &clk_input_length-1)==STRING.CUT("&clk", 1))
    ( 
      &match=1
    )
  )
  else if (&wild_tail==1)
  (
    if (STRING.MID("audio_core_avsync_fm_xo_clk", 0, &clk_input_length-1)==STRING.CUT("&clk", -1))
    ( 
      &match=1
    )
  )	  
  else if ("audio_core_avsync_fm_xo_clk"=="&clk")
  (
    &match=1
  )
  
  if (&match==1)
  (
    &clk_test=&CLK_TEST_AUDIO_CORE_AVSYNC_FM_XO_CLK
    &clk_reg=&HWIO_LPASS_AUDIO_CORE_AVSYNC_FM_XO_CBCR_ADDR
    &clk_reg_name="LPASS_AUDIO_CORE_AVSYNC_FM_XO_CBCR"
    &clk_name="audio_core_avsync_fm_xo_clk"
    &clk_reg_cbcr_type="sm_cbc"

    gosub Print_Clk_Info_Line
  )
  
  &match=0
  &wild_head=0
  &wild_tail=0
  &clk_input_length=STRING.LENGTH("&clk")
  &clk_itr_length=STRING.LENGTH("audio_core_avsync_xo_clk")

  if (STRING.SCAN("&clk", "*", 0)==0)
  (
    &wild_head=1
  )
  if (STRING.SCAN("&clk", "*", 1)==(STRING.LENGTH("&clk")-1))
  (
    &wild_tail=1
  )

  if ((&wild_head==1)&&(&wild_tail==1))
  (
    if (STRING.SCAN("audio_core_avsync_xo_clk", STRING.MID("&clk", 1, &clk_input_length-2), 0)!=-1)
    ( 
      &match=1
    )
  )
  else if (&wild_head==1)
  (
    if (STRING.MID("audio_core_avsync_xo_clk", &clk_itr_length-&clk_input_length+1, &clk_input_length-1)==STRING.CUT("&clk", 1))
    ( 
      &match=1
    )
  )
  else if (&wild_tail==1)
  (
    if (STRING.MID("audio_core_avsync_xo_clk", 0, &clk_input_length-1)==STRING.CUT("&clk", -1))
    ( 
      &match=1
    )
  )	  
  else if ("audio_core_avsync_xo_clk"=="&clk")
  (
    &match=1
  )
  
  if (&match==1)
  (
    &clk_test=&CLK_TEST_AUDIO_CORE_AVSYNC_XO_CLK
    &clk_reg=&HWIO_LPASS_AUDIO_CORE_AVSYNC_XO_CBCR_ADDR
    &clk_reg_name="LPASS_AUDIO_CORE_AVSYNC_XO_CBCR"
    &clk_name="audio_core_avsync_xo_clk"
    &clk_reg_cbcr_type="sm_cbc"

    gosub Print_Clk_Info_Line
  )
  
  &match=0
  &wild_head=0
  &wild_tail=0
  &clk_input_length=STRING.LENGTH("&clk")
  &clk_itr_length=STRING.LENGTH("audio_core_avtimer_xo_clk")

  if (STRING.SCAN("&clk", "*", 0)==0)
  (
    &wild_head=1
  )
  if (STRING.SCAN("&clk", "*", 1)==(STRING.LENGTH("&clk")-1))
  (
    &wild_tail=1
  )

  if ((&wild_head==1)&&(&wild_tail==1))
  (
    if (STRING.SCAN("audio_core_avtimer_xo_clk", STRING.MID("&clk", 1, &clk_input_length-2), 0)!=-1)
    ( 
      &match=1
    )
  )
  else if (&wild_head==1)
  (
    if (STRING.MID("audio_core_avtimer_xo_clk", &clk_itr_length-&clk_input_length+1, &clk_input_length-1)==STRING.CUT("&clk", 1))
    ( 
      &match=1
    )
  )
  else if (&wild_tail==1)
  (
    if (STRING.MID("audio_core_avtimer_xo_clk", 0, &clk_input_length-1)==STRING.CUT("&clk", -1))
    ( 
      &match=1
    )
  )	  
  else if ("audio_core_avtimer_xo_clk"=="&clk")
  (
    &match=1
  )
  
  if (&match==1)
  (
    &clk_test=&CLK_TEST_AUDIO_CORE_AVTIMER_XO_CLK
    &clk_reg=0
    &clk_reg_name="No CBCR"
    &clk_name="audio_core_avtimer_xo_clk"
    &clk_reg_cbcr_type="sm_cbc"

    gosub Print_Clk_Info_Line
  )
  
  &match=0
  &wild_head=0
  &wild_tail=0
  &clk_input_length=STRING.LENGTH("&clk")
  &clk_itr_length=STRING.LENGTH("audio_core_gdsc_xo_clk")

  if (STRING.SCAN("&clk", "*", 0)==0)
  (
    &wild_head=1
  )
  if (STRING.SCAN("&clk", "*", 1)==(STRING.LENGTH("&clk")-1))
  (
    &wild_tail=1
  )

  if ((&wild_head==1)&&(&wild_tail==1))
  (
    if (STRING.SCAN("audio_core_gdsc_xo_clk", STRING.MID("&clk", 1, &clk_input_length-2), 0)!=-1)
    ( 
      &match=1
    )
  )
  else if (&wild_head==1)
  (
    if (STRING.MID("audio_core_gdsc_xo_clk", &clk_itr_length-&clk_input_length+1, &clk_input_length-1)==STRING.CUT("&clk", 1))
    ( 
      &match=1
    )
  )
  else if (&wild_tail==1)
  (
    if (STRING.MID("audio_core_gdsc_xo_clk", 0, &clk_input_length-1)==STRING.CUT("&clk", -1))
    ( 
      &match=1
    )
  )	  
  else if ("audio_core_gdsc_xo_clk"=="&clk")
  (
    &match=1
  )
  
  if (&match==1)
  (
    &clk_test=&CLK_TEST_AUDIO_CORE_GDSC_XO_CLK
    &clk_reg=&HWIO_LPASS_AUDIO_CORE_GDSC_XO_CBCR_ADDR
    &clk_reg_name="LPASS_AUDIO_CORE_GDSC_XO_CBCR"
    &clk_name="audio_core_gdsc_xo_clk"
    &clk_reg_cbcr_type="sm_cbc"

    gosub Print_Clk_Info_Line
  )
  
  &match=0
  &wild_head=0
  &wild_tail=0
  &clk_input_length=STRING.LENGTH("&clk")
  &clk_itr_length=STRING.LENGTH("audio_wrapper_stm_xo_clk")

  if (STRING.SCAN("&clk", "*", 0)==0)
  (
    &wild_head=1
  )
  if (STRING.SCAN("&clk", "*", 1)==(STRING.LENGTH("&clk")-1))
  (
    &wild_tail=1
  )

  if ((&wild_head==1)&&(&wild_tail==1))
  (
    if (STRING.SCAN("audio_wrapper_stm_xo_clk", STRING.MID("&clk", 1, &clk_input_length-2), 0)!=-1)
    ( 
      &match=1
    )
  )
  else if (&wild_head==1)
  (
    if (STRING.MID("audio_wrapper_stm_xo_clk", &clk_itr_length-&clk_input_length+1, &clk_input_length-1)==STRING.CUT("&clk", 1))
    ( 
      &match=1
    )
  )
  else if (&wild_tail==1)
  (
    if (STRING.MID("audio_wrapper_stm_xo_clk", 0, &clk_input_length-1)==STRING.CUT("&clk", -1))
    ( 
      &match=1
    )
  )	  
  else if ("audio_wrapper_stm_xo_clk"=="&clk")
  (
    &match=1
  )
  
  if (&match==1)
  (
    &clk_test=0
    &clk_reg=&HWIO_LPASS_AUDIO_WRAPPER_STM_XO_CBCR_ADDR
    &clk_reg_name="LPASS_AUDIO_WRAPPER_STM_XO_CBCR"
    &clk_name="audio_wrapper_stm_xo_clk"
    &clk_reg_cbcr_type="sm_cbc"

    gosub Print_Clk_Info_Line
  )
  
  &match=0
  &wild_head=0
  &wild_tail=0
  &clk_input_length=STRING.LENGTH("&clk")
  &clk_itr_length=STRING.LENGTH("q6ss_xo_clk")

  if (STRING.SCAN("&clk", "*", 0)==0)
  (
    &wild_head=1
  )
  if (STRING.SCAN("&clk", "*", 1)==(STRING.LENGTH("&clk")-1))
  (
    &wild_tail=1
  )

  if ((&wild_head==1)&&(&wild_tail==1))
  (
    if (STRING.SCAN("q6ss_xo_clk", STRING.MID("&clk", 1, &clk_input_length-2), 0)!=-1)
    ( 
      &match=1
    )
  )
  else if (&wild_head==1)
  (
    if (STRING.MID("q6ss_xo_clk", &clk_itr_length-&clk_input_length+1, &clk_input_length-1)==STRING.CUT("&clk", 1))
    ( 
      &match=1
    )
  )
  else if (&wild_tail==1)
  (
    if (STRING.MID("q6ss_xo_clk", 0, &clk_input_length-1)==STRING.CUT("&clk", -1))
    ( 
      &match=1
    )
  )	  
  else if ("q6ss_xo_clk"=="&clk")
  (
    &match=1
  )
  
  if (&match==1)
  (
    &clk_test=&CLK_TEST_Q6SS_XO_CLK
    &clk_reg=&HWIO_LPASS_Q6SS_XO_CBCR_ADDR
    &clk_reg_name="LPASS_Q6SS_XO_CBCR"
    &clk_name="q6ss_xo_clk"
    &clk_reg_cbcr_type="sm_cbc"

    gosub Print_Clk_Info_Line
  )
  
  &match=0
  &wild_head=0
  &wild_tail=0
  &clk_input_length=STRING.LENGTH("&clk")
  &clk_itr_length=STRING.LENGTH("xo_clk_src")

  if (STRING.SCAN("&clk", "*", 0)==0)
  (
    &wild_head=1
  )
  if (STRING.SCAN("&clk", "*", 1)==(STRING.LENGTH("&clk")-1))
  (
    &wild_tail=1
  )

  if ((&wild_head==1)&&(&wild_tail==1))
  (
    if (STRING.SCAN("xo_clk_src", STRING.MID("&clk", 1, &clk_input_length-2), 0)!=-1)
    ( 
      &match=1
    )
  )
  else if (&wild_head==1)
  (
    if (STRING.MID("xo_clk_src", &clk_itr_length-&clk_input_length+1, &clk_input_length-1)==STRING.CUT("&clk", 1))
    ( 
      &match=1
    )
  )
  else if (&wild_tail==1)
  (
    if (STRING.MID("xo_clk_src", 0, &clk_input_length-1)==STRING.CUT("&clk", -1))
    ( 
      &match=1
    )
  )	  
  else if ("xo_clk_src"=="&clk")
  (
    &match=1
  )
  
  if (&match==1)
  (
    &clk_test=&CLK_TEST_XO_CLK_SRC
    &clk_reg=0
    &clk_reg_name="No CBCR"
    &clk_name="xo_clk_src"
    &clk_reg_cbcr_type=""

    gosub Print_Clk_Info_Line
  )
  
  &match=0
  &wild_head=0
  &wild_tail=0
  &clk_input_length=STRING.LENGTH("&clk")
  &clk_itr_length=STRING.LENGTH("digcodec_clk")

  if (STRING.SCAN("&clk", "*", 0)==0)
  (
    &wild_head=1
  )
  if (STRING.SCAN("&clk", "*", 1)==(STRING.LENGTH("&clk")-1))
  (
    &wild_tail=1
  )

  if ((&wild_head==1)&&(&wild_tail==1))
  (
    if (STRING.SCAN("digcodec_clk", STRING.MID("&clk", 1, &clk_input_length-2), 0)!=-1)
    ( 
      &match=1
    )
  )
  else if (&wild_head==1)
  (
    if (STRING.MID("digcodec_clk", &clk_itr_length-&clk_input_length+1, &clk_input_length-1)==STRING.CUT("&clk", 1))
    ( 
      &match=1
    )
  )
  else if (&wild_tail==1)
  (
    if (STRING.MID("digcodec_clk", 0, &clk_input_length-1)==STRING.CUT("&clk", -1))
    ( 
      &match=1
    )
  )	  
  else if ("digcodec_clk"=="&clk")
  (
    &match=1
  )
  
  if (&match==1)
  (
    &clk_test=&CLK_TEST_DIGCODEC_CLK
    &clk_reg=&HWIO_LPASS_DIGCODEC_CBCR_ADDR
    &clk_reg_name="LPASS_DIGCODEC_CBCR"
    &clk_name="digcodec_clk"
    &clk_reg_cbcr_type="sm_cbc"

    gosub Print_Clk_Info_Line
  )
  
  &match=0
  &wild_head=0
  &wild_tail=0
  &clk_input_length=STRING.LENGTH("&clk")
  &clk_itr_length=STRING.LENGTH("lpass_gcc_dbg_clk")

  if (STRING.SCAN("&clk", "*", 0)==0)
  (
    &wild_head=1
  )
  if (STRING.SCAN("&clk", "*", 1)==(STRING.LENGTH("&clk")-1))
  (
    &wild_tail=1
  )

  if ((&wild_head==1)&&(&wild_tail==1))
  (
    if (STRING.SCAN("lpass_gcc_dbg_clk", STRING.MID("&clk", 1, &clk_input_length-2), 0)!=-1)
    ( 
      &match=1
    )
  )
  else if (&wild_head==1)
  (
    if (STRING.MID("lpass_gcc_dbg_clk", &clk_itr_length-&clk_input_length+1, &clk_input_length-1)==STRING.CUT("&clk", 1))
    ( 
      &match=1
    )
  )
  else if (&wild_tail==1)
  (
    if (STRING.MID("lpass_gcc_dbg_clk", 0, &clk_input_length-1)==STRING.CUT("&clk", -1))
    ( 
      &match=1
    )
  )	  
  else if ("lpass_gcc_dbg_clk"=="&clk")
  (
    &match=1
  )
  
  if (&match==1)
  (
    &clk_test=&CLK_TEST_LPASS_GCC_DBG_CLK
    &clk_reg=0
    &clk_reg_name="No CBCR"
    &clk_name="lpass_gcc_dbg_clk"
    &clk_reg_cbcr_type="debug_mux_output"

    gosub Print_Clk_Info_Line
  )
  
  &match=0
  &wild_head=0
  &wild_tail=0
  &clk_input_length=STRING.LENGTH("&clk")
  &clk_itr_length=STRING.LENGTH("audio_core_lpaif_pcm_data_oe_clk")

  if (STRING.SCAN("&clk", "*", 0)==0)
  (
    &wild_head=1
  )
  if (STRING.SCAN("&clk", "*", 1)==(STRING.LENGTH("&clk")-1))
  (
    &wild_tail=1
  )

  if ((&wild_head==1)&&(&wild_tail==1))
  (
    if (STRING.SCAN("audio_core_lpaif_pcm_data_oe_clk", STRING.MID("&clk", 1, &clk_input_length-2), 0)!=-1)
    ( 
      &match=1
    )
  )
  else if (&wild_head==1)
  (
    if (STRING.MID("audio_core_lpaif_pcm_data_oe_clk", &clk_itr_length-&clk_input_length+1, &clk_input_length-1)==STRING.CUT("&clk", 1))
    ( 
      &match=1
    )
  )
  else if (&wild_tail==1)
  (
    if (STRING.MID("audio_core_lpaif_pcm_data_oe_clk", 0, &clk_input_length-1)==STRING.CUT("&clk", -1))
    ( 
      &match=1
    )
  )	  
  else if ("audio_core_lpaif_pcm_data_oe_clk"=="&clk")
  (
    &match=1
  )
  
  if (&match==1)
  (
    &clk_test=&CLK_TEST_AUDIO_CORE_LPAIF_PCM_DATA_OE_CLK
    &clk_reg=&HWIO_LPASS_AUDIO_CORE_LPAIF_PCM_DATA_OE_CBCR_ADDR
    &clk_reg_name="LPASS_AUDIO_CORE_LPAIF_PCM_DATA_OE_CBCR"
    &clk_name="audio_core_lpaif_pcm_data_oe_clk"
    &clk_reg_cbcr_type="sm_cbc"

    gosub Print_Clk_Info_Line
  )
  
  &match=0
  &wild_head=0
  &wild_tail=0
  &clk_input_length=STRING.LENGTH("&clk")
  &clk_itr_length=STRING.LENGTH("lpaif_pcmoe_clk_src")

  if (STRING.SCAN("&clk", "*", 0)==0)
  (
    &wild_head=1
  )
  if (STRING.SCAN("&clk", "*", 1)==(STRING.LENGTH("&clk")-1))
  (
    &wild_tail=1
  )

  if ((&wild_head==1)&&(&wild_tail==1))
  (
    if (STRING.SCAN("lpaif_pcmoe_clk_src", STRING.MID("&clk", 1, &clk_input_length-2), 0)!=-1)
    ( 
      &match=1
    )
  )
  else if (&wild_head==1)
  (
    if (STRING.MID("lpaif_pcmoe_clk_src", &clk_itr_length-&clk_input_length+1, &clk_input_length-1)==STRING.CUT("&clk", 1))
    ( 
      &match=1
    )
  )
  else if (&wild_tail==1)
  (
    if (STRING.MID("lpaif_pcmoe_clk_src", 0, &clk_input_length-1)==STRING.CUT("&clk", -1))
    ( 
      &match=1
    )
  )	  
  else if ("lpaif_pcmoe_clk_src"=="&clk")
  (
    &match=1
  )
  
  if (&match==1)
  (
    &clk_test=&CLK_TEST_LPAIF_PCMOE_CLK_SRC
    &clk_reg=0
    &clk_reg_name="No CBCR"
    &clk_name="lpaif_pcmoe_clk_src"
    &clk_reg_cbcr_type=""

    gosub Print_Clk_Info_Line
  )
  
  &match=0
  &wild_head=0
  &wild_tail=0
  &clk_input_length=STRING.LENGTH("&clk")
  &clk_itr_length=STRING.LENGTH("audio_core_lpaif_pri_ebit_clk")

  if (STRING.SCAN("&clk", "*", 0)==0)
  (
    &wild_head=1
  )
  if (STRING.SCAN("&clk", "*", 1)==(STRING.LENGTH("&clk")-1))
  (
    &wild_tail=1
  )

  if ((&wild_head==1)&&(&wild_tail==1))
  (
    if (STRING.SCAN("audio_core_lpaif_pri_ebit_clk", STRING.MID("&clk", 1, &clk_input_length-2), 0)!=-1)
    ( 
      &match=1
    )
  )
  else if (&wild_head==1)
  (
    if (STRING.MID("audio_core_lpaif_pri_ebit_clk", &clk_itr_length-&clk_input_length+1, &clk_input_length-1)==STRING.CUT("&clk", 1))
    ( 
      &match=1
    )
  )
  else if (&wild_tail==1)
  (
    if (STRING.MID("audio_core_lpaif_pri_ebit_clk", 0, &clk_input_length-1)==STRING.CUT("&clk", -1))
    ( 
      &match=1
    )
  )	  
  else if ("audio_core_lpaif_pri_ebit_clk"=="&clk")
  (
    &match=1
  )
  
  if (&match==1)
  (
    &clk_test=0
    &clk_reg=&HWIO_LPASS_AUDIO_CORE_LPAIF_PRI_EBIT_CBCR_ADDR
    &clk_reg_name="LPASS_AUDIO_CORE_LPAIF_PRI_EBIT_CBCR"
    &clk_name="audio_core_lpaif_pri_ebit_clk"
    &clk_reg_cbcr_type="sm_cbc"

    gosub Print_Clk_Info_Line
  )
  
  &match=0
  &wild_head=0
  &wild_tail=0
  &clk_input_length=STRING.LENGTH("&clk")
  &clk_itr_length=STRING.LENGTH("audio_core_lpaif_pri_ibit_clk")

  if (STRING.SCAN("&clk", "*", 0)==0)
  (
    &wild_head=1
  )
  if (STRING.SCAN("&clk", "*", 1)==(STRING.LENGTH("&clk")-1))
  (
    &wild_tail=1
  )

  if ((&wild_head==1)&&(&wild_tail==1))
  (
    if (STRING.SCAN("audio_core_lpaif_pri_ibit_clk", STRING.MID("&clk", 1, &clk_input_length-2), 0)!=-1)
    ( 
      &match=1
    )
  )
  else if (&wild_head==1)
  (
    if (STRING.MID("audio_core_lpaif_pri_ibit_clk", &clk_itr_length-&clk_input_length+1, &clk_input_length-1)==STRING.CUT("&clk", 1))
    ( 
      &match=1
    )
  )
  else if (&wild_tail==1)
  (
    if (STRING.MID("audio_core_lpaif_pri_ibit_clk", 0, &clk_input_length-1)==STRING.CUT("&clk", -1))
    ( 
      &match=1
    )
  )	  
  else if ("audio_core_lpaif_pri_ibit_clk"=="&clk")
  (
    &match=1
  )
  
  if (&match==1)
  (
    &clk_test=0
    &clk_reg=&HWIO_LPASS_AUDIO_CORE_LPAIF_PRI_IBIT_CBCR_ADDR
    &clk_reg_name="LPASS_AUDIO_CORE_LPAIF_PRI_IBIT_CBCR"
    &clk_name="audio_core_lpaif_pri_ibit_clk"
    &clk_reg_cbcr_type="sm_cbc"

    gosub Print_Clk_Info_Line
  )
  
  &match=0
  &wild_head=0
  &wild_tail=0
  &clk_input_length=STRING.LENGTH("&clk")
  &clk_itr_length=STRING.LENGTH("audio_core_lpaif_pri_osr_clk")

  if (STRING.SCAN("&clk", "*", 0)==0)
  (
    &wild_head=1
  )
  if (STRING.SCAN("&clk", "*", 1)==(STRING.LENGTH("&clk")-1))
  (
    &wild_tail=1
  )

  if ((&wild_head==1)&&(&wild_tail==1))
  (
    if (STRING.SCAN("audio_core_lpaif_pri_osr_clk", STRING.MID("&clk", 1, &clk_input_length-2), 0)!=-1)
    ( 
      &match=1
    )
  )
  else if (&wild_head==1)
  (
    if (STRING.MID("audio_core_lpaif_pri_osr_clk", &clk_itr_length-&clk_input_length+1, &clk_input_length-1)==STRING.CUT("&clk", 1))
    ( 
      &match=1
    )
  )
  else if (&wild_tail==1)
  (
    if (STRING.MID("audio_core_lpaif_pri_osr_clk", 0, &clk_input_length-1)==STRING.CUT("&clk", -1))
    ( 
      &match=1
    )
  )	  
  else if ("audio_core_lpaif_pri_osr_clk"=="&clk")
  (
    &match=1
  )
  
  if (&match==1)
  (
    &clk_test=0
    &clk_reg=&HWIO_LPASS_AUDIO_CORE_LPAIF_PRI_OSR_CBCR_ADDR
    &clk_reg_name="LPASS_AUDIO_CORE_LPAIF_PRI_OSR_CBCR"
    &clk_name="audio_core_lpaif_pri_osr_clk"
    &clk_reg_cbcr_type="sm_cbc"

    gosub Print_Clk_Info_Line
  )
  
  &match=0
  &wild_head=0
  &wild_tail=0
  &clk_input_length=STRING.LENGTH("&clk")
  &clk_itr_length=STRING.LENGTH("lpaif_pri_clk_src")

  if (STRING.SCAN("&clk", "*", 0)==0)
  (
    &wild_head=1
  )
  if (STRING.SCAN("&clk", "*", 1)==(STRING.LENGTH("&clk")-1))
  (
    &wild_tail=1
  )

  if ((&wild_head==1)&&(&wild_tail==1))
  (
    if (STRING.SCAN("lpaif_pri_clk_src", STRING.MID("&clk", 1, &clk_input_length-2), 0)!=-1)
    ( 
      &match=1
    )
  )
  else if (&wild_head==1)
  (
    if (STRING.MID("lpaif_pri_clk_src", &clk_itr_length-&clk_input_length+1, &clk_input_length-1)==STRING.CUT("&clk", 1))
    ( 
      &match=1
    )
  )
  else if (&wild_tail==1)
  (
    if (STRING.MID("lpaif_pri_clk_src", 0, &clk_input_length-1)==STRING.CUT("&clk", -1))
    ( 
      &match=1
    )
  )	  
  else if ("lpaif_pri_clk_src"=="&clk")
  (
    &match=1
  )
  
  if (&match==1)
  (
    &clk_test=&CLK_TEST_LPAIF_PRI_CLK_SRC
    &clk_reg=0
    &clk_reg_name="No CBCR"
    &clk_name="lpaif_pri_clk_src"
    &clk_reg_cbcr_type=""

    gosub Print_Clk_Info_Line
  )
  
  &match=0
  &wild_head=0
  &wild_tail=0
  &clk_input_length=STRING.LENGTH("&clk")
  &clk_itr_length=STRING.LENGTH("audio_core_lpaif_pcm0_ebit_clk")

  if (STRING.SCAN("&clk", "*", 0)==0)
  (
    &wild_head=1
  )
  if (STRING.SCAN("&clk", "*", 1)==(STRING.LENGTH("&clk")-1))
  (
    &wild_tail=1
  )

  if ((&wild_head==1)&&(&wild_tail==1))
  (
    if (STRING.SCAN("audio_core_lpaif_pcm0_ebit_clk", STRING.MID("&clk", 1, &clk_input_length-2), 0)!=-1)
    ( 
      &match=1
    )
  )
  else if (&wild_head==1)
  (
    if (STRING.MID("audio_core_lpaif_pcm0_ebit_clk", &clk_itr_length-&clk_input_length+1, &clk_input_length-1)==STRING.CUT("&clk", 1))
    ( 
      &match=1
    )
  )
  else if (&wild_tail==1)
  (
    if (STRING.MID("audio_core_lpaif_pcm0_ebit_clk", 0, &clk_input_length-1)==STRING.CUT("&clk", -1))
    ( 
      &match=1
    )
  )	  
  else if ("audio_core_lpaif_pcm0_ebit_clk"=="&clk")
  (
    &match=1
  )
  
  if (&match==1)
  (
    &clk_test=0
    &clk_reg=&HWIO_LPASS_AUDIO_CORE_LPAIF_PCM0_EBIT_CBCR_ADDR
    &clk_reg_name="LPASS_AUDIO_CORE_LPAIF_PCM0_EBIT_CBCR"
    &clk_name="audio_core_lpaif_pcm0_ebit_clk"
    &clk_reg_cbcr_type="sm_cbc"

    gosub Print_Clk_Info_Line
  )
  
  &match=0
  &wild_head=0
  &wild_tail=0
  &clk_input_length=STRING.LENGTH("&clk")
  &clk_itr_length=STRING.LENGTH("audio_core_lpaif_pcm0_ibit_clk")

  if (STRING.SCAN("&clk", "*", 0)==0)
  (
    &wild_head=1
  )
  if (STRING.SCAN("&clk", "*", 1)==(STRING.LENGTH("&clk")-1))
  (
    &wild_tail=1
  )

  if ((&wild_head==1)&&(&wild_tail==1))
  (
    if (STRING.SCAN("audio_core_lpaif_pcm0_ibit_clk", STRING.MID("&clk", 1, &clk_input_length-2), 0)!=-1)
    ( 
      &match=1
    )
  )
  else if (&wild_head==1)
  (
    if (STRING.MID("audio_core_lpaif_pcm0_ibit_clk", &clk_itr_length-&clk_input_length+1, &clk_input_length-1)==STRING.CUT("&clk", 1))
    ( 
      &match=1
    )
  )
  else if (&wild_tail==1)
  (
    if (STRING.MID("audio_core_lpaif_pcm0_ibit_clk", 0, &clk_input_length-1)==STRING.CUT("&clk", -1))
    ( 
      &match=1
    )
  )	  
  else if ("audio_core_lpaif_pcm0_ibit_clk"=="&clk")
  (
    &match=1
  )
  
  if (&match==1)
  (
    &clk_test=0
    &clk_reg=&HWIO_LPASS_AUDIO_CORE_LPAIF_PCM0_IBIT_CBCR_ADDR
    &clk_reg_name="LPASS_AUDIO_CORE_LPAIF_PCM0_IBIT_CBCR"
    &clk_name="audio_core_lpaif_pcm0_ibit_clk"
    &clk_reg_cbcr_type="sm_cbc"

    gosub Print_Clk_Info_Line
  )
  
  &match=0
  &wild_head=0
  &wild_tail=0
  &clk_input_length=STRING.LENGTH("&clk")
  &clk_itr_length=STRING.LENGTH("lpaif_pcm0_clk_src")

  if (STRING.SCAN("&clk", "*", 0)==0)
  (
    &wild_head=1
  )
  if (STRING.SCAN("&clk", "*", 1)==(STRING.LENGTH("&clk")-1))
  (
    &wild_tail=1
  )

  if ((&wild_head==1)&&(&wild_tail==1))
  (
    if (STRING.SCAN("lpaif_pcm0_clk_src", STRING.MID("&clk", 1, &clk_input_length-2), 0)!=-1)
    ( 
      &match=1
    )
  )
  else if (&wild_head==1)
  (
    if (STRING.MID("lpaif_pcm0_clk_src", &clk_itr_length-&clk_input_length+1, &clk_input_length-1)==STRING.CUT("&clk", 1))
    ( 
      &match=1
    )
  )
  else if (&wild_tail==1)
  (
    if (STRING.MID("lpaif_pcm0_clk_src", 0, &clk_input_length-1)==STRING.CUT("&clk", -1))
    ( 
      &match=1
    )
  )	  
  else if ("lpaif_pcm0_clk_src"=="&clk")
  (
    &match=1
  )
  
  if (&match==1)
  (
    &clk_test=&CLK_TEST_LPAIF_PCM0_CLK_SRC
    &clk_reg=0
    &clk_reg_name="No CBCR"
    &clk_name="lpaif_pcm0_clk_src"
    &clk_reg_cbcr_type=""

    gosub Print_Clk_Info_Line
  )
  
  &match=0
  &wild_head=0
  &wild_tail=0
  &clk_input_length=STRING.LENGTH("&clk")
  &clk_itr_length=STRING.LENGTH("q6core_clk_src")

  if (STRING.SCAN("&clk", "*", 0)==0)
  (
    &wild_head=1
  )
  if (STRING.SCAN("&clk", "*", 1)==(STRING.LENGTH("&clk")-1))
  (
    &wild_tail=1
  )

  if ((&wild_head==1)&&(&wild_tail==1))
  (
    if (STRING.SCAN("q6core_clk_src", STRING.MID("&clk", 1, &clk_input_length-2), 0)!=-1)
    ( 
      &match=1
    )
  )
  else if (&wild_head==1)
  (
    if (STRING.MID("q6core_clk_src", &clk_itr_length-&clk_input_length+1, &clk_input_length-1)==STRING.CUT("&clk", 1))
    ( 
      &match=1
    )
  )
  else if (&wild_tail==1)
  (
    if (STRING.MID("q6core_clk_src", 0, &clk_input_length-1)==STRING.CUT("&clk", -1))
    ( 
      &match=1
    )
  )	  
  else if ("q6core_clk_src"=="&clk")
  (
    &match=1
  )
  
  ; This clock belongs to the 'cpus' display group.
  if ("cpus"=="&clk")
  (
    &match=1	  
  )
  
  if (&match==1)
  (
    &clk_test=&CLK_TEST_Q6CORE_CLK_SRC
    &clk_reg=0
    &clk_reg_name="No CBCR"
    &clk_name="q6core_clk_src"
    &clk_reg_cbcr_type=""

    gosub Print_Clk_Info_Line
  )
  
  &match=0
  &wild_head=0
  &wild_tail=0
  &clk_input_length=STRING.LENGTH("&clk")
  &clk_itr_length=STRING.LENGTH("audio_core_lpaif_quad_ebit_clk")

  if (STRING.SCAN("&clk", "*", 0)==0)
  (
    &wild_head=1
  )
  if (STRING.SCAN("&clk", "*", 1)==(STRING.LENGTH("&clk")-1))
  (
    &wild_tail=1
  )

  if ((&wild_head==1)&&(&wild_tail==1))
  (
    if (STRING.SCAN("audio_core_lpaif_quad_ebit_clk", STRING.MID("&clk", 1, &clk_input_length-2), 0)!=-1)
    ( 
      &match=1
    )
  )
  else if (&wild_head==1)
  (
    if (STRING.MID("audio_core_lpaif_quad_ebit_clk", &clk_itr_length-&clk_input_length+1, &clk_input_length-1)==STRING.CUT("&clk", 1))
    ( 
      &match=1
    )
  )
  else if (&wild_tail==1)
  (
    if (STRING.MID("audio_core_lpaif_quad_ebit_clk", 0, &clk_input_length-1)==STRING.CUT("&clk", -1))
    ( 
      &match=1
    )
  )	  
  else if ("audio_core_lpaif_quad_ebit_clk"=="&clk")
  (
    &match=1
  )
  
  if (&match==1)
  (
    &clk_test=0
    &clk_reg=&HWIO_LPASS_AUDIO_CORE_LPAIF_QUAD_EBIT_CBCR_ADDR
    &clk_reg_name="LPASS_AUDIO_CORE_LPAIF_QUAD_EBIT_CBCR"
    &clk_name="audio_core_lpaif_quad_ebit_clk"
    &clk_reg_cbcr_type="sm_cbc"

    gosub Print_Clk_Info_Line
  )
  
  &match=0
  &wild_head=0
  &wild_tail=0
  &clk_input_length=STRING.LENGTH("&clk")
  &clk_itr_length=STRING.LENGTH("audio_core_lpaif_quad_ibit_clk")

  if (STRING.SCAN("&clk", "*", 0)==0)
  (
    &wild_head=1
  )
  if (STRING.SCAN("&clk", "*", 1)==(STRING.LENGTH("&clk")-1))
  (
    &wild_tail=1
  )

  if ((&wild_head==1)&&(&wild_tail==1))
  (
    if (STRING.SCAN("audio_core_lpaif_quad_ibit_clk", STRING.MID("&clk", 1, &clk_input_length-2), 0)!=-1)
    ( 
      &match=1
    )
  )
  else if (&wild_head==1)
  (
    if (STRING.MID("audio_core_lpaif_quad_ibit_clk", &clk_itr_length-&clk_input_length+1, &clk_input_length-1)==STRING.CUT("&clk", 1))
    ( 
      &match=1
    )
  )
  else if (&wild_tail==1)
  (
    if (STRING.MID("audio_core_lpaif_quad_ibit_clk", 0, &clk_input_length-1)==STRING.CUT("&clk", -1))
    ( 
      &match=1
    )
  )	  
  else if ("audio_core_lpaif_quad_ibit_clk"=="&clk")
  (
    &match=1
  )
  
  if (&match==1)
  (
    &clk_test=0
    &clk_reg=&HWIO_LPASS_AUDIO_CORE_LPAIF_QUAD_IBIT_CBCR_ADDR
    &clk_reg_name="LPASS_AUDIO_CORE_LPAIF_QUAD_IBIT_CBCR"
    &clk_name="audio_core_lpaif_quad_ibit_clk"
    &clk_reg_cbcr_type="sm_cbc"

    gosub Print_Clk_Info_Line
  )
  
  &match=0
  &wild_head=0
  &wild_tail=0
  &clk_input_length=STRING.LENGTH("&clk")
  &clk_itr_length=STRING.LENGTH("audio_core_lpaif_quad_osr_clk")

  if (STRING.SCAN("&clk", "*", 0)==0)
  (
    &wild_head=1
  )
  if (STRING.SCAN("&clk", "*", 1)==(STRING.LENGTH("&clk")-1))
  (
    &wild_tail=1
  )

  if ((&wild_head==1)&&(&wild_tail==1))
  (
    if (STRING.SCAN("audio_core_lpaif_quad_osr_clk", STRING.MID("&clk", 1, &clk_input_length-2), 0)!=-1)
    ( 
      &match=1
    )
  )
  else if (&wild_head==1)
  (
    if (STRING.MID("audio_core_lpaif_quad_osr_clk", &clk_itr_length-&clk_input_length+1, &clk_input_length-1)==STRING.CUT("&clk", 1))
    ( 
      &match=1
    )
  )
  else if (&wild_tail==1)
  (
    if (STRING.MID("audio_core_lpaif_quad_osr_clk", 0, &clk_input_length-1)==STRING.CUT("&clk", -1))
    ( 
      &match=1
    )
  )	  
  else if ("audio_core_lpaif_quad_osr_clk"=="&clk")
  (
    &match=1
  )
  
  if (&match==1)
  (
    &clk_test=0
    &clk_reg=&HWIO_LPASS_AUDIO_CORE_LPAIF_QUAD_OSR_CBCR_ADDR
    &clk_reg_name="LPASS_AUDIO_CORE_LPAIF_QUAD_OSR_CBCR"
    &clk_name="audio_core_lpaif_quad_osr_clk"
    &clk_reg_cbcr_type="sm_cbc"

    gosub Print_Clk_Info_Line
  )
  
  &match=0
  &wild_head=0
  &wild_tail=0
  &clk_input_length=STRING.LENGTH("&clk")
  &clk_itr_length=STRING.LENGTH("lpaif_quad_clk_src")

  if (STRING.SCAN("&clk", "*", 0)==0)
  (
    &wild_head=1
  )
  if (STRING.SCAN("&clk", "*", 1)==(STRING.LENGTH("&clk")-1))
  (
    &wild_tail=1
  )

  if ((&wild_head==1)&&(&wild_tail==1))
  (
    if (STRING.SCAN("lpaif_quad_clk_src", STRING.MID("&clk", 1, &clk_input_length-2), 0)!=-1)
    ( 
      &match=1
    )
  )
  else if (&wild_head==1)
  (
    if (STRING.MID("lpaif_quad_clk_src", &clk_itr_length-&clk_input_length+1, &clk_input_length-1)==STRING.CUT("&clk", 1))
    ( 
      &match=1
    )
  )
  else if (&wild_tail==1)
  (
    if (STRING.MID("lpaif_quad_clk_src", 0, &clk_input_length-1)==STRING.CUT("&clk", -1))
    ( 
      &match=1
    )
  )	  
  else if ("lpaif_quad_clk_src"=="&clk")
  (
    &match=1
  )
  
  if (&match==1)
  (
    &clk_test=&CLK_TEST_LPAIF_QUAD_CLK_SRC
    &clk_reg=0
    &clk_reg_name="No CBCR"
    &clk_name="lpaif_quad_clk_src"
    &clk_reg_cbcr_type=""

    gosub Print_Clk_Info_Line
  )
  
  &match=0
  &wild_head=0
  &wild_tail=0
  &clk_input_length=STRING.LENGTH("&clk")
  &clk_itr_length=STRING.LENGTH("audio_core_resampler_core_clk")

  if (STRING.SCAN("&clk", "*", 0)==0)
  (
    &wild_head=1
  )
  if (STRING.SCAN("&clk", "*", 1)==(STRING.LENGTH("&clk")-1))
  (
    &wild_tail=1
  )

  if ((&wild_head==1)&&(&wild_tail==1))
  (
    if (STRING.SCAN("audio_core_resampler_core_clk", STRING.MID("&clk", 1, &clk_input_length-2), 0)!=-1)
    ( 
      &match=1
    )
  )
  else if (&wild_head==1)
  (
    if (STRING.MID("audio_core_resampler_core_clk", &clk_itr_length-&clk_input_length+1, &clk_input_length-1)==STRING.CUT("&clk", 1))
    ( 
      &match=1
    )
  )
  else if (&wild_tail==1)
  (
    if (STRING.MID("audio_core_resampler_core_clk", 0, &clk_input_length-1)==STRING.CUT("&clk", -1))
    ( 
      &match=1
    )
  )	  
  else if ("audio_core_resampler_core_clk"=="&clk")
  (
    &match=1
  )
  
  if (&match==1)
  (
    &clk_test=&CLK_TEST_AUDIO_CORE_RESAMPLER_CORE_CLK
    &clk_reg=&HWIO_LPASS_AUDIO_CORE_RESAMPLER_CORE_CBCR_ADDR
    &clk_reg_name="LPASS_AUDIO_CORE_RESAMPLER_CORE_CBCR"
    &clk_name="audio_core_resampler_core_clk"
    &clk_reg_cbcr_type="sm_pscbc"

    gosub Print_Clk_Info_Line
  )
  
  &match=0
  &wild_head=0
  &wild_tail=0
  &clk_input_length=STRING.LENGTH("&clk")
  &clk_itr_length=STRING.LENGTH("resampler_clk_src")

  if (STRING.SCAN("&clk", "*", 0)==0)
  (
    &wild_head=1
  )
  if (STRING.SCAN("&clk", "*", 1)==(STRING.LENGTH("&clk")-1))
  (
    &wild_tail=1
  )

  if ((&wild_head==1)&&(&wild_tail==1))
  (
    if (STRING.SCAN("resampler_clk_src", STRING.MID("&clk", 1, &clk_input_length-2), 0)!=-1)
    ( 
      &match=1
    )
  )
  else if (&wild_head==1)
  (
    if (STRING.MID("resampler_clk_src", &clk_itr_length-&clk_input_length+1, &clk_input_length-1)==STRING.CUT("&clk", 1))
    ( 
      &match=1
    )
  )
  else if (&wild_tail==1)
  (
    if (STRING.MID("resampler_clk_src", 0, &clk_input_length-1)==STRING.CUT("&clk", -1))
    ( 
      &match=1
    )
  )	  
  else if ("resampler_clk_src"=="&clk")
  (
    &match=1
  )
  
  if (&match==1)
  (
    &clk_test=&CLK_TEST_RESAMPLER_CLK_SRC
    &clk_reg=0
    &clk_reg_name="No CBCR"
    &clk_name="resampler_clk_src"
    &clk_reg_cbcr_type=""

    gosub Print_Clk_Info_Line
  )
  
  &match=0
  &wild_head=0
  &wild_tail=0
  &clk_input_length=STRING.LENGTH("&clk")
  &clk_itr_length=STRING.LENGTH("sif_clk")

  if (STRING.SCAN("&clk", "*", 0)==0)
  (
    &wild_head=1
  )
  if (STRING.SCAN("&clk", "*", 1)==(STRING.LENGTH("&clk")-1))
  (
    &wild_tail=1
  )

  if ((&wild_head==1)&&(&wild_tail==1))
  (
    if (STRING.SCAN("sif_clk", STRING.MID("&clk", 1, &clk_input_length-2), 0)!=-1)
    ( 
      &match=1
    )
  )
  else if (&wild_head==1)
  (
    if (STRING.MID("sif_clk", &clk_itr_length-&clk_input_length+1, &clk_input_length-1)==STRING.CUT("&clk", 1))
    ( 
      &match=1
    )
  )
  else if (&wild_tail==1)
  (
    if (STRING.MID("sif_clk", 0, &clk_input_length-1)==STRING.CUT("&clk", -1))
    ( 
      &match=1
    )
  )	  
  else if ("sif_clk"=="&clk")
  (
    &match=1
  )
  
  if (&match==1)
  (
    &clk_test=&CLK_TEST_SIF_CLK
    &clk_reg=&HWIO_LPASS_SIF_CBCR_ADDR
    &clk_reg_name="LPASS_SIF_CBCR"
    &clk_name="sif_clk"
    &clk_reg_cbcr_type="sm_cbc"

    gosub Print_Clk_Info_Line
  )
  
  &match=0
  &wild_head=0
  &wild_tail=0
  &clk_input_length=STRING.LENGTH("&clk")
  &clk_itr_length=STRING.LENGTH("audio_core_slimbus_core_clk")

  if (STRING.SCAN("&clk", "*", 0)==0)
  (
    &wild_head=1
  )
  if (STRING.SCAN("&clk", "*", 1)==(STRING.LENGTH("&clk")-1))
  (
    &wild_tail=1
  )

  if ((&wild_head==1)&&(&wild_tail==1))
  (
    if (STRING.SCAN("audio_core_slimbus_core_clk", STRING.MID("&clk", 1, &clk_input_length-2), 0)!=-1)
    ( 
      &match=1
    )
  )
  else if (&wild_head==1)
  (
    if (STRING.MID("audio_core_slimbus_core_clk", &clk_itr_length-&clk_input_length+1, &clk_input_length-1)==STRING.CUT("&clk", 1))
    ( 
      &match=1
    )
  )
  else if (&wild_tail==1)
  (
    if (STRING.MID("audio_core_slimbus_core_clk", 0, &clk_input_length-1)==STRING.CUT("&clk", -1))
    ( 
      &match=1
    )
  )	  
  else if ("audio_core_slimbus_core_clk"=="&clk")
  (
    &match=1
  )
  
  if (&match==1)
  (
    &clk_test=&CLK_TEST_AUDIO_CORE_SLIMBUS_CORE_CLK
    &clk_reg=&HWIO_LPASS_AUDIO_CORE_SLIMBUS_CORE_CBCR_ADDR
    &clk_reg_name="LPASS_AUDIO_CORE_SLIMBUS_CORE_CBCR"
    &clk_name="audio_core_slimbus_core_clk"
    &clk_reg_cbcr_type="sm_cbc"

    gosub Print_Clk_Info_Line
  )
  
  &match=0
  &wild_head=0
  &wild_tail=0
  &clk_input_length=STRING.LENGTH("&clk")
  &clk_itr_length=STRING.LENGTH("audio_core_slimbus_core_clk")

  if (STRING.SCAN("&clk", "*", 0)==0)
  (
    &wild_head=1
  )
  if (STRING.SCAN("&clk", "*", 1)==(STRING.LENGTH("&clk")-1))
  (
    &wild_tail=1
  )

  if ((&wild_head==1)&&(&wild_tail==1))
  (
    if (STRING.SCAN("audio_core_slimbus_core_clk", STRING.MID("&clk", 1, &clk_input_length-2), 0)!=-1)
    ( 
      &match=1
    )
  )
  else if (&wild_head==1)
  (
    if (STRING.MID("audio_core_slimbus_core_clk", &clk_itr_length-&clk_input_length+1, &clk_input_length-1)==STRING.CUT("&clk", 1))
    ( 
      &match=1
    )
  )
  else if (&wild_tail==1)
  (
    if (STRING.MID("audio_core_slimbus_core_clk", 0, &clk_input_length-1)==STRING.CUT("&clk", -1))
    ( 
      &match=1
    )
  )	  
  else if ("audio_core_slimbus_core_clk"=="&clk")
  (
    &match=1
  )
  
  if (&match==1)
  (
    &clk_test=&CLK_TEST_AUDIO_CORE_SLIMBUS_CORE_CLK
    &clk_reg=&HWIO_LPASS_AUDIO_CORE_SLIMBUS_CORE_CBCR_ADDR
    &clk_reg_name="LPASS_AUDIO_CORE_SLIMBUS_CORE_CBCR"
    &clk_name="audio_core_slimbus_core_clk"
    &clk_reg_cbcr_type="sm_cbc"

    gosub Print_Clk_Info_Line
  )
  
  &match=0
  &wild_head=0
  &wild_tail=0
  &clk_input_length=STRING.LENGTH("&clk")
  &clk_itr_length=STRING.LENGTH("slimbus_clk_src")

  if (STRING.SCAN("&clk", "*", 0)==0)
  (
    &wild_head=1
  )
  if (STRING.SCAN("&clk", "*", 1)==(STRING.LENGTH("&clk")-1))
  (
    &wild_tail=1
  )

  if ((&wild_head==1)&&(&wild_tail==1))
  (
    if (STRING.SCAN("slimbus_clk_src", STRING.MID("&clk", 1, &clk_input_length-2), 0)!=-1)
    ( 
      &match=1
    )
  )
  else if (&wild_head==1)
  (
    if (STRING.MID("slimbus_clk_src", &clk_itr_length-&clk_input_length+1, &clk_input_length-1)==STRING.CUT("&clk", 1))
    ( 
      &match=1
    )
  )
  else if (&wild_tail==1)
  (
    if (STRING.MID("slimbus_clk_src", 0, &clk_input_length-1)==STRING.CUT("&clk", -1))
    ( 
      &match=1
    )
  )	  
  else if ("slimbus_clk_src"=="&clk")
  (
    &match=1
  )
  
  if (&match==1)
  (
    &clk_test=&CLK_TEST_SLIMBUS_CLK_SRC
    &clk_reg=0
    &clk_reg_name="No CBCR"
    &clk_name="slimbus_clk_src"
    &clk_reg_cbcr_type=""

    gosub Print_Clk_Info_Line
  )
  
  &match=0
  &wild_head=0
  &wild_tail=0
  &clk_input_length=STRING.LENGTH("&clk")
  &clk_itr_length=STRING.LENGTH("slimbus_clk_src")

  if (STRING.SCAN("&clk", "*", 0)==0)
  (
    &wild_head=1
  )
  if (STRING.SCAN("&clk", "*", 1)==(STRING.LENGTH("&clk")-1))
  (
    &wild_tail=1
  )

  if ((&wild_head==1)&&(&wild_tail==1))
  (
    if (STRING.SCAN("slimbus_clk_src", STRING.MID("&clk", 1, &clk_input_length-2), 0)!=-1)
    ( 
      &match=1
    )
  )
  else if (&wild_head==1)
  (
    if (STRING.MID("slimbus_clk_src", &clk_itr_length-&clk_input_length+1, &clk_input_length-1)==STRING.CUT("&clk", 1))
    ( 
      &match=1
    )
  )
  else if (&wild_tail==1)
  (
    if (STRING.MID("slimbus_clk_src", 0, &clk_input_length-1)==STRING.CUT("&clk", -1))
    ( 
      &match=1
    )
  )	  
  else if ("slimbus_clk_src"=="&clk")
  (
    &match=1
  )
  
  if (&match==1)
  (
    &clk_test=&CLK_TEST_SLIMBUS_CLK_SRC
    &clk_reg=0
    &clk_reg_name="No CBCR"
    &clk_name="slimbus_clk_src"
    &clk_reg_cbcr_type=""

    gosub Print_Clk_Info_Line
  )
  
  &match=0
  &wild_head=0
  &wild_tail=0
  &clk_input_length=STRING.LENGTH("&clk")
  &clk_itr_length=STRING.LENGTH("spdiftx_bmc_clk")

  if (STRING.SCAN("&clk", "*", 0)==0)
  (
    &wild_head=1
  )
  if (STRING.SCAN("&clk", "*", 1)==(STRING.LENGTH("&clk")-1))
  (
    &wild_tail=1
  )

  if ((&wild_head==1)&&(&wild_tail==1))
  (
    if (STRING.SCAN("spdiftx_bmc_clk", STRING.MID("&clk", 1, &clk_input_length-2), 0)!=-1)
    ( 
      &match=1
    )
  )
  else if (&wild_head==1)
  (
    if (STRING.MID("spdiftx_bmc_clk", &clk_itr_length-&clk_input_length+1, &clk_input_length-1)==STRING.CUT("&clk", 1))
    ( 
      &match=1
    )
  )
  else if (&wild_tail==1)
  (
    if (STRING.MID("spdiftx_bmc_clk", 0, &clk_input_length-1)==STRING.CUT("&clk", -1))
    ( 
      &match=1
    )
  )	  
  else if ("spdiftx_bmc_clk"=="&clk")
  (
    &match=1
  )
  
  if (&match==1)
  (
    &clk_test=&CLK_TEST_SPDIFTX_BMC_CLK
    &clk_reg=&HWIO_LPASS_SPDIFTX_BMC_CBCR_ADDR
    &clk_reg_name="LPASS_SPDIFTX_BMC_CBCR"
    &clk_name="spdiftx_bmc_clk"
    &clk_reg_cbcr_type="sm_cbc"

    gosub Print_Clk_Info_Line
  )
  
  &match=0
  &wild_head=0
  &wild_tail=0
  &clk_input_length=STRING.LENGTH("&clk")
  &clk_itr_length=STRING.LENGTH("spdiftx_bmc_clk_src")

  if (STRING.SCAN("&clk", "*", 0)==0)
  (
    &wild_head=1
  )
  if (STRING.SCAN("&clk", "*", 1)==(STRING.LENGTH("&clk")-1))
  (
    &wild_tail=1
  )

  if ((&wild_head==1)&&(&wild_tail==1))
  (
    if (STRING.SCAN("spdiftx_bmc_clk_src", STRING.MID("&clk", 1, &clk_input_length-2), 0)!=-1)
    ( 
      &match=1
    )
  )
  else if (&wild_head==1)
  (
    if (STRING.MID("spdiftx_bmc_clk_src", &clk_itr_length-&clk_input_length+1, &clk_input_length-1)==STRING.CUT("&clk", 1))
    ( 
      &match=1
    )
  )
  else if (&wild_tail==1)
  (
    if (STRING.MID("spdiftx_bmc_clk_src", 0, &clk_input_length-1)==STRING.CUT("&clk", -1))
    ( 
      &match=1
    )
  )	  
  else if ("spdiftx_bmc_clk_src"=="&clk")
  (
    &match=1
  )
  
  if (&match==1)
  (
    &clk_test=&CLK_TEST_SPDIFTX_BMC_CLK_SRC
    &clk_reg=0
    &clk_reg_name="No CBCR"
    &clk_name="spdiftx_bmc_clk_src"
    &clk_reg_cbcr_type=""

    gosub Print_Clk_Info_Line
  )
  
  &match=0
  &wild_head=0
  &wild_tail=0
  &clk_input_length=STRING.LENGTH("&clk")
  &clk_itr_length=STRING.LENGTH("q6_spdm_clk_src")

  if (STRING.SCAN("&clk", "*", 0)==0)
  (
    &wild_head=1
  )
  if (STRING.SCAN("&clk", "*", 1)==(STRING.LENGTH("&clk")-1))
  (
    &wild_tail=1
  )

  if ((&wild_head==1)&&(&wild_tail==1))
  (
    if (STRING.SCAN("q6_spdm_clk_src", STRING.MID("&clk", 1, &clk_input_length-2), 0)!=-1)
    ( 
      &match=1
    )
  )
  else if (&wild_head==1)
  (
    if (STRING.MID("q6_spdm_clk_src", &clk_itr_length-&clk_input_length+1, &clk_input_length-1)==STRING.CUT("&clk", 1))
    ( 
      &match=1
    )
  )
  else if (&wild_tail==1)
  (
    if (STRING.MID("q6_spdm_clk_src", 0, &clk_input_length-1)==STRING.CUT("&clk", -1))
    ( 
      &match=1
    )
  )	  
  else if ("q6_spdm_clk_src"=="&clk")
  (
    &match=1
  )
  
  if (&match==1)
  (
    &clk_test=&CLK_TEST_Q6_SPDM_CLK_SRC
    &clk_reg=0
    &clk_reg_name="No CBCR"
    &clk_name="q6_spdm_clk_src"
    &clk_reg_cbcr_type=""

    gosub Print_Clk_Info_Line
  )
  
  &match=0
  &wild_head=0
  &wild_tail=0
  &clk_input_length=STRING.LENGTH("&clk")
  &clk_itr_length=STRING.LENGTH("q6_spdmtm_clk")

  if (STRING.SCAN("&clk", "*", 0)==0)
  (
    &wild_head=1
  )
  if (STRING.SCAN("&clk", "*", 1)==(STRING.LENGTH("&clk")-1))
  (
    &wild_tail=1
  )

  if ((&wild_head==1)&&(&wild_tail==1))
  (
    if (STRING.SCAN("q6_spdmtm_clk", STRING.MID("&clk", 1, &clk_input_length-2), 0)!=-1)
    ( 
      &match=1
    )
  )
  else if (&wild_head==1)
  (
    if (STRING.MID("q6_spdmtm_clk", &clk_itr_length-&clk_input_length+1, &clk_input_length-1)==STRING.CUT("&clk", 1))
    ( 
      &match=1
    )
  )
  else if (&wild_tail==1)
  (
    if (STRING.MID("q6_spdmtm_clk", 0, &clk_input_length-1)==STRING.CUT("&clk", -1))
    ( 
      &match=1
    )
  )	  
  else if ("q6_spdmtm_clk"=="&clk")
  (
    &match=1
  )
  
  if (&match==1)
  (
    &clk_test=&CLK_TEST_Q6_SPDMTM_CLK
    &clk_reg=0
    &clk_reg_name="No CBCR"
    &clk_name="q6_spdmtm_clk"
    &clk_reg_cbcr_type="sm_cbc"

    gosub Print_Clk_Info_Line
  )
  
  &match=0
  &wild_head=0
  &wild_tail=0
  &clk_input_length=STRING.LENGTH("&clk")
  &clk_itr_length=STRING.LENGTH("audio_core_lpaif_sec_ebit_clk")

  if (STRING.SCAN("&clk", "*", 0)==0)
  (
    &wild_head=1
  )
  if (STRING.SCAN("&clk", "*", 1)==(STRING.LENGTH("&clk")-1))
  (
    &wild_tail=1
  )

  if ((&wild_head==1)&&(&wild_tail==1))
  (
    if (STRING.SCAN("audio_core_lpaif_sec_ebit_clk", STRING.MID("&clk", 1, &clk_input_length-2), 0)!=-1)
    ( 
      &match=1
    )
  )
  else if (&wild_head==1)
  (
    if (STRING.MID("audio_core_lpaif_sec_ebit_clk", &clk_itr_length-&clk_input_length+1, &clk_input_length-1)==STRING.CUT("&clk", 1))
    ( 
      &match=1
    )
  )
  else if (&wild_tail==1)
  (
    if (STRING.MID("audio_core_lpaif_sec_ebit_clk", 0, &clk_input_length-1)==STRING.CUT("&clk", -1))
    ( 
      &match=1
    )
  )	  
  else if ("audio_core_lpaif_sec_ebit_clk"=="&clk")
  (
    &match=1
  )
  
  if (&match==1)
  (
    &clk_test=0
    &clk_reg=&HWIO_LPASS_AUDIO_CORE_LPAIF_SEC_EBIT_CBCR_ADDR
    &clk_reg_name="LPASS_AUDIO_CORE_LPAIF_SEC_EBIT_CBCR"
    &clk_name="audio_core_lpaif_sec_ebit_clk"
    &clk_reg_cbcr_type="sm_cbc"

    gosub Print_Clk_Info_Line
  )
  
  &match=0
  &wild_head=0
  &wild_tail=0
  &clk_input_length=STRING.LENGTH("&clk")
  &clk_itr_length=STRING.LENGTH("audio_core_lpaif_sec_ibit_clk")

  if (STRING.SCAN("&clk", "*", 0)==0)
  (
    &wild_head=1
  )
  if (STRING.SCAN("&clk", "*", 1)==(STRING.LENGTH("&clk")-1))
  (
    &wild_tail=1
  )

  if ((&wild_head==1)&&(&wild_tail==1))
  (
    if (STRING.SCAN("audio_core_lpaif_sec_ibit_clk", STRING.MID("&clk", 1, &clk_input_length-2), 0)!=-1)
    ( 
      &match=1
    )
  )
  else if (&wild_head==1)
  (
    if (STRING.MID("audio_core_lpaif_sec_ibit_clk", &clk_itr_length-&clk_input_length+1, &clk_input_length-1)==STRING.CUT("&clk", 1))
    ( 
      &match=1
    )
  )
  else if (&wild_tail==1)
  (
    if (STRING.MID("audio_core_lpaif_sec_ibit_clk", 0, &clk_input_length-1)==STRING.CUT("&clk", -1))
    ( 
      &match=1
    )
  )	  
  else if ("audio_core_lpaif_sec_ibit_clk"=="&clk")
  (
    &match=1
  )
  
  if (&match==1)
  (
    &clk_test=0
    &clk_reg=&HWIO_LPASS_AUDIO_CORE_LPAIF_SEC_IBIT_CBCR_ADDR
    &clk_reg_name="LPASS_AUDIO_CORE_LPAIF_SEC_IBIT_CBCR"
    &clk_name="audio_core_lpaif_sec_ibit_clk"
    &clk_reg_cbcr_type="sm_cbc"

    gosub Print_Clk_Info_Line
  )
  
  &match=0
  &wild_head=0
  &wild_tail=0
  &clk_input_length=STRING.LENGTH("&clk")
  &clk_itr_length=STRING.LENGTH("audio_core_lpaif_sec_osr_clk")

  if (STRING.SCAN("&clk", "*", 0)==0)
  (
    &wild_head=1
  )
  if (STRING.SCAN("&clk", "*", 1)==(STRING.LENGTH("&clk")-1))
  (
    &wild_tail=1
  )

  if ((&wild_head==1)&&(&wild_tail==1))
  (
    if (STRING.SCAN("audio_core_lpaif_sec_osr_clk", STRING.MID("&clk", 1, &clk_input_length-2), 0)!=-1)
    ( 
      &match=1
    )
  )
  else if (&wild_head==1)
  (
    if (STRING.MID("audio_core_lpaif_sec_osr_clk", &clk_itr_length-&clk_input_length+1, &clk_input_length-1)==STRING.CUT("&clk", 1))
    ( 
      &match=1
    )
  )
  else if (&wild_tail==1)
  (
    if (STRING.MID("audio_core_lpaif_sec_osr_clk", 0, &clk_input_length-1)==STRING.CUT("&clk", -1))
    ( 
      &match=1
    )
  )	  
  else if ("audio_core_lpaif_sec_osr_clk"=="&clk")
  (
    &match=1
  )
  
  if (&match==1)
  (
    &clk_test=0
    &clk_reg=&HWIO_LPASS_AUDIO_CORE_LPAIF_SEC_OSR_CBCR_ADDR
    &clk_reg_name="LPASS_AUDIO_CORE_LPAIF_SEC_OSR_CBCR"
    &clk_name="audio_core_lpaif_sec_osr_clk"
    &clk_reg_cbcr_type="sm_cbc"

    gosub Print_Clk_Info_Line
  )
  
  &match=0
  &wild_head=0
  &wild_tail=0
  &clk_input_length=STRING.LENGTH("&clk")
  &clk_itr_length=STRING.LENGTH("lpaif_sec_clk_src")

  if (STRING.SCAN("&clk", "*", 0)==0)
  (
    &wild_head=1
  )
  if (STRING.SCAN("&clk", "*", 1)==(STRING.LENGTH("&clk")-1))
  (
    &wild_tail=1
  )

  if ((&wild_head==1)&&(&wild_tail==1))
  (
    if (STRING.SCAN("lpaif_sec_clk_src", STRING.MID("&clk", 1, &clk_input_length-2), 0)!=-1)
    ( 
      &match=1
    )
  )
  else if (&wild_head==1)
  (
    if (STRING.MID("lpaif_sec_clk_src", &clk_itr_length-&clk_input_length+1, &clk_input_length-1)==STRING.CUT("&clk", 1))
    ( 
      &match=1
    )
  )
  else if (&wild_tail==1)
  (
    if (STRING.MID("lpaif_sec_clk_src", 0, &clk_input_length-1)==STRING.CUT("&clk", -1))
    ( 
      &match=1
    )
  )	  
  else if ("lpaif_sec_clk_src"=="&clk")
  (
    &match=1
  )
  
  if (&match==1)
  (
    &clk_test=&CLK_TEST_LPAIF_SEC_CLK_SRC
    &clk_reg=0
    &clk_reg_name="No CBCR"
    &clk_name="lpaif_sec_clk_src"
    &clk_reg_cbcr_type=""

    gosub Print_Clk_Info_Line
  )
  
  &match=0
  &wild_head=0
  &wild_tail=0
  &clk_input_length=STRING.LENGTH("&clk")
  &clk_itr_length=STRING.LENGTH("audio_core_lpaif_pcm1_ebit_clk")

  if (STRING.SCAN("&clk", "*", 0)==0)
  (
    &wild_head=1
  )
  if (STRING.SCAN("&clk", "*", 1)==(STRING.LENGTH("&clk")-1))
  (
    &wild_tail=1
  )

  if ((&wild_head==1)&&(&wild_tail==1))
  (
    if (STRING.SCAN("audio_core_lpaif_pcm1_ebit_clk", STRING.MID("&clk", 1, &clk_input_length-2), 0)!=-1)
    ( 
      &match=1
    )
  )
  else if (&wild_head==1)
  (
    if (STRING.MID("audio_core_lpaif_pcm1_ebit_clk", &clk_itr_length-&clk_input_length+1, &clk_input_length-1)==STRING.CUT("&clk", 1))
    ( 
      &match=1
    )
  )
  else if (&wild_tail==1)
  (
    if (STRING.MID("audio_core_lpaif_pcm1_ebit_clk", 0, &clk_input_length-1)==STRING.CUT("&clk", -1))
    ( 
      &match=1
    )
  )	  
  else if ("audio_core_lpaif_pcm1_ebit_clk"=="&clk")
  (
    &match=1
  )
  
  if (&match==1)
  (
    &clk_test=0
    &clk_reg=&HWIO_LPASS_AUDIO_CORE_LPAIF_PCM1_EBIT_CBCR_ADDR
    &clk_reg_name="LPASS_AUDIO_CORE_LPAIF_PCM1_EBIT_CBCR"
    &clk_name="audio_core_lpaif_pcm1_ebit_clk"
    &clk_reg_cbcr_type="sm_cbc"

    gosub Print_Clk_Info_Line
  )
  
  &match=0
  &wild_head=0
  &wild_tail=0
  &clk_input_length=STRING.LENGTH("&clk")
  &clk_itr_length=STRING.LENGTH("audio_core_lpaif_pcm1_ibit_clk")

  if (STRING.SCAN("&clk", "*", 0)==0)
  (
    &wild_head=1
  )
  if (STRING.SCAN("&clk", "*", 1)==(STRING.LENGTH("&clk")-1))
  (
    &wild_tail=1
  )

  if ((&wild_head==1)&&(&wild_tail==1))
  (
    if (STRING.SCAN("audio_core_lpaif_pcm1_ibit_clk", STRING.MID("&clk", 1, &clk_input_length-2), 0)!=-1)
    ( 
      &match=1
    )
  )
  else if (&wild_head==1)
  (
    if (STRING.MID("audio_core_lpaif_pcm1_ibit_clk", &clk_itr_length-&clk_input_length+1, &clk_input_length-1)==STRING.CUT("&clk", 1))
    ( 
      &match=1
    )
  )
  else if (&wild_tail==1)
  (
    if (STRING.MID("audio_core_lpaif_pcm1_ibit_clk", 0, &clk_input_length-1)==STRING.CUT("&clk", -1))
    ( 
      &match=1
    )
  )	  
  else if ("audio_core_lpaif_pcm1_ibit_clk"=="&clk")
  (
    &match=1
  )
  
  if (&match==1)
  (
    &clk_test=0
    &clk_reg=&HWIO_LPASS_AUDIO_CORE_LPAIF_PCM1_IBIT_CBCR_ADDR
    &clk_reg_name="LPASS_AUDIO_CORE_LPAIF_PCM1_IBIT_CBCR"
    &clk_name="audio_core_lpaif_pcm1_ibit_clk"
    &clk_reg_cbcr_type="sm_cbc"

    gosub Print_Clk_Info_Line
  )
  
  &match=0
  &wild_head=0
  &wild_tail=0
  &clk_input_length=STRING.LENGTH("&clk")
  &clk_itr_length=STRING.LENGTH("lpaif_pcm1_clk_src")

  if (STRING.SCAN("&clk", "*", 0)==0)
  (
    &wild_head=1
  )
  if (STRING.SCAN("&clk", "*", 1)==(STRING.LENGTH("&clk")-1))
  (
    &wild_tail=1
  )

  if ((&wild_head==1)&&(&wild_tail==1))
  (
    if (STRING.SCAN("lpaif_pcm1_clk_src", STRING.MID("&clk", 1, &clk_input_length-2), 0)!=-1)
    ( 
      &match=1
    )
  )
  else if (&wild_head==1)
  (
    if (STRING.MID("lpaif_pcm1_clk_src", &clk_itr_length-&clk_input_length+1, &clk_input_length-1)==STRING.CUT("&clk", 1))
    ( 
      &match=1
    )
  )
  else if (&wild_tail==1)
  (
    if (STRING.MID("lpaif_pcm1_clk_src", 0, &clk_input_length-1)==STRING.CUT("&clk", -1))
    ( 
      &match=1
    )
  )	  
  else if ("lpaif_pcm1_clk_src"=="&clk")
  (
    &match=1
  )
  
  if (&match==1)
  (
    &clk_test=&CLK_TEST_LPAIF_PCM1_CLK_SRC
    &clk_reg=0
    &clk_reg_name="No CBCR"
    &clk_name="lpaif_pcm1_clk_src"
    &clk_reg_cbcr_type=""

    gosub Print_Clk_Info_Line
  )
  
  &match=0
  &wild_head=0
  &wild_tail=0
  &clk_input_length=STRING.LENGTH("&clk")
  &clk_itr_length=STRING.LENGTH("audio_core_bcr_slp_clk")

  if (STRING.SCAN("&clk", "*", 0)==0)
  (
    &wild_head=1
  )
  if (STRING.SCAN("&clk", "*", 1)==(STRING.LENGTH("&clk")-1))
  (
    &wild_tail=1
  )

  if ((&wild_head==1)&&(&wild_tail==1))
  (
    if (STRING.SCAN("audio_core_bcr_slp_clk", STRING.MID("&clk", 1, &clk_input_length-2), 0)!=-1)
    ( 
      &match=1
    )
  )
  else if (&wild_head==1)
  (
    if (STRING.MID("audio_core_bcr_slp_clk", &clk_itr_length-&clk_input_length+1, &clk_input_length-1)==STRING.CUT("&clk", 1))
    ( 
      &match=1
    )
  )
  else if (&wild_tail==1)
  (
    if (STRING.MID("audio_core_bcr_slp_clk", 0, &clk_input_length-1)==STRING.CUT("&clk", -1))
    ( 
      &match=1
    )
  )	  
  else if ("audio_core_bcr_slp_clk"=="&clk")
  (
    &match=1
  )
  
  if (&match==1)
  (
    &clk_test=&CLK_TEST_AUDIO_CORE_BCR_SLP_CLK
    &clk_reg=&HWIO_LPASS_AUDIO_CORE_BCR_SLP_CBCR_ADDR
    &clk_reg_name="LPASS_AUDIO_CORE_BCR_SLP_CBCR"
    &clk_name="audio_core_bcr_slp_clk"
    &clk_reg_cbcr_type="sm_cbc"

    gosub Print_Clk_Info_Line
  )
  
  &match=0
  &wild_head=0
  &wild_tail=0
  &clk_input_length=STRING.LENGTH("&clk")
  &clk_itr_length=STRING.LENGTH("q6ss_bcr_slp_clk")

  if (STRING.SCAN("&clk", "*", 0)==0)
  (
    &wild_head=1
  )
  if (STRING.SCAN("&clk", "*", 1)==(STRING.LENGTH("&clk")-1))
  (
    &wild_tail=1
  )

  if ((&wild_head==1)&&(&wild_tail==1))
  (
    if (STRING.SCAN("q6ss_bcr_slp_clk", STRING.MID("&clk", 1, &clk_input_length-2), 0)!=-1)
    ( 
      &match=1
    )
  )
  else if (&wild_head==1)
  (
    if (STRING.MID("q6ss_bcr_slp_clk", &clk_itr_length-&clk_input_length+1, &clk_input_length-1)==STRING.CUT("&clk", 1))
    ( 
      &match=1
    )
  )
  else if (&wild_tail==1)
  (
    if (STRING.MID("q6ss_bcr_slp_clk", 0, &clk_input_length-1)==STRING.CUT("&clk", -1))
    ( 
      &match=1
    )
  )	  
  else if ("q6ss_bcr_slp_clk"=="&clk")
  (
    &match=1
  )
  
  if (&match==1)
  (
    &clk_test=&CLK_TEST_Q6SS_BCR_SLP_CLK
    &clk_reg=&HWIO_LPASS_Q6SS_BCR_SLP_CBCR_ADDR
    &clk_reg_name="LPASS_Q6SS_BCR_SLP_CBCR"
    &clk_name="q6ss_bcr_slp_clk"
    &clk_reg_cbcr_type="sm_cbc"

    gosub Print_Clk_Info_Line
  )
  
  &match=0
  &wild_head=0
  &wild_tail=0
  &clk_input_length=STRING.LENGTH("&clk")
  &clk_itr_length=STRING.LENGTH("q6ss_slp_clk")

  if (STRING.SCAN("&clk", "*", 0)==0)
  (
    &wild_head=1
  )
  if (STRING.SCAN("&clk", "*", 1)==(STRING.LENGTH("&clk")-1))
  (
    &wild_tail=1
  )

  if ((&wild_head==1)&&(&wild_tail==1))
  (
    if (STRING.SCAN("q6ss_slp_clk", STRING.MID("&clk", 1, &clk_input_length-2), 0)!=-1)
    ( 
      &match=1
    )
  )
  else if (&wild_head==1)
  (
    if (STRING.MID("q6ss_slp_clk", &clk_itr_length-&clk_input_length+1, &clk_input_length-1)==STRING.CUT("&clk", 1))
    ( 
      &match=1
    )
  )
  else if (&wild_tail==1)
  (
    if (STRING.MID("q6ss_slp_clk", 0, &clk_input_length-1)==STRING.CUT("&clk", -1))
    ( 
      &match=1
    )
  )	  
  else if ("q6ss_slp_clk"=="&clk")
  (
    &match=1
  )
  
  if (&match==1)
  (
    &clk_test=&CLK_TEST_Q6SS_SLP_CLK
    &clk_reg=&HWIO_LPASS_Q6SS_SLP_CBCR_ADDR
    &clk_reg_name="LPASS_Q6SS_SLP_CBCR"
    &clk_name="q6ss_slp_clk"
    &clk_reg_cbcr_type="sm_cbc"

    gosub Print_Clk_Info_Line
  )
  
  &match=0
  &wild_head=0
  &wild_tail=0
  &clk_input_length=STRING.LENGTH("&clk")
  &clk_itr_length=STRING.LENGTH("sleep_clk_src")

  if (STRING.SCAN("&clk", "*", 0)==0)
  (
    &wild_head=1
  )
  if (STRING.SCAN("&clk", "*", 1)==(STRING.LENGTH("&clk")-1))
  (
    &wild_tail=1
  )

  if ((&wild_head==1)&&(&wild_tail==1))
  (
    if (STRING.SCAN("sleep_clk_src", STRING.MID("&clk", 1, &clk_input_length-2), 0)!=-1)
    ( 
      &match=1
    )
  )
  else if (&wild_head==1)
  (
    if (STRING.MID("sleep_clk_src", &clk_itr_length-&clk_input_length+1, &clk_input_length-1)==STRING.CUT("&clk", 1))
    ( 
      &match=1
    )
  )
  else if (&wild_tail==1)
  (
    if (STRING.MID("sleep_clk_src", 0, &clk_input_length-1)==STRING.CUT("&clk", -1))
    ( 
      &match=1
    )
  )	  
  else if ("sleep_clk_src"=="&clk")
  (
    &match=1
  )
  
  if (&match==1)
  (
    &clk_test=&CLK_TEST_SLEEP_CLK_SRC
    &clk_reg=0
    &clk_reg_name="No CBCR"
    &clk_name="sleep_clk_src"
    &clk_reg_cbcr_type=""

    gosub Print_Clk_Info_Line
  )
  
  &match=0
  &wild_head=0
  &wild_tail=0
  &clk_input_length=STRING.LENGTH("&clk")
  &clk_itr_length=STRING.LENGTH("audio_core_lpaif_codec_spkr_ebit_clk")

  if (STRING.SCAN("&clk", "*", 0)==0)
  (
    &wild_head=1
  )
  if (STRING.SCAN("&clk", "*", 1)==(STRING.LENGTH("&clk")-1))
  (
    &wild_tail=1
  )

  if ((&wild_head==1)&&(&wild_tail==1))
  (
    if (STRING.SCAN("audio_core_lpaif_codec_spkr_ebit_clk", STRING.MID("&clk", 1, &clk_input_length-2), 0)!=-1)
    ( 
      &match=1
    )
  )
  else if (&wild_head==1)
  (
    if (STRING.MID("audio_core_lpaif_codec_spkr_ebit_clk", &clk_itr_length-&clk_input_length+1, &clk_input_length-1)==STRING.CUT("&clk", 1))
    ( 
      &match=1
    )
  )
  else if (&wild_tail==1)
  (
    if (STRING.MID("audio_core_lpaif_codec_spkr_ebit_clk", 0, &clk_input_length-1)==STRING.CUT("&clk", -1))
    ( 
      &match=1
    )
  )	  
  else if ("audio_core_lpaif_codec_spkr_ebit_clk"=="&clk")
  (
    &match=1
  )
  
  if (&match==1)
  (
    &clk_test=0
    &clk_reg=&HWIO_LPASS_AUDIO_CORE_LPAIF_CODEC_SPKR_EBIT_CBCR_ADDR
    &clk_reg_name="LPASS_AUDIO_CORE_LPAIF_CODEC_SPKR_EBIT_CBCR"
    &clk_name="audio_core_lpaif_codec_spkr_ebit_clk"
    &clk_reg_cbcr_type="sm_cbc"

    gosub Print_Clk_Info_Line
  )
  
  &match=0
  &wild_head=0
  &wild_tail=0
  &clk_input_length=STRING.LENGTH("&clk")
  &clk_itr_length=STRING.LENGTH("audio_core_lpaif_codec_spkr_ibit_clk")

  if (STRING.SCAN("&clk", "*", 0)==0)
  (
    &wild_head=1
  )
  if (STRING.SCAN("&clk", "*", 1)==(STRING.LENGTH("&clk")-1))
  (
    &wild_tail=1
  )

  if ((&wild_head==1)&&(&wild_tail==1))
  (
    if (STRING.SCAN("audio_core_lpaif_codec_spkr_ibit_clk", STRING.MID("&clk", 1, &clk_input_length-2), 0)!=-1)
    ( 
      &match=1
    )
  )
  else if (&wild_head==1)
  (
    if (STRING.MID("audio_core_lpaif_codec_spkr_ibit_clk", &clk_itr_length-&clk_input_length+1, &clk_input_length-1)==STRING.CUT("&clk", 1))
    ( 
      &match=1
    )
  )
  else if (&wild_tail==1)
  (
    if (STRING.MID("audio_core_lpaif_codec_spkr_ibit_clk", 0, &clk_input_length-1)==STRING.CUT("&clk", -1))
    ( 
      &match=1
    )
  )	  
  else if ("audio_core_lpaif_codec_spkr_ibit_clk"=="&clk")
  (
    &match=1
  )
  
  if (&match==1)
  (
    &clk_test=0
    &clk_reg=&HWIO_LPASS_AUDIO_CORE_LPAIF_CODEC_SPKR_IBIT_CBCR_ADDR
    &clk_reg_name="LPASS_AUDIO_CORE_LPAIF_CODEC_SPKR_IBIT_CBCR"
    &clk_name="audio_core_lpaif_codec_spkr_ibit_clk"
    &clk_reg_cbcr_type="sm_cbc"

    gosub Print_Clk_Info_Line
  )
  
  &match=0
  &wild_head=0
  &wild_tail=0
  &clk_input_length=STRING.LENGTH("&clk")
  &clk_itr_length=STRING.LENGTH("audio_core_lpaif_codec_spkr_osr_clk")

  if (STRING.SCAN("&clk", "*", 0)==0)
  (
    &wild_head=1
  )
  if (STRING.SCAN("&clk", "*", 1)==(STRING.LENGTH("&clk")-1))
  (
    &wild_tail=1
  )

  if ((&wild_head==1)&&(&wild_tail==1))
  (
    if (STRING.SCAN("audio_core_lpaif_codec_spkr_osr_clk", STRING.MID("&clk", 1, &clk_input_length-2), 0)!=-1)
    ( 
      &match=1
    )
  )
  else if (&wild_head==1)
  (
    if (STRING.MID("audio_core_lpaif_codec_spkr_osr_clk", &clk_itr_length-&clk_input_length+1, &clk_input_length-1)==STRING.CUT("&clk", 1))
    ( 
      &match=1
    )
  )
  else if (&wild_tail==1)
  (
    if (STRING.MID("audio_core_lpaif_codec_spkr_osr_clk", 0, &clk_input_length-1)==STRING.CUT("&clk", -1))
    ( 
      &match=1
    )
  )	  
  else if ("audio_core_lpaif_codec_spkr_osr_clk"=="&clk")
  (
    &match=1
  )
  
  if (&match==1)
  (
    &clk_test=0
    &clk_reg=&HWIO_LPASS_AUDIO_CORE_LPAIF_CODEC_SPKR_OSR_CBCR_ADDR
    &clk_reg_name="LPASS_AUDIO_CORE_LPAIF_CODEC_SPKR_OSR_CBCR"
    &clk_name="audio_core_lpaif_codec_spkr_osr_clk"
    &clk_reg_cbcr_type="sm_cbc"

    gosub Print_Clk_Info_Line
  )
  
  &match=0
  &wild_head=0
  &wild_tail=0
  &clk_input_length=STRING.LENGTH("&clk")
  &clk_itr_length=STRING.LENGTH("lpaif_spkr_clk_src")

  if (STRING.SCAN("&clk", "*", 0)==0)
  (
    &wild_head=1
  )
  if (STRING.SCAN("&clk", "*", 1)==(STRING.LENGTH("&clk")-1))
  (
    &wild_tail=1
  )

  if ((&wild_head==1)&&(&wild_tail==1))
  (
    if (STRING.SCAN("lpaif_spkr_clk_src", STRING.MID("&clk", 1, &clk_input_length-2), 0)!=-1)
    ( 
      &match=1
    )
  )
  else if (&wild_head==1)
  (
    if (STRING.MID("lpaif_spkr_clk_src", &clk_itr_length-&clk_input_length+1, &clk_input_length-1)==STRING.CUT("&clk", 1))
    ( 
      &match=1
    )
  )
  else if (&wild_tail==1)
  (
    if (STRING.MID("lpaif_spkr_clk_src", 0, &clk_input_length-1)==STRING.CUT("&clk", -1))
    ( 
      &match=1
    )
  )	  
  else if ("lpaif_spkr_clk_src"=="&clk")
  (
    &match=1
  )
  
  if (&match==1)
  (
    &clk_test=&CLK_TEST_LPAIF_SPKR_CLK_SRC
    &clk_reg=0
    &clk_reg_name="No CBCR"
    &clk_name="lpaif_spkr_clk_src"
    &clk_reg_cbcr_type=""

    gosub Print_Clk_Info_Line
  )
  
  &match=0
  &wild_head=0
  &wild_tail=0
  &clk_input_length=STRING.LENGTH("&clk")
  &clk_itr_length=STRING.LENGTH("audio_core_lpaif_ter_ebit_clk")

  if (STRING.SCAN("&clk", "*", 0)==0)
  (
    &wild_head=1
  )
  if (STRING.SCAN("&clk", "*", 1)==(STRING.LENGTH("&clk")-1))
  (
    &wild_tail=1
  )

  if ((&wild_head==1)&&(&wild_tail==1))
  (
    if (STRING.SCAN("audio_core_lpaif_ter_ebit_clk", STRING.MID("&clk", 1, &clk_input_length-2), 0)!=-1)
    ( 
      &match=1
    )
  )
  else if (&wild_head==1)
  (
    if (STRING.MID("audio_core_lpaif_ter_ebit_clk", &clk_itr_length-&clk_input_length+1, &clk_input_length-1)==STRING.CUT("&clk", 1))
    ( 
      &match=1
    )
  )
  else if (&wild_tail==1)
  (
    if (STRING.MID("audio_core_lpaif_ter_ebit_clk", 0, &clk_input_length-1)==STRING.CUT("&clk", -1))
    ( 
      &match=1
    )
  )	  
  else if ("audio_core_lpaif_ter_ebit_clk"=="&clk")
  (
    &match=1
  )
  
  if (&match==1)
  (
    &clk_test=0
    &clk_reg=&HWIO_LPASS_AUDIO_CORE_LPAIF_TER_EBIT_CBCR_ADDR
    &clk_reg_name="LPASS_AUDIO_CORE_LPAIF_TER_EBIT_CBCR"
    &clk_name="audio_core_lpaif_ter_ebit_clk"
    &clk_reg_cbcr_type="sm_cbc"

    gosub Print_Clk_Info_Line
  )
  
  &match=0
  &wild_head=0
  &wild_tail=0
  &clk_input_length=STRING.LENGTH("&clk")
  &clk_itr_length=STRING.LENGTH("audio_core_lpaif_ter_ibit_clk")

  if (STRING.SCAN("&clk", "*", 0)==0)
  (
    &wild_head=1
  )
  if (STRING.SCAN("&clk", "*", 1)==(STRING.LENGTH("&clk")-1))
  (
    &wild_tail=1
  )

  if ((&wild_head==1)&&(&wild_tail==1))
  (
    if (STRING.SCAN("audio_core_lpaif_ter_ibit_clk", STRING.MID("&clk", 1, &clk_input_length-2), 0)!=-1)
    ( 
      &match=1
    )
  )
  else if (&wild_head==1)
  (
    if (STRING.MID("audio_core_lpaif_ter_ibit_clk", &clk_itr_length-&clk_input_length+1, &clk_input_length-1)==STRING.CUT("&clk", 1))
    ( 
      &match=1
    )
  )
  else if (&wild_tail==1)
  (
    if (STRING.MID("audio_core_lpaif_ter_ibit_clk", 0, &clk_input_length-1)==STRING.CUT("&clk", -1))
    ( 
      &match=1
    )
  )	  
  else if ("audio_core_lpaif_ter_ibit_clk"=="&clk")
  (
    &match=1
  )
  
  if (&match==1)
  (
    &clk_test=0
    &clk_reg=&HWIO_LPASS_AUDIO_CORE_LPAIF_TER_IBIT_CBCR_ADDR
    &clk_reg_name="LPASS_AUDIO_CORE_LPAIF_TER_IBIT_CBCR"
    &clk_name="audio_core_lpaif_ter_ibit_clk"
    &clk_reg_cbcr_type="sm_cbc"

    gosub Print_Clk_Info_Line
  )
  
  &match=0
  &wild_head=0
  &wild_tail=0
  &clk_input_length=STRING.LENGTH("&clk")
  &clk_itr_length=STRING.LENGTH("audio_core_lpaif_ter_osr_clk")

  if (STRING.SCAN("&clk", "*", 0)==0)
  (
    &wild_head=1
  )
  if (STRING.SCAN("&clk", "*", 1)==(STRING.LENGTH("&clk")-1))
  (
    &wild_tail=1
  )

  if ((&wild_head==1)&&(&wild_tail==1))
  (
    if (STRING.SCAN("audio_core_lpaif_ter_osr_clk", STRING.MID("&clk", 1, &clk_input_length-2), 0)!=-1)
    ( 
      &match=1
    )
  )
  else if (&wild_head==1)
  (
    if (STRING.MID("audio_core_lpaif_ter_osr_clk", &clk_itr_length-&clk_input_length+1, &clk_input_length-1)==STRING.CUT("&clk", 1))
    ( 
      &match=1
    )
  )
  else if (&wild_tail==1)
  (
    if (STRING.MID("audio_core_lpaif_ter_osr_clk", 0, &clk_input_length-1)==STRING.CUT("&clk", -1))
    ( 
      &match=1
    )
  )	  
  else if ("audio_core_lpaif_ter_osr_clk"=="&clk")
  (
    &match=1
  )
  
  if (&match==1)
  (
    &clk_test=0
    &clk_reg=&HWIO_LPASS_AUDIO_CORE_LPAIF_TER_OSR_CBCR_ADDR
    &clk_reg_name="LPASS_AUDIO_CORE_LPAIF_TER_OSR_CBCR"
    &clk_name="audio_core_lpaif_ter_osr_clk"
    &clk_reg_cbcr_type="sm_cbc"

    gosub Print_Clk_Info_Line
  )
  
  &match=0
  &wild_head=0
  &wild_tail=0
  &clk_input_length=STRING.LENGTH("&clk")
  &clk_itr_length=STRING.LENGTH("lpaif_ter_clk_src")

  if (STRING.SCAN("&clk", "*", 0)==0)
  (
    &wild_head=1
  )
  if (STRING.SCAN("&clk", "*", 1)==(STRING.LENGTH("&clk")-1))
  (
    &wild_tail=1
  )

  if ((&wild_head==1)&&(&wild_tail==1))
  (
    if (STRING.SCAN("lpaif_ter_clk_src", STRING.MID("&clk", 1, &clk_input_length-2), 0)!=-1)
    ( 
      &match=1
    )
  )
  else if (&wild_head==1)
  (
    if (STRING.MID("lpaif_ter_clk_src", &clk_itr_length-&clk_input_length+1, &clk_input_length-1)==STRING.CUT("&clk", 1))
    ( 
      &match=1
    )
  )
  else if (&wild_tail==1)
  (
    if (STRING.MID("lpaif_ter_clk_src", 0, &clk_input_length-1)==STRING.CUT("&clk", -1))
    ( 
      &match=1
    )
  )	  
  else if ("lpaif_ter_clk_src"=="&clk")
  (
    &match=1
  )
  
  if (&match==1)
  (
    &clk_test=&CLK_TEST_LPAIF_TER_CLK_SRC
    &clk_reg=0
    &clk_reg_name="No CBCR"
    &clk_name="lpaif_ter_clk_src"
    &clk_reg_cbcr_type=""

    gosub Print_Clk_Info_Line
  )
  
; Setting appropriate access mode for non-MSS clocks
&clk_access_mod="eahb:"

  &match=0
  &wild_head=0
  &wild_tail=0
  &clk_input_length=STRING.LENGTH("&clk")
  &clk_itr_length=STRING.LENGTH("avsync_ahb_clk")

  if (STRING.SCAN("&clk", "*", 0)==0)
  (
    &wild_head=1
  )
  if (STRING.SCAN("&clk", "*", 1)==(STRING.LENGTH("&clk")-1))
  (
    &wild_tail=1
  )

  if ((&wild_head==1)&&(&wild_tail==1))
  (
    if (STRING.SCAN("avsync_ahb_clk", STRING.MID("&clk", 1, &clk_input_length-2), 0)!=-1)
    ( 
      &match=1
    )
  )
  else if (&wild_head==1)
  (
    if (STRING.MID("avsync_ahb_clk", &clk_itr_length-&clk_input_length+1, &clk_input_length-1)==STRING.CUT("&clk", 1))
    ( 
      &match=1
    )
  )
  else if (&wild_tail==1)
  (
    if (STRING.MID("avsync_ahb_clk", 0, &clk_input_length-1)==STRING.CUT("&clk", -1))
    ( 
      &match=1
    )
  )	  
  else if ("avsync_ahb_clk"=="&clk")
  (
    &match=1
  )
  
  if (&match==1)
  (
    &clk_test=&CLK_TEST_AVSYNC_AHB_CLK
    &clk_reg=&HWIO_MMSS_AVSYNC_AHB_CBCR_ADDR
    &clk_reg_name="MMSS_AVSYNC_AHB_CBCR"
    &clk_name="avsync_ahb_clk"
    &clk_reg_cbcr_type="sm_cbc"

    gosub Print_Clk_Info_Line
  )
  
  &match=0
  &wild_head=0
  &wild_tail=0
  &clk_input_length=STRING.LENGTH("&clk")
  &clk_itr_length=STRING.LENGTH("avsync_edppixel_clk")

  if (STRING.SCAN("&clk", "*", 0)==0)
  (
    &wild_head=1
  )
  if (STRING.SCAN("&clk", "*", 1)==(STRING.LENGTH("&clk")-1))
  (
    &wild_tail=1
  )

  if ((&wild_head==1)&&(&wild_tail==1))
  (
    if (STRING.SCAN("avsync_edppixel_clk", STRING.MID("&clk", 1, &clk_input_length-2), 0)!=-1)
    ( 
      &match=1
    )
  )
  else if (&wild_head==1)
  (
    if (STRING.MID("avsync_edppixel_clk", &clk_itr_length-&clk_input_length+1, &clk_input_length-1)==STRING.CUT("&clk", 1))
    ( 
      &match=1
    )
  )
  else if (&wild_tail==1)
  (
    if (STRING.MID("avsync_edppixel_clk", 0, &clk_input_length-1)==STRING.CUT("&clk", -1))
    ( 
      &match=1
    )
  )	  
  else if ("avsync_edppixel_clk"=="&clk")
  (
    &match=1
  )
  
  if (&match==1)
  (
    &clk_test=&CLK_TEST_AVSYNC_EDPPIXEL_CLK
    &clk_reg=&HWIO_MMSS_AVSYNC_EDPPIXEL_CBCR_ADDR
    &clk_reg_name="MMSS_AVSYNC_EDPPIXEL_CBCR"
    &clk_name="avsync_edppixel_clk"
    &clk_reg_cbcr_type="sm_cbc"

    gosub Print_Clk_Info_Line
  )
  
  &match=0
  &wild_head=0
  &wild_tail=0
  &clk_input_length=STRING.LENGTH("&clk")
  &clk_itr_length=STRING.LENGTH("avsync_extpclk_clk")

  if (STRING.SCAN("&clk", "*", 0)==0)
  (
    &wild_head=1
  )
  if (STRING.SCAN("&clk", "*", 1)==(STRING.LENGTH("&clk")-1))
  (
    &wild_tail=1
  )

  if ((&wild_head==1)&&(&wild_tail==1))
  (
    if (STRING.SCAN("avsync_extpclk_clk", STRING.MID("&clk", 1, &clk_input_length-2), 0)!=-1)
    ( 
      &match=1
    )
  )
  else if (&wild_head==1)
  (
    if (STRING.MID("avsync_extpclk_clk", &clk_itr_length-&clk_input_length+1, &clk_input_length-1)==STRING.CUT("&clk", 1))
    ( 
      &match=1
    )
  )
  else if (&wild_tail==1)
  (
    if (STRING.MID("avsync_extpclk_clk", 0, &clk_input_length-1)==STRING.CUT("&clk", -1))
    ( 
      &match=1
    )
  )	  
  else if ("avsync_extpclk_clk"=="&clk")
  (
    &match=1
  )
  
  if (&match==1)
  (
    &clk_test=&CLK_TEST_AVSYNC_EXTPCLK_CLK
    &clk_reg=&HWIO_MMSS_AVSYNC_EXTPCLK_CBCR_ADDR
    &clk_reg_name="MMSS_AVSYNC_EXTPCLK_CBCR"
    &clk_name="avsync_extpclk_clk"
    &clk_reg_cbcr_type="sm_cbc"

    gosub Print_Clk_Info_Line
  )
  
  &match=0
  &wild_head=0
  &wild_tail=0
  &clk_input_length=STRING.LENGTH("&clk")
  &clk_itr_length=STRING.LENGTH("avsync_pclk0_clk")

  if (STRING.SCAN("&clk", "*", 0)==0)
  (
    &wild_head=1
  )
  if (STRING.SCAN("&clk", "*", 1)==(STRING.LENGTH("&clk")-1))
  (
    &wild_tail=1
  )

  if ((&wild_head==1)&&(&wild_tail==1))
  (
    if (STRING.SCAN("avsync_pclk0_clk", STRING.MID("&clk", 1, &clk_input_length-2), 0)!=-1)
    ( 
      &match=1
    )
  )
  else if (&wild_head==1)
  (
    if (STRING.MID("avsync_pclk0_clk", &clk_itr_length-&clk_input_length+1, &clk_input_length-1)==STRING.CUT("&clk", 1))
    ( 
      &match=1
    )
  )
  else if (&wild_tail==1)
  (
    if (STRING.MID("avsync_pclk0_clk", 0, &clk_input_length-1)==STRING.CUT("&clk", -1))
    ( 
      &match=1
    )
  )	  
  else if ("avsync_pclk0_clk"=="&clk")
  (
    &match=1
  )
  
  if (&match==1)
  (
    &clk_test=&CLK_TEST_AVSYNC_PCLK0_CLK
    &clk_reg=&HWIO_MMSS_AVSYNC_PCLK0_CBCR_ADDR
    &clk_reg_name="MMSS_AVSYNC_PCLK0_CBCR"
    &clk_name="avsync_pclk0_clk"
    &clk_reg_cbcr_type="sm_cbc"

    gosub Print_Clk_Info_Line
  )
  
  &match=0
  &wild_head=0
  &wild_tail=0
  &clk_input_length=STRING.LENGTH("&clk")
  &clk_itr_length=STRING.LENGTH("avsync_pclk1_clk")

  if (STRING.SCAN("&clk", "*", 0)==0)
  (
    &wild_head=1
  )
  if (STRING.SCAN("&clk", "*", 1)==(STRING.LENGTH("&clk")-1))
  (
    &wild_tail=1
  )

  if ((&wild_head==1)&&(&wild_tail==1))
  (
    if (STRING.SCAN("avsync_pclk1_clk", STRING.MID("&clk", 1, &clk_input_length-2), 0)!=-1)
    ( 
      &match=1
    )
  )
  else if (&wild_head==1)
  (
    if (STRING.MID("avsync_pclk1_clk", &clk_itr_length-&clk_input_length+1, &clk_input_length-1)==STRING.CUT("&clk", 1))
    ( 
      &match=1
    )
  )
  else if (&wild_tail==1)
  (
    if (STRING.MID("avsync_pclk1_clk", 0, &clk_input_length-1)==STRING.CUT("&clk", -1))
    ( 
      &match=1
    )
  )	  
  else if ("avsync_pclk1_clk"=="&clk")
  (
    &match=1
  )
  
  if (&match==1)
  (
    &clk_test=&CLK_TEST_AVSYNC_PCLK1_CLK
    &clk_reg=&HWIO_MMSS_AVSYNC_PCLK1_CBCR_ADDR
    &clk_reg_name="MMSS_AVSYNC_PCLK1_CBCR"
    &clk_name="avsync_pclk1_clk"
    &clk_reg_cbcr_type="sm_cbc"

    gosub Print_Clk_Info_Line
  )
  
  &match=0
  &wild_head=0
  &wild_tail=0
  &clk_input_length=STRING.LENGTH("&clk")
  &clk_itr_length=STRING.LENGTH("avsync_vp_clk")

  if (STRING.SCAN("&clk", "*", 0)==0)
  (
    &wild_head=1
  )
  if (STRING.SCAN("&clk", "*", 1)==(STRING.LENGTH("&clk")-1))
  (
    &wild_tail=1
  )

  if ((&wild_head==1)&&(&wild_tail==1))
  (
    if (STRING.SCAN("avsync_vp_clk", STRING.MID("&clk", 1, &clk_input_length-2), 0)!=-1)
    ( 
      &match=1
    )
  )
  else if (&wild_head==1)
  (
    if (STRING.MID("avsync_vp_clk", &clk_itr_length-&clk_input_length+1, &clk_input_length-1)==STRING.CUT("&clk", 1))
    ( 
      &match=1
    )
  )
  else if (&wild_tail==1)
  (
    if (STRING.MID("avsync_vp_clk", 0, &clk_input_length-1)==STRING.CUT("&clk", -1))
    ( 
      &match=1
    )
  )	  
  else if ("avsync_vp_clk"=="&clk")
  (
    &match=1
  )
  
  if (&match==1)
  (
    &clk_test=&CLK_TEST_AVSYNC_VP_CLK
    &clk_reg=&HWIO_MMSS_AVSYNC_VP_CBCR_ADDR
    &clk_reg_name="MMSS_AVSYNC_VP_CBCR"
    &clk_name="avsync_vp_clk"
    &clk_reg_cbcr_type="sm_cbc"

    gosub Print_Clk_Info_Line
  )
  
  &match=0
  &wild_head=0
  &wild_tail=0
  &clk_input_length=STRING.LENGTH("&clk")
  &clk_itr_length=STRING.LENGTH("camss_ahb_clk")

  if (STRING.SCAN("&clk", "*", 0)==0)
  (
    &wild_head=1
  )
  if (STRING.SCAN("&clk", "*", 1)==(STRING.LENGTH("&clk")-1))
  (
    &wild_tail=1
  )

  if ((&wild_head==1)&&(&wild_tail==1))
  (
    if (STRING.SCAN("camss_ahb_clk", STRING.MID("&clk", 1, &clk_input_length-2), 0)!=-1)
    ( 
      &match=1
    )
  )
  else if (&wild_head==1)
  (
    if (STRING.MID("camss_ahb_clk", &clk_itr_length-&clk_input_length+1, &clk_input_length-1)==STRING.CUT("&clk", 1))
    ( 
      &match=1
    )
  )
  else if (&wild_tail==1)
  (
    if (STRING.MID("camss_ahb_clk", 0, &clk_input_length-1)==STRING.CUT("&clk", -1))
    ( 
      &match=1
    )
  )	  
  else if ("camss_ahb_clk"=="&clk")
  (
    &match=1
  )
  
  if (&match==1)
  (
    &clk_test=&CLK_TEST_CAMSS_AHB_CLK
    &clk_reg=&HWIO_MMSS_CAMSS_AHB_CBCR_ADDR
    &clk_reg_name="MMSS_CAMSS_AHB_CBCR"
    &clk_name="camss_ahb_clk"
    &clk_reg_cbcr_type="sm_cbc"

    gosub Print_Clk_Info_Line
  )
  
  &match=0
  &wild_head=0
  &wild_tail=0
  &clk_input_length=STRING.LENGTH("&clk")
  &clk_itr_length=STRING.LENGTH("camss_cci_cci_ahb_clk")

  if (STRING.SCAN("&clk", "*", 0)==0)
  (
    &wild_head=1
  )
  if (STRING.SCAN("&clk", "*", 1)==(STRING.LENGTH("&clk")-1))
  (
    &wild_tail=1
  )

  if ((&wild_head==1)&&(&wild_tail==1))
  (
    if (STRING.SCAN("camss_cci_cci_ahb_clk", STRING.MID("&clk", 1, &clk_input_length-2), 0)!=-1)
    ( 
      &match=1
    )
  )
  else if (&wild_head==1)
  (
    if (STRING.MID("camss_cci_cci_ahb_clk", &clk_itr_length-&clk_input_length+1, &clk_input_length-1)==STRING.CUT("&clk", 1))
    ( 
      &match=1
    )
  )
  else if (&wild_tail==1)
  (
    if (STRING.MID("camss_cci_cci_ahb_clk", 0, &clk_input_length-1)==STRING.CUT("&clk", -1))
    ( 
      &match=1
    )
  )	  
  else if ("camss_cci_cci_ahb_clk"=="&clk")
  (
    &match=1
  )
  
  if (&match==1)
  (
    &clk_test=&CLK_TEST_CAMSS_CCI_CCI_AHB_CLK
    &clk_reg=&HWIO_MMSS_CAMSS_CCI_CCI_AHB_CBCR_ADDR
    &clk_reg_name="MMSS_CAMSS_CCI_CCI_AHB_CBCR"
    &clk_name="camss_cci_cci_ahb_clk"
    &clk_reg_cbcr_type="sm_cbc"

    gosub Print_Clk_Info_Line
  )
  
  &match=0
  &wild_head=0
  &wild_tail=0
  &clk_input_length=STRING.LENGTH("&clk")
  &clk_itr_length=STRING.LENGTH("camss_cci_cci_clk")

  if (STRING.SCAN("&clk", "*", 0)==0)
  (
    &wild_head=1
  )
  if (STRING.SCAN("&clk", "*", 1)==(STRING.LENGTH("&clk")-1))
  (
    &wild_tail=1
  )

  if ((&wild_head==1)&&(&wild_tail==1))
  (
    if (STRING.SCAN("camss_cci_cci_clk", STRING.MID("&clk", 1, &clk_input_length-2), 0)!=-1)
    ( 
      &match=1
    )
  )
  else if (&wild_head==1)
  (
    if (STRING.MID("camss_cci_cci_clk", &clk_itr_length-&clk_input_length+1, &clk_input_length-1)==STRING.CUT("&clk", 1))
    ( 
      &match=1
    )
  )
  else if (&wild_tail==1)
  (
    if (STRING.MID("camss_cci_cci_clk", 0, &clk_input_length-1)==STRING.CUT("&clk", -1))
    ( 
      &match=1
    )
  )	  
  else if ("camss_cci_cci_clk"=="&clk")
  (
    &match=1
  )
  
  if (&match==1)
  (
    &clk_test=&CLK_TEST_CAMSS_CCI_CCI_CLK
    &clk_reg=&HWIO_MMSS_CAMSS_CCI_CCI_CBCR_ADDR
    &clk_reg_name="MMSS_CAMSS_CCI_CCI_CBCR"
    &clk_name="camss_cci_cci_clk"
    &clk_reg_cbcr_type="sm_cbc"

    gosub Print_Clk_Info_Line
  )
  
  &match=0
  &wild_head=0
  &wild_tail=0
  &clk_input_length=STRING.LENGTH("&clk")
  &clk_itr_length=STRING.LENGTH("camss_csi0_ahb_clk")

  if (STRING.SCAN("&clk", "*", 0)==0)
  (
    &wild_head=1
  )
  if (STRING.SCAN("&clk", "*", 1)==(STRING.LENGTH("&clk")-1))
  (
    &wild_tail=1
  )

  if ((&wild_head==1)&&(&wild_tail==1))
  (
    if (STRING.SCAN("camss_csi0_ahb_clk", STRING.MID("&clk", 1, &clk_input_length-2), 0)!=-1)
    ( 
      &match=1
    )
  )
  else if (&wild_head==1)
  (
    if (STRING.MID("camss_csi0_ahb_clk", &clk_itr_length-&clk_input_length+1, &clk_input_length-1)==STRING.CUT("&clk", 1))
    ( 
      &match=1
    )
  )
  else if (&wild_tail==1)
  (
    if (STRING.MID("camss_csi0_ahb_clk", 0, &clk_input_length-1)==STRING.CUT("&clk", -1))
    ( 
      &match=1
    )
  )	  
  else if ("camss_csi0_ahb_clk"=="&clk")
  (
    &match=1
  )
  
  if (&match==1)
  (
    &clk_test=&CLK_TEST_CAMSS_CSI0_AHB_CLK
    &clk_reg=&HWIO_MMSS_CAMSS_CSI0_AHB_CBCR_ADDR
    &clk_reg_name="MMSS_CAMSS_CSI0_AHB_CBCR"
    &clk_name="camss_csi0_ahb_clk"
    &clk_reg_cbcr_type="sm_cbc"

    gosub Print_Clk_Info_Line
  )
  
  &match=0
  &wild_head=0
  &wild_tail=0
  &clk_input_length=STRING.LENGTH("&clk")
  &clk_itr_length=STRING.LENGTH("camss_csi0_clk")

  if (STRING.SCAN("&clk", "*", 0)==0)
  (
    &wild_head=1
  )
  if (STRING.SCAN("&clk", "*", 1)==(STRING.LENGTH("&clk")-1))
  (
    &wild_tail=1
  )

  if ((&wild_head==1)&&(&wild_tail==1))
  (
    if (STRING.SCAN("camss_csi0_clk", STRING.MID("&clk", 1, &clk_input_length-2), 0)!=-1)
    ( 
      &match=1
    )
  )
  else if (&wild_head==1)
  (
    if (STRING.MID("camss_csi0_clk", &clk_itr_length-&clk_input_length+1, &clk_input_length-1)==STRING.CUT("&clk", 1))
    ( 
      &match=1
    )
  )
  else if (&wild_tail==1)
  (
    if (STRING.MID("camss_csi0_clk", 0, &clk_input_length-1)==STRING.CUT("&clk", -1))
    ( 
      &match=1
    )
  )	  
  else if ("camss_csi0_clk"=="&clk")
  (
    &match=1
  )
  
  if (&match==1)
  (
    &clk_test=&CLK_TEST_CAMSS_CSI0_CLK
    &clk_reg=&HWIO_MMSS_CAMSS_CSI0_CBCR_ADDR
    &clk_reg_name="MMSS_CAMSS_CSI0_CBCR"
    &clk_name="camss_csi0_clk"
    &clk_reg_cbcr_type="sm_cbc"

    gosub Print_Clk_Info_Line
  )
  
  &match=0
  &wild_head=0
  &wild_tail=0
  &clk_input_length=STRING.LENGTH("&clk")
  &clk_itr_length=STRING.LENGTH("camss_csi0phy_clk")

  if (STRING.SCAN("&clk", "*", 0)==0)
  (
    &wild_head=1
  )
  if (STRING.SCAN("&clk", "*", 1)==(STRING.LENGTH("&clk")-1))
  (
    &wild_tail=1
  )

  if ((&wild_head==1)&&(&wild_tail==1))
  (
    if (STRING.SCAN("camss_csi0phy_clk", STRING.MID("&clk", 1, &clk_input_length-2), 0)!=-1)
    ( 
      &match=1
    )
  )
  else if (&wild_head==1)
  (
    if (STRING.MID("camss_csi0phy_clk", &clk_itr_length-&clk_input_length+1, &clk_input_length-1)==STRING.CUT("&clk", 1))
    ( 
      &match=1
    )
  )
  else if (&wild_tail==1)
  (
    if (STRING.MID("camss_csi0phy_clk", 0, &clk_input_length-1)==STRING.CUT("&clk", -1))
    ( 
      &match=1
    )
  )	  
  else if ("camss_csi0phy_clk"=="&clk")
  (
    &match=1
  )
  
  if (&match==1)
  (
    &clk_test=&CLK_TEST_CAMSS_CSI0PHY_CLK
    &clk_reg=&HWIO_MMSS_CAMSS_CSI0PHY_CBCR_ADDR
    &clk_reg_name="MMSS_CAMSS_CSI0PHY_CBCR"
    &clk_name="camss_csi0phy_clk"
    &clk_reg_cbcr_type="sm_cbc"

    gosub Print_Clk_Info_Line
  )
  
  &match=0
  &wild_head=0
  &wild_tail=0
  &clk_input_length=STRING.LENGTH("&clk")
  &clk_itr_length=STRING.LENGTH("camss_csi0pix_clk")

  if (STRING.SCAN("&clk", "*", 0)==0)
  (
    &wild_head=1
  )
  if (STRING.SCAN("&clk", "*", 1)==(STRING.LENGTH("&clk")-1))
  (
    &wild_tail=1
  )

  if ((&wild_head==1)&&(&wild_tail==1))
  (
    if (STRING.SCAN("camss_csi0pix_clk", STRING.MID("&clk", 1, &clk_input_length-2), 0)!=-1)
    ( 
      &match=1
    )
  )
  else if (&wild_head==1)
  (
    if (STRING.MID("camss_csi0pix_clk", &clk_itr_length-&clk_input_length+1, &clk_input_length-1)==STRING.CUT("&clk", 1))
    ( 
      &match=1
    )
  )
  else if (&wild_tail==1)
  (
    if (STRING.MID("camss_csi0pix_clk", 0, &clk_input_length-1)==STRING.CUT("&clk", -1))
    ( 
      &match=1
    )
  )	  
  else if ("camss_csi0pix_clk"=="&clk")
  (
    &match=1
  )
  
  if (&match==1)
  (
    &clk_test=&CLK_TEST_CAMSS_CSI0PIX_CLK
    &clk_reg=&HWIO_MMSS_CAMSS_CSI0PIX_CBCR_ADDR
    &clk_reg_name="MMSS_CAMSS_CSI0PIX_CBCR"
    &clk_name="camss_csi0pix_clk"
    &clk_reg_cbcr_type="sm_cbc"

    gosub Print_Clk_Info_Line
  )
  
  &match=0
  &wild_head=0
  &wild_tail=0
  &clk_input_length=STRING.LENGTH("&clk")
  &clk_itr_length=STRING.LENGTH("camss_csi0rdi_clk")

  if (STRING.SCAN("&clk", "*", 0)==0)
  (
    &wild_head=1
  )
  if (STRING.SCAN("&clk", "*", 1)==(STRING.LENGTH("&clk")-1))
  (
    &wild_tail=1
  )

  if ((&wild_head==1)&&(&wild_tail==1))
  (
    if (STRING.SCAN("camss_csi0rdi_clk", STRING.MID("&clk", 1, &clk_input_length-2), 0)!=-1)
    ( 
      &match=1
    )
  )
  else if (&wild_head==1)
  (
    if (STRING.MID("camss_csi0rdi_clk", &clk_itr_length-&clk_input_length+1, &clk_input_length-1)==STRING.CUT("&clk", 1))
    ( 
      &match=1
    )
  )
  else if (&wild_tail==1)
  (
    if (STRING.MID("camss_csi0rdi_clk", 0, &clk_input_length-1)==STRING.CUT("&clk", -1))
    ( 
      &match=1
    )
  )	  
  else if ("camss_csi0rdi_clk"=="&clk")
  (
    &match=1
  )
  
  if (&match==1)
  (
    &clk_test=&CLK_TEST_CAMSS_CSI0RDI_CLK
    &clk_reg=&HWIO_MMSS_CAMSS_CSI0RDI_CBCR_ADDR
    &clk_reg_name="MMSS_CAMSS_CSI0RDI_CBCR"
    &clk_name="camss_csi0rdi_clk"
    &clk_reg_cbcr_type="sm_cbc"

    gosub Print_Clk_Info_Line
  )
  
  &match=0
  &wild_head=0
  &wild_tail=0
  &clk_input_length=STRING.LENGTH("&clk")
  &clk_itr_length=STRING.LENGTH("camss_csi1_ahb_clk")

  if (STRING.SCAN("&clk", "*", 0)==0)
  (
    &wild_head=1
  )
  if (STRING.SCAN("&clk", "*", 1)==(STRING.LENGTH("&clk")-1))
  (
    &wild_tail=1
  )

  if ((&wild_head==1)&&(&wild_tail==1))
  (
    if (STRING.SCAN("camss_csi1_ahb_clk", STRING.MID("&clk", 1, &clk_input_length-2), 0)!=-1)
    ( 
      &match=1
    )
  )
  else if (&wild_head==1)
  (
    if (STRING.MID("camss_csi1_ahb_clk", &clk_itr_length-&clk_input_length+1, &clk_input_length-1)==STRING.CUT("&clk", 1))
    ( 
      &match=1
    )
  )
  else if (&wild_tail==1)
  (
    if (STRING.MID("camss_csi1_ahb_clk", 0, &clk_input_length-1)==STRING.CUT("&clk", -1))
    ( 
      &match=1
    )
  )	  
  else if ("camss_csi1_ahb_clk"=="&clk")
  (
    &match=1
  )
  
  if (&match==1)
  (
    &clk_test=&CLK_TEST_CAMSS_CSI1_AHB_CLK
    &clk_reg=&HWIO_MMSS_CAMSS_CSI1_AHB_CBCR_ADDR
    &clk_reg_name="MMSS_CAMSS_CSI1_AHB_CBCR"
    &clk_name="camss_csi1_ahb_clk"
    &clk_reg_cbcr_type="sm_cbc"

    gosub Print_Clk_Info_Line
  )
  
  &match=0
  &wild_head=0
  &wild_tail=0
  &clk_input_length=STRING.LENGTH("&clk")
  &clk_itr_length=STRING.LENGTH("camss_csi1_clk")

  if (STRING.SCAN("&clk", "*", 0)==0)
  (
    &wild_head=1
  )
  if (STRING.SCAN("&clk", "*", 1)==(STRING.LENGTH("&clk")-1))
  (
    &wild_tail=1
  )

  if ((&wild_head==1)&&(&wild_tail==1))
  (
    if (STRING.SCAN("camss_csi1_clk", STRING.MID("&clk", 1, &clk_input_length-2), 0)!=-1)
    ( 
      &match=1
    )
  )
  else if (&wild_head==1)
  (
    if (STRING.MID("camss_csi1_clk", &clk_itr_length-&clk_input_length+1, &clk_input_length-1)==STRING.CUT("&clk", 1))
    ( 
      &match=1
    )
  )
  else if (&wild_tail==1)
  (
    if (STRING.MID("camss_csi1_clk", 0, &clk_input_length-1)==STRING.CUT("&clk", -1))
    ( 
      &match=1
    )
  )	  
  else if ("camss_csi1_clk"=="&clk")
  (
    &match=1
  )
  
  if (&match==1)
  (
    &clk_test=&CLK_TEST_CAMSS_CSI1_CLK
    &clk_reg=&HWIO_MMSS_CAMSS_CSI1_CBCR_ADDR
    &clk_reg_name="MMSS_CAMSS_CSI1_CBCR"
    &clk_name="camss_csi1_clk"
    &clk_reg_cbcr_type="sm_cbc"

    gosub Print_Clk_Info_Line
  )
  
  &match=0
  &wild_head=0
  &wild_tail=0
  &clk_input_length=STRING.LENGTH("&clk")
  &clk_itr_length=STRING.LENGTH("camss_csi1phy_clk")

  if (STRING.SCAN("&clk", "*", 0)==0)
  (
    &wild_head=1
  )
  if (STRING.SCAN("&clk", "*", 1)==(STRING.LENGTH("&clk")-1))
  (
    &wild_tail=1
  )

  if ((&wild_head==1)&&(&wild_tail==1))
  (
    if (STRING.SCAN("camss_csi1phy_clk", STRING.MID("&clk", 1, &clk_input_length-2), 0)!=-1)
    ( 
      &match=1
    )
  )
  else if (&wild_head==1)
  (
    if (STRING.MID("camss_csi1phy_clk", &clk_itr_length-&clk_input_length+1, &clk_input_length-1)==STRING.CUT("&clk", 1))
    ( 
      &match=1
    )
  )
  else if (&wild_tail==1)
  (
    if (STRING.MID("camss_csi1phy_clk", 0, &clk_input_length-1)==STRING.CUT("&clk", -1))
    ( 
      &match=1
    )
  )	  
  else if ("camss_csi1phy_clk"=="&clk")
  (
    &match=1
  )
  
  if (&match==1)
  (
    &clk_test=&CLK_TEST_CAMSS_CSI1PHY_CLK
    &clk_reg=&HWIO_MMSS_CAMSS_CSI1PHY_CBCR_ADDR
    &clk_reg_name="MMSS_CAMSS_CSI1PHY_CBCR"
    &clk_name="camss_csi1phy_clk"
    &clk_reg_cbcr_type="sm_cbc"

    gosub Print_Clk_Info_Line
  )
  
  &match=0
  &wild_head=0
  &wild_tail=0
  &clk_input_length=STRING.LENGTH("&clk")
  &clk_itr_length=STRING.LENGTH("camss_csi1pix_clk")

  if (STRING.SCAN("&clk", "*", 0)==0)
  (
    &wild_head=1
  )
  if (STRING.SCAN("&clk", "*", 1)==(STRING.LENGTH("&clk")-1))
  (
    &wild_tail=1
  )

  if ((&wild_head==1)&&(&wild_tail==1))
  (
    if (STRING.SCAN("camss_csi1pix_clk", STRING.MID("&clk", 1, &clk_input_length-2), 0)!=-1)
    ( 
      &match=1
    )
  )
  else if (&wild_head==1)
  (
    if (STRING.MID("camss_csi1pix_clk", &clk_itr_length-&clk_input_length+1, &clk_input_length-1)==STRING.CUT("&clk", 1))
    ( 
      &match=1
    )
  )
  else if (&wild_tail==1)
  (
    if (STRING.MID("camss_csi1pix_clk", 0, &clk_input_length-1)==STRING.CUT("&clk", -1))
    ( 
      &match=1
    )
  )	  
  else if ("camss_csi1pix_clk"=="&clk")
  (
    &match=1
  )
  
  if (&match==1)
  (
    &clk_test=&CLK_TEST_CAMSS_CSI1PIX_CLK
    &clk_reg=&HWIO_MMSS_CAMSS_CSI1PIX_CBCR_ADDR
    &clk_reg_name="MMSS_CAMSS_CSI1PIX_CBCR"
    &clk_name="camss_csi1pix_clk"
    &clk_reg_cbcr_type="sm_cbc"

    gosub Print_Clk_Info_Line
  )
  
  &match=0
  &wild_head=0
  &wild_tail=0
  &clk_input_length=STRING.LENGTH("&clk")
  &clk_itr_length=STRING.LENGTH("camss_csi1rdi_clk")

  if (STRING.SCAN("&clk", "*", 0)==0)
  (
    &wild_head=1
  )
  if (STRING.SCAN("&clk", "*", 1)==(STRING.LENGTH("&clk")-1))
  (
    &wild_tail=1
  )

  if ((&wild_head==1)&&(&wild_tail==1))
  (
    if (STRING.SCAN("camss_csi1rdi_clk", STRING.MID("&clk", 1, &clk_input_length-2), 0)!=-1)
    ( 
      &match=1
    )
  )
  else if (&wild_head==1)
  (
    if (STRING.MID("camss_csi1rdi_clk", &clk_itr_length-&clk_input_length+1, &clk_input_length-1)==STRING.CUT("&clk", 1))
    ( 
      &match=1
    )
  )
  else if (&wild_tail==1)
  (
    if (STRING.MID("camss_csi1rdi_clk", 0, &clk_input_length-1)==STRING.CUT("&clk", -1))
    ( 
      &match=1
    )
  )	  
  else if ("camss_csi1rdi_clk"=="&clk")
  (
    &match=1
  )
  
  if (&match==1)
  (
    &clk_test=&CLK_TEST_CAMSS_CSI1RDI_CLK
    &clk_reg=&HWIO_MMSS_CAMSS_CSI1RDI_CBCR_ADDR
    &clk_reg_name="MMSS_CAMSS_CSI1RDI_CBCR"
    &clk_name="camss_csi1rdi_clk"
    &clk_reg_cbcr_type="sm_cbc"

    gosub Print_Clk_Info_Line
  )
  
  &match=0
  &wild_head=0
  &wild_tail=0
  &clk_input_length=STRING.LENGTH("&clk")
  &clk_itr_length=STRING.LENGTH("camss_csi2_ahb_clk")

  if (STRING.SCAN("&clk", "*", 0)==0)
  (
    &wild_head=1
  )
  if (STRING.SCAN("&clk", "*", 1)==(STRING.LENGTH("&clk")-1))
  (
    &wild_tail=1
  )

  if ((&wild_head==1)&&(&wild_tail==1))
  (
    if (STRING.SCAN("camss_csi2_ahb_clk", STRING.MID("&clk", 1, &clk_input_length-2), 0)!=-1)
    ( 
      &match=1
    )
  )
  else if (&wild_head==1)
  (
    if (STRING.MID("camss_csi2_ahb_clk", &clk_itr_length-&clk_input_length+1, &clk_input_length-1)==STRING.CUT("&clk", 1))
    ( 
      &match=1
    )
  )
  else if (&wild_tail==1)
  (
    if (STRING.MID("camss_csi2_ahb_clk", 0, &clk_input_length-1)==STRING.CUT("&clk", -1))
    ( 
      &match=1
    )
  )	  
  else if ("camss_csi2_ahb_clk"=="&clk")
  (
    &match=1
  )
  
  if (&match==1)
  (
    &clk_test=&CLK_TEST_CAMSS_CSI2_AHB_CLK
    &clk_reg=&HWIO_MMSS_CAMSS_CSI2_AHB_CBCR_ADDR
    &clk_reg_name="MMSS_CAMSS_CSI2_AHB_CBCR"
    &clk_name="camss_csi2_ahb_clk"
    &clk_reg_cbcr_type="sm_cbc"

    gosub Print_Clk_Info_Line
  )
  
  &match=0
  &wild_head=0
  &wild_tail=0
  &clk_input_length=STRING.LENGTH("&clk")
  &clk_itr_length=STRING.LENGTH("camss_csi2_clk")

  if (STRING.SCAN("&clk", "*", 0)==0)
  (
    &wild_head=1
  )
  if (STRING.SCAN("&clk", "*", 1)==(STRING.LENGTH("&clk")-1))
  (
    &wild_tail=1
  )

  if ((&wild_head==1)&&(&wild_tail==1))
  (
    if (STRING.SCAN("camss_csi2_clk", STRING.MID("&clk", 1, &clk_input_length-2), 0)!=-1)
    ( 
      &match=1
    )
  )
  else if (&wild_head==1)
  (
    if (STRING.MID("camss_csi2_clk", &clk_itr_length-&clk_input_length+1, &clk_input_length-1)==STRING.CUT("&clk", 1))
    ( 
      &match=1
    )
  )
  else if (&wild_tail==1)
  (
    if (STRING.MID("camss_csi2_clk", 0, &clk_input_length-1)==STRING.CUT("&clk", -1))
    ( 
      &match=1
    )
  )	  
  else if ("camss_csi2_clk"=="&clk")
  (
    &match=1
  )
  
  if (&match==1)
  (
    &clk_test=&CLK_TEST_CAMSS_CSI2_CLK
    &clk_reg=&HWIO_MMSS_CAMSS_CSI2_CBCR_ADDR
    &clk_reg_name="MMSS_CAMSS_CSI2_CBCR"
    &clk_name="camss_csi2_clk"
    &clk_reg_cbcr_type="sm_cbc"

    gosub Print_Clk_Info_Line
  )
  
  &match=0
  &wild_head=0
  &wild_tail=0
  &clk_input_length=STRING.LENGTH("&clk")
  &clk_itr_length=STRING.LENGTH("camss_csi2phy_clk")

  if (STRING.SCAN("&clk", "*", 0)==0)
  (
    &wild_head=1
  )
  if (STRING.SCAN("&clk", "*", 1)==(STRING.LENGTH("&clk")-1))
  (
    &wild_tail=1
  )

  if ((&wild_head==1)&&(&wild_tail==1))
  (
    if (STRING.SCAN("camss_csi2phy_clk", STRING.MID("&clk", 1, &clk_input_length-2), 0)!=-1)
    ( 
      &match=1
    )
  )
  else if (&wild_head==1)
  (
    if (STRING.MID("camss_csi2phy_clk", &clk_itr_length-&clk_input_length+1, &clk_input_length-1)==STRING.CUT("&clk", 1))
    ( 
      &match=1
    )
  )
  else if (&wild_tail==1)
  (
    if (STRING.MID("camss_csi2phy_clk", 0, &clk_input_length-1)==STRING.CUT("&clk", -1))
    ( 
      &match=1
    )
  )	  
  else if ("camss_csi2phy_clk"=="&clk")
  (
    &match=1
  )
  
  if (&match==1)
  (
    &clk_test=&CLK_TEST_CAMSS_CSI2PHY_CLK
    &clk_reg=&HWIO_MMSS_CAMSS_CSI2PHY_CBCR_ADDR
    &clk_reg_name="MMSS_CAMSS_CSI2PHY_CBCR"
    &clk_name="camss_csi2phy_clk"
    &clk_reg_cbcr_type="sm_cbc"

    gosub Print_Clk_Info_Line
  )
  
  &match=0
  &wild_head=0
  &wild_tail=0
  &clk_input_length=STRING.LENGTH("&clk")
  &clk_itr_length=STRING.LENGTH("camss_csi2pix_clk")

  if (STRING.SCAN("&clk", "*", 0)==0)
  (
    &wild_head=1
  )
  if (STRING.SCAN("&clk", "*", 1)==(STRING.LENGTH("&clk")-1))
  (
    &wild_tail=1
  )

  if ((&wild_head==1)&&(&wild_tail==1))
  (
    if (STRING.SCAN("camss_csi2pix_clk", STRING.MID("&clk", 1, &clk_input_length-2), 0)!=-1)
    ( 
      &match=1
    )
  )
  else if (&wild_head==1)
  (
    if (STRING.MID("camss_csi2pix_clk", &clk_itr_length-&clk_input_length+1, &clk_input_length-1)==STRING.CUT("&clk", 1))
    ( 
      &match=1
    )
  )
  else if (&wild_tail==1)
  (
    if (STRING.MID("camss_csi2pix_clk", 0, &clk_input_length-1)==STRING.CUT("&clk", -1))
    ( 
      &match=1
    )
  )	  
  else if ("camss_csi2pix_clk"=="&clk")
  (
    &match=1
  )
  
  if (&match==1)
  (
    &clk_test=&CLK_TEST_CAMSS_CSI2PIX_CLK
    &clk_reg=&HWIO_MMSS_CAMSS_CSI2PIX_CBCR_ADDR
    &clk_reg_name="MMSS_CAMSS_CSI2PIX_CBCR"
    &clk_name="camss_csi2pix_clk"
    &clk_reg_cbcr_type="sm_cbc"

    gosub Print_Clk_Info_Line
  )
  
  &match=0
  &wild_head=0
  &wild_tail=0
  &clk_input_length=STRING.LENGTH("&clk")
  &clk_itr_length=STRING.LENGTH("camss_csi2rdi_clk")

  if (STRING.SCAN("&clk", "*", 0)==0)
  (
    &wild_head=1
  )
  if (STRING.SCAN("&clk", "*", 1)==(STRING.LENGTH("&clk")-1))
  (
    &wild_tail=1
  )

  if ((&wild_head==1)&&(&wild_tail==1))
  (
    if (STRING.SCAN("camss_csi2rdi_clk", STRING.MID("&clk", 1, &clk_input_length-2), 0)!=-1)
    ( 
      &match=1
    )
  )
  else if (&wild_head==1)
  (
    if (STRING.MID("camss_csi2rdi_clk", &clk_itr_length-&clk_input_length+1, &clk_input_length-1)==STRING.CUT("&clk", 1))
    ( 
      &match=1
    )
  )
  else if (&wild_tail==1)
  (
    if (STRING.MID("camss_csi2rdi_clk", 0, &clk_input_length-1)==STRING.CUT("&clk", -1))
    ( 
      &match=1
    )
  )	  
  else if ("camss_csi2rdi_clk"=="&clk")
  (
    &match=1
  )
  
  if (&match==1)
  (
    &clk_test=&CLK_TEST_CAMSS_CSI2RDI_CLK
    &clk_reg=&HWIO_MMSS_CAMSS_CSI2RDI_CBCR_ADDR
    &clk_reg_name="MMSS_CAMSS_CSI2RDI_CBCR"
    &clk_name="camss_csi2rdi_clk"
    &clk_reg_cbcr_type="sm_cbc"

    gosub Print_Clk_Info_Line
  )
  
  &match=0
  &wild_head=0
  &wild_tail=0
  &clk_input_length=STRING.LENGTH("&clk")
  &clk_itr_length=STRING.LENGTH("camss_csi3_ahb_clk")

  if (STRING.SCAN("&clk", "*", 0)==0)
  (
    &wild_head=1
  )
  if (STRING.SCAN("&clk", "*", 1)==(STRING.LENGTH("&clk")-1))
  (
    &wild_tail=1
  )

  if ((&wild_head==1)&&(&wild_tail==1))
  (
    if (STRING.SCAN("camss_csi3_ahb_clk", STRING.MID("&clk", 1, &clk_input_length-2), 0)!=-1)
    ( 
      &match=1
    )
  )
  else if (&wild_head==1)
  (
    if (STRING.MID("camss_csi3_ahb_clk", &clk_itr_length-&clk_input_length+1, &clk_input_length-1)==STRING.CUT("&clk", 1))
    ( 
      &match=1
    )
  )
  else if (&wild_tail==1)
  (
    if (STRING.MID("camss_csi3_ahb_clk", 0, &clk_input_length-1)==STRING.CUT("&clk", -1))
    ( 
      &match=1
    )
  )	  
  else if ("camss_csi3_ahb_clk"=="&clk")
  (
    &match=1
  )
  
  if (&match==1)
  (
    &clk_test=&CLK_TEST_CAMSS_CSI3_AHB_CLK
    &clk_reg=&HWIO_MMSS_CAMSS_CSI3_AHB_CBCR_ADDR
    &clk_reg_name="MMSS_CAMSS_CSI3_AHB_CBCR"
    &clk_name="camss_csi3_ahb_clk"
    &clk_reg_cbcr_type="sm_cbc"

    gosub Print_Clk_Info_Line
  )
  
  &match=0
  &wild_head=0
  &wild_tail=0
  &clk_input_length=STRING.LENGTH("&clk")
  &clk_itr_length=STRING.LENGTH("camss_csi3_clk")

  if (STRING.SCAN("&clk", "*", 0)==0)
  (
    &wild_head=1
  )
  if (STRING.SCAN("&clk", "*", 1)==(STRING.LENGTH("&clk")-1))
  (
    &wild_tail=1
  )

  if ((&wild_head==1)&&(&wild_tail==1))
  (
    if (STRING.SCAN("camss_csi3_clk", STRING.MID("&clk", 1, &clk_input_length-2), 0)!=-1)
    ( 
      &match=1
    )
  )
  else if (&wild_head==1)
  (
    if (STRING.MID("camss_csi3_clk", &clk_itr_length-&clk_input_length+1, &clk_input_length-1)==STRING.CUT("&clk", 1))
    ( 
      &match=1
    )
  )
  else if (&wild_tail==1)
  (
    if (STRING.MID("camss_csi3_clk", 0, &clk_input_length-1)==STRING.CUT("&clk", -1))
    ( 
      &match=1
    )
  )	  
  else if ("camss_csi3_clk"=="&clk")
  (
    &match=1
  )
  
  if (&match==1)
  (
    &clk_test=&CLK_TEST_CAMSS_CSI3_CLK
    &clk_reg=&HWIO_MMSS_CAMSS_CSI3_CBCR_ADDR
    &clk_reg_name="MMSS_CAMSS_CSI3_CBCR"
    &clk_name="camss_csi3_clk"
    &clk_reg_cbcr_type="sm_cbc"

    gosub Print_Clk_Info_Line
  )
  
  &match=0
  &wild_head=0
  &wild_tail=0
  &clk_input_length=STRING.LENGTH("&clk")
  &clk_itr_length=STRING.LENGTH("camss_csi3phy_clk")

  if (STRING.SCAN("&clk", "*", 0)==0)
  (
    &wild_head=1
  )
  if (STRING.SCAN("&clk", "*", 1)==(STRING.LENGTH("&clk")-1))
  (
    &wild_tail=1
  )

  if ((&wild_head==1)&&(&wild_tail==1))
  (
    if (STRING.SCAN("camss_csi3phy_clk", STRING.MID("&clk", 1, &clk_input_length-2), 0)!=-1)
    ( 
      &match=1
    )
  )
  else if (&wild_head==1)
  (
    if (STRING.MID("camss_csi3phy_clk", &clk_itr_length-&clk_input_length+1, &clk_input_length-1)==STRING.CUT("&clk", 1))
    ( 
      &match=1
    )
  )
  else if (&wild_tail==1)
  (
    if (STRING.MID("camss_csi3phy_clk", 0, &clk_input_length-1)==STRING.CUT("&clk", -1))
    ( 
      &match=1
    )
  )	  
  else if ("camss_csi3phy_clk"=="&clk")
  (
    &match=1
  )
  
  if (&match==1)
  (
    &clk_test=&CLK_TEST_CAMSS_CSI3PHY_CLK
    &clk_reg=&HWIO_MMSS_CAMSS_CSI3PHY_CBCR_ADDR
    &clk_reg_name="MMSS_CAMSS_CSI3PHY_CBCR"
    &clk_name="camss_csi3phy_clk"
    &clk_reg_cbcr_type="sm_cbc"

    gosub Print_Clk_Info_Line
  )
  
  &match=0
  &wild_head=0
  &wild_tail=0
  &clk_input_length=STRING.LENGTH("&clk")
  &clk_itr_length=STRING.LENGTH("camss_csi3pix_clk")

  if (STRING.SCAN("&clk", "*", 0)==0)
  (
    &wild_head=1
  )
  if (STRING.SCAN("&clk", "*", 1)==(STRING.LENGTH("&clk")-1))
  (
    &wild_tail=1
  )

  if ((&wild_head==1)&&(&wild_tail==1))
  (
    if (STRING.SCAN("camss_csi3pix_clk", STRING.MID("&clk", 1, &clk_input_length-2), 0)!=-1)
    ( 
      &match=1
    )
  )
  else if (&wild_head==1)
  (
    if (STRING.MID("camss_csi3pix_clk", &clk_itr_length-&clk_input_length+1, &clk_input_length-1)==STRING.CUT("&clk", 1))
    ( 
      &match=1
    )
  )
  else if (&wild_tail==1)
  (
    if (STRING.MID("camss_csi3pix_clk", 0, &clk_input_length-1)==STRING.CUT("&clk", -1))
    ( 
      &match=1
    )
  )	  
  else if ("camss_csi3pix_clk"=="&clk")
  (
    &match=1
  )
  
  if (&match==1)
  (
    &clk_test=&CLK_TEST_CAMSS_CSI3PIX_CLK
    &clk_reg=&HWIO_MMSS_CAMSS_CSI3PIX_CBCR_ADDR
    &clk_reg_name="MMSS_CAMSS_CSI3PIX_CBCR"
    &clk_name="camss_csi3pix_clk"
    &clk_reg_cbcr_type="sm_cbc"

    gosub Print_Clk_Info_Line
  )
  
  &match=0
  &wild_head=0
  &wild_tail=0
  &clk_input_length=STRING.LENGTH("&clk")
  &clk_itr_length=STRING.LENGTH("camss_csi3rdi_clk")

  if (STRING.SCAN("&clk", "*", 0)==0)
  (
    &wild_head=1
  )
  if (STRING.SCAN("&clk", "*", 1)==(STRING.LENGTH("&clk")-1))
  (
    &wild_tail=1
  )

  if ((&wild_head==1)&&(&wild_tail==1))
  (
    if (STRING.SCAN("camss_csi3rdi_clk", STRING.MID("&clk", 1, &clk_input_length-2), 0)!=-1)
    ( 
      &match=1
    )
  )
  else if (&wild_head==1)
  (
    if (STRING.MID("camss_csi3rdi_clk", &clk_itr_length-&clk_input_length+1, &clk_input_length-1)==STRING.CUT("&clk", 1))
    ( 
      &match=1
    )
  )
  else if (&wild_tail==1)
  (
    if (STRING.MID("camss_csi3rdi_clk", 0, &clk_input_length-1)==STRING.CUT("&clk", -1))
    ( 
      &match=1
    )
  )	  
  else if ("camss_csi3rdi_clk"=="&clk")
  (
    &match=1
  )
  
  if (&match==1)
  (
    &clk_test=&CLK_TEST_CAMSS_CSI3RDI_CLK
    &clk_reg=&HWIO_MMSS_CAMSS_CSI3RDI_CBCR_ADDR
    &clk_reg_name="MMSS_CAMSS_CSI3RDI_CBCR"
    &clk_name="camss_csi3rdi_clk"
    &clk_reg_cbcr_type="sm_cbc"

    gosub Print_Clk_Info_Line
  )
  
  &match=0
  &wild_head=0
  &wild_tail=0
  &clk_input_length=STRING.LENGTH("&clk")
  &clk_itr_length=STRING.LENGTH("camss_csi_vfe0_clk")

  if (STRING.SCAN("&clk", "*", 0)==0)
  (
    &wild_head=1
  )
  if (STRING.SCAN("&clk", "*", 1)==(STRING.LENGTH("&clk")-1))
  (
    &wild_tail=1
  )

  if ((&wild_head==1)&&(&wild_tail==1))
  (
    if (STRING.SCAN("camss_csi_vfe0_clk", STRING.MID("&clk", 1, &clk_input_length-2), 0)!=-1)
    ( 
      &match=1
    )
  )
  else if (&wild_head==1)
  (
    if (STRING.MID("camss_csi_vfe0_clk", &clk_itr_length-&clk_input_length+1, &clk_input_length-1)==STRING.CUT("&clk", 1))
    ( 
      &match=1
    )
  )
  else if (&wild_tail==1)
  (
    if (STRING.MID("camss_csi_vfe0_clk", 0, &clk_input_length-1)==STRING.CUT("&clk", -1))
    ( 
      &match=1
    )
  )	  
  else if ("camss_csi_vfe0_clk"=="&clk")
  (
    &match=1
  )
  
  if (&match==1)
  (
    &clk_test=&CLK_TEST_CAMSS_CSI_VFE0_CLK
    &clk_reg=&HWIO_MMSS_CAMSS_CSI_VFE0_CBCR_ADDR
    &clk_reg_name="MMSS_CAMSS_CSI_VFE0_CBCR"
    &clk_name="camss_csi_vfe0_clk"
    &clk_reg_cbcr_type="sm_pscbc"

    gosub Print_Clk_Info_Line
  )
  
  &match=0
  &wild_head=0
  &wild_tail=0
  &clk_input_length=STRING.LENGTH("&clk")
  &clk_itr_length=STRING.LENGTH("camss_csi_vfe1_clk")

  if (STRING.SCAN("&clk", "*", 0)==0)
  (
    &wild_head=1
  )
  if (STRING.SCAN("&clk", "*", 1)==(STRING.LENGTH("&clk")-1))
  (
    &wild_tail=1
  )

  if ((&wild_head==1)&&(&wild_tail==1))
  (
    if (STRING.SCAN("camss_csi_vfe1_clk", STRING.MID("&clk", 1, &clk_input_length-2), 0)!=-1)
    ( 
      &match=1
    )
  )
  else if (&wild_head==1)
  (
    if (STRING.MID("camss_csi_vfe1_clk", &clk_itr_length-&clk_input_length+1, &clk_input_length-1)==STRING.CUT("&clk", 1))
    ( 
      &match=1
    )
  )
  else if (&wild_tail==1)
  (
    if (STRING.MID("camss_csi_vfe1_clk", 0, &clk_input_length-1)==STRING.CUT("&clk", -1))
    ( 
      &match=1
    )
  )	  
  else if ("camss_csi_vfe1_clk"=="&clk")
  (
    &match=1
  )
  
  if (&match==1)
  (
    &clk_test=&CLK_TEST_CAMSS_CSI_VFE1_CLK
    &clk_reg=&HWIO_MMSS_CAMSS_CSI_VFE1_CBCR_ADDR
    &clk_reg_name="MMSS_CAMSS_CSI_VFE1_CBCR"
    &clk_name="camss_csi_vfe1_clk"
    &clk_reg_cbcr_type="sm_pscbc"

    gosub Print_Clk_Info_Line
  )
  
  &match=0
  &wild_head=0
  &wild_tail=0
  &clk_input_length=STRING.LENGTH("&clk")
  &clk_itr_length=STRING.LENGTH("camss_gp0_clk")

  if (STRING.SCAN("&clk", "*", 0)==0)
  (
    &wild_head=1
  )
  if (STRING.SCAN("&clk", "*", 1)==(STRING.LENGTH("&clk")-1))
  (
    &wild_tail=1
  )

  if ((&wild_head==1)&&(&wild_tail==1))
  (
    if (STRING.SCAN("camss_gp0_clk", STRING.MID("&clk", 1, &clk_input_length-2), 0)!=-1)
    ( 
      &match=1
    )
  )
  else if (&wild_head==1)
  (
    if (STRING.MID("camss_gp0_clk", &clk_itr_length-&clk_input_length+1, &clk_input_length-1)==STRING.CUT("&clk", 1))
    ( 
      &match=1
    )
  )
  else if (&wild_tail==1)
  (
    if (STRING.MID("camss_gp0_clk", 0, &clk_input_length-1)==STRING.CUT("&clk", -1))
    ( 
      &match=1
    )
  )	  
  else if ("camss_gp0_clk"=="&clk")
  (
    &match=1
  )
  
  if (&match==1)
  (
    &clk_test=&CLK_TEST_CAMSS_GP0_CLK
    &clk_reg=&HWIO_MMSS_CAMSS_GP0_CBCR_ADDR
    &clk_reg_name="MMSS_CAMSS_GP0_CBCR"
    &clk_name="camss_gp0_clk"
    &clk_reg_cbcr_type="sm_cbc"

    gosub Print_Clk_Info_Line
  )
  
  &match=0
  &wild_head=0
  &wild_tail=0
  &clk_input_length=STRING.LENGTH("&clk")
  &clk_itr_length=STRING.LENGTH("camss_gp1_clk")

  if (STRING.SCAN("&clk", "*", 0)==0)
  (
    &wild_head=1
  )
  if (STRING.SCAN("&clk", "*", 1)==(STRING.LENGTH("&clk")-1))
  (
    &wild_tail=1
  )

  if ((&wild_head==1)&&(&wild_tail==1))
  (
    if (STRING.SCAN("camss_gp1_clk", STRING.MID("&clk", 1, &clk_input_length-2), 0)!=-1)
    ( 
      &match=1
    )
  )
  else if (&wild_head==1)
  (
    if (STRING.MID("camss_gp1_clk", &clk_itr_length-&clk_input_length+1, &clk_input_length-1)==STRING.CUT("&clk", 1))
    ( 
      &match=1
    )
  )
  else if (&wild_tail==1)
  (
    if (STRING.MID("camss_gp1_clk", 0, &clk_input_length-1)==STRING.CUT("&clk", -1))
    ( 
      &match=1
    )
  )	  
  else if ("camss_gp1_clk"=="&clk")
  (
    &match=1
  )
  
  if (&match==1)
  (
    &clk_test=&CLK_TEST_CAMSS_GP1_CLK
    &clk_reg=&HWIO_MMSS_CAMSS_GP1_CBCR_ADDR
    &clk_reg_name="MMSS_CAMSS_GP1_CBCR"
    &clk_name="camss_gp1_clk"
    &clk_reg_cbcr_type="sm_cbc"

    gosub Print_Clk_Info_Line
  )
  
  &match=0
  &wild_head=0
  &wild_tail=0
  &clk_input_length=STRING.LENGTH("&clk")
  &clk_itr_length=STRING.LENGTH("camss_ispif_ahb_clk")

  if (STRING.SCAN("&clk", "*", 0)==0)
  (
    &wild_head=1
  )
  if (STRING.SCAN("&clk", "*", 1)==(STRING.LENGTH("&clk")-1))
  (
    &wild_tail=1
  )

  if ((&wild_head==1)&&(&wild_tail==1))
  (
    if (STRING.SCAN("camss_ispif_ahb_clk", STRING.MID("&clk", 1, &clk_input_length-2), 0)!=-1)
    ( 
      &match=1
    )
  )
  else if (&wild_head==1)
  (
    if (STRING.MID("camss_ispif_ahb_clk", &clk_itr_length-&clk_input_length+1, &clk_input_length-1)==STRING.CUT("&clk", 1))
    ( 
      &match=1
    )
  )
  else if (&wild_tail==1)
  (
    if (STRING.MID("camss_ispif_ahb_clk", 0, &clk_input_length-1)==STRING.CUT("&clk", -1))
    ( 
      &match=1
    )
  )	  
  else if ("camss_ispif_ahb_clk"=="&clk")
  (
    &match=1
  )
  
  if (&match==1)
  (
    &clk_test=&CLK_TEST_CAMSS_ISPIF_AHB_CLK
    &clk_reg=&HWIO_MMSS_CAMSS_ISPIF_AHB_CBCR_ADDR
    &clk_reg_name="MMSS_CAMSS_ISPIF_AHB_CBCR"
    &clk_name="camss_ispif_ahb_clk"
    &clk_reg_cbcr_type="sm_cbc"

    gosub Print_Clk_Info_Line
  )
  
  &match=0
  &wild_head=0
  &wild_tail=0
  &clk_input_length=STRING.LENGTH("&clk")
  &clk_itr_length=STRING.LENGTH("camss_jpeg_jpeg0_clk")

  if (STRING.SCAN("&clk", "*", 0)==0)
  (
    &wild_head=1
  )
  if (STRING.SCAN("&clk", "*", 1)==(STRING.LENGTH("&clk")-1))
  (
    &wild_tail=1
  )

  if ((&wild_head==1)&&(&wild_tail==1))
  (
    if (STRING.SCAN("camss_jpeg_jpeg0_clk", STRING.MID("&clk", 1, &clk_input_length-2), 0)!=-1)
    ( 
      &match=1
    )
  )
  else if (&wild_head==1)
  (
    if (STRING.MID("camss_jpeg_jpeg0_clk", &clk_itr_length-&clk_input_length+1, &clk_input_length-1)==STRING.CUT("&clk", 1))
    ( 
      &match=1
    )
  )
  else if (&wild_tail==1)
  (
    if (STRING.MID("camss_jpeg_jpeg0_clk", 0, &clk_input_length-1)==STRING.CUT("&clk", -1))
    ( 
      &match=1
    )
  )	  
  else if ("camss_jpeg_jpeg0_clk"=="&clk")
  (
    &match=1
  )
  
  if (&match==1)
  (
    &clk_test=&CLK_TEST_CAMSS_JPEG_JPEG0_CLK
    &clk_reg=&HWIO_MMSS_CAMSS_JPEG_JPEG0_CBCR_ADDR
    &clk_reg_name="MMSS_CAMSS_JPEG_JPEG0_CBCR"
    &clk_name="camss_jpeg_jpeg0_clk"
    &clk_reg_cbcr_type="sm_pscbc"

    gosub Print_Clk_Info_Line
  )
  
  &match=0
  &wild_head=0
  &wild_tail=0
  &clk_input_length=STRING.LENGTH("&clk")
  &clk_itr_length=STRING.LENGTH("camss_jpeg_jpeg1_clk")

  if (STRING.SCAN("&clk", "*", 0)==0)
  (
    &wild_head=1
  )
  if (STRING.SCAN("&clk", "*", 1)==(STRING.LENGTH("&clk")-1))
  (
    &wild_tail=1
  )

  if ((&wild_head==1)&&(&wild_tail==1))
  (
    if (STRING.SCAN("camss_jpeg_jpeg1_clk", STRING.MID("&clk", 1, &clk_input_length-2), 0)!=-1)
    ( 
      &match=1
    )
  )
  else if (&wild_head==1)
  (
    if (STRING.MID("camss_jpeg_jpeg1_clk", &clk_itr_length-&clk_input_length+1, &clk_input_length-1)==STRING.CUT("&clk", 1))
    ( 
      &match=1
    )
  )
  else if (&wild_tail==1)
  (
    if (STRING.MID("camss_jpeg_jpeg1_clk", 0, &clk_input_length-1)==STRING.CUT("&clk", -1))
    ( 
      &match=1
    )
  )	  
  else if ("camss_jpeg_jpeg1_clk"=="&clk")
  (
    &match=1
  )
  
  if (&match==1)
  (
    &clk_test=&CLK_TEST_CAMSS_JPEG_JPEG1_CLK
    &clk_reg=&HWIO_MMSS_CAMSS_JPEG_JPEG1_CBCR_ADDR
    &clk_reg_name="MMSS_CAMSS_JPEG_JPEG1_CBCR"
    &clk_name="camss_jpeg_jpeg1_clk"
    &clk_reg_cbcr_type="sm_pscbc"

    gosub Print_Clk_Info_Line
  )
  
  &match=0
  &wild_head=0
  &wild_tail=0
  &clk_input_length=STRING.LENGTH("&clk")
  &clk_itr_length=STRING.LENGTH("camss_jpeg_jpeg2_clk")

  if (STRING.SCAN("&clk", "*", 0)==0)
  (
    &wild_head=1
  )
  if (STRING.SCAN("&clk", "*", 1)==(STRING.LENGTH("&clk")-1))
  (
    &wild_tail=1
  )

  if ((&wild_head==1)&&(&wild_tail==1))
  (
    if (STRING.SCAN("camss_jpeg_jpeg2_clk", STRING.MID("&clk", 1, &clk_input_length-2), 0)!=-1)
    ( 
      &match=1
    )
  )
  else if (&wild_head==1)
  (
    if (STRING.MID("camss_jpeg_jpeg2_clk", &clk_itr_length-&clk_input_length+1, &clk_input_length-1)==STRING.CUT("&clk", 1))
    ( 
      &match=1
    )
  )
  else if (&wild_tail==1)
  (
    if (STRING.MID("camss_jpeg_jpeg2_clk", 0, &clk_input_length-1)==STRING.CUT("&clk", -1))
    ( 
      &match=1
    )
  )	  
  else if ("camss_jpeg_jpeg2_clk"=="&clk")
  (
    &match=1
  )
  
  if (&match==1)
  (
    &clk_test=&CLK_TEST_CAMSS_JPEG_JPEG2_CLK
    &clk_reg=&HWIO_MMSS_CAMSS_JPEG_JPEG2_CBCR_ADDR
    &clk_reg_name="MMSS_CAMSS_JPEG_JPEG2_CBCR"
    &clk_name="camss_jpeg_jpeg2_clk"
    &clk_reg_cbcr_type="sm_pscbc"

    gosub Print_Clk_Info_Line
  )
  
  &match=0
  &wild_head=0
  &wild_tail=0
  &clk_input_length=STRING.LENGTH("&clk")
  &clk_itr_length=STRING.LENGTH("camss_jpeg_jpeg_ahb_clk")

  if (STRING.SCAN("&clk", "*", 0)==0)
  (
    &wild_head=1
  )
  if (STRING.SCAN("&clk", "*", 1)==(STRING.LENGTH("&clk")-1))
  (
    &wild_tail=1
  )

  if ((&wild_head==1)&&(&wild_tail==1))
  (
    if (STRING.SCAN("camss_jpeg_jpeg_ahb_clk", STRING.MID("&clk", 1, &clk_input_length-2), 0)!=-1)
    ( 
      &match=1
    )
  )
  else if (&wild_head==1)
  (
    if (STRING.MID("camss_jpeg_jpeg_ahb_clk", &clk_itr_length-&clk_input_length+1, &clk_input_length-1)==STRING.CUT("&clk", 1))
    ( 
      &match=1
    )
  )
  else if (&wild_tail==1)
  (
    if (STRING.MID("camss_jpeg_jpeg_ahb_clk", 0, &clk_input_length-1)==STRING.CUT("&clk", -1))
    ( 
      &match=1
    )
  )	  
  else if ("camss_jpeg_jpeg_ahb_clk"=="&clk")
  (
    &match=1
  )
  
  if (&match==1)
  (
    &clk_test=&CLK_TEST_CAMSS_JPEG_JPEG_AHB_CLK
    &clk_reg=&HWIO_MMSS_CAMSS_JPEG_JPEG_AHB_CBCR_ADDR
    &clk_reg_name="MMSS_CAMSS_JPEG_JPEG_AHB_CBCR"
    &clk_name="camss_jpeg_jpeg_ahb_clk"
    &clk_reg_cbcr_type="sm_cbc"

    gosub Print_Clk_Info_Line
  )
  
  &match=0
  &wild_head=0
  &wild_tail=0
  &clk_input_length=STRING.LENGTH("&clk")
  &clk_itr_length=STRING.LENGTH("camss_jpeg_jpeg_axi_clk")

  if (STRING.SCAN("&clk", "*", 0)==0)
  (
    &wild_head=1
  )
  if (STRING.SCAN("&clk", "*", 1)==(STRING.LENGTH("&clk")-1))
  (
    &wild_tail=1
  )

  if ((&wild_head==1)&&(&wild_tail==1))
  (
    if (STRING.SCAN("camss_jpeg_jpeg_axi_clk", STRING.MID("&clk", 1, &clk_input_length-2), 0)!=-1)
    ( 
      &match=1
    )
  )
  else if (&wild_head==1)
  (
    if (STRING.MID("camss_jpeg_jpeg_axi_clk", &clk_itr_length-&clk_input_length+1, &clk_input_length-1)==STRING.CUT("&clk", 1))
    ( 
      &match=1
    )
  )
  else if (&wild_tail==1)
  (
    if (STRING.MID("camss_jpeg_jpeg_axi_clk", 0, &clk_input_length-1)==STRING.CUT("&clk", -1))
    ( 
      &match=1
    )
  )	  
  else if ("camss_jpeg_jpeg_axi_clk"=="&clk")
  (
    &match=1
  )
  
  if (&match==1)
  (
    &clk_test=&CLK_TEST_CAMSS_JPEG_JPEG_AXI_CLK
    &clk_reg=&HWIO_MMSS_CAMSS_JPEG_JPEG_AXI_CBCR_ADDR
    &clk_reg_name="MMSS_CAMSS_JPEG_JPEG_AXI_CBCR"
    &clk_name="camss_jpeg_jpeg_axi_clk"
    &clk_reg_cbcr_type="sm_pscbc"

    gosub Print_Clk_Info_Line
  )
  
  &match=0
  &wild_head=0
  &wild_tail=0
  &clk_input_length=STRING.LENGTH("&clk")
  &clk_itr_length=STRING.LENGTH("camss_mclk0_clk")

  if (STRING.SCAN("&clk", "*", 0)==0)
  (
    &wild_head=1
  )
  if (STRING.SCAN("&clk", "*", 1)==(STRING.LENGTH("&clk")-1))
  (
    &wild_tail=1
  )

  if ((&wild_head==1)&&(&wild_tail==1))
  (
    if (STRING.SCAN("camss_mclk0_clk", STRING.MID("&clk", 1, &clk_input_length-2), 0)!=-1)
    ( 
      &match=1
    )
  )
  else if (&wild_head==1)
  (
    if (STRING.MID("camss_mclk0_clk", &clk_itr_length-&clk_input_length+1, &clk_input_length-1)==STRING.CUT("&clk", 1))
    ( 
      &match=1
    )
  )
  else if (&wild_tail==1)
  (
    if (STRING.MID("camss_mclk0_clk", 0, &clk_input_length-1)==STRING.CUT("&clk", -1))
    ( 
      &match=1
    )
  )	  
  else if ("camss_mclk0_clk"=="&clk")
  (
    &match=1
  )
  
  if (&match==1)
  (
    &clk_test=&CLK_TEST_CAMSS_MCLK0_CLK
    &clk_reg=&HWIO_MMSS_CAMSS_MCLK0_CBCR_ADDR
    &clk_reg_name="MMSS_CAMSS_MCLK0_CBCR"
    &clk_name="camss_mclk0_clk"
    &clk_reg_cbcr_type="sm_cbc"

    gosub Print_Clk_Info_Line
  )
  
  &match=0
  &wild_head=0
  &wild_tail=0
  &clk_input_length=STRING.LENGTH("&clk")
  &clk_itr_length=STRING.LENGTH("camss_mclk1_clk")

  if (STRING.SCAN("&clk", "*", 0)==0)
  (
    &wild_head=1
  )
  if (STRING.SCAN("&clk", "*", 1)==(STRING.LENGTH("&clk")-1))
  (
    &wild_tail=1
  )

  if ((&wild_head==1)&&(&wild_tail==1))
  (
    if (STRING.SCAN("camss_mclk1_clk", STRING.MID("&clk", 1, &clk_input_length-2), 0)!=-1)
    ( 
      &match=1
    )
  )
  else if (&wild_head==1)
  (
    if (STRING.MID("camss_mclk1_clk", &clk_itr_length-&clk_input_length+1, &clk_input_length-1)==STRING.CUT("&clk", 1))
    ( 
      &match=1
    )
  )
  else if (&wild_tail==1)
  (
    if (STRING.MID("camss_mclk1_clk", 0, &clk_input_length-1)==STRING.CUT("&clk", -1))
    ( 
      &match=1
    )
  )	  
  else if ("camss_mclk1_clk"=="&clk")
  (
    &match=1
  )
  
  if (&match==1)
  (
    &clk_test=&CLK_TEST_CAMSS_MCLK1_CLK
    &clk_reg=&HWIO_MMSS_CAMSS_MCLK1_CBCR_ADDR
    &clk_reg_name="MMSS_CAMSS_MCLK1_CBCR"
    &clk_name="camss_mclk1_clk"
    &clk_reg_cbcr_type="sm_cbc"

    gosub Print_Clk_Info_Line
  )
  
  &match=0
  &wild_head=0
  &wild_tail=0
  &clk_input_length=STRING.LENGTH("&clk")
  &clk_itr_length=STRING.LENGTH("camss_mclk2_clk")

  if (STRING.SCAN("&clk", "*", 0)==0)
  (
    &wild_head=1
  )
  if (STRING.SCAN("&clk", "*", 1)==(STRING.LENGTH("&clk")-1))
  (
    &wild_tail=1
  )

  if ((&wild_head==1)&&(&wild_tail==1))
  (
    if (STRING.SCAN("camss_mclk2_clk", STRING.MID("&clk", 1, &clk_input_length-2), 0)!=-1)
    ( 
      &match=1
    )
  )
  else if (&wild_head==1)
  (
    if (STRING.MID("camss_mclk2_clk", &clk_itr_length-&clk_input_length+1, &clk_input_length-1)==STRING.CUT("&clk", 1))
    ( 
      &match=1
    )
  )
  else if (&wild_tail==1)
  (
    if (STRING.MID("camss_mclk2_clk", 0, &clk_input_length-1)==STRING.CUT("&clk", -1))
    ( 
      &match=1
    )
  )	  
  else if ("camss_mclk2_clk"=="&clk")
  (
    &match=1
  )
  
  if (&match==1)
  (
    &clk_test=&CLK_TEST_CAMSS_MCLK2_CLK
    &clk_reg=&HWIO_MMSS_CAMSS_MCLK2_CBCR_ADDR
    &clk_reg_name="MMSS_CAMSS_MCLK2_CBCR"
    &clk_name="camss_mclk2_clk"
    &clk_reg_cbcr_type="sm_cbc"

    gosub Print_Clk_Info_Line
  )
  
  &match=0
  &wild_head=0
  &wild_tail=0
  &clk_input_length=STRING.LENGTH("&clk")
  &clk_itr_length=STRING.LENGTH("camss_mclk3_clk")

  if (STRING.SCAN("&clk", "*", 0)==0)
  (
    &wild_head=1
  )
  if (STRING.SCAN("&clk", "*", 1)==(STRING.LENGTH("&clk")-1))
  (
    &wild_tail=1
  )

  if ((&wild_head==1)&&(&wild_tail==1))
  (
    if (STRING.SCAN("camss_mclk3_clk", STRING.MID("&clk", 1, &clk_input_length-2), 0)!=-1)
    ( 
      &match=1
    )
  )
  else if (&wild_head==1)
  (
    if (STRING.MID("camss_mclk3_clk", &clk_itr_length-&clk_input_length+1, &clk_input_length-1)==STRING.CUT("&clk", 1))
    ( 
      &match=1
    )
  )
  else if (&wild_tail==1)
  (
    if (STRING.MID("camss_mclk3_clk", 0, &clk_input_length-1)==STRING.CUT("&clk", -1))
    ( 
      &match=1
    )
  )	  
  else if ("camss_mclk3_clk"=="&clk")
  (
    &match=1
  )
  
  if (&match==1)
  (
    &clk_test=&CLK_TEST_CAMSS_MCLK3_CLK
    &clk_reg=&HWIO_MMSS_CAMSS_MCLK3_CBCR_ADDR
    &clk_reg_name="MMSS_CAMSS_MCLK3_CBCR"
    &clk_name="camss_mclk3_clk"
    &clk_reg_cbcr_type="sm_cbc"

    gosub Print_Clk_Info_Line
  )
  
  &match=0
  &wild_head=0
  &wild_tail=0
  &clk_input_length=STRING.LENGTH("&clk")
  &clk_itr_length=STRING.LENGTH("camss_micro_ahb_clk")

  if (STRING.SCAN("&clk", "*", 0)==0)
  (
    &wild_head=1
  )
  if (STRING.SCAN("&clk", "*", 1)==(STRING.LENGTH("&clk")-1))
  (
    &wild_tail=1
  )

  if ((&wild_head==1)&&(&wild_tail==1))
  (
    if (STRING.SCAN("camss_micro_ahb_clk", STRING.MID("&clk", 1, &clk_input_length-2), 0)!=-1)
    ( 
      &match=1
    )
  )
  else if (&wild_head==1)
  (
    if (STRING.MID("camss_micro_ahb_clk", &clk_itr_length-&clk_input_length+1, &clk_input_length-1)==STRING.CUT("&clk", 1))
    ( 
      &match=1
    )
  )
  else if (&wild_tail==1)
  (
    if (STRING.MID("camss_micro_ahb_clk", 0, &clk_input_length-1)==STRING.CUT("&clk", -1))
    ( 
      &match=1
    )
  )	  
  else if ("camss_micro_ahb_clk"=="&clk")
  (
    &match=1
  )
  
  if (&match==1)
  (
    &clk_test=&CLK_TEST_CAMSS_MICRO_AHB_CLK
    &clk_reg=&HWIO_MMSS_CAMSS_MICRO_AHB_CBCR_ADDR
    &clk_reg_name="MMSS_CAMSS_MICRO_AHB_CBCR"
    &clk_name="camss_micro_ahb_clk"
    &clk_reg_cbcr_type="sm_pscbc"

    gosub Print_Clk_Info_Line
  )
  
  &match=0
  &wild_head=0
  &wild_tail=0
  &clk_input_length=STRING.LENGTH("&clk")
  &clk_itr_length=STRING.LENGTH("camss_phy0_csi0phytimer_clk")

  if (STRING.SCAN("&clk", "*", 0)==0)
  (
    &wild_head=1
  )
  if (STRING.SCAN("&clk", "*", 1)==(STRING.LENGTH("&clk")-1))
  (
    &wild_tail=1
  )

  if ((&wild_head==1)&&(&wild_tail==1))
  (
    if (STRING.SCAN("camss_phy0_csi0phytimer_clk", STRING.MID("&clk", 1, &clk_input_length-2), 0)!=-1)
    ( 
      &match=1
    )
  )
  else if (&wild_head==1)
  (
    if (STRING.MID("camss_phy0_csi0phytimer_clk", &clk_itr_length-&clk_input_length+1, &clk_input_length-1)==STRING.CUT("&clk", 1))
    ( 
      &match=1
    )
  )
  else if (&wild_tail==1)
  (
    if (STRING.MID("camss_phy0_csi0phytimer_clk", 0, &clk_input_length-1)==STRING.CUT("&clk", -1))
    ( 
      &match=1
    )
  )	  
  else if ("camss_phy0_csi0phytimer_clk"=="&clk")
  (
    &match=1
  )
  
  if (&match==1)
  (
    &clk_test=&CLK_TEST_CAMSS_PHY0_CSI0PHYTIMER_CLK
    &clk_reg=&HWIO_MMSS_CAMSS_PHY0_CSI0PHYTIMER_CBCR_ADDR
    &clk_reg_name="MMSS_CAMSS_PHY0_CSI0PHYTIMER_CBCR"
    &clk_name="camss_phy0_csi0phytimer_clk"
    &clk_reg_cbcr_type="sm_cbc"

    gosub Print_Clk_Info_Line
  )
  
  &match=0
  &wild_head=0
  &wild_tail=0
  &clk_input_length=STRING.LENGTH("&clk")
  &clk_itr_length=STRING.LENGTH("camss_phy1_csi1phytimer_clk")

  if (STRING.SCAN("&clk", "*", 0)==0)
  (
    &wild_head=1
  )
  if (STRING.SCAN("&clk", "*", 1)==(STRING.LENGTH("&clk")-1))
  (
    &wild_tail=1
  )

  if ((&wild_head==1)&&(&wild_tail==1))
  (
    if (STRING.SCAN("camss_phy1_csi1phytimer_clk", STRING.MID("&clk", 1, &clk_input_length-2), 0)!=-1)
    ( 
      &match=1
    )
  )
  else if (&wild_head==1)
  (
    if (STRING.MID("camss_phy1_csi1phytimer_clk", &clk_itr_length-&clk_input_length+1, &clk_input_length-1)==STRING.CUT("&clk", 1))
    ( 
      &match=1
    )
  )
  else if (&wild_tail==1)
  (
    if (STRING.MID("camss_phy1_csi1phytimer_clk", 0, &clk_input_length-1)==STRING.CUT("&clk", -1))
    ( 
      &match=1
    )
  )	  
  else if ("camss_phy1_csi1phytimer_clk"=="&clk")
  (
    &match=1
  )
  
  if (&match==1)
  (
    &clk_test=&CLK_TEST_CAMSS_PHY1_CSI1PHYTIMER_CLK
    &clk_reg=&HWIO_MMSS_CAMSS_PHY1_CSI1PHYTIMER_CBCR_ADDR
    &clk_reg_name="MMSS_CAMSS_PHY1_CSI1PHYTIMER_CBCR"
    &clk_name="camss_phy1_csi1phytimer_clk"
    &clk_reg_cbcr_type="sm_cbc"

    gosub Print_Clk_Info_Line
  )
  
  &match=0
  &wild_head=0
  &wild_tail=0
  &clk_input_length=STRING.LENGTH("&clk")
  &clk_itr_length=STRING.LENGTH("camss_phy2_csi2phytimer_clk")

  if (STRING.SCAN("&clk", "*", 0)==0)
  (
    &wild_head=1
  )
  if (STRING.SCAN("&clk", "*", 1)==(STRING.LENGTH("&clk")-1))
  (
    &wild_tail=1
  )

  if ((&wild_head==1)&&(&wild_tail==1))
  (
    if (STRING.SCAN("camss_phy2_csi2phytimer_clk", STRING.MID("&clk", 1, &clk_input_length-2), 0)!=-1)
    ( 
      &match=1
    )
  )
  else if (&wild_head==1)
  (
    if (STRING.MID("camss_phy2_csi2phytimer_clk", &clk_itr_length-&clk_input_length+1, &clk_input_length-1)==STRING.CUT("&clk", 1))
    ( 
      &match=1
    )
  )
  else if (&wild_tail==1)
  (
    if (STRING.MID("camss_phy2_csi2phytimer_clk", 0, &clk_input_length-1)==STRING.CUT("&clk", -1))
    ( 
      &match=1
    )
  )	  
  else if ("camss_phy2_csi2phytimer_clk"=="&clk")
  (
    &match=1
  )
  
  if (&match==1)
  (
    &clk_test=&CLK_TEST_CAMSS_PHY2_CSI2PHYTIMER_CLK
    &clk_reg=&HWIO_MMSS_CAMSS_PHY2_CSI2PHYTIMER_CBCR_ADDR
    &clk_reg_name="MMSS_CAMSS_PHY2_CSI2PHYTIMER_CBCR"
    &clk_name="camss_phy2_csi2phytimer_clk"
    &clk_reg_cbcr_type="sm_cbc"

    gosub Print_Clk_Info_Line
  )
  
  &match=0
  &wild_head=0
  &wild_tail=0
  &clk_input_length=STRING.LENGTH("&clk")
  &clk_itr_length=STRING.LENGTH("camss_top_ahb_clk")

  if (STRING.SCAN("&clk", "*", 0)==0)
  (
    &wild_head=1
  )
  if (STRING.SCAN("&clk", "*", 1)==(STRING.LENGTH("&clk")-1))
  (
    &wild_tail=1
  )

  if ((&wild_head==1)&&(&wild_tail==1))
  (
    if (STRING.SCAN("camss_top_ahb_clk", STRING.MID("&clk", 1, &clk_input_length-2), 0)!=-1)
    ( 
      &match=1
    )
  )
  else if (&wild_head==1)
  (
    if (STRING.MID("camss_top_ahb_clk", &clk_itr_length-&clk_input_length+1, &clk_input_length-1)==STRING.CUT("&clk", 1))
    ( 
      &match=1
    )
  )
  else if (&wild_tail==1)
  (
    if (STRING.MID("camss_top_ahb_clk", 0, &clk_input_length-1)==STRING.CUT("&clk", -1))
    ( 
      &match=1
    )
  )	  
  else if ("camss_top_ahb_clk"=="&clk")
  (
    &match=1
  )
  
  if (&match==1)
  (
    &clk_test=&CLK_TEST_CAMSS_TOP_AHB_CLK
    &clk_reg=&HWIO_MMSS_CAMSS_TOP_AHB_CBCR_ADDR
    &clk_reg_name="MMSS_CAMSS_TOP_AHB_CBCR"
    &clk_name="camss_top_ahb_clk"
    &clk_reg_cbcr_type="sm_cbc"

    gosub Print_Clk_Info_Line
  )
  
  &match=0
  &wild_head=0
  &wild_tail=0
  &clk_input_length=STRING.LENGTH("&clk")
  &clk_itr_length=STRING.LENGTH("camss_vfe_cpp_ahb_clk")

  if (STRING.SCAN("&clk", "*", 0)==0)
  (
    &wild_head=1
  )
  if (STRING.SCAN("&clk", "*", 1)==(STRING.LENGTH("&clk")-1))
  (
    &wild_tail=1
  )

  if ((&wild_head==1)&&(&wild_tail==1))
  (
    if (STRING.SCAN("camss_vfe_cpp_ahb_clk", STRING.MID("&clk", 1, &clk_input_length-2), 0)!=-1)
    ( 
      &match=1
    )
  )
  else if (&wild_head==1)
  (
    if (STRING.MID("camss_vfe_cpp_ahb_clk", &clk_itr_length-&clk_input_length+1, &clk_input_length-1)==STRING.CUT("&clk", 1))
    ( 
      &match=1
    )
  )
  else if (&wild_tail==1)
  (
    if (STRING.MID("camss_vfe_cpp_ahb_clk", 0, &clk_input_length-1)==STRING.CUT("&clk", -1))
    ( 
      &match=1
    )
  )	  
  else if ("camss_vfe_cpp_ahb_clk"=="&clk")
  (
    &match=1
  )
  
  if (&match==1)
  (
    &clk_test=&CLK_TEST_CAMSS_VFE_CPP_AHB_CLK
    &clk_reg=&HWIO_MMSS_CAMSS_VFE_CPP_AHB_CBCR_ADDR
    &clk_reg_name="MMSS_CAMSS_VFE_CPP_AHB_CBCR"
    &clk_name="camss_vfe_cpp_ahb_clk"
    &clk_reg_cbcr_type="sm_cbc"

    gosub Print_Clk_Info_Line
  )
  
  &match=0
  &wild_head=0
  &wild_tail=0
  &clk_input_length=STRING.LENGTH("&clk")
  &clk_itr_length=STRING.LENGTH("camss_vfe_cpp_clk")

  if (STRING.SCAN("&clk", "*", 0)==0)
  (
    &wild_head=1
  )
  if (STRING.SCAN("&clk", "*", 1)==(STRING.LENGTH("&clk")-1))
  (
    &wild_tail=1
  )

  if ((&wild_head==1)&&(&wild_tail==1))
  (
    if (STRING.SCAN("camss_vfe_cpp_clk", STRING.MID("&clk", 1, &clk_input_length-2), 0)!=-1)
    ( 
      &match=1
    )
  )
  else if (&wild_head==1)
  (
    if (STRING.MID("camss_vfe_cpp_clk", &clk_itr_length-&clk_input_length+1, &clk_input_length-1)==STRING.CUT("&clk", 1))
    ( 
      &match=1
    )
  )
  else if (&wild_tail==1)
  (
    if (STRING.MID("camss_vfe_cpp_clk", 0, &clk_input_length-1)==STRING.CUT("&clk", -1))
    ( 
      &match=1
    )
  )	  
  else if ("camss_vfe_cpp_clk"=="&clk")
  (
    &match=1
  )
  
  if (&match==1)
  (
    &clk_test=&CLK_TEST_CAMSS_VFE_CPP_CLK
    &clk_reg=&HWIO_MMSS_CAMSS_VFE_CPP_CBCR_ADDR
    &clk_reg_name="MMSS_CAMSS_VFE_CPP_CBCR"
    &clk_name="camss_vfe_cpp_clk"
    &clk_reg_cbcr_type="sm_pscbc"

    gosub Print_Clk_Info_Line
  )
  
  &match=0
  &wild_head=0
  &wild_tail=0
  &clk_input_length=STRING.LENGTH("&clk")
  &clk_itr_length=STRING.LENGTH("camss_vfe_vfe0_clk")

  if (STRING.SCAN("&clk", "*", 0)==0)
  (
    &wild_head=1
  )
  if (STRING.SCAN("&clk", "*", 1)==(STRING.LENGTH("&clk")-1))
  (
    &wild_tail=1
  )

  if ((&wild_head==1)&&(&wild_tail==1))
  (
    if (STRING.SCAN("camss_vfe_vfe0_clk", STRING.MID("&clk", 1, &clk_input_length-2), 0)!=-1)
    ( 
      &match=1
    )
  )
  else if (&wild_head==1)
  (
    if (STRING.MID("camss_vfe_vfe0_clk", &clk_itr_length-&clk_input_length+1, &clk_input_length-1)==STRING.CUT("&clk", 1))
    ( 
      &match=1
    )
  )
  else if (&wild_tail==1)
  (
    if (STRING.MID("camss_vfe_vfe0_clk", 0, &clk_input_length-1)==STRING.CUT("&clk", -1))
    ( 
      &match=1
    )
  )	  
  else if ("camss_vfe_vfe0_clk"=="&clk")
  (
    &match=1
  )
  
  if (&match==1)
  (
    &clk_test=&CLK_TEST_CAMSS_VFE_VFE0_CLK
    &clk_reg=&HWIO_MMSS_CAMSS_VFE_VFE0_CBCR_ADDR
    &clk_reg_name="MMSS_CAMSS_VFE_VFE0_CBCR"
    &clk_name="camss_vfe_vfe0_clk"
    &clk_reg_cbcr_type="sm_pscbc"

    gosub Print_Clk_Info_Line
  )
  
  &match=0
  &wild_head=0
  &wild_tail=0
  &clk_input_length=STRING.LENGTH("&clk")
  &clk_itr_length=STRING.LENGTH("camss_vfe_vfe1_clk")

  if (STRING.SCAN("&clk", "*", 0)==0)
  (
    &wild_head=1
  )
  if (STRING.SCAN("&clk", "*", 1)==(STRING.LENGTH("&clk")-1))
  (
    &wild_tail=1
  )

  if ((&wild_head==1)&&(&wild_tail==1))
  (
    if (STRING.SCAN("camss_vfe_vfe1_clk", STRING.MID("&clk", 1, &clk_input_length-2), 0)!=-1)
    ( 
      &match=1
    )
  )
  else if (&wild_head==1)
  (
    if (STRING.MID("camss_vfe_vfe1_clk", &clk_itr_length-&clk_input_length+1, &clk_input_length-1)==STRING.CUT("&clk", 1))
    ( 
      &match=1
    )
  )
  else if (&wild_tail==1)
  (
    if (STRING.MID("camss_vfe_vfe1_clk", 0, &clk_input_length-1)==STRING.CUT("&clk", -1))
    ( 
      &match=1
    )
  )	  
  else if ("camss_vfe_vfe1_clk"=="&clk")
  (
    &match=1
  )
  
  if (&match==1)
  (
    &clk_test=&CLK_TEST_CAMSS_VFE_VFE1_CLK
    &clk_reg=&HWIO_MMSS_CAMSS_VFE_VFE1_CBCR_ADDR
    &clk_reg_name="MMSS_CAMSS_VFE_VFE1_CBCR"
    &clk_name="camss_vfe_vfe1_clk"
    &clk_reg_cbcr_type="sm_pscbc"

    gosub Print_Clk_Info_Line
  )
  
  &match=0
  &wild_head=0
  &wild_tail=0
  &clk_input_length=STRING.LENGTH("&clk")
  &clk_itr_length=STRING.LENGTH("camss_vfe_vfe_ahb_clk")

  if (STRING.SCAN("&clk", "*", 0)==0)
  (
    &wild_head=1
  )
  if (STRING.SCAN("&clk", "*", 1)==(STRING.LENGTH("&clk")-1))
  (
    &wild_tail=1
  )

  if ((&wild_head==1)&&(&wild_tail==1))
  (
    if (STRING.SCAN("camss_vfe_vfe_ahb_clk", STRING.MID("&clk", 1, &clk_input_length-2), 0)!=-1)
    ( 
      &match=1
    )
  )
  else if (&wild_head==1)
  (
    if (STRING.MID("camss_vfe_vfe_ahb_clk", &clk_itr_length-&clk_input_length+1, &clk_input_length-1)==STRING.CUT("&clk", 1))
    ( 
      &match=1
    )
  )
  else if (&wild_tail==1)
  (
    if (STRING.MID("camss_vfe_vfe_ahb_clk", 0, &clk_input_length-1)==STRING.CUT("&clk", -1))
    ( 
      &match=1
    )
  )	  
  else if ("camss_vfe_vfe_ahb_clk"=="&clk")
  (
    &match=1
  )
  
  if (&match==1)
  (
    &clk_test=&CLK_TEST_CAMSS_VFE_VFE_AHB_CLK
    &clk_reg=&HWIO_MMSS_CAMSS_VFE_VFE_AHB_CBCR_ADDR
    &clk_reg_name="MMSS_CAMSS_VFE_VFE_AHB_CBCR"
    &clk_name="camss_vfe_vfe_ahb_clk"
    &clk_reg_cbcr_type="sm_cbc"

    gosub Print_Clk_Info_Line
  )
  
  &match=0
  &wild_head=0
  &wild_tail=0
  &clk_input_length=STRING.LENGTH("&clk")
  &clk_itr_length=STRING.LENGTH("camss_vfe_vfe_axi_clk")

  if (STRING.SCAN("&clk", "*", 0)==0)
  (
    &wild_head=1
  )
  if (STRING.SCAN("&clk", "*", 1)==(STRING.LENGTH("&clk")-1))
  (
    &wild_tail=1
  )

  if ((&wild_head==1)&&(&wild_tail==1))
  (
    if (STRING.SCAN("camss_vfe_vfe_axi_clk", STRING.MID("&clk", 1, &clk_input_length-2), 0)!=-1)
    ( 
      &match=1
    )
  )
  else if (&wild_head==1)
  (
    if (STRING.MID("camss_vfe_vfe_axi_clk", &clk_itr_length-&clk_input_length+1, &clk_input_length-1)==STRING.CUT("&clk", 1))
    ( 
      &match=1
    )
  )
  else if (&wild_tail==1)
  (
    if (STRING.MID("camss_vfe_vfe_axi_clk", 0, &clk_input_length-1)==STRING.CUT("&clk", -1))
    ( 
      &match=1
    )
  )	  
  else if ("camss_vfe_vfe_axi_clk"=="&clk")
  (
    &match=1
  )
  
  if (&match==1)
  (
    &clk_test=&CLK_TEST_CAMSS_VFE_VFE_AXI_CLK
    &clk_reg=&HWIO_MMSS_CAMSS_VFE_VFE_AXI_CBCR_ADDR
    &clk_reg_name="MMSS_CAMSS_VFE_VFE_AXI_CBCR"
    &clk_name="camss_vfe_vfe_axi_clk"
    &clk_reg_cbcr_type="sm_pscbc"

    gosub Print_Clk_Info_Line
  )
  
  &match=0
  &wild_head=0
  &wild_tail=0
  &clk_input_length=STRING.LENGTH("&clk")
  &clk_itr_length=STRING.LENGTH("mdss_ahb_clk")

  if (STRING.SCAN("&clk", "*", 0)==0)
  (
    &wild_head=1
  )
  if (STRING.SCAN("&clk", "*", 1)==(STRING.LENGTH("&clk")-1))
  (
    &wild_tail=1
  )

  if ((&wild_head==1)&&(&wild_tail==1))
  (
    if (STRING.SCAN("mdss_ahb_clk", STRING.MID("&clk", 1, &clk_input_length-2), 0)!=-1)
    ( 
      &match=1
    )
  )
  else if (&wild_head==1)
  (
    if (STRING.MID("mdss_ahb_clk", &clk_itr_length-&clk_input_length+1, &clk_input_length-1)==STRING.CUT("&clk", 1))
    ( 
      &match=1
    )
  )
  else if (&wild_tail==1)
  (
    if (STRING.MID("mdss_ahb_clk", 0, &clk_input_length-1)==STRING.CUT("&clk", -1))
    ( 
      &match=1
    )
  )	  
  else if ("mdss_ahb_clk"=="&clk")
  (
    &match=1
  )
  
  if (&match==1)
  (
    &clk_test=&CLK_TEST_MDSS_AHB_CLK
    &clk_reg=&HWIO_MMSS_MDSS_AHB_CBCR_ADDR
    &clk_reg_name="MMSS_MDSS_AHB_CBCR"
    &clk_name="mdss_ahb_clk"
    &clk_reg_cbcr_type="sm_cbc"

    gosub Print_Clk_Info_Line
  )
  
  &match=0
  &wild_head=0
  &wild_tail=0
  &clk_input_length=STRING.LENGTH("&clk")
  &clk_itr_length=STRING.LENGTH("mdss_axi_clk")

  if (STRING.SCAN("&clk", "*", 0)==0)
  (
    &wild_head=1
  )
  if (STRING.SCAN("&clk", "*", 1)==(STRING.LENGTH("&clk")-1))
  (
    &wild_tail=1
  )

  if ((&wild_head==1)&&(&wild_tail==1))
  (
    if (STRING.SCAN("mdss_axi_clk", STRING.MID("&clk", 1, &clk_input_length-2), 0)!=-1)
    ( 
      &match=1
    )
  )
  else if (&wild_head==1)
  (
    if (STRING.MID("mdss_axi_clk", &clk_itr_length-&clk_input_length+1, &clk_input_length-1)==STRING.CUT("&clk", 1))
    ( 
      &match=1
    )
  )
  else if (&wild_tail==1)
  (
    if (STRING.MID("mdss_axi_clk", 0, &clk_input_length-1)==STRING.CUT("&clk", -1))
    ( 
      &match=1
    )
  )	  
  else if ("mdss_axi_clk"=="&clk")
  (
    &match=1
  )
  
  if (&match==1)
  (
    &clk_test=&CLK_TEST_MDSS_AXI_CLK
    &clk_reg=&HWIO_MMSS_MDSS_AXI_CBCR_ADDR
    &clk_reg_name="MMSS_MDSS_AXI_CBCR"
    &clk_name="mdss_axi_clk"
    &clk_reg_cbcr_type="sm_pscbc"

    gosub Print_Clk_Info_Line
  )
  
  &match=0
  &wild_head=0
  &wild_tail=0
  &clk_input_length=STRING.LENGTH("&clk")
  &clk_itr_length=STRING.LENGTH("mdss_byte0_clk")

  if (STRING.SCAN("&clk", "*", 0)==0)
  (
    &wild_head=1
  )
  if (STRING.SCAN("&clk", "*", 1)==(STRING.LENGTH("&clk")-1))
  (
    &wild_tail=1
  )

  if ((&wild_head==1)&&(&wild_tail==1))
  (
    if (STRING.SCAN("mdss_byte0_clk", STRING.MID("&clk", 1, &clk_input_length-2), 0)!=-1)
    ( 
      &match=1
    )
  )
  else if (&wild_head==1)
  (
    if (STRING.MID("mdss_byte0_clk", &clk_itr_length-&clk_input_length+1, &clk_input_length-1)==STRING.CUT("&clk", 1))
    ( 
      &match=1
    )
  )
  else if (&wild_tail==1)
  (
    if (STRING.MID("mdss_byte0_clk", 0, &clk_input_length-1)==STRING.CUT("&clk", -1))
    ( 
      &match=1
    )
  )	  
  else if ("mdss_byte0_clk"=="&clk")
  (
    &match=1
  )
  
  if (&match==1)
  (
    &clk_test=&CLK_TEST_MDSS_BYTE0_CLK
    &clk_reg=&HWIO_MMSS_MDSS_BYTE0_CBCR_ADDR
    &clk_reg_name="MMSS_MDSS_BYTE0_CBCR"
    &clk_name="mdss_byte0_clk"
    &clk_reg_cbcr_type="sm_cbc"

    gosub Print_Clk_Info_Line
  )
  
  &match=0
  &wild_head=0
  &wild_tail=0
  &clk_input_length=STRING.LENGTH("&clk")
  &clk_itr_length=STRING.LENGTH("mdss_byte1_clk")

  if (STRING.SCAN("&clk", "*", 0)==0)
  (
    &wild_head=1
  )
  if (STRING.SCAN("&clk", "*", 1)==(STRING.LENGTH("&clk")-1))
  (
    &wild_tail=1
  )

  if ((&wild_head==1)&&(&wild_tail==1))
  (
    if (STRING.SCAN("mdss_byte1_clk", STRING.MID("&clk", 1, &clk_input_length-2), 0)!=-1)
    ( 
      &match=1
    )
  )
  else if (&wild_head==1)
  (
    if (STRING.MID("mdss_byte1_clk", &clk_itr_length-&clk_input_length+1, &clk_input_length-1)==STRING.CUT("&clk", 1))
    ( 
      &match=1
    )
  )
  else if (&wild_tail==1)
  (
    if (STRING.MID("mdss_byte1_clk", 0, &clk_input_length-1)==STRING.CUT("&clk", -1))
    ( 
      &match=1
    )
  )	  
  else if ("mdss_byte1_clk"=="&clk")
  (
    &match=1
  )
  
  if (&match==1)
  (
    &clk_test=&CLK_TEST_MDSS_BYTE1_CLK
    &clk_reg=&HWIO_MMSS_MDSS_BYTE1_CBCR_ADDR
    &clk_reg_name="MMSS_MDSS_BYTE1_CBCR"
    &clk_name="mdss_byte1_clk"
    &clk_reg_cbcr_type="sm_cbc"

    gosub Print_Clk_Info_Line
  )
  
  &match=0
  &wild_head=0
  &wild_tail=0
  &clk_input_length=STRING.LENGTH("&clk")
  &clk_itr_length=STRING.LENGTH("mdss_edpaux_clk")

  if (STRING.SCAN("&clk", "*", 0)==0)
  (
    &wild_head=1
  )
  if (STRING.SCAN("&clk", "*", 1)==(STRING.LENGTH("&clk")-1))
  (
    &wild_tail=1
  )

  if ((&wild_head==1)&&(&wild_tail==1))
  (
    if (STRING.SCAN("mdss_edpaux_clk", STRING.MID("&clk", 1, &clk_input_length-2), 0)!=-1)
    ( 
      &match=1
    )
  )
  else if (&wild_head==1)
  (
    if (STRING.MID("mdss_edpaux_clk", &clk_itr_length-&clk_input_length+1, &clk_input_length-1)==STRING.CUT("&clk", 1))
    ( 
      &match=1
    )
  )
  else if (&wild_tail==1)
  (
    if (STRING.MID("mdss_edpaux_clk", 0, &clk_input_length-1)==STRING.CUT("&clk", -1))
    ( 
      &match=1
    )
  )	  
  else if ("mdss_edpaux_clk"=="&clk")
  (
    &match=1
  )
  
  if (&match==1)
  (
    &clk_test=&CLK_TEST_MDSS_EDPAUX_CLK
    &clk_reg=&HWIO_MMSS_MDSS_EDPAUX_CBCR_ADDR
    &clk_reg_name="MMSS_MDSS_EDPAUX_CBCR"
    &clk_name="mdss_edpaux_clk"
    &clk_reg_cbcr_type="sm_cbc"

    gosub Print_Clk_Info_Line
  )
  
  &match=0
  &wild_head=0
  &wild_tail=0
  &clk_input_length=STRING.LENGTH("&clk")
  &clk_itr_length=STRING.LENGTH("mdss_edplink_clk")

  if (STRING.SCAN("&clk", "*", 0)==0)
  (
    &wild_head=1
  )
  if (STRING.SCAN("&clk", "*", 1)==(STRING.LENGTH("&clk")-1))
  (
    &wild_tail=1
  )

  if ((&wild_head==1)&&(&wild_tail==1))
  (
    if (STRING.SCAN("mdss_edplink_clk", STRING.MID("&clk", 1, &clk_input_length-2), 0)!=-1)
    ( 
      &match=1
    )
  )
  else if (&wild_head==1)
  (
    if (STRING.MID("mdss_edplink_clk", &clk_itr_length-&clk_input_length+1, &clk_input_length-1)==STRING.CUT("&clk", 1))
    ( 
      &match=1
    )
  )
  else if (&wild_tail==1)
  (
    if (STRING.MID("mdss_edplink_clk", 0, &clk_input_length-1)==STRING.CUT("&clk", -1))
    ( 
      &match=1
    )
  )	  
  else if ("mdss_edplink_clk"=="&clk")
  (
    &match=1
  )
  
  if (&match==1)
  (
    &clk_test=&CLK_TEST_MDSS_EDPLINK_CLK
    &clk_reg=&HWIO_MMSS_MDSS_EDPLINK_CBCR_ADDR
    &clk_reg_name="MMSS_MDSS_EDPLINK_CBCR"
    &clk_name="mdss_edplink_clk"
    &clk_reg_cbcr_type="sm_cbc"

    gosub Print_Clk_Info_Line
  )
  
  &match=0
  &wild_head=0
  &wild_tail=0
  &clk_input_length=STRING.LENGTH("&clk")
  &clk_itr_length=STRING.LENGTH("mdss_edppixel_clk")

  if (STRING.SCAN("&clk", "*", 0)==0)
  (
    &wild_head=1
  )
  if (STRING.SCAN("&clk", "*", 1)==(STRING.LENGTH("&clk")-1))
  (
    &wild_tail=1
  )

  if ((&wild_head==1)&&(&wild_tail==1))
  (
    if (STRING.SCAN("mdss_edppixel_clk", STRING.MID("&clk", 1, &clk_input_length-2), 0)!=-1)
    ( 
      &match=1
    )
  )
  else if (&wild_head==1)
  (
    if (STRING.MID("mdss_edppixel_clk", &clk_itr_length-&clk_input_length+1, &clk_input_length-1)==STRING.CUT("&clk", 1))
    ( 
      &match=1
    )
  )
  else if (&wild_tail==1)
  (
    if (STRING.MID("mdss_edppixel_clk", 0, &clk_input_length-1)==STRING.CUT("&clk", -1))
    ( 
      &match=1
    )
  )	  
  else if ("mdss_edppixel_clk"=="&clk")
  (
    &match=1
  )
  
  if (&match==1)
  (
    &clk_test=&CLK_TEST_MDSS_EDPPIXEL_CLK
    &clk_reg=&HWIO_MMSS_MDSS_EDPPIXEL_CBCR_ADDR
    &clk_reg_name="MMSS_MDSS_EDPPIXEL_CBCR"
    &clk_name="mdss_edppixel_clk"
    &clk_reg_cbcr_type="sm_cbc"

    gosub Print_Clk_Info_Line
  )
  
  &match=0
  &wild_head=0
  &wild_tail=0
  &clk_input_length=STRING.LENGTH("&clk")
  &clk_itr_length=STRING.LENGTH("mdss_esc0_clk")

  if (STRING.SCAN("&clk", "*", 0)==0)
  (
    &wild_head=1
  )
  if (STRING.SCAN("&clk", "*", 1)==(STRING.LENGTH("&clk")-1))
  (
    &wild_tail=1
  )

  if ((&wild_head==1)&&(&wild_tail==1))
  (
    if (STRING.SCAN("mdss_esc0_clk", STRING.MID("&clk", 1, &clk_input_length-2), 0)!=-1)
    ( 
      &match=1
    )
  )
  else if (&wild_head==1)
  (
    if (STRING.MID("mdss_esc0_clk", &clk_itr_length-&clk_input_length+1, &clk_input_length-1)==STRING.CUT("&clk", 1))
    ( 
      &match=1
    )
  )
  else if (&wild_tail==1)
  (
    if (STRING.MID("mdss_esc0_clk", 0, &clk_input_length-1)==STRING.CUT("&clk", -1))
    ( 
      &match=1
    )
  )	  
  else if ("mdss_esc0_clk"=="&clk")
  (
    &match=1
  )
  
  if (&match==1)
  (
    &clk_test=&CLK_TEST_MDSS_ESC0_CLK
    &clk_reg=&HWIO_MMSS_MDSS_ESC0_CBCR_ADDR
    &clk_reg_name="MMSS_MDSS_ESC0_CBCR"
    &clk_name="mdss_esc0_clk"
    &clk_reg_cbcr_type="sm_cbc"

    gosub Print_Clk_Info_Line
  )
  
  &match=0
  &wild_head=0
  &wild_tail=0
  &clk_input_length=STRING.LENGTH("&clk")
  &clk_itr_length=STRING.LENGTH("mdss_esc1_clk")

  if (STRING.SCAN("&clk", "*", 0)==0)
  (
    &wild_head=1
  )
  if (STRING.SCAN("&clk", "*", 1)==(STRING.LENGTH("&clk")-1))
  (
    &wild_tail=1
  )

  if ((&wild_head==1)&&(&wild_tail==1))
  (
    if (STRING.SCAN("mdss_esc1_clk", STRING.MID("&clk", 1, &clk_input_length-2), 0)!=-1)
    ( 
      &match=1
    )
  )
  else if (&wild_head==1)
  (
    if (STRING.MID("mdss_esc1_clk", &clk_itr_length-&clk_input_length+1, &clk_input_length-1)==STRING.CUT("&clk", 1))
    ( 
      &match=1
    )
  )
  else if (&wild_tail==1)
  (
    if (STRING.MID("mdss_esc1_clk", 0, &clk_input_length-1)==STRING.CUT("&clk", -1))
    ( 
      &match=1
    )
  )	  
  else if ("mdss_esc1_clk"=="&clk")
  (
    &match=1
  )
  
  if (&match==1)
  (
    &clk_test=&CLK_TEST_MDSS_ESC1_CLK
    &clk_reg=&HWIO_MMSS_MDSS_ESC1_CBCR_ADDR
    &clk_reg_name="MMSS_MDSS_ESC1_CBCR"
    &clk_name="mdss_esc1_clk"
    &clk_reg_cbcr_type="sm_cbc"

    gosub Print_Clk_Info_Line
  )
  
  &match=0
  &wild_head=0
  &wild_tail=0
  &clk_input_length=STRING.LENGTH("&clk")
  &clk_itr_length=STRING.LENGTH("mdss_extpclk_clk")

  if (STRING.SCAN("&clk", "*", 0)==0)
  (
    &wild_head=1
  )
  if (STRING.SCAN("&clk", "*", 1)==(STRING.LENGTH("&clk")-1))
  (
    &wild_tail=1
  )

  if ((&wild_head==1)&&(&wild_tail==1))
  (
    if (STRING.SCAN("mdss_extpclk_clk", STRING.MID("&clk", 1, &clk_input_length-2), 0)!=-1)
    ( 
      &match=1
    )
  )
  else if (&wild_head==1)
  (
    if (STRING.MID("mdss_extpclk_clk", &clk_itr_length-&clk_input_length+1, &clk_input_length-1)==STRING.CUT("&clk", 1))
    ( 
      &match=1
    )
  )
  else if (&wild_tail==1)
  (
    if (STRING.MID("mdss_extpclk_clk", 0, &clk_input_length-1)==STRING.CUT("&clk", -1))
    ( 
      &match=1
    )
  )	  
  else if ("mdss_extpclk_clk"=="&clk")
  (
    &match=1
  )
  
  if (&match==1)
  (
    &clk_test=&CLK_TEST_MDSS_EXTPCLK_CLK
    &clk_reg=&HWIO_MMSS_MDSS_EXTPCLK_CBCR_ADDR
    &clk_reg_name="MMSS_MDSS_EXTPCLK_CBCR"
    &clk_name="mdss_extpclk_clk"
    &clk_reg_cbcr_type="sm_cbc"

    gosub Print_Clk_Info_Line
  )
  
  &match=0
  &wild_head=0
  &wild_tail=0
  &clk_input_length=STRING.LENGTH("&clk")
  &clk_itr_length=STRING.LENGTH("mdss_hdmi_ahb_clk")

  if (STRING.SCAN("&clk", "*", 0)==0)
  (
    &wild_head=1
  )
  if (STRING.SCAN("&clk", "*", 1)==(STRING.LENGTH("&clk")-1))
  (
    &wild_tail=1
  )

  if ((&wild_head==1)&&(&wild_tail==1))
  (
    if (STRING.SCAN("mdss_hdmi_ahb_clk", STRING.MID("&clk", 1, &clk_input_length-2), 0)!=-1)
    ( 
      &match=1
    )
  )
  else if (&wild_head==1)
  (
    if (STRING.MID("mdss_hdmi_ahb_clk", &clk_itr_length-&clk_input_length+1, &clk_input_length-1)==STRING.CUT("&clk", 1))
    ( 
      &match=1
    )
  )
  else if (&wild_tail==1)
  (
    if (STRING.MID("mdss_hdmi_ahb_clk", 0, &clk_input_length-1)==STRING.CUT("&clk", -1))
    ( 
      &match=1
    )
  )	  
  else if ("mdss_hdmi_ahb_clk"=="&clk")
  (
    &match=1
  )
  
  if (&match==1)
  (
    &clk_test=&CLK_TEST_MDSS_HDMI_AHB_CLK
    &clk_reg=&HWIO_MMSS_MDSS_HDMI_AHB_CBCR_ADDR
    &clk_reg_name="MMSS_MDSS_HDMI_AHB_CBCR"
    &clk_name="mdss_hdmi_ahb_clk"
    &clk_reg_cbcr_type="sm_cbc"

    gosub Print_Clk_Info_Line
  )
  
  &match=0
  &wild_head=0
  &wild_tail=0
  &clk_input_length=STRING.LENGTH("&clk")
  &clk_itr_length=STRING.LENGTH("mdss_hdmi_clk")

  if (STRING.SCAN("&clk", "*", 0)==0)
  (
    &wild_head=1
  )
  if (STRING.SCAN("&clk", "*", 1)==(STRING.LENGTH("&clk")-1))
  (
    &wild_tail=1
  )

  if ((&wild_head==1)&&(&wild_tail==1))
  (
    if (STRING.SCAN("mdss_hdmi_clk", STRING.MID("&clk", 1, &clk_input_length-2), 0)!=-1)
    ( 
      &match=1
    )
  )
  else if (&wild_head==1)
  (
    if (STRING.MID("mdss_hdmi_clk", &clk_itr_length-&clk_input_length+1, &clk_input_length-1)==STRING.CUT("&clk", 1))
    ( 
      &match=1
    )
  )
  else if (&wild_tail==1)
  (
    if (STRING.MID("mdss_hdmi_clk", 0, &clk_input_length-1)==STRING.CUT("&clk", -1))
    ( 
      &match=1
    )
  )	  
  else if ("mdss_hdmi_clk"=="&clk")
  (
    &match=1
  )
  
  if (&match==1)
  (
    &clk_test=&CLK_TEST_MDSS_HDMI_CLK
    &clk_reg=&HWIO_MMSS_MDSS_HDMI_CBCR_ADDR
    &clk_reg_name="MMSS_MDSS_HDMI_CBCR"
    &clk_name="mdss_hdmi_clk"
    &clk_reg_cbcr_type="sm_cbc"

    gosub Print_Clk_Info_Line
  )
  
  &match=0
  &wild_head=0
  &wild_tail=0
  &clk_input_length=STRING.LENGTH("&clk")
  &clk_itr_length=STRING.LENGTH("mdss_mdp_clk")

  if (STRING.SCAN("&clk", "*", 0)==0)
  (
    &wild_head=1
  )
  if (STRING.SCAN("&clk", "*", 1)==(STRING.LENGTH("&clk")-1))
  (
    &wild_tail=1
  )

  if ((&wild_head==1)&&(&wild_tail==1))
  (
    if (STRING.SCAN("mdss_mdp_clk", STRING.MID("&clk", 1, &clk_input_length-2), 0)!=-1)
    ( 
      &match=1
    )
  )
  else if (&wild_head==1)
  (
    if (STRING.MID("mdss_mdp_clk", &clk_itr_length-&clk_input_length+1, &clk_input_length-1)==STRING.CUT("&clk", 1))
    ( 
      &match=1
    )
  )
  else if (&wild_tail==1)
  (
    if (STRING.MID("mdss_mdp_clk", 0, &clk_input_length-1)==STRING.CUT("&clk", -1))
    ( 
      &match=1
    )
  )	  
  else if ("mdss_mdp_clk"=="&clk")
  (
    &match=1
  )
  
  if (&match==1)
  (
    &clk_test=&CLK_TEST_MDSS_MDP_CLK
    &clk_reg=&HWIO_MMSS_MDSS_MDP_CBCR_ADDR
    &clk_reg_name="MMSS_MDSS_MDP_CBCR"
    &clk_name="mdss_mdp_clk"
    &clk_reg_cbcr_type="sm_pscbc"

    gosub Print_Clk_Info_Line
  )
  
  &match=0
  &wild_head=0
  &wild_tail=0
  &clk_input_length=STRING.LENGTH("&clk")
  &clk_itr_length=STRING.LENGTH("mdss_mdp_lut_clk")

  if (STRING.SCAN("&clk", "*", 0)==0)
  (
    &wild_head=1
  )
  if (STRING.SCAN("&clk", "*", 1)==(STRING.LENGTH("&clk")-1))
  (
    &wild_tail=1
  )

  if ((&wild_head==1)&&(&wild_tail==1))
  (
    if (STRING.SCAN("mdss_mdp_lut_clk", STRING.MID("&clk", 1, &clk_input_length-2), 0)!=-1)
    ( 
      &match=1
    )
  )
  else if (&wild_head==1)
  (
    if (STRING.MID("mdss_mdp_lut_clk", &clk_itr_length-&clk_input_length+1, &clk_input_length-1)==STRING.CUT("&clk", 1))
    ( 
      &match=1
    )
  )
  else if (&wild_tail==1)
  (
    if (STRING.MID("mdss_mdp_lut_clk", 0, &clk_input_length-1)==STRING.CUT("&clk", -1))
    ( 
      &match=1
    )
  )	  
  else if ("mdss_mdp_lut_clk"=="&clk")
  (
    &match=1
  )
  
  if (&match==1)
  (
    &clk_test=&CLK_TEST_MDSS_MDP_LUT_CLK
    &clk_reg=&HWIO_MMSS_MDSS_MDP_LUT_CBCR_ADDR
    &clk_reg_name="MMSS_MDSS_MDP_LUT_CBCR"
    &clk_name="mdss_mdp_lut_clk"
    &clk_reg_cbcr_type="sm_pscbc"

    gosub Print_Clk_Info_Line
  )
  
  &match=0
  &wild_head=0
  &wild_tail=0
  &clk_input_length=STRING.LENGTH("&clk")
  &clk_itr_length=STRING.LENGTH("mdss_pclk0_clk")

  if (STRING.SCAN("&clk", "*", 0)==0)
  (
    &wild_head=1
  )
  if (STRING.SCAN("&clk", "*", 1)==(STRING.LENGTH("&clk")-1))
  (
    &wild_tail=1
  )

  if ((&wild_head==1)&&(&wild_tail==1))
  (
    if (STRING.SCAN("mdss_pclk0_clk", STRING.MID("&clk", 1, &clk_input_length-2), 0)!=-1)
    ( 
      &match=1
    )
  )
  else if (&wild_head==1)
  (
    if (STRING.MID("mdss_pclk0_clk", &clk_itr_length-&clk_input_length+1, &clk_input_length-1)==STRING.CUT("&clk", 1))
    ( 
      &match=1
    )
  )
  else if (&wild_tail==1)
  (
    if (STRING.MID("mdss_pclk0_clk", 0, &clk_input_length-1)==STRING.CUT("&clk", -1))
    ( 
      &match=1
    )
  )	  
  else if ("mdss_pclk0_clk"=="&clk")
  (
    &match=1
  )
  
  if (&match==1)
  (
    &clk_test=&CLK_TEST_MDSS_PCLK0_CLK
    &clk_reg=&HWIO_MMSS_MDSS_PCLK0_CBCR_ADDR
    &clk_reg_name="MMSS_MDSS_PCLK0_CBCR"
    &clk_name="mdss_pclk0_clk"
    &clk_reg_cbcr_type="sm_cbc"

    gosub Print_Clk_Info_Line
  )
  
  &match=0
  &wild_head=0
  &wild_tail=0
  &clk_input_length=STRING.LENGTH("&clk")
  &clk_itr_length=STRING.LENGTH("mdss_pclk1_clk")

  if (STRING.SCAN("&clk", "*", 0)==0)
  (
    &wild_head=1
  )
  if (STRING.SCAN("&clk", "*", 1)==(STRING.LENGTH("&clk")-1))
  (
    &wild_tail=1
  )

  if ((&wild_head==1)&&(&wild_tail==1))
  (
    if (STRING.SCAN("mdss_pclk1_clk", STRING.MID("&clk", 1, &clk_input_length-2), 0)!=-1)
    ( 
      &match=1
    )
  )
  else if (&wild_head==1)
  (
    if (STRING.MID("mdss_pclk1_clk", &clk_itr_length-&clk_input_length+1, &clk_input_length-1)==STRING.CUT("&clk", 1))
    ( 
      &match=1
    )
  )
  else if (&wild_tail==1)
  (
    if (STRING.MID("mdss_pclk1_clk", 0, &clk_input_length-1)==STRING.CUT("&clk", -1))
    ( 
      &match=1
    )
  )	  
  else if ("mdss_pclk1_clk"=="&clk")
  (
    &match=1
  )
  
  if (&match==1)
  (
    &clk_test=&CLK_TEST_MDSS_PCLK1_CLK
    &clk_reg=&HWIO_MMSS_MDSS_PCLK1_CBCR_ADDR
    &clk_reg_name="MMSS_MDSS_PCLK1_CBCR"
    &clk_name="mdss_pclk1_clk"
    &clk_reg_cbcr_type="sm_cbc"

    gosub Print_Clk_Info_Line
  )
  
  &match=0
  &wild_head=0
  &wild_tail=0
  &clk_input_length=STRING.LENGTH("&clk")
  &clk_itr_length=STRING.LENGTH("mdss_vsync_clk")

  if (STRING.SCAN("&clk", "*", 0)==0)
  (
    &wild_head=1
  )
  if (STRING.SCAN("&clk", "*", 1)==(STRING.LENGTH("&clk")-1))
  (
    &wild_tail=1
  )

  if ((&wild_head==1)&&(&wild_tail==1))
  (
    if (STRING.SCAN("mdss_vsync_clk", STRING.MID("&clk", 1, &clk_input_length-2), 0)!=-1)
    ( 
      &match=1
    )
  )
  else if (&wild_head==1)
  (
    if (STRING.MID("mdss_vsync_clk", &clk_itr_length-&clk_input_length+1, &clk_input_length-1)==STRING.CUT("&clk", 1))
    ( 
      &match=1
    )
  )
  else if (&wild_tail==1)
  (
    if (STRING.MID("mdss_vsync_clk", 0, &clk_input_length-1)==STRING.CUT("&clk", -1))
    ( 
      &match=1
    )
  )	  
  else if ("mdss_vsync_clk"=="&clk")
  (
    &match=1
  )
  
  if (&match==1)
  (
    &clk_test=&CLK_TEST_MDSS_VSYNC_CLK
    &clk_reg=&HWIO_MMSS_MDSS_VSYNC_CBCR_ADDR
    &clk_reg_name="MMSS_MDSS_VSYNC_CBCR"
    &clk_name="mdss_vsync_clk"
    &clk_reg_cbcr_type="sm_cbc"

    gosub Print_Clk_Info_Line
  )
  
  &match=0
  &wild_head=0
  &wild_tail=0
  &clk_input_length=STRING.LENGTH("&clk")
  &clk_itr_length=STRING.LENGTH("mmss_cxo_clk")

  if (STRING.SCAN("&clk", "*", 0)==0)
  (
    &wild_head=1
  )
  if (STRING.SCAN("&clk", "*", 1)==(STRING.LENGTH("&clk")-1))
  (
    &wild_tail=1
  )

  if ((&wild_head==1)&&(&wild_tail==1))
  (
    if (STRING.SCAN("mmss_cxo_clk", STRING.MID("&clk", 1, &clk_input_length-2), 0)!=-1)
    ( 
      &match=1
    )
  )
  else if (&wild_head==1)
  (
    if (STRING.MID("mmss_cxo_clk", &clk_itr_length-&clk_input_length+1, &clk_input_length-1)==STRING.CUT("&clk", 1))
    ( 
      &match=1
    )
  )
  else if (&wild_tail==1)
  (
    if (STRING.MID("mmss_cxo_clk", 0, &clk_input_length-1)==STRING.CUT("&clk", -1))
    ( 
      &match=1
    )
  )	  
  else if ("mmss_cxo_clk"=="&clk")
  (
    &match=1
  )
  
  if (&match==1)
  (
    &clk_test=0
    &clk_reg=&HWIO_MMSS_CXO_CBCR_ADDR
    &clk_reg_name="MMSS_CXO_CBCR"
    &clk_name="mmss_cxo_clk"
    &clk_reg_cbcr_type="sm_cbc"

    gosub Print_Clk_Info_Line
  )
  
  &match=0
  &wild_head=0
  &wild_tail=0
  &clk_input_length=STRING.LENGTH("&clk")
  &clk_itr_length=STRING.LENGTH("mmss_sleepclk_clk")

  if (STRING.SCAN("&clk", "*", 0)==0)
  (
    &wild_head=1
  )
  if (STRING.SCAN("&clk", "*", 1)==(STRING.LENGTH("&clk")-1))
  (
    &wild_tail=1
  )

  if ((&wild_head==1)&&(&wild_tail==1))
  (
    if (STRING.SCAN("mmss_sleepclk_clk", STRING.MID("&clk", 1, &clk_input_length-2), 0)!=-1)
    ( 
      &match=1
    )
  )
  else if (&wild_head==1)
  (
    if (STRING.MID("mmss_sleepclk_clk", &clk_itr_length-&clk_input_length+1, &clk_input_length-1)==STRING.CUT("&clk", 1))
    ( 
      &match=1
    )
  )
  else if (&wild_tail==1)
  (
    if (STRING.MID("mmss_sleepclk_clk", 0, &clk_input_length-1)==STRING.CUT("&clk", -1))
    ( 
      &match=1
    )
  )	  
  else if ("mmss_sleepclk_clk"=="&clk")
  (
    &match=1
  )
  
  if (&match==1)
  (
    &clk_test=0
    &clk_reg=&HWIO_MMSS_SLEEPCLK_CBCR_ADDR
    &clk_reg_name="MMSS_SLEEPCLK_CBCR"
    &clk_name="mmss_sleepclk_clk"
    &clk_reg_cbcr_type="sm_cbc"

    gosub Print_Clk_Info_Line
  )
  
  &match=0
  &wild_head=0
  &wild_tail=0
  &clk_input_length=STRING.LENGTH("&clk")
  &clk_itr_length=STRING.LENGTH("mmss_misc_ahb_clk")

  if (STRING.SCAN("&clk", "*", 0)==0)
  (
    &wild_head=1
  )
  if (STRING.SCAN("&clk", "*", 1)==(STRING.LENGTH("&clk")-1))
  (
    &wild_tail=1
  )

  if ((&wild_head==1)&&(&wild_tail==1))
  (
    if (STRING.SCAN("mmss_misc_ahb_clk", STRING.MID("&clk", 1, &clk_input_length-2), 0)!=-1)
    ( 
      &match=1
    )
  )
  else if (&wild_head==1)
  (
    if (STRING.MID("mmss_misc_ahb_clk", &clk_itr_length-&clk_input_length+1, &clk_input_length-1)==STRING.CUT("&clk", 1))
    ( 
      &match=1
    )
  )
  else if (&wild_tail==1)
  (
    if (STRING.MID("mmss_misc_ahb_clk", 0, &clk_input_length-1)==STRING.CUT("&clk", -1))
    ( 
      &match=1
    )
  )	  
  else if ("mmss_misc_ahb_clk"=="&clk")
  (
    &match=1
  )
  
  if (&match==1)
  (
    &clk_test=&CLK_TEST_MMSS_MISC_AHB_CLK
    &clk_reg=&HWIO_MMSS_MISC_AHB_CBCR_ADDR
    &clk_reg_name="MMSS_MISC_AHB_CBCR"
    &clk_name="mmss_misc_ahb_clk"
    &clk_reg_cbcr_type="sm_cbc"

    gosub Print_Clk_Info_Line
  )
  
  &match=0
  &wild_head=0
  &wild_tail=0
  &clk_input_length=STRING.LENGTH("&clk")
  &clk_itr_length=STRING.LENGTH("mmss_mmssnoc_ahb_clk")

  if (STRING.SCAN("&clk", "*", 0)==0)
  (
    &wild_head=1
  )
  if (STRING.SCAN("&clk", "*", 1)==(STRING.LENGTH("&clk")-1))
  (
    &wild_tail=1
  )

  if ((&wild_head==1)&&(&wild_tail==1))
  (
    if (STRING.SCAN("mmss_mmssnoc_ahb_clk", STRING.MID("&clk", 1, &clk_input_length-2), 0)!=-1)
    ( 
      &match=1
    )
  )
  else if (&wild_head==1)
  (
    if (STRING.MID("mmss_mmssnoc_ahb_clk", &clk_itr_length-&clk_input_length+1, &clk_input_length-1)==STRING.CUT("&clk", 1))
    ( 
      &match=1
    )
  )
  else if (&wild_tail==1)
  (
    if (STRING.MID("mmss_mmssnoc_ahb_clk", 0, &clk_input_length-1)==STRING.CUT("&clk", -1))
    ( 
      &match=1
    )
  )	  
  else if ("mmss_mmssnoc_ahb_clk"=="&clk")
  (
    &match=1
  )
  
  ; This clock belongs to the 'buses' display group.
  if ("buses"=="&clk")
  (
    &match=1	  
  )
  
  if (&match==1)
  (
    &clk_test=&CLK_TEST_MMSS_MMSSNOC_AHB_CLK
    &clk_reg=&HWIO_MMSS_MMSSNOC_AHB_CBCR_ADDR
    &clk_reg_name="MMSS_MMSSNOC_AHB_CBCR"
    &clk_name="mmss_mmssnoc_ahb_clk"
    &clk_reg_cbcr_type="sm_cbc"

    gosub Print_Clk_Info_Line
  )
  
  &match=0
  &wild_head=0
  &wild_tail=0
  &clk_input_length=STRING.LENGTH("&clk")
  &clk_itr_length=STRING.LENGTH("mmss_mmssnoc_bto_ahb_clk")

  if (STRING.SCAN("&clk", "*", 0)==0)
  (
    &wild_head=1
  )
  if (STRING.SCAN("&clk", "*", 1)==(STRING.LENGTH("&clk")-1))
  (
    &wild_tail=1
  )

  if ((&wild_head==1)&&(&wild_tail==1))
  (
    if (STRING.SCAN("mmss_mmssnoc_bto_ahb_clk", STRING.MID("&clk", 1, &clk_input_length-2), 0)!=-1)
    ( 
      &match=1
    )
  )
  else if (&wild_head==1)
  (
    if (STRING.MID("mmss_mmssnoc_bto_ahb_clk", &clk_itr_length-&clk_input_length+1, &clk_input_length-1)==STRING.CUT("&clk", 1))
    ( 
      &match=1
    )
  )
  else if (&wild_tail==1)
  (
    if (STRING.MID("mmss_mmssnoc_bto_ahb_clk", 0, &clk_input_length-1)==STRING.CUT("&clk", -1))
    ( 
      &match=1
    )
  )	  
  else if ("mmss_mmssnoc_bto_ahb_clk"=="&clk")
  (
    &match=1
  )
  
  if (&match==1)
  (
    &clk_test=&CLK_TEST_MMSS_MMSSNOC_BTO_AHB_CLK
    &clk_reg=&HWIO_MMSS_MMSSNOC_BTO_AHB_CBCR_ADDR
    &clk_reg_name="MMSS_MMSSNOC_BTO_AHB_CBCR"
    &clk_name="mmss_mmssnoc_bto_ahb_clk"
    &clk_reg_cbcr_type="sm_cbc"

    gosub Print_Clk_Info_Line
  )
  
  &match=0
  &wild_head=0
  &wild_tail=0
  &clk_input_length=STRING.LENGTH("&clk")
  &clk_itr_length=STRING.LENGTH("mmss_mmssnoc_axi_clk")

  if (STRING.SCAN("&clk", "*", 0)==0)
  (
    &wild_head=1
  )
  if (STRING.SCAN("&clk", "*", 1)==(STRING.LENGTH("&clk")-1))
  (
    &wild_tail=1
  )

  if ((&wild_head==1)&&(&wild_tail==1))
  (
    if (STRING.SCAN("mmss_mmssnoc_axi_clk", STRING.MID("&clk", 1, &clk_input_length-2), 0)!=-1)
    ( 
      &match=1
    )
  )
  else if (&wild_head==1)
  (
    if (STRING.MID("mmss_mmssnoc_axi_clk", &clk_itr_length-&clk_input_length+1, &clk_input_length-1)==STRING.CUT("&clk", 1))
    ( 
      &match=1
    )
  )
  else if (&wild_tail==1)
  (
    if (STRING.MID("mmss_mmssnoc_axi_clk", 0, &clk_input_length-1)==STRING.CUT("&clk", -1))
    ( 
      &match=1
    )
  )	  
  else if ("mmss_mmssnoc_axi_clk"=="&clk")
  (
    &match=1
  )
  
  ; This clock belongs to the 'buses' display group.
  if ("buses"=="&clk")
  (
    &match=1	  
  )
  
  if (&match==1)
  (
    &clk_test=&CLK_TEST_MMSS_MMSSNOC_AXI_CLK
    &clk_reg=&HWIO_MMSS_MMSSNOC_AXI_CBCR_ADDR
    &clk_reg_name="MMSS_MMSSNOC_AXI_CBCR"
    &clk_name="mmss_mmssnoc_axi_clk"
    &clk_reg_cbcr_type="sm_cbc"

    gosub Print_Clk_Info_Line
  )
  
  &match=0
  &wild_head=0
  &wild_tail=0
  &clk_input_length=STRING.LENGTH("&clk")
  &clk_itr_length=STRING.LENGTH("mmss_s0_axi_clk")

  if (STRING.SCAN("&clk", "*", 0)==0)
  (
    &wild_head=1
  )
  if (STRING.SCAN("&clk", "*", 1)==(STRING.LENGTH("&clk")-1))
  (
    &wild_tail=1
  )

  if ((&wild_head==1)&&(&wild_tail==1))
  (
    if (STRING.SCAN("mmss_s0_axi_clk", STRING.MID("&clk", 1, &clk_input_length-2), 0)!=-1)
    ( 
      &match=1
    )
  )
  else if (&wild_head==1)
  (
    if (STRING.MID("mmss_s0_axi_clk", &clk_itr_length-&clk_input_length+1, &clk_input_length-1)==STRING.CUT("&clk", 1))
    ( 
      &match=1
    )
  )
  else if (&wild_tail==1)
  (
    if (STRING.MID("mmss_s0_axi_clk", 0, &clk_input_length-1)==STRING.CUT("&clk", -1))
    ( 
      &match=1
    )
  )	  
  else if ("mmss_s0_axi_clk"=="&clk")
  (
    &match=1
  )
  
  if (&match==1)
  (
    &clk_test=&CLK_TEST_MMSS_S0_AXI_CLK
    &clk_reg=&HWIO_MMSS_S0_AXI_CBCR_ADDR
    &clk_reg_name="MMSS_S0_AXI_CBCR"
    &clk_name="mmss_s0_axi_clk"
    &clk_reg_cbcr_type="sm_cbc"

    gosub Print_Clk_Info_Line
  )
  
  &match=0
  &wild_head=0
  &wild_tail=0
  &clk_input_length=STRING.LENGTH("&clk")
  &clk_itr_length=STRING.LENGTH("mmss_rbcpr_ahb_clk")

  if (STRING.SCAN("&clk", "*", 0)==0)
  (
    &wild_head=1
  )
  if (STRING.SCAN("&clk", "*", 1)==(STRING.LENGTH("&clk")-1))
  (
    &wild_tail=1
  )

  if ((&wild_head==1)&&(&wild_tail==1))
  (
    if (STRING.SCAN("mmss_rbcpr_ahb_clk", STRING.MID("&clk", 1, &clk_input_length-2), 0)!=-1)
    ( 
      &match=1
    )
  )
  else if (&wild_head==1)
  (
    if (STRING.MID("mmss_rbcpr_ahb_clk", &clk_itr_length-&clk_input_length+1, &clk_input_length-1)==STRING.CUT("&clk", 1))
    ( 
      &match=1
    )
  )
  else if (&wild_tail==1)
  (
    if (STRING.MID("mmss_rbcpr_ahb_clk", 0, &clk_input_length-1)==STRING.CUT("&clk", -1))
    ( 
      &match=1
    )
  )	  
  else if ("mmss_rbcpr_ahb_clk"=="&clk")
  (
    &match=1
  )
  
  if (&match==1)
  (
    &clk_test=&CLK_TEST_MMSS_RBCPR_AHB_CLK
    &clk_reg=&HWIO_MMSS_RBCPR_AHB_CBCR_ADDR
    &clk_reg_name="MMSS_RBCPR_AHB_CBCR"
    &clk_name="mmss_rbcpr_ahb_clk"
    &clk_reg_cbcr_type="sm_cbc"

    gosub Print_Clk_Info_Line
  )
  
  &match=0
  &wild_head=0
  &wild_tail=0
  &clk_input_length=STRING.LENGTH("&clk")
  &clk_itr_length=STRING.LENGTH("mmss_rbcpr_clk")

  if (STRING.SCAN("&clk", "*", 0)==0)
  (
    &wild_head=1
  )
  if (STRING.SCAN("&clk", "*", 1)==(STRING.LENGTH("&clk")-1))
  (
    &wild_tail=1
  )

  if ((&wild_head==1)&&(&wild_tail==1))
  (
    if (STRING.SCAN("mmss_rbcpr_clk", STRING.MID("&clk", 1, &clk_input_length-2), 0)!=-1)
    ( 
      &match=1
    )
  )
  else if (&wild_head==1)
  (
    if (STRING.MID("mmss_rbcpr_clk", &clk_itr_length-&clk_input_length+1, &clk_input_length-1)==STRING.CUT("&clk", 1))
    ( 
      &match=1
    )
  )
  else if (&wild_tail==1)
  (
    if (STRING.MID("mmss_rbcpr_clk", 0, &clk_input_length-1)==STRING.CUT("&clk", -1))
    ( 
      &match=1
    )
  )	  
  else if ("mmss_rbcpr_clk"=="&clk")
  (
    &match=1
  )
  
  if (&match==1)
  (
    &clk_test=&CLK_TEST_MMSS_RBCPR_CLK
    &clk_reg=&HWIO_MMSS_RBCPR_CBCR_ADDR
    &clk_reg_name="MMSS_RBCPR_CBCR"
    &clk_name="mmss_rbcpr_clk"
    &clk_reg_cbcr_type="sm_cbc"

    gosub Print_Clk_Info_Line
  )
  
  &match=0
  &wild_head=0
  &wild_tail=0
  &clk_input_length=STRING.LENGTH("&clk")
  &clk_itr_length=STRING.LENGTH("mmss_spdm_ahb_clk")

  if (STRING.SCAN("&clk", "*", 0)==0)
  (
    &wild_head=1
  )
  if (STRING.SCAN("&clk", "*", 1)==(STRING.LENGTH("&clk")-1))
  (
    &wild_tail=1
  )

  if ((&wild_head==1)&&(&wild_tail==1))
  (
    if (STRING.SCAN("mmss_spdm_ahb_clk", STRING.MID("&clk", 1, &clk_input_length-2), 0)!=-1)
    ( 
      &match=1
    )
  )
  else if (&wild_head==1)
  (
    if (STRING.MID("mmss_spdm_ahb_clk", &clk_itr_length-&clk_input_length+1, &clk_input_length-1)==STRING.CUT("&clk", 1))
    ( 
      &match=1
    )
  )
  else if (&wild_tail==1)
  (
    if (STRING.MID("mmss_spdm_ahb_clk", 0, &clk_input_length-1)==STRING.CUT("&clk", -1))
    ( 
      &match=1
    )
  )	  
  else if ("mmss_spdm_ahb_clk"=="&clk")
  (
    &match=1
  )
  
  if (&match==1)
  (
    &clk_test=&CLK_TEST_MMSS_SPDM_AHB_CLK
    &clk_reg=&HWIO_MMSS_SPDM_AHB_CBCR_ADDR
    &clk_reg_name="MMSS_SPDM_AHB_CBCR"
    &clk_name="mmss_spdm_ahb_clk"
    &clk_reg_cbcr_type="sm_cbc"

    gosub Print_Clk_Info_Line
  )
  
  &match=0
  &wild_head=0
  &wild_tail=0
  &clk_input_length=STRING.LENGTH("&clk")
  &clk_itr_length=STRING.LENGTH("mmss_spdm_axi_clk")

  if (STRING.SCAN("&clk", "*", 0)==0)
  (
    &wild_head=1
  )
  if (STRING.SCAN("&clk", "*", 1)==(STRING.LENGTH("&clk")-1))
  (
    &wild_tail=1
  )

  if ((&wild_head==1)&&(&wild_tail==1))
  (
    if (STRING.SCAN("mmss_spdm_axi_clk", STRING.MID("&clk", 1, &clk_input_length-2), 0)!=-1)
    ( 
      &match=1
    )
  )
  else if (&wild_head==1)
  (
    if (STRING.MID("mmss_spdm_axi_clk", &clk_itr_length-&clk_input_length+1, &clk_input_length-1)==STRING.CUT("&clk", 1))
    ( 
      &match=1
    )
  )
  else if (&wild_tail==1)
  (
    if (STRING.MID("mmss_spdm_axi_clk", 0, &clk_input_length-1)==STRING.CUT("&clk", -1))
    ( 
      &match=1
    )
  )	  
  else if ("mmss_spdm_axi_clk"=="&clk")
  (
    &match=1
  )
  
  if (&match==1)
  (
    &clk_test=&CLK_TEST_MMSS_SPDM_AXI_CLK
    &clk_reg=&HWIO_MMSS_SPDM_AXI_CBCR_ADDR
    &clk_reg_name="MMSS_SPDM_AXI_CBCR"
    &clk_name="mmss_spdm_axi_clk"
    &clk_reg_cbcr_type="sm_cbc"

    gosub Print_Clk_Info_Line
  )
  
  &match=0
  &wild_head=0
  &wild_tail=0
  &clk_input_length=STRING.LENGTH("&clk")
  &clk_itr_length=STRING.LENGTH("mmss_spdm_csi0_clk")

  if (STRING.SCAN("&clk", "*", 0)==0)
  (
    &wild_head=1
  )
  if (STRING.SCAN("&clk", "*", 1)==(STRING.LENGTH("&clk")-1))
  (
    &wild_tail=1
  )

  if ((&wild_head==1)&&(&wild_tail==1))
  (
    if (STRING.SCAN("mmss_spdm_csi0_clk", STRING.MID("&clk", 1, &clk_input_length-2), 0)!=-1)
    ( 
      &match=1
    )
  )
  else if (&wild_head==1)
  (
    if (STRING.MID("mmss_spdm_csi0_clk", &clk_itr_length-&clk_input_length+1, &clk_input_length-1)==STRING.CUT("&clk", 1))
    ( 
      &match=1
    )
  )
  else if (&wild_tail==1)
  (
    if (STRING.MID("mmss_spdm_csi0_clk", 0, &clk_input_length-1)==STRING.CUT("&clk", -1))
    ( 
      &match=1
    )
  )	  
  else if ("mmss_spdm_csi0_clk"=="&clk")
  (
    &match=1
  )
  
  if (&match==1)
  (
    &clk_test=&CLK_TEST_MMSS_SPDM_CSI0_CLK
    &clk_reg=&HWIO_MMSS_SPDM_CSI0_CBCR_ADDR
    &clk_reg_name="MMSS_SPDM_CSI0_CBCR"
    &clk_name="mmss_spdm_csi0_clk"
    &clk_reg_cbcr_type="sm_cbc"

    gosub Print_Clk_Info_Line
  )
  
  &match=0
  &wild_head=0
  &wild_tail=0
  &clk_input_length=STRING.LENGTH("&clk")
  &clk_itr_length=STRING.LENGTH("mmss_spdm_gfx3d_clk")

  if (STRING.SCAN("&clk", "*", 0)==0)
  (
    &wild_head=1
  )
  if (STRING.SCAN("&clk", "*", 1)==(STRING.LENGTH("&clk")-1))
  (
    &wild_tail=1
  )

  if ((&wild_head==1)&&(&wild_tail==1))
  (
    if (STRING.SCAN("mmss_spdm_gfx3d_clk", STRING.MID("&clk", 1, &clk_input_length-2), 0)!=-1)
    ( 
      &match=1
    )
  )
  else if (&wild_head==1)
  (
    if (STRING.MID("mmss_spdm_gfx3d_clk", &clk_itr_length-&clk_input_length+1, &clk_input_length-1)==STRING.CUT("&clk", 1))
    ( 
      &match=1
    )
  )
  else if (&wild_tail==1)
  (
    if (STRING.MID("mmss_spdm_gfx3d_clk", 0, &clk_input_length-1)==STRING.CUT("&clk", -1))
    ( 
      &match=1
    )
  )	  
  else if ("mmss_spdm_gfx3d_clk"=="&clk")
  (
    &match=1
  )
  
  if (&match==1)
  (
    &clk_test=&CLK_TEST_MMSS_SPDM_GFX3D_CLK
    &clk_reg=&HWIO_MMSS_SPDM_GFX3D_CBCR_ADDR
    &clk_reg_name="MMSS_SPDM_GFX3D_CBCR"
    &clk_name="mmss_spdm_gfx3d_clk"
    &clk_reg_cbcr_type="sm_cbc"

    gosub Print_Clk_Info_Line
  )
  
  &match=0
  &wild_head=0
  &wild_tail=0
  &clk_input_length=STRING.LENGTH("&clk")
  &clk_itr_length=STRING.LENGTH("mmss_spdm_jpeg0_clk")

  if (STRING.SCAN("&clk", "*", 0)==0)
  (
    &wild_head=1
  )
  if (STRING.SCAN("&clk", "*", 1)==(STRING.LENGTH("&clk")-1))
  (
    &wild_tail=1
  )

  if ((&wild_head==1)&&(&wild_tail==1))
  (
    if (STRING.SCAN("mmss_spdm_jpeg0_clk", STRING.MID("&clk", 1, &clk_input_length-2), 0)!=-1)
    ( 
      &match=1
    )
  )
  else if (&wild_head==1)
  (
    if (STRING.MID("mmss_spdm_jpeg0_clk", &clk_itr_length-&clk_input_length+1, &clk_input_length-1)==STRING.CUT("&clk", 1))
    ( 
      &match=1
    )
  )
  else if (&wild_tail==1)
  (
    if (STRING.MID("mmss_spdm_jpeg0_clk", 0, &clk_input_length-1)==STRING.CUT("&clk", -1))
    ( 
      &match=1
    )
  )	  
  else if ("mmss_spdm_jpeg0_clk"=="&clk")
  (
    &match=1
  )
  
  if (&match==1)
  (
    &clk_test=&CLK_TEST_MMSS_SPDM_JPEG0_CLK
    &clk_reg=&HWIO_MMSS_SPDM_JPEG0_CBCR_ADDR
    &clk_reg_name="MMSS_SPDM_JPEG0_CBCR"
    &clk_name="mmss_spdm_jpeg0_clk"
    &clk_reg_cbcr_type="sm_cbc"

    gosub Print_Clk_Info_Line
  )
  
  &match=0
  &wild_head=0
  &wild_tail=0
  &clk_input_length=STRING.LENGTH("&clk")
  &clk_itr_length=STRING.LENGTH("mmss_spdm_jpeg1_clk")

  if (STRING.SCAN("&clk", "*", 0)==0)
  (
    &wild_head=1
  )
  if (STRING.SCAN("&clk", "*", 1)==(STRING.LENGTH("&clk")-1))
  (
    &wild_tail=1
  )

  if ((&wild_head==1)&&(&wild_tail==1))
  (
    if (STRING.SCAN("mmss_spdm_jpeg1_clk", STRING.MID("&clk", 1, &clk_input_length-2), 0)!=-1)
    ( 
      &match=1
    )
  )
  else if (&wild_head==1)
  (
    if (STRING.MID("mmss_spdm_jpeg1_clk", &clk_itr_length-&clk_input_length+1, &clk_input_length-1)==STRING.CUT("&clk", 1))
    ( 
      &match=1
    )
  )
  else if (&wild_tail==1)
  (
    if (STRING.MID("mmss_spdm_jpeg1_clk", 0, &clk_input_length-1)==STRING.CUT("&clk", -1))
    ( 
      &match=1
    )
  )	  
  else if ("mmss_spdm_jpeg1_clk"=="&clk")
  (
    &match=1
  )
  
  if (&match==1)
  (
    &clk_test=&CLK_TEST_MMSS_SPDM_JPEG1_CLK
    &clk_reg=&HWIO_MMSS_SPDM_JPEG1_CBCR_ADDR
    &clk_reg_name="MMSS_SPDM_JPEG1_CBCR"
    &clk_name="mmss_spdm_jpeg1_clk"
    &clk_reg_cbcr_type="sm_cbc"

    gosub Print_Clk_Info_Line
  )
  
  &match=0
  &wild_head=0
  &wild_tail=0
  &clk_input_length=STRING.LENGTH("&clk")
  &clk_itr_length=STRING.LENGTH("mmss_spdm_jpeg2_clk")

  if (STRING.SCAN("&clk", "*", 0)==0)
  (
    &wild_head=1
  )
  if (STRING.SCAN("&clk", "*", 1)==(STRING.LENGTH("&clk")-1))
  (
    &wild_tail=1
  )

  if ((&wild_head==1)&&(&wild_tail==1))
  (
    if (STRING.SCAN("mmss_spdm_jpeg2_clk", STRING.MID("&clk", 1, &clk_input_length-2), 0)!=-1)
    ( 
      &match=1
    )
  )
  else if (&wild_head==1)
  (
    if (STRING.MID("mmss_spdm_jpeg2_clk", &clk_itr_length-&clk_input_length+1, &clk_input_length-1)==STRING.CUT("&clk", 1))
    ( 
      &match=1
    )
  )
  else if (&wild_tail==1)
  (
    if (STRING.MID("mmss_spdm_jpeg2_clk", 0, &clk_input_length-1)==STRING.CUT("&clk", -1))
    ( 
      &match=1
    )
  )	  
  else if ("mmss_spdm_jpeg2_clk"=="&clk")
  (
    &match=1
  )
  
  if (&match==1)
  (
    &clk_test=&CLK_TEST_MMSS_SPDM_JPEG2_CLK
    &clk_reg=&HWIO_MMSS_SPDM_JPEG2_CBCR_ADDR
    &clk_reg_name="MMSS_SPDM_JPEG2_CBCR"
    &clk_name="mmss_spdm_jpeg2_clk"
    &clk_reg_cbcr_type="sm_cbc"

    gosub Print_Clk_Info_Line
  )
  
  &match=0
  &wild_head=0
  &wild_tail=0
  &clk_input_length=STRING.LENGTH("&clk")
  &clk_itr_length=STRING.LENGTH("mmss_spdm_mdp_clk")

  if (STRING.SCAN("&clk", "*", 0)==0)
  (
    &wild_head=1
  )
  if (STRING.SCAN("&clk", "*", 1)==(STRING.LENGTH("&clk")-1))
  (
    &wild_tail=1
  )

  if ((&wild_head==1)&&(&wild_tail==1))
  (
    if (STRING.SCAN("mmss_spdm_mdp_clk", STRING.MID("&clk", 1, &clk_input_length-2), 0)!=-1)
    ( 
      &match=1
    )
  )
  else if (&wild_head==1)
  (
    if (STRING.MID("mmss_spdm_mdp_clk", &clk_itr_length-&clk_input_length+1, &clk_input_length-1)==STRING.CUT("&clk", 1))
    ( 
      &match=1
    )
  )
  else if (&wild_tail==1)
  (
    if (STRING.MID("mmss_spdm_mdp_clk", 0, &clk_input_length-1)==STRING.CUT("&clk", -1))
    ( 
      &match=1
    )
  )	  
  else if ("mmss_spdm_mdp_clk"=="&clk")
  (
    &match=1
  )
  
  if (&match==1)
  (
    &clk_test=&CLK_TEST_MMSS_SPDM_MDP_CLK
    &clk_reg=&HWIO_MMSS_SPDM_MDP_CBCR_ADDR
    &clk_reg_name="MMSS_SPDM_MDP_CBCR"
    &clk_name="mmss_spdm_mdp_clk"
    &clk_reg_cbcr_type="sm_cbc"

    gosub Print_Clk_Info_Line
  )
  
  &match=0
  &wild_head=0
  &wild_tail=0
  &clk_input_length=STRING.LENGTH("&clk")
  &clk_itr_length=STRING.LENGTH("mmss_spdm_pclk0_clk")

  if (STRING.SCAN("&clk", "*", 0)==0)
  (
    &wild_head=1
  )
  if (STRING.SCAN("&clk", "*", 1)==(STRING.LENGTH("&clk")-1))
  (
    &wild_tail=1
  )

  if ((&wild_head==1)&&(&wild_tail==1))
  (
    if (STRING.SCAN("mmss_spdm_pclk0_clk", STRING.MID("&clk", 1, &clk_input_length-2), 0)!=-1)
    ( 
      &match=1
    )
  )
  else if (&wild_head==1)
  (
    if (STRING.MID("mmss_spdm_pclk0_clk", &clk_itr_length-&clk_input_length+1, &clk_input_length-1)==STRING.CUT("&clk", 1))
    ( 
      &match=1
    )
  )
  else if (&wild_tail==1)
  (
    if (STRING.MID("mmss_spdm_pclk0_clk", 0, &clk_input_length-1)==STRING.CUT("&clk", -1))
    ( 
      &match=1
    )
  )	  
  else if ("mmss_spdm_pclk0_clk"=="&clk")
  (
    &match=1
  )
  
  if (&match==1)
  (
    &clk_test=&CLK_TEST_MMSS_SPDM_PCLK0_CLK
    &clk_reg=&HWIO_MMSS_SPDM_PCLK0_CBCR_ADDR
    &clk_reg_name="MMSS_SPDM_PCLK0_CBCR"
    &clk_name="mmss_spdm_pclk0_clk"
    &clk_reg_cbcr_type="sm_cbc"

    gosub Print_Clk_Info_Line
  )
  
  &match=0
  &wild_head=0
  &wild_tail=0
  &clk_input_length=STRING.LENGTH("&clk")
  &clk_itr_length=STRING.LENGTH("mmss_spdm_pclk1_clk")

  if (STRING.SCAN("&clk", "*", 0)==0)
  (
    &wild_head=1
  )
  if (STRING.SCAN("&clk", "*", 1)==(STRING.LENGTH("&clk")-1))
  (
    &wild_tail=1
  )

  if ((&wild_head==1)&&(&wild_tail==1))
  (
    if (STRING.SCAN("mmss_spdm_pclk1_clk", STRING.MID("&clk", 1, &clk_input_length-2), 0)!=-1)
    ( 
      &match=1
    )
  )
  else if (&wild_head==1)
  (
    if (STRING.MID("mmss_spdm_pclk1_clk", &clk_itr_length-&clk_input_length+1, &clk_input_length-1)==STRING.CUT("&clk", 1))
    ( 
      &match=1
    )
  )
  else if (&wild_tail==1)
  (
    if (STRING.MID("mmss_spdm_pclk1_clk", 0, &clk_input_length-1)==STRING.CUT("&clk", -1))
    ( 
      &match=1
    )
  )	  
  else if ("mmss_spdm_pclk1_clk"=="&clk")
  (
    &match=1
  )
  
  if (&match==1)
  (
    &clk_test=&CLK_TEST_MMSS_SPDM_PCLK1_CLK
    &clk_reg=&HWIO_MMSS_SPDM_PCLK1_CBCR_ADDR
    &clk_reg_name="MMSS_SPDM_PCLK1_CBCR"
    &clk_name="mmss_spdm_pclk1_clk"
    &clk_reg_cbcr_type="sm_cbc"

    gosub Print_Clk_Info_Line
  )
  
  &match=0
  &wild_head=0
  &wild_tail=0
  &clk_input_length=STRING.LENGTH("&clk")
  &clk_itr_length=STRING.LENGTH("mmss_spdm_vcodec0_clk")

  if (STRING.SCAN("&clk", "*", 0)==0)
  (
    &wild_head=1
  )
  if (STRING.SCAN("&clk", "*", 1)==(STRING.LENGTH("&clk")-1))
  (
    &wild_tail=1
  )

  if ((&wild_head==1)&&(&wild_tail==1))
  (
    if (STRING.SCAN("mmss_spdm_vcodec0_clk", STRING.MID("&clk", 1, &clk_input_length-2), 0)!=-1)
    ( 
      &match=1
    )
  )
  else if (&wild_head==1)
  (
    if (STRING.MID("mmss_spdm_vcodec0_clk", &clk_itr_length-&clk_input_length+1, &clk_input_length-1)==STRING.CUT("&clk", 1))
    ( 
      &match=1
    )
  )
  else if (&wild_tail==1)
  (
    if (STRING.MID("mmss_spdm_vcodec0_clk", 0, &clk_input_length-1)==STRING.CUT("&clk", -1))
    ( 
      &match=1
    )
  )	  
  else if ("mmss_spdm_vcodec0_clk"=="&clk")
  (
    &match=1
  )
  
  if (&match==1)
  (
    &clk_test=&CLK_TEST_MMSS_SPDM_VCODEC0_CLK
    &clk_reg=&HWIO_MMSS_SPDM_VCODEC0_CBCR_ADDR
    &clk_reg_name="MMSS_SPDM_VCODEC0_CBCR"
    &clk_name="mmss_spdm_vcodec0_clk"
    &clk_reg_cbcr_type="sm_cbc"

    gosub Print_Clk_Info_Line
  )
  
  &match=0
  &wild_head=0
  &wild_tail=0
  &clk_input_length=STRING.LENGTH("&clk")
  &clk_itr_length=STRING.LENGTH("mmss_spdm_vfe0_clk")

  if (STRING.SCAN("&clk", "*", 0)==0)
  (
    &wild_head=1
  )
  if (STRING.SCAN("&clk", "*", 1)==(STRING.LENGTH("&clk")-1))
  (
    &wild_tail=1
  )

  if ((&wild_head==1)&&(&wild_tail==1))
  (
    if (STRING.SCAN("mmss_spdm_vfe0_clk", STRING.MID("&clk", 1, &clk_input_length-2), 0)!=-1)
    ( 
      &match=1
    )
  )
  else if (&wild_head==1)
  (
    if (STRING.MID("mmss_spdm_vfe0_clk", &clk_itr_length-&clk_input_length+1, &clk_input_length-1)==STRING.CUT("&clk", 1))
    ( 
      &match=1
    )
  )
  else if (&wild_tail==1)
  (
    if (STRING.MID("mmss_spdm_vfe0_clk", 0, &clk_input_length-1)==STRING.CUT("&clk", -1))
    ( 
      &match=1
    )
  )	  
  else if ("mmss_spdm_vfe0_clk"=="&clk")
  (
    &match=1
  )
  
  if (&match==1)
  (
    &clk_test=&CLK_TEST_MMSS_SPDM_VFE0_CLK
    &clk_reg=&HWIO_MMSS_SPDM_VFE0_CBCR_ADDR
    &clk_reg_name="MMSS_SPDM_VFE0_CBCR"
    &clk_name="mmss_spdm_vfe0_clk"
    &clk_reg_cbcr_type="sm_cbc"

    gosub Print_Clk_Info_Line
  )
  
  &match=0
  &wild_head=0
  &wild_tail=0
  &clk_input_length=STRING.LENGTH("&clk")
  &clk_itr_length=STRING.LENGTH("mmss_spdm_vfe1_clk")

  if (STRING.SCAN("&clk", "*", 0)==0)
  (
    &wild_head=1
  )
  if (STRING.SCAN("&clk", "*", 1)==(STRING.LENGTH("&clk")-1))
  (
    &wild_tail=1
  )

  if ((&wild_head==1)&&(&wild_tail==1))
  (
    if (STRING.SCAN("mmss_spdm_vfe1_clk", STRING.MID("&clk", 1, &clk_input_length-2), 0)!=-1)
    ( 
      &match=1
    )
  )
  else if (&wild_head==1)
  (
    if (STRING.MID("mmss_spdm_vfe1_clk", &clk_itr_length-&clk_input_length+1, &clk_input_length-1)==STRING.CUT("&clk", 1))
    ( 
      &match=1
    )
  )
  else if (&wild_tail==1)
  (
    if (STRING.MID("mmss_spdm_vfe1_clk", 0, &clk_input_length-1)==STRING.CUT("&clk", -1))
    ( 
      &match=1
    )
  )	  
  else if ("mmss_spdm_vfe1_clk"=="&clk")
  (
    &match=1
  )
  
  if (&match==1)
  (
    &clk_test=&CLK_TEST_MMSS_SPDM_VFE1_CLK
    &clk_reg=&HWIO_MMSS_SPDM_VFE1_CBCR_ADDR
    &clk_reg_name="MMSS_SPDM_VFE1_CBCR"
    &clk_name="mmss_spdm_vfe1_clk"
    &clk_reg_cbcr_type="sm_cbc"

    gosub Print_Clk_Info_Line
  )
  
  &match=0
  &wild_head=0
  &wild_tail=0
  &clk_input_length=STRING.LENGTH("&clk")
  &clk_itr_length=STRING.LENGTH("mmss_spdm_rm_axi_clk")

  if (STRING.SCAN("&clk", "*", 0)==0)
  (
    &wild_head=1
  )
  if (STRING.SCAN("&clk", "*", 1)==(STRING.LENGTH("&clk")-1))
  (
    &wild_tail=1
  )

  if ((&wild_head==1)&&(&wild_tail==1))
  (
    if (STRING.SCAN("mmss_spdm_rm_axi_clk", STRING.MID("&clk", 1, &clk_input_length-2), 0)!=-1)
    ( 
      &match=1
    )
  )
  else if (&wild_head==1)
  (
    if (STRING.MID("mmss_spdm_rm_axi_clk", &clk_itr_length-&clk_input_length+1, &clk_input_length-1)==STRING.CUT("&clk", 1))
    ( 
      &match=1
    )
  )
  else if (&wild_tail==1)
  (
    if (STRING.MID("mmss_spdm_rm_axi_clk", 0, &clk_input_length-1)==STRING.CUT("&clk", -1))
    ( 
      &match=1
    )
  )	  
  else if ("mmss_spdm_rm_axi_clk"=="&clk")
  (
    &match=1
  )
  
  if (&match==1)
  (
    &clk_test=&CLK_TEST_MMSS_SPDM_RM_AXI_CLK
    &clk_reg=&HWIO_MMSS_SPDM_RM_AXI_CBCR_ADDR
    &clk_reg_name="MMSS_SPDM_RM_AXI_CBCR"
    &clk_name="mmss_spdm_rm_axi_clk"
    &clk_reg_cbcr_type="sm_cbc"

    gosub Print_Clk_Info_Line
  )
  
  &match=0
  &wild_head=0
  &wild_tail=0
  &clk_input_length=STRING.LENGTH("&clk")
  &clk_itr_length=STRING.LENGTH("mmss_spdm_rm_ocmemnoc_clk")

  if (STRING.SCAN("&clk", "*", 0)==0)
  (
    &wild_head=1
  )
  if (STRING.SCAN("&clk", "*", 1)==(STRING.LENGTH("&clk")-1))
  (
    &wild_tail=1
  )

  if ((&wild_head==1)&&(&wild_tail==1))
  (
    if (STRING.SCAN("mmss_spdm_rm_ocmemnoc_clk", STRING.MID("&clk", 1, &clk_input_length-2), 0)!=-1)
    ( 
      &match=1
    )
  )
  else if (&wild_head==1)
  (
    if (STRING.MID("mmss_spdm_rm_ocmemnoc_clk", &clk_itr_length-&clk_input_length+1, &clk_input_length-1)==STRING.CUT("&clk", 1))
    ( 
      &match=1
    )
  )
  else if (&wild_tail==1)
  (
    if (STRING.MID("mmss_spdm_rm_ocmemnoc_clk", 0, &clk_input_length-1)==STRING.CUT("&clk", -1))
    ( 
      &match=1
    )
  )	  
  else if ("mmss_spdm_rm_ocmemnoc_clk"=="&clk")
  (
    &match=1
  )
  
  if (&match==1)
  (
    &clk_test=&CLK_TEST_MMSS_SPDM_RM_OCMEMNOC_CLK
    &clk_reg=&HWIO_MMSS_SPDM_RM_OCMEMNOC_CBCR_ADDR
    &clk_reg_name="MMSS_SPDM_RM_OCMEMNOC_CBCR"
    &clk_name="mmss_spdm_rm_ocmemnoc_clk"
    &clk_reg_cbcr_type="sm_cbc"

    gosub Print_Clk_Info_Line
  )
  
  &match=0
  &wild_head=0
  &wild_tail=0
  &clk_input_length=STRING.LENGTH("&clk")
  &clk_itr_length=STRING.LENGTH("gcc_ocmem_sys_noc_axi_clk")

  if (STRING.SCAN("&clk", "*", 0)==0)
  (
    &wild_head=1
  )
  if (STRING.SCAN("&clk", "*", 1)==(STRING.LENGTH("&clk")-1))
  (
    &wild_tail=1
  )

  if ((&wild_head==1)&&(&wild_tail==1))
  (
    if (STRING.SCAN("gcc_ocmem_sys_noc_axi_clk", STRING.MID("&clk", 1, &clk_input_length-2), 0)!=-1)
    ( 
      &match=1
    )
  )
  else if (&wild_head==1)
  (
    if (STRING.MID("gcc_ocmem_sys_noc_axi_clk", &clk_itr_length-&clk_input_length+1, &clk_input_length-1)==STRING.CUT("&clk", 1))
    ( 
      &match=1
    )
  )
  else if (&wild_tail==1)
  (
    if (STRING.MID("gcc_ocmem_sys_noc_axi_clk", 0, &clk_input_length-1)==STRING.CUT("&clk", -1))
    ( 
      &match=1
    )
  )	  
  else if ("gcc_ocmem_sys_noc_axi_clk"=="&clk")
  (
    &match=1
  )
  
  if (&match==1)
  (
    &clk_test=&CLK_TEST_GCC_OCMEM_SYS_NOC_AXI_CLK
    &clk_reg=0
    &clk_reg_name="No CBCR"
    &clk_name="gcc_ocmem_sys_noc_axi_clk"
    &clk_reg_cbcr_type="gcc"

    gosub Print_Clk_Info_Line
  )
  
  &match=0
  &wild_head=0
  &wild_tail=0
  &clk_input_length=STRING.LENGTH("&clk")
  &clk_itr_length=STRING.LENGTH("ocmemcx_ahb_clk")

  if (STRING.SCAN("&clk", "*", 0)==0)
  (
    &wild_head=1
  )
  if (STRING.SCAN("&clk", "*", 1)==(STRING.LENGTH("&clk")-1))
  (
    &wild_tail=1
  )

  if ((&wild_head==1)&&(&wild_tail==1))
  (
    if (STRING.SCAN("ocmemcx_ahb_clk", STRING.MID("&clk", 1, &clk_input_length-2), 0)!=-1)
    ( 
      &match=1
    )
  )
  else if (&wild_head==1)
  (
    if (STRING.MID("ocmemcx_ahb_clk", &clk_itr_length-&clk_input_length+1, &clk_input_length-1)==STRING.CUT("&clk", 1))
    ( 
      &match=1
    )
  )
  else if (&wild_tail==1)
  (
    if (STRING.MID("ocmemcx_ahb_clk", 0, &clk_input_length-1)==STRING.CUT("&clk", -1))
    ( 
      &match=1
    )
  )	  
  else if ("ocmemcx_ahb_clk"=="&clk")
  (
    &match=1
  )
  
  if (&match==1)
  (
    &clk_test=&CLK_TEST_OCMEMCX_AHB_CLK
    &clk_reg=&HWIO_MMSS_OCMEMCX_AHB_CBCR_ADDR
    &clk_reg_name="MMSS_OCMEMCX_AHB_CBCR"
    &clk_name="ocmemcx_ahb_clk"
    &clk_reg_cbcr_type="sm_cbc"

    gosub Print_Clk_Info_Line
  )
  
  &match=0
  &wild_head=0
  &wild_tail=0
  &clk_input_length=STRING.LENGTH("&clk")
  &clk_itr_length=STRING.LENGTH("ocmemcx_ocmemnoc_clk")

  if (STRING.SCAN("&clk", "*", 0)==0)
  (
    &wild_head=1
  )
  if (STRING.SCAN("&clk", "*", 1)==(STRING.LENGTH("&clk")-1))
  (
    &wild_tail=1
  )

  if ((&wild_head==1)&&(&wild_tail==1))
  (
    if (STRING.SCAN("ocmemcx_ocmemnoc_clk", STRING.MID("&clk", 1, &clk_input_length-2), 0)!=-1)
    ( 
      &match=1
    )
  )
  else if (&wild_head==1)
  (
    if (STRING.MID("ocmemcx_ocmemnoc_clk", &clk_itr_length-&clk_input_length+1, &clk_input_length-1)==STRING.CUT("&clk", 1))
    ( 
      &match=1
    )
  )
  else if (&wild_tail==1)
  (
    if (STRING.MID("ocmemcx_ocmemnoc_clk", 0, &clk_input_length-1)==STRING.CUT("&clk", -1))
    ( 
      &match=1
    )
  )	  
  else if ("ocmemcx_ocmemnoc_clk"=="&clk")
  (
    &match=1
  )
  
  if (&match==1)
  (
    &clk_test=&CLK_TEST_OCMEMCX_OCMEMNOC_CLK
    &clk_reg=&HWIO_MMSS_OCMEMCX_OCMEMNOC_CBCR_ADDR
    &clk_reg_name="MMSS_OCMEMCX_OCMEMNOC_CBCR"
    &clk_name="ocmemcx_ocmemnoc_clk"
    &clk_reg_cbcr_type="sm_cbc"

    gosub Print_Clk_Info_Line
  )
  
  &match=0
  &wild_head=0
  &wild_tail=0
  &clk_input_length=STRING.LENGTH("&clk")
  &clk_itr_length=STRING.LENGTH("oxili_ocmemgx_clk")

  if (STRING.SCAN("&clk", "*", 0)==0)
  (
    &wild_head=1
  )
  if (STRING.SCAN("&clk", "*", 1)==(STRING.LENGTH("&clk")-1))
  (
    &wild_tail=1
  )

  if ((&wild_head==1)&&(&wild_tail==1))
  (
    if (STRING.SCAN("oxili_ocmemgx_clk", STRING.MID("&clk", 1, &clk_input_length-2), 0)!=-1)
    ( 
      &match=1
    )
  )
  else if (&wild_head==1)
  (
    if (STRING.MID("oxili_ocmemgx_clk", &clk_itr_length-&clk_input_length+1, &clk_input_length-1)==STRING.CUT("&clk", 1))
    ( 
      &match=1
    )
  )
  else if (&wild_tail==1)
  (
    if (STRING.MID("oxili_ocmemgx_clk", 0, &clk_input_length-1)==STRING.CUT("&clk", -1))
    ( 
      &match=1
    )
  )	  
  else if ("oxili_ocmemgx_clk"=="&clk")
  (
    &match=1
  )
  
  if (&match==1)
  (
    &clk_test=0
    &clk_reg=&HWIO_MMSS_OXILI_OCMEMGX_CBCR_ADDR
    &clk_reg_name="MMSS_OXILI_OCMEMGX_CBCR"
    &clk_name="oxili_ocmemgx_clk"
    &clk_reg_cbcr_type="sm_pscbc"

    gosub Print_Clk_Info_Line
  )
  
  &match=0
  &wild_head=0
  &wild_tail=0
  &clk_input_length=STRING.LENGTH("&clk")
  &clk_itr_length=STRING.LENGTH("gfx3d_clk_src")

  if (STRING.SCAN("&clk", "*", 0)==0)
  (
    &wild_head=1
  )
  if (STRING.SCAN("&clk", "*", 1)==(STRING.LENGTH("&clk")-1))
  (
    &wild_tail=1
  )

  if ((&wild_head==1)&&(&wild_tail==1))
  (
    if (STRING.SCAN("gfx3d_clk_src", STRING.MID("&clk", 1, &clk_input_length-2), 0)!=-1)
    ( 
      &match=1
    )
  )
  else if (&wild_head==1)
  (
    if (STRING.MID("gfx3d_clk_src", &clk_itr_length-&clk_input_length+1, &clk_input_length-1)==STRING.CUT("&clk", 1))
    ( 
      &match=1
    )
  )
  else if (&wild_tail==1)
  (
    if (STRING.MID("gfx3d_clk_src", 0, &clk_input_length-1)==STRING.CUT("&clk", -1))
    ( 
      &match=1
    )
  )	  
  else if ("gfx3d_clk_src"=="&clk")
  (
    &match=1
  )
  
  if (&match==1)
  (
    &clk_test=&CLK_TEST_GFX3D_CLK_SRC
    &clk_reg=0
    &clk_reg_name="No CBCR"
    &clk_name="gfx3d_clk_src"
    &clk_reg_cbcr_type=""

    gosub Print_Clk_Info_Line
  )
  
  &match=0
  &wild_head=0
  &wild_tail=0
  &clk_input_length=STRING.LENGTH("&clk")
  &clk_itr_length=STRING.LENGTH("oxili_gfx3d_clk")

  if (STRING.SCAN("&clk", "*", 0)==0)
  (
    &wild_head=1
  )
  if (STRING.SCAN("&clk", "*", 1)==(STRING.LENGTH("&clk")-1))
  (
    &wild_tail=1
  )

  if ((&wild_head==1)&&(&wild_tail==1))
  (
    if (STRING.SCAN("oxili_gfx3d_clk", STRING.MID("&clk", 1, &clk_input_length-2), 0)!=-1)
    ( 
      &match=1
    )
  )
  else if (&wild_head==1)
  (
    if (STRING.MID("oxili_gfx3d_clk", &clk_itr_length-&clk_input_length+1, &clk_input_length-1)==STRING.CUT("&clk", 1))
    ( 
      &match=1
    )
  )
  else if (&wild_tail==1)
  (
    if (STRING.MID("oxili_gfx3d_clk", 0, &clk_input_length-1)==STRING.CUT("&clk", -1))
    ( 
      &match=1
    )
  )	  
  else if ("oxili_gfx3d_clk"=="&clk")
  (
    &match=1
  )
  
  if (&match==1)
  (
    &clk_test=0
    &clk_reg=&HWIO_MMSS_OXILI_GFX3D_CBCR_ADDR
    &clk_reg_name="MMSS_OXILI_GFX3D_CBCR"
    &clk_name="oxili_gfx3d_clk"
    &clk_reg_cbcr_type="sm_pscbc"

    gosub Print_Clk_Info_Line
  )
  
  &match=0
  &wild_head=0
  &wild_tail=0
  &clk_input_length=STRING.LENGTH("&clk")
  &clk_itr_length=STRING.LENGTH("oxili_rbbmtimer_clk")

  if (STRING.SCAN("&clk", "*", 0)==0)
  (
    &wild_head=1
  )
  if (STRING.SCAN("&clk", "*", 1)==(STRING.LENGTH("&clk")-1))
  (
    &wild_tail=1
  )

  if ((&wild_head==1)&&(&wild_tail==1))
  (
    if (STRING.SCAN("oxili_rbbmtimer_clk", STRING.MID("&clk", 1, &clk_input_length-2), 0)!=-1)
    ( 
      &match=1
    )
  )
  else if (&wild_head==1)
  (
    if (STRING.MID("oxili_rbbmtimer_clk", &clk_itr_length-&clk_input_length+1, &clk_input_length-1)==STRING.CUT("&clk", 1))
    ( 
      &match=1
    )
  )
  else if (&wild_tail==1)
  (
    if (STRING.MID("oxili_rbbmtimer_clk", 0, &clk_input_length-1)==STRING.CUT("&clk", -1))
    ( 
      &match=1
    )
  )	  
  else if ("oxili_rbbmtimer_clk"=="&clk")
  (
    &match=1
  )
  
  if (&match==1)
  (
    &clk_test=&CLK_TEST_OXILI_RBBMTIMER_CLK
    &clk_reg=&HWIO_MMSS_OXILI_RBBMTIMER_CBCR_ADDR
    &clk_reg_name="MMSS_OXILI_RBBMTIMER_CBCR"
    &clk_name="oxili_rbbmtimer_clk"
    &clk_reg_cbcr_type="sm_cbc"

    gosub Print_Clk_Info_Line
  )
  
  &match=0
  &wild_head=0
  &wild_tail=0
  &clk_input_length=STRING.LENGTH("&clk")
  &clk_itr_length=STRING.LENGTH("oxilicx_ahb_clk")

  if (STRING.SCAN("&clk", "*", 0)==0)
  (
    &wild_head=1
  )
  if (STRING.SCAN("&clk", "*", 1)==(STRING.LENGTH("&clk")-1))
  (
    &wild_tail=1
  )

  if ((&wild_head==1)&&(&wild_tail==1))
  (
    if (STRING.SCAN("oxilicx_ahb_clk", STRING.MID("&clk", 1, &clk_input_length-2), 0)!=-1)
    ( 
      &match=1
    )
  )
  else if (&wild_head==1)
  (
    if (STRING.MID("oxilicx_ahb_clk", &clk_itr_length-&clk_input_length+1, &clk_input_length-1)==STRING.CUT("&clk", 1))
    ( 
      &match=1
    )
  )
  else if (&wild_tail==1)
  (
    if (STRING.MID("oxilicx_ahb_clk", 0, &clk_input_length-1)==STRING.CUT("&clk", -1))
    ( 
      &match=1
    )
  )	  
  else if ("oxilicx_ahb_clk"=="&clk")
  (
    &match=1
  )
  
  if (&match==1)
  (
    &clk_test=&CLK_TEST_OXILICX_AHB_CLK
    &clk_reg=&HWIO_MMSS_OXILICX_AHB_CBCR_ADDR
    &clk_reg_name="MMSS_OXILICX_AHB_CBCR"
    &clk_name="oxilicx_ahb_clk"
    &clk_reg_cbcr_type="sm_cbc"

    gosub Print_Clk_Info_Line
  )
  
  &match=0
  &wild_head=0
  &wild_tail=0
  &clk_input_length=STRING.LENGTH("&clk")
  &clk_itr_length=STRING.LENGTH("mmpll0_dtest")

  if (STRING.SCAN("&clk", "*", 0)==0)
  (
    &wild_head=1
  )
  if (STRING.SCAN("&clk", "*", 1)==(STRING.LENGTH("&clk")-1))
  (
    &wild_tail=1
  )

  if ((&wild_head==1)&&(&wild_tail==1))
  (
    if (STRING.SCAN("mmpll0_dtest", STRING.MID("&clk", 1, &clk_input_length-2), 0)!=-1)
    ( 
      &match=1
    )
  )
  else if (&wild_head==1)
  (
    if (STRING.MID("mmpll0_dtest", &clk_itr_length-&clk_input_length+1, &clk_input_length-1)==STRING.CUT("&clk", 1))
    ( 
      &match=1
    )
  )
  else if (&wild_tail==1)
  (
    if (STRING.MID("mmpll0_dtest", 0, &clk_input_length-1)==STRING.CUT("&clk", -1))
    ( 
      &match=1
    )
  )	  
  else if ("mmpll0_dtest"=="&clk")
  (
    &match=1
  )
  
  if (&match==1)
  (
    &clk_test=&CLK_TEST_MMPLL0_DTEST
    &clk_reg=0
    &clk_reg_name="No CBCR"
    &clk_name="mmpll0_dtest"
    &clk_reg_cbcr_type="pll_test_data"

    gosub Print_Clk_Info_Line
  )
  
  &match=0
  &wild_head=0
  &wild_tail=0
  &clk_input_length=STRING.LENGTH("&clk")
  &clk_itr_length=STRING.LENGTH("mmpll0_dtest")

  if (STRING.SCAN("&clk", "*", 0)==0)
  (
    &wild_head=1
  )
  if (STRING.SCAN("&clk", "*", 1)==(STRING.LENGTH("&clk")-1))
  (
    &wild_tail=1
  )

  if ((&wild_head==1)&&(&wild_tail==1))
  (
    if (STRING.SCAN("mmpll0_dtest", STRING.MID("&clk", 1, &clk_input_length-2), 0)!=-1)
    ( 
      &match=1
    )
  )
  else if (&wild_head==1)
  (
    if (STRING.MID("mmpll0_dtest", &clk_itr_length-&clk_input_length+1, &clk_input_length-1)==STRING.CUT("&clk", 1))
    ( 
      &match=1
    )
  )
  else if (&wild_tail==1)
  (
    if (STRING.MID("mmpll0_dtest", 0, &clk_input_length-1)==STRING.CUT("&clk", -1))
    ( 
      &match=1
    )
  )	  
  else if ("mmpll0_dtest"=="&clk")
  (
    &match=1
  )
  
  if (&match==1)
  (
    &clk_test=&CLK_TEST_MMPLL0_DTEST
    &clk_reg=0
    &clk_reg_name="No CBCR"
    &clk_name="mmpll0_dtest"
    &clk_reg_cbcr_type="pll_test_data"

    gosub Print_Clk_Info_Line
  )
  
  &match=0
  &wild_head=0
  &wild_tail=0
  &clk_input_length=STRING.LENGTH("&clk")
  &clk_itr_length=STRING.LENGTH("mmpll0_lock_det")

  if (STRING.SCAN("&clk", "*", 0)==0)
  (
    &wild_head=1
  )
  if (STRING.SCAN("&clk", "*", 1)==(STRING.LENGTH("&clk")-1))
  (
    &wild_tail=1
  )

  if ((&wild_head==1)&&(&wild_tail==1))
  (
    if (STRING.SCAN("mmpll0_lock_det", STRING.MID("&clk", 1, &clk_input_length-2), 0)!=-1)
    ( 
      &match=1
    )
  )
  else if (&wild_head==1)
  (
    if (STRING.MID("mmpll0_lock_det", &clk_itr_length-&clk_input_length+1, &clk_input_length-1)==STRING.CUT("&clk", 1))
    ( 
      &match=1
    )
  )
  else if (&wild_tail==1)
  (
    if (STRING.MID("mmpll0_lock_det", 0, &clk_input_length-1)==STRING.CUT("&clk", -1))
    ( 
      &match=1
    )
  )	  
  else if ("mmpll0_lock_det"=="&clk")
  (
    &match=1
  )
  
  if (&match==1)
  (
    &clk_test=&CLK_TEST_MMPLL0_LOCK_DET
    &clk_reg=0
    &clk_reg_name="No CBCR"
    &clk_name="mmpll0_lock_det"
    &clk_reg_cbcr_type="pll_test_data"

    gosub Print_Clk_Info_Line
  )
  
  &match=0
  &wild_head=0
  &wild_tail=0
  &clk_input_length=STRING.LENGTH("&clk")
  &clk_itr_length=STRING.LENGTH("mmpll0_lock_det")

  if (STRING.SCAN("&clk", "*", 0)==0)
  (
    &wild_head=1
  )
  if (STRING.SCAN("&clk", "*", 1)==(STRING.LENGTH("&clk")-1))
  (
    &wild_tail=1
  )

  if ((&wild_head==1)&&(&wild_tail==1))
  (
    if (STRING.SCAN("mmpll0_lock_det", STRING.MID("&clk", 1, &clk_input_length-2), 0)!=-1)
    ( 
      &match=1
    )
  )
  else if (&wild_head==1)
  (
    if (STRING.MID("mmpll0_lock_det", &clk_itr_length-&clk_input_length+1, &clk_input_length-1)==STRING.CUT("&clk", 1))
    ( 
      &match=1
    )
  )
  else if (&wild_tail==1)
  (
    if (STRING.MID("mmpll0_lock_det", 0, &clk_input_length-1)==STRING.CUT("&clk", -1))
    ( 
      &match=1
    )
  )	  
  else if ("mmpll0_lock_det"=="&clk")
  (
    &match=1
  )
  
  if (&match==1)
  (
    &clk_test=&CLK_TEST_MMPLL0_LOCK_DET
    &clk_reg=0
    &clk_reg_name="No CBCR"
    &clk_name="mmpll0_lock_det"
    &clk_reg_cbcr_type="pll_test_data"

    gosub Print_Clk_Info_Line
  )
  
  &match=0
  &wild_head=0
  &wild_tail=0
  &clk_input_length=STRING.LENGTH("&clk")
  &clk_itr_length=STRING.LENGTH("mmpll1_dtest")

  if (STRING.SCAN("&clk", "*", 0)==0)
  (
    &wild_head=1
  )
  if (STRING.SCAN("&clk", "*", 1)==(STRING.LENGTH("&clk")-1))
  (
    &wild_tail=1
  )

  if ((&wild_head==1)&&(&wild_tail==1))
  (
    if (STRING.SCAN("mmpll1_dtest", STRING.MID("&clk", 1, &clk_input_length-2), 0)!=-1)
    ( 
      &match=1
    )
  )
  else if (&wild_head==1)
  (
    if (STRING.MID("mmpll1_dtest", &clk_itr_length-&clk_input_length+1, &clk_input_length-1)==STRING.CUT("&clk", 1))
    ( 
      &match=1
    )
  )
  else if (&wild_tail==1)
  (
    if (STRING.MID("mmpll1_dtest", 0, &clk_input_length-1)==STRING.CUT("&clk", -1))
    ( 
      &match=1
    )
  )	  
  else if ("mmpll1_dtest"=="&clk")
  (
    &match=1
  )
  
  if (&match==1)
  (
    &clk_test=&CLK_TEST_MMPLL1_DTEST
    &clk_reg=0
    &clk_reg_name="No CBCR"
    &clk_name="mmpll1_dtest"
    &clk_reg_cbcr_type="pll_test_data"

    gosub Print_Clk_Info_Line
  )
  
  &match=0
  &wild_head=0
  &wild_tail=0
  &clk_input_length=STRING.LENGTH("&clk")
  &clk_itr_length=STRING.LENGTH("mmpll1_dtest")

  if (STRING.SCAN("&clk", "*", 0)==0)
  (
    &wild_head=1
  )
  if (STRING.SCAN("&clk", "*", 1)==(STRING.LENGTH("&clk")-1))
  (
    &wild_tail=1
  )

  if ((&wild_head==1)&&(&wild_tail==1))
  (
    if (STRING.SCAN("mmpll1_dtest", STRING.MID("&clk", 1, &clk_input_length-2), 0)!=-1)
    ( 
      &match=1
    )
  )
  else if (&wild_head==1)
  (
    if (STRING.MID("mmpll1_dtest", &clk_itr_length-&clk_input_length+1, &clk_input_length-1)==STRING.CUT("&clk", 1))
    ( 
      &match=1
    )
  )
  else if (&wild_tail==1)
  (
    if (STRING.MID("mmpll1_dtest", 0, &clk_input_length-1)==STRING.CUT("&clk", -1))
    ( 
      &match=1
    )
  )	  
  else if ("mmpll1_dtest"=="&clk")
  (
    &match=1
  )
  
  if (&match==1)
  (
    &clk_test=&CLK_TEST_MMPLL1_DTEST
    &clk_reg=0
    &clk_reg_name="No CBCR"
    &clk_name="mmpll1_dtest"
    &clk_reg_cbcr_type="pll_test_data"

    gosub Print_Clk_Info_Line
  )
  
  &match=0
  &wild_head=0
  &wild_tail=0
  &clk_input_length=STRING.LENGTH("&clk")
  &clk_itr_length=STRING.LENGTH("mmpll1_lock_det")

  if (STRING.SCAN("&clk", "*", 0)==0)
  (
    &wild_head=1
  )
  if (STRING.SCAN("&clk", "*", 1)==(STRING.LENGTH("&clk")-1))
  (
    &wild_tail=1
  )

  if ((&wild_head==1)&&(&wild_tail==1))
  (
    if (STRING.SCAN("mmpll1_lock_det", STRING.MID("&clk", 1, &clk_input_length-2), 0)!=-1)
    ( 
      &match=1
    )
  )
  else if (&wild_head==1)
  (
    if (STRING.MID("mmpll1_lock_det", &clk_itr_length-&clk_input_length+1, &clk_input_length-1)==STRING.CUT("&clk", 1))
    ( 
      &match=1
    )
  )
  else if (&wild_tail==1)
  (
    if (STRING.MID("mmpll1_lock_det", 0, &clk_input_length-1)==STRING.CUT("&clk", -1))
    ( 
      &match=1
    )
  )	  
  else if ("mmpll1_lock_det"=="&clk")
  (
    &match=1
  )
  
  if (&match==1)
  (
    &clk_test=&CLK_TEST_MMPLL1_LOCK_DET
    &clk_reg=0
    &clk_reg_name="No CBCR"
    &clk_name="mmpll1_lock_det"
    &clk_reg_cbcr_type="pll_test_data"

    gosub Print_Clk_Info_Line
  )
  
  &match=0
  &wild_head=0
  &wild_tail=0
  &clk_input_length=STRING.LENGTH("&clk")
  &clk_itr_length=STRING.LENGTH("mmpll1_lock_det")

  if (STRING.SCAN("&clk", "*", 0)==0)
  (
    &wild_head=1
  )
  if (STRING.SCAN("&clk", "*", 1)==(STRING.LENGTH("&clk")-1))
  (
    &wild_tail=1
  )

  if ((&wild_head==1)&&(&wild_tail==1))
  (
    if (STRING.SCAN("mmpll1_lock_det", STRING.MID("&clk", 1, &clk_input_length-2), 0)!=-1)
    ( 
      &match=1
    )
  )
  else if (&wild_head==1)
  (
    if (STRING.MID("mmpll1_lock_det", &clk_itr_length-&clk_input_length+1, &clk_input_length-1)==STRING.CUT("&clk", 1))
    ( 
      &match=1
    )
  )
  else if (&wild_tail==1)
  (
    if (STRING.MID("mmpll1_lock_det", 0, &clk_input_length-1)==STRING.CUT("&clk", -1))
    ( 
      &match=1
    )
  )	  
  else if ("mmpll1_lock_det"=="&clk")
  (
    &match=1
  )
  
  if (&match==1)
  (
    &clk_test=&CLK_TEST_MMPLL1_LOCK_DET
    &clk_reg=0
    &clk_reg_name="No CBCR"
    &clk_name="mmpll1_lock_det"
    &clk_reg_cbcr_type="pll_test_data"

    gosub Print_Clk_Info_Line
  )
  
  &match=0
  &wild_head=0
  &wild_tail=0
  &clk_input_length=STRING.LENGTH("&clk")
  &clk_itr_length=STRING.LENGTH("mmpll2_dtest")

  if (STRING.SCAN("&clk", "*", 0)==0)
  (
    &wild_head=1
  )
  if (STRING.SCAN("&clk", "*", 1)==(STRING.LENGTH("&clk")-1))
  (
    &wild_tail=1
  )

  if ((&wild_head==1)&&(&wild_tail==1))
  (
    if (STRING.SCAN("mmpll2_dtest", STRING.MID("&clk", 1, &clk_input_length-2), 0)!=-1)
    ( 
      &match=1
    )
  )
  else if (&wild_head==1)
  (
    if (STRING.MID("mmpll2_dtest", &clk_itr_length-&clk_input_length+1, &clk_input_length-1)==STRING.CUT("&clk", 1))
    ( 
      &match=1
    )
  )
  else if (&wild_tail==1)
  (
    if (STRING.MID("mmpll2_dtest", 0, &clk_input_length-1)==STRING.CUT("&clk", -1))
    ( 
      &match=1
    )
  )	  
  else if ("mmpll2_dtest"=="&clk")
  (
    &match=1
  )
  
  if (&match==1)
  (
    &clk_test=&CLK_TEST_MMPLL2_DTEST
    &clk_reg=0
    &clk_reg_name="No CBCR"
    &clk_name="mmpll2_dtest"
    &clk_reg_cbcr_type="pll_test_data"

    gosub Print_Clk_Info_Line
  )
  
  &match=0
  &wild_head=0
  &wild_tail=0
  &clk_input_length=STRING.LENGTH("&clk")
  &clk_itr_length=STRING.LENGTH("mmpll2_dtest")

  if (STRING.SCAN("&clk", "*", 0)==0)
  (
    &wild_head=1
  )
  if (STRING.SCAN("&clk", "*", 1)==(STRING.LENGTH("&clk")-1))
  (
    &wild_tail=1
  )

  if ((&wild_head==1)&&(&wild_tail==1))
  (
    if (STRING.SCAN("mmpll2_dtest", STRING.MID("&clk", 1, &clk_input_length-2), 0)!=-1)
    ( 
      &match=1
    )
  )
  else if (&wild_head==1)
  (
    if (STRING.MID("mmpll2_dtest", &clk_itr_length-&clk_input_length+1, &clk_input_length-1)==STRING.CUT("&clk", 1))
    ( 
      &match=1
    )
  )
  else if (&wild_tail==1)
  (
    if (STRING.MID("mmpll2_dtest", 0, &clk_input_length-1)==STRING.CUT("&clk", -1))
    ( 
      &match=1
    )
  )	  
  else if ("mmpll2_dtest"=="&clk")
  (
    &match=1
  )
  
  if (&match==1)
  (
    &clk_test=&CLK_TEST_MMPLL2_DTEST
    &clk_reg=0
    &clk_reg_name="No CBCR"
    &clk_name="mmpll2_dtest"
    &clk_reg_cbcr_type="pll_test_data"

    gosub Print_Clk_Info_Line
  )
  
  &match=0
  &wild_head=0
  &wild_tail=0
  &clk_input_length=STRING.LENGTH("&clk")
  &clk_itr_length=STRING.LENGTH("mmpll2_lock_det")

  if (STRING.SCAN("&clk", "*", 0)==0)
  (
    &wild_head=1
  )
  if (STRING.SCAN("&clk", "*", 1)==(STRING.LENGTH("&clk")-1))
  (
    &wild_tail=1
  )

  if ((&wild_head==1)&&(&wild_tail==1))
  (
    if (STRING.SCAN("mmpll2_lock_det", STRING.MID("&clk", 1, &clk_input_length-2), 0)!=-1)
    ( 
      &match=1
    )
  )
  else if (&wild_head==1)
  (
    if (STRING.MID("mmpll2_lock_det", &clk_itr_length-&clk_input_length+1, &clk_input_length-1)==STRING.CUT("&clk", 1))
    ( 
      &match=1
    )
  )
  else if (&wild_tail==1)
  (
    if (STRING.MID("mmpll2_lock_det", 0, &clk_input_length-1)==STRING.CUT("&clk", -1))
    ( 
      &match=1
    )
  )	  
  else if ("mmpll2_lock_det"=="&clk")
  (
    &match=1
  )
  
  if (&match==1)
  (
    &clk_test=&CLK_TEST_MMPLL2_LOCK_DET
    &clk_reg=0
    &clk_reg_name="No CBCR"
    &clk_name="mmpll2_lock_det"
    &clk_reg_cbcr_type="pll_test_data"

    gosub Print_Clk_Info_Line
  )
  
  &match=0
  &wild_head=0
  &wild_tail=0
  &clk_input_length=STRING.LENGTH("&clk")
  &clk_itr_length=STRING.LENGTH("mmpll2_lock_det")

  if (STRING.SCAN("&clk", "*", 0)==0)
  (
    &wild_head=1
  )
  if (STRING.SCAN("&clk", "*", 1)==(STRING.LENGTH("&clk")-1))
  (
    &wild_tail=1
  )

  if ((&wild_head==1)&&(&wild_tail==1))
  (
    if (STRING.SCAN("mmpll2_lock_det", STRING.MID("&clk", 1, &clk_input_length-2), 0)!=-1)
    ( 
      &match=1
    )
  )
  else if (&wild_head==1)
  (
    if (STRING.MID("mmpll2_lock_det", &clk_itr_length-&clk_input_length+1, &clk_input_length-1)==STRING.CUT("&clk", 1))
    ( 
      &match=1
    )
  )
  else if (&wild_tail==1)
  (
    if (STRING.MID("mmpll2_lock_det", 0, &clk_input_length-1)==STRING.CUT("&clk", -1))
    ( 
      &match=1
    )
  )	  
  else if ("mmpll2_lock_det"=="&clk")
  (
    &match=1
  )
  
  if (&match==1)
  (
    &clk_test=&CLK_TEST_MMPLL2_LOCK_DET
    &clk_reg=0
    &clk_reg_name="No CBCR"
    &clk_name="mmpll2_lock_det"
    &clk_reg_cbcr_type="pll_test_data"

    gosub Print_Clk_Info_Line
  )
  
  &match=0
  &wild_head=0
  &wild_tail=0
  &clk_input_length=STRING.LENGTH("&clk")
  &clk_itr_length=STRING.LENGTH("mmpll3_dtest")

  if (STRING.SCAN("&clk", "*", 0)==0)
  (
    &wild_head=1
  )
  if (STRING.SCAN("&clk", "*", 1)==(STRING.LENGTH("&clk")-1))
  (
    &wild_tail=1
  )

  if ((&wild_head==1)&&(&wild_tail==1))
  (
    if (STRING.SCAN("mmpll3_dtest", STRING.MID("&clk", 1, &clk_input_length-2), 0)!=-1)
    ( 
      &match=1
    )
  )
  else if (&wild_head==1)
  (
    if (STRING.MID("mmpll3_dtest", &clk_itr_length-&clk_input_length+1, &clk_input_length-1)==STRING.CUT("&clk", 1))
    ( 
      &match=1
    )
  )
  else if (&wild_tail==1)
  (
    if (STRING.MID("mmpll3_dtest", 0, &clk_input_length-1)==STRING.CUT("&clk", -1))
    ( 
      &match=1
    )
  )	  
  else if ("mmpll3_dtest"=="&clk")
  (
    &match=1
  )
  
  if (&match==1)
  (
    &clk_test=&CLK_TEST_MMPLL3_DTEST
    &clk_reg=0
    &clk_reg_name="No CBCR"
    &clk_name="mmpll3_dtest"
    &clk_reg_cbcr_type="pll_test_data"

    gosub Print_Clk_Info_Line
  )
  
  &match=0
  &wild_head=0
  &wild_tail=0
  &clk_input_length=STRING.LENGTH("&clk")
  &clk_itr_length=STRING.LENGTH("mmpll3_dtest")

  if (STRING.SCAN("&clk", "*", 0)==0)
  (
    &wild_head=1
  )
  if (STRING.SCAN("&clk", "*", 1)==(STRING.LENGTH("&clk")-1))
  (
    &wild_tail=1
  )

  if ((&wild_head==1)&&(&wild_tail==1))
  (
    if (STRING.SCAN("mmpll3_dtest", STRING.MID("&clk", 1, &clk_input_length-2), 0)!=-1)
    ( 
      &match=1
    )
  )
  else if (&wild_head==1)
  (
    if (STRING.MID("mmpll3_dtest", &clk_itr_length-&clk_input_length+1, &clk_input_length-1)==STRING.CUT("&clk", 1))
    ( 
      &match=1
    )
  )
  else if (&wild_tail==1)
  (
    if (STRING.MID("mmpll3_dtest", 0, &clk_input_length-1)==STRING.CUT("&clk", -1))
    ( 
      &match=1
    )
  )	  
  else if ("mmpll3_dtest"=="&clk")
  (
    &match=1
  )
  
  if (&match==1)
  (
    &clk_test=&CLK_TEST_MMPLL3_DTEST
    &clk_reg=0
    &clk_reg_name="No CBCR"
    &clk_name="mmpll3_dtest"
    &clk_reg_cbcr_type="pll_test_data"

    gosub Print_Clk_Info_Line
  )
  
  &match=0
  &wild_head=0
  &wild_tail=0
  &clk_input_length=STRING.LENGTH("&clk")
  &clk_itr_length=STRING.LENGTH("mmpll3_lock_det")

  if (STRING.SCAN("&clk", "*", 0)==0)
  (
    &wild_head=1
  )
  if (STRING.SCAN("&clk", "*", 1)==(STRING.LENGTH("&clk")-1))
  (
    &wild_tail=1
  )

  if ((&wild_head==1)&&(&wild_tail==1))
  (
    if (STRING.SCAN("mmpll3_lock_det", STRING.MID("&clk", 1, &clk_input_length-2), 0)!=-1)
    ( 
      &match=1
    )
  )
  else if (&wild_head==1)
  (
    if (STRING.MID("mmpll3_lock_det", &clk_itr_length-&clk_input_length+1, &clk_input_length-1)==STRING.CUT("&clk", 1))
    ( 
      &match=1
    )
  )
  else if (&wild_tail==1)
  (
    if (STRING.MID("mmpll3_lock_det", 0, &clk_input_length-1)==STRING.CUT("&clk", -1))
    ( 
      &match=1
    )
  )	  
  else if ("mmpll3_lock_det"=="&clk")
  (
    &match=1
  )
  
  if (&match==1)
  (
    &clk_test=&CLK_TEST_MMPLL3_LOCK_DET
    &clk_reg=0
    &clk_reg_name="No CBCR"
    &clk_name="mmpll3_lock_det"
    &clk_reg_cbcr_type="pll_test_data"

    gosub Print_Clk_Info_Line
  )
  
  &match=0
  &wild_head=0
  &wild_tail=0
  &clk_input_length=STRING.LENGTH("&clk")
  &clk_itr_length=STRING.LENGTH("mmpll3_lock_det")

  if (STRING.SCAN("&clk", "*", 0)==0)
  (
    &wild_head=1
  )
  if (STRING.SCAN("&clk", "*", 1)==(STRING.LENGTH("&clk")-1))
  (
    &wild_tail=1
  )

  if ((&wild_head==1)&&(&wild_tail==1))
  (
    if (STRING.SCAN("mmpll3_lock_det", STRING.MID("&clk", 1, &clk_input_length-2), 0)!=-1)
    ( 
      &match=1
    )
  )
  else if (&wild_head==1)
  (
    if (STRING.MID("mmpll3_lock_det", &clk_itr_length-&clk_input_length+1, &clk_input_length-1)==STRING.CUT("&clk", 1))
    ( 
      &match=1
    )
  )
  else if (&wild_tail==1)
  (
    if (STRING.MID("mmpll3_lock_det", 0, &clk_input_length-1)==STRING.CUT("&clk", -1))
    ( 
      &match=1
    )
  )	  
  else if ("mmpll3_lock_det"=="&clk")
  (
    &match=1
  )
  
  if (&match==1)
  (
    &clk_test=&CLK_TEST_MMPLL3_LOCK_DET
    &clk_reg=0
    &clk_reg_name="No CBCR"
    &clk_name="mmpll3_lock_det"
    &clk_reg_cbcr_type="pll_test_data"

    gosub Print_Clk_Info_Line
  )
  
  &match=0
  &wild_head=0
  &wild_tail=0
  &clk_input_length=STRING.LENGTH("&clk")
  &clk_itr_length=STRING.LENGTH("mmpll4_dtest")

  if (STRING.SCAN("&clk", "*", 0)==0)
  (
    &wild_head=1
  )
  if (STRING.SCAN("&clk", "*", 1)==(STRING.LENGTH("&clk")-1))
  (
    &wild_tail=1
  )

  if ((&wild_head==1)&&(&wild_tail==1))
  (
    if (STRING.SCAN("mmpll4_dtest", STRING.MID("&clk", 1, &clk_input_length-2), 0)!=-1)
    ( 
      &match=1
    )
  )
  else if (&wild_head==1)
  (
    if (STRING.MID("mmpll4_dtest", &clk_itr_length-&clk_input_length+1, &clk_input_length-1)==STRING.CUT("&clk", 1))
    ( 
      &match=1
    )
  )
  else if (&wild_tail==1)
  (
    if (STRING.MID("mmpll4_dtest", 0, &clk_input_length-1)==STRING.CUT("&clk", -1))
    ( 
      &match=1
    )
  )	  
  else if ("mmpll4_dtest"=="&clk")
  (
    &match=1
  )
  
  if (&match==1)
  (
    &clk_test=&CLK_TEST_MMPLL4_DTEST
    &clk_reg=0
    &clk_reg_name="No CBCR"
    &clk_name="mmpll4_dtest"
    &clk_reg_cbcr_type="pll_test_data"

    gosub Print_Clk_Info_Line
  )
  
  &match=0
  &wild_head=0
  &wild_tail=0
  &clk_input_length=STRING.LENGTH("&clk")
  &clk_itr_length=STRING.LENGTH("mmpll4_dtest")

  if (STRING.SCAN("&clk", "*", 0)==0)
  (
    &wild_head=1
  )
  if (STRING.SCAN("&clk", "*", 1)==(STRING.LENGTH("&clk")-1))
  (
    &wild_tail=1
  )

  if ((&wild_head==1)&&(&wild_tail==1))
  (
    if (STRING.SCAN("mmpll4_dtest", STRING.MID("&clk", 1, &clk_input_length-2), 0)!=-1)
    ( 
      &match=1
    )
  )
  else if (&wild_head==1)
  (
    if (STRING.MID("mmpll4_dtest", &clk_itr_length-&clk_input_length+1, &clk_input_length-1)==STRING.CUT("&clk", 1))
    ( 
      &match=1
    )
  )
  else if (&wild_tail==1)
  (
    if (STRING.MID("mmpll4_dtest", 0, &clk_input_length-1)==STRING.CUT("&clk", -1))
    ( 
      &match=1
    )
  )	  
  else if ("mmpll4_dtest"=="&clk")
  (
    &match=1
  )
  
  if (&match==1)
  (
    &clk_test=&CLK_TEST_MMPLL4_DTEST
    &clk_reg=0
    &clk_reg_name="No CBCR"
    &clk_name="mmpll4_dtest"
    &clk_reg_cbcr_type="pll_test_data"

    gosub Print_Clk_Info_Line
  )
  
  &match=0
  &wild_head=0
  &wild_tail=0
  &clk_input_length=STRING.LENGTH("&clk")
  &clk_itr_length=STRING.LENGTH("mmpll4_lock_det")

  if (STRING.SCAN("&clk", "*", 0)==0)
  (
    &wild_head=1
  )
  if (STRING.SCAN("&clk", "*", 1)==(STRING.LENGTH("&clk")-1))
  (
    &wild_tail=1
  )

  if ((&wild_head==1)&&(&wild_tail==1))
  (
    if (STRING.SCAN("mmpll4_lock_det", STRING.MID("&clk", 1, &clk_input_length-2), 0)!=-1)
    ( 
      &match=1
    )
  )
  else if (&wild_head==1)
  (
    if (STRING.MID("mmpll4_lock_det", &clk_itr_length-&clk_input_length+1, &clk_input_length-1)==STRING.CUT("&clk", 1))
    ( 
      &match=1
    )
  )
  else if (&wild_tail==1)
  (
    if (STRING.MID("mmpll4_lock_det", 0, &clk_input_length-1)==STRING.CUT("&clk", -1))
    ( 
      &match=1
    )
  )	  
  else if ("mmpll4_lock_det"=="&clk")
  (
    &match=1
  )
  
  if (&match==1)
  (
    &clk_test=&CLK_TEST_MMPLL4_LOCK_DET
    &clk_reg=0
    &clk_reg_name="No CBCR"
    &clk_name="mmpll4_lock_det"
    &clk_reg_cbcr_type="pll_test_data"

    gosub Print_Clk_Info_Line
  )
  
  &match=0
  &wild_head=0
  &wild_tail=0
  &clk_input_length=STRING.LENGTH("&clk")
  &clk_itr_length=STRING.LENGTH("mmpll4_lock_det")

  if (STRING.SCAN("&clk", "*", 0)==0)
  (
    &wild_head=1
  )
  if (STRING.SCAN("&clk", "*", 1)==(STRING.LENGTH("&clk")-1))
  (
    &wild_tail=1
  )

  if ((&wild_head==1)&&(&wild_tail==1))
  (
    if (STRING.SCAN("mmpll4_lock_det", STRING.MID("&clk", 1, &clk_input_length-2), 0)!=-1)
    ( 
      &match=1
    )
  )
  else if (&wild_head==1)
  (
    if (STRING.MID("mmpll4_lock_det", &clk_itr_length-&clk_input_length+1, &clk_input_length-1)==STRING.CUT("&clk", 1))
    ( 
      &match=1
    )
  )
  else if (&wild_tail==1)
  (
    if (STRING.MID("mmpll4_lock_det", 0, &clk_input_length-1)==STRING.CUT("&clk", -1))
    ( 
      &match=1
    )
  )	  
  else if ("mmpll4_lock_det"=="&clk")
  (
    &match=1
  )
  
  if (&match==1)
  (
    &clk_test=&CLK_TEST_MMPLL4_LOCK_DET
    &clk_reg=0
    &clk_reg_name="No CBCR"
    &clk_name="mmpll4_lock_det"
    &clk_reg_cbcr_type="pll_test_data"

    gosub Print_Clk_Info_Line
  )
  
  &match=0
  &wild_head=0
  &wild_tail=0
  &clk_input_length=STRING.LENGTH("&clk")
  &clk_itr_length=STRING.LENGTH("venus0_ahb_clk")

  if (STRING.SCAN("&clk", "*", 0)==0)
  (
    &wild_head=1
  )
  if (STRING.SCAN("&clk", "*", 1)==(STRING.LENGTH("&clk")-1))
  (
    &wild_tail=1
  )

  if ((&wild_head==1)&&(&wild_tail==1))
  (
    if (STRING.SCAN("venus0_ahb_clk", STRING.MID("&clk", 1, &clk_input_length-2), 0)!=-1)
    ( 
      &match=1
    )
  )
  else if (&wild_head==1)
  (
    if (STRING.MID("venus0_ahb_clk", &clk_itr_length-&clk_input_length+1, &clk_input_length-1)==STRING.CUT("&clk", 1))
    ( 
      &match=1
    )
  )
  else if (&wild_tail==1)
  (
    if (STRING.MID("venus0_ahb_clk", 0, &clk_input_length-1)==STRING.CUT("&clk", -1))
    ( 
      &match=1
    )
  )	  
  else if ("venus0_ahb_clk"=="&clk")
  (
    &match=1
  )
  
  if (&match==1)
  (
    &clk_test=&CLK_TEST_VENUS0_AHB_CLK
    &clk_reg=&HWIO_MMSS_VENUS0_AHB_CBCR_ADDR
    &clk_reg_name="MMSS_VENUS0_AHB_CBCR"
    &clk_name="venus0_ahb_clk"
    &clk_reg_cbcr_type="sm_cbc"

    gosub Print_Clk_Info_Line
  )
  
  &match=0
  &wild_head=0
  &wild_tail=0
  &clk_input_length=STRING.LENGTH("&clk")
  &clk_itr_length=STRING.LENGTH("venus0_axi_clk")

  if (STRING.SCAN("&clk", "*", 0)==0)
  (
    &wild_head=1
  )
  if (STRING.SCAN("&clk", "*", 1)==(STRING.LENGTH("&clk")-1))
  (
    &wild_tail=1
  )

  if ((&wild_head==1)&&(&wild_tail==1))
  (
    if (STRING.SCAN("venus0_axi_clk", STRING.MID("&clk", 1, &clk_input_length-2), 0)!=-1)
    ( 
      &match=1
    )
  )
  else if (&wild_head==1)
  (
    if (STRING.MID("venus0_axi_clk", &clk_itr_length-&clk_input_length+1, &clk_input_length-1)==STRING.CUT("&clk", 1))
    ( 
      &match=1
    )
  )
  else if (&wild_tail==1)
  (
    if (STRING.MID("venus0_axi_clk", 0, &clk_input_length-1)==STRING.CUT("&clk", -1))
    ( 
      &match=1
    )
  )	  
  else if ("venus0_axi_clk"=="&clk")
  (
    &match=1
  )
  
  if (&match==1)
  (
    &clk_test=&CLK_TEST_VENUS0_AXI_CLK
    &clk_reg=&HWIO_MMSS_VENUS0_AXI_CBCR_ADDR
    &clk_reg_name="MMSS_VENUS0_AXI_CBCR"
    &clk_name="venus0_axi_clk"
    &clk_reg_cbcr_type="sm_pscbc"

    gosub Print_Clk_Info_Line
  )
  
  &match=0
  &wild_head=0
  &wild_tail=0
  &clk_input_length=STRING.LENGTH("&clk")
  &clk_itr_length=STRING.LENGTH("venus0_core0_vcodec_clk")

  if (STRING.SCAN("&clk", "*", 0)==0)
  (
    &wild_head=1
  )
  if (STRING.SCAN("&clk", "*", 1)==(STRING.LENGTH("&clk")-1))
  (
    &wild_tail=1
  )

  if ((&wild_head==1)&&(&wild_tail==1))
  (
    if (STRING.SCAN("venus0_core0_vcodec_clk", STRING.MID("&clk", 1, &clk_input_length-2), 0)!=-1)
    ( 
      &match=1
    )
  )
  else if (&wild_head==1)
  (
    if (STRING.MID("venus0_core0_vcodec_clk", &clk_itr_length-&clk_input_length+1, &clk_input_length-1)==STRING.CUT("&clk", 1))
    ( 
      &match=1
    )
  )
  else if (&wild_tail==1)
  (
    if (STRING.MID("venus0_core0_vcodec_clk", 0, &clk_input_length-1)==STRING.CUT("&clk", -1))
    ( 
      &match=1
    )
  )	  
  else if ("venus0_core0_vcodec_clk"=="&clk")
  (
    &match=1
  )
  
  if (&match==1)
  (
    &clk_test=&CLK_TEST_VENUS0_CORE0_VCODEC_CLK
    &clk_reg=&HWIO_MMSS_VENUS0_CORE0_VCODEC_CBCR_ADDR
    &clk_reg_name="MMSS_VENUS0_CORE0_VCODEC_CBCR"
    &clk_name="venus0_core0_vcodec_clk"
    &clk_reg_cbcr_type="sm_pscbc"

    gosub Print_Clk_Info_Line
  )
  
  &match=0
  &wild_head=0
  &wild_tail=0
  &clk_input_length=STRING.LENGTH("&clk")
  &clk_itr_length=STRING.LENGTH("venus0_core1_vcodec_clk")

  if (STRING.SCAN("&clk", "*", 0)==0)
  (
    &wild_head=1
  )
  if (STRING.SCAN("&clk", "*", 1)==(STRING.LENGTH("&clk")-1))
  (
    &wild_tail=1
  )

  if ((&wild_head==1)&&(&wild_tail==1))
  (
    if (STRING.SCAN("venus0_core1_vcodec_clk", STRING.MID("&clk", 1, &clk_input_length-2), 0)!=-1)
    ( 
      &match=1
    )
  )
  else if (&wild_head==1)
  (
    if (STRING.MID("venus0_core1_vcodec_clk", &clk_itr_length-&clk_input_length+1, &clk_input_length-1)==STRING.CUT("&clk", 1))
    ( 
      &match=1
    )
  )
  else if (&wild_tail==1)
  (
    if (STRING.MID("venus0_core1_vcodec_clk", 0, &clk_input_length-1)==STRING.CUT("&clk", -1))
    ( 
      &match=1
    )
  )	  
  else if ("venus0_core1_vcodec_clk"=="&clk")
  (
    &match=1
  )
  
  if (&match==1)
  (
    &clk_test=&CLK_TEST_VENUS0_CORE1_VCODEC_CLK
    &clk_reg=&HWIO_MMSS_VENUS0_CORE1_VCODEC_CBCR_ADDR
    &clk_reg_name="MMSS_VENUS0_CORE1_VCODEC_CBCR"
    &clk_name="venus0_core1_vcodec_clk"
    &clk_reg_cbcr_type="sm_pscbc"

    gosub Print_Clk_Info_Line
  )
  
  &match=0
  &wild_head=0
  &wild_tail=0
  &clk_input_length=STRING.LENGTH("&clk")
  &clk_itr_length=STRING.LENGTH("venus0_ocmemnoc_clk")

  if (STRING.SCAN("&clk", "*", 0)==0)
  (
    &wild_head=1
  )
  if (STRING.SCAN("&clk", "*", 1)==(STRING.LENGTH("&clk")-1))
  (
    &wild_tail=1
  )

  if ((&wild_head==1)&&(&wild_tail==1))
  (
    if (STRING.SCAN("venus0_ocmemnoc_clk", STRING.MID("&clk", 1, &clk_input_length-2), 0)!=-1)
    ( 
      &match=1
    )
  )
  else if (&wild_head==1)
  (
    if (STRING.MID("venus0_ocmemnoc_clk", &clk_itr_length-&clk_input_length+1, &clk_input_length-1)==STRING.CUT("&clk", 1))
    ( 
      &match=1
    )
  )
  else if (&wild_tail==1)
  (
    if (STRING.MID("venus0_ocmemnoc_clk", 0, &clk_input_length-1)==STRING.CUT("&clk", -1))
    ( 
      &match=1
    )
  )	  
  else if ("venus0_ocmemnoc_clk"=="&clk")
  (
    &match=1
  )
  
  if (&match==1)
  (
    &clk_test=&CLK_TEST_VENUS0_OCMEMNOC_CLK
    &clk_reg=&HWIO_MMSS_VENUS0_OCMEMNOC_CBCR_ADDR
    &clk_reg_name="MMSS_VENUS0_OCMEMNOC_CBCR"
    &clk_name="venus0_ocmemnoc_clk"
    &clk_reg_cbcr_type="sm_pscbc"

    gosub Print_Clk_Info_Line
  )
  
  &match=0
  &wild_head=0
  &wild_tail=0
  &clk_input_length=STRING.LENGTH("&clk")
  &clk_itr_length=STRING.LENGTH("venus0_vcodec0_clk")

  if (STRING.SCAN("&clk", "*", 0)==0)
  (
    &wild_head=1
  )
  if (STRING.SCAN("&clk", "*", 1)==(STRING.LENGTH("&clk")-1))
  (
    &wild_tail=1
  )

  if ((&wild_head==1)&&(&wild_tail==1))
  (
    if (STRING.SCAN("venus0_vcodec0_clk", STRING.MID("&clk", 1, &clk_input_length-2), 0)!=-1)
    ( 
      &match=1
    )
  )
  else if (&wild_head==1)
  (
    if (STRING.MID("venus0_vcodec0_clk", &clk_itr_length-&clk_input_length+1, &clk_input_length-1)==STRING.CUT("&clk", 1))
    ( 
      &match=1
    )
  )
  else if (&wild_tail==1)
  (
    if (STRING.MID("venus0_vcodec0_clk", 0, &clk_input_length-1)==STRING.CUT("&clk", -1))
    ( 
      &match=1
    )
  )	  
  else if ("venus0_vcodec0_clk"=="&clk")
  (
    &match=1
  )
  
  if (&match==1)
  (
    &clk_test=&CLK_TEST_VENUS0_VCODEC0_CLK
    &clk_reg=&HWIO_MMSS_VENUS0_VCODEC0_CBCR_ADDR
    &clk_reg_name="MMSS_VENUS0_VCODEC0_CBCR"
    &clk_name="venus0_vcodec0_clk"
    &clk_reg_cbcr_type="sm_pscbc"

    gosub Print_Clk_Info_Line
  )
  
  &match=0
  &wild_head=0
  &wild_tail=0
  &clk_input_length=STRING.LENGTH("&clk")
  &clk_itr_length=STRING.LENGTH("vpu_ahb_clk")

  if (STRING.SCAN("&clk", "*", 0)==0)
  (
    &wild_head=1
  )
  if (STRING.SCAN("&clk", "*", 1)==(STRING.LENGTH("&clk")-1))
  (
    &wild_tail=1
  )

  if ((&wild_head==1)&&(&wild_tail==1))
  (
    if (STRING.SCAN("vpu_ahb_clk", STRING.MID("&clk", 1, &clk_input_length-2), 0)!=-1)
    ( 
      &match=1
    )
  )
  else if (&wild_head==1)
  (
    if (STRING.MID("vpu_ahb_clk", &clk_itr_length-&clk_input_length+1, &clk_input_length-1)==STRING.CUT("&clk", 1))
    ( 
      &match=1
    )
  )
  else if (&wild_tail==1)
  (
    if (STRING.MID("vpu_ahb_clk", 0, &clk_input_length-1)==STRING.CUT("&clk", -1))
    ( 
      &match=1
    )
  )	  
  else if ("vpu_ahb_clk"=="&clk")
  (
    &match=1
  )
  
  if (&match==1)
  (
    &clk_test=&CLK_TEST_VPU_AHB_CLK
    &clk_reg=&HWIO_MMSS_VPU_AHB_CBCR_ADDR
    &clk_reg_name="MMSS_VPU_AHB_CBCR"
    &clk_name="vpu_ahb_clk"
    &clk_reg_cbcr_type="sm_cbc"

    gosub Print_Clk_Info_Line
  )
  
  &match=0
  &wild_head=0
  &wild_tail=0
  &clk_input_length=STRING.LENGTH("&clk")
  &clk_itr_length=STRING.LENGTH("vpu_axi_clk")

  if (STRING.SCAN("&clk", "*", 0)==0)
  (
    &wild_head=1
  )
  if (STRING.SCAN("&clk", "*", 1)==(STRING.LENGTH("&clk")-1))
  (
    &wild_tail=1
  )

  if ((&wild_head==1)&&(&wild_tail==1))
  (
    if (STRING.SCAN("vpu_axi_clk", STRING.MID("&clk", 1, &clk_input_length-2), 0)!=-1)
    ( 
      &match=1
    )
  )
  else if (&wild_head==1)
  (
    if (STRING.MID("vpu_axi_clk", &clk_itr_length-&clk_input_length+1, &clk_input_length-1)==STRING.CUT("&clk", 1))
    ( 
      &match=1
    )
  )
  else if (&wild_tail==1)
  (
    if (STRING.MID("vpu_axi_clk", 0, &clk_input_length-1)==STRING.CUT("&clk", -1))
    ( 
      &match=1
    )
  )	  
  else if ("vpu_axi_clk"=="&clk")
  (
    &match=1
  )
  
  if (&match==1)
  (
    &clk_test=&CLK_TEST_VPU_AXI_CLK
    &clk_reg=&HWIO_MMSS_VPU_AXI_CBCR_ADDR
    &clk_reg_name="MMSS_VPU_AXI_CBCR"
    &clk_name="vpu_axi_clk"
    &clk_reg_cbcr_type="sm_pscbc"

    gosub Print_Clk_Info_Line
  )
  
  &match=0
  &wild_head=0
  &wild_tail=0
  &clk_input_length=STRING.LENGTH("&clk")
  &clk_itr_length=STRING.LENGTH("vpu_bus_clk")

  if (STRING.SCAN("&clk", "*", 0)==0)
  (
    &wild_head=1
  )
  if (STRING.SCAN("&clk", "*", 1)==(STRING.LENGTH("&clk")-1))
  (
    &wild_tail=1
  )

  if ((&wild_head==1)&&(&wild_tail==1))
  (
    if (STRING.SCAN("vpu_bus_clk", STRING.MID("&clk", 1, &clk_input_length-2), 0)!=-1)
    ( 
      &match=1
    )
  )
  else if (&wild_head==1)
  (
    if (STRING.MID("vpu_bus_clk", &clk_itr_length-&clk_input_length+1, &clk_input_length-1)==STRING.CUT("&clk", 1))
    ( 
      &match=1
    )
  )
  else if (&wild_tail==1)
  (
    if (STRING.MID("vpu_bus_clk", 0, &clk_input_length-1)==STRING.CUT("&clk", -1))
    ( 
      &match=1
    )
  )	  
  else if ("vpu_bus_clk"=="&clk")
  (
    &match=1
  )
  
  if (&match==1)
  (
    &clk_test=&CLK_TEST_VPU_BUS_CLK
    &clk_reg=&HWIO_MMSS_VPU_BUS_CBCR_ADDR
    &clk_reg_name="MMSS_VPU_BUS_CBCR"
    &clk_name="vpu_bus_clk"
    &clk_reg_cbcr_type="sm_cbc"

    gosub Print_Clk_Info_Line
  )
  
  &match=0
  &wild_head=0
  &wild_tail=0
  &clk_input_length=STRING.LENGTH("&clk")
  &clk_itr_length=STRING.LENGTH("vpu_cxo_clk")

  if (STRING.SCAN("&clk", "*", 0)==0)
  (
    &wild_head=1
  )
  if (STRING.SCAN("&clk", "*", 1)==(STRING.LENGTH("&clk")-1))
  (
    &wild_tail=1
  )

  if ((&wild_head==1)&&(&wild_tail==1))
  (
    if (STRING.SCAN("vpu_cxo_clk", STRING.MID("&clk", 1, &clk_input_length-2), 0)!=-1)
    ( 
      &match=1
    )
  )
  else if (&wild_head==1)
  (
    if (STRING.MID("vpu_cxo_clk", &clk_itr_length-&clk_input_length+1, &clk_input_length-1)==STRING.CUT("&clk", 1))
    ( 
      &match=1
    )
  )
  else if (&wild_tail==1)
  (
    if (STRING.MID("vpu_cxo_clk", 0, &clk_input_length-1)==STRING.CUT("&clk", -1))
    ( 
      &match=1
    )
  )	  
  else if ("vpu_cxo_clk"=="&clk")
  (
    &match=1
  )
  
  if (&match==1)
  (
    &clk_test=&CLK_TEST_VPU_CXO_CLK
    &clk_reg=&HWIO_MMSS_VPU_CXO_CBCR_ADDR
    &clk_reg_name="MMSS_VPU_CXO_CBCR"
    &clk_name="vpu_cxo_clk"
    &clk_reg_cbcr_type="sm_cbc"

    gosub Print_Clk_Info_Line
  )
  
  &match=0
  &wild_head=0
  &wild_tail=0
  &clk_input_length=STRING.LENGTH("&clk")
  &clk_itr_length=STRING.LENGTH("vpu_maple_clk")

  if (STRING.SCAN("&clk", "*", 0)==0)
  (
    &wild_head=1
  )
  if (STRING.SCAN("&clk", "*", 1)==(STRING.LENGTH("&clk")-1))
  (
    &wild_tail=1
  )

  if ((&wild_head==1)&&(&wild_tail==1))
  (
    if (STRING.SCAN("vpu_maple_clk", STRING.MID("&clk", 1, &clk_input_length-2), 0)!=-1)
    ( 
      &match=1
    )
  )
  else if (&wild_head==1)
  (
    if (STRING.MID("vpu_maple_clk", &clk_itr_length-&clk_input_length+1, &clk_input_length-1)==STRING.CUT("&clk", 1))
    ( 
      &match=1
    )
  )
  else if (&wild_tail==1)
  (
    if (STRING.MID("vpu_maple_clk", 0, &clk_input_length-1)==STRING.CUT("&clk", -1))
    ( 
      &match=1
    )
  )	  
  else if ("vpu_maple_clk"=="&clk")
  (
    &match=1
  )
  
  if (&match==1)
  (
    &clk_test=&CLK_TEST_VPU_MAPLE_CLK
    &clk_reg=&HWIO_MMSS_VPU_MAPLE_CBCR_ADDR
    &clk_reg_name="MMSS_VPU_MAPLE_CBCR"
    &clk_name="vpu_maple_clk"
    &clk_reg_cbcr_type="sm_pscbc"

    gosub Print_Clk_Info_Line
  )
  
  &match=0
  &wild_head=0
  &wild_tail=0
  &clk_input_length=STRING.LENGTH("&clk")
  &clk_itr_length=STRING.LENGTH("vpu_sleep_clk")

  if (STRING.SCAN("&clk", "*", 0)==0)
  (
    &wild_head=1
  )
  if (STRING.SCAN("&clk", "*", 1)==(STRING.LENGTH("&clk")-1))
  (
    &wild_tail=1
  )

  if ((&wild_head==1)&&(&wild_tail==1))
  (
    if (STRING.SCAN("vpu_sleep_clk", STRING.MID("&clk", 1, &clk_input_length-2), 0)!=-1)
    ( 
      &match=1
    )
  )
  else if (&wild_head==1)
  (
    if (STRING.MID("vpu_sleep_clk", &clk_itr_length-&clk_input_length+1, &clk_input_length-1)==STRING.CUT("&clk", 1))
    ( 
      &match=1
    )
  )
  else if (&wild_tail==1)
  (
    if (STRING.MID("vpu_sleep_clk", 0, &clk_input_length-1)==STRING.CUT("&clk", -1))
    ( 
      &match=1
    )
  )	  
  else if ("vpu_sleep_clk"=="&clk")
  (
    &match=1
  )
  
  if (&match==1)
  (
    &clk_test=&CLK_TEST_VPU_SLEEP_CLK
    &clk_reg=&HWIO_MMSS_VPU_SLEEP_CBCR_ADDR
    &clk_reg_name="MMSS_VPU_SLEEP_CBCR"
    &clk_name="vpu_sleep_clk"
    &clk_reg_cbcr_type="sm_cbc"

    gosub Print_Clk_Info_Line
  )
  
  &match=0
  &wild_head=0
  &wild_tail=0
  &clk_input_length=STRING.LENGTH("&clk")
  &clk_itr_length=STRING.LENGTH("vpu_vdp_clk")

  if (STRING.SCAN("&clk", "*", 0)==0)
  (
    &wild_head=1
  )
  if (STRING.SCAN("&clk", "*", 1)==(STRING.LENGTH("&clk")-1))
  (
    &wild_tail=1
  )

  if ((&wild_head==1)&&(&wild_tail==1))
  (
    if (STRING.SCAN("vpu_vdp_clk", STRING.MID("&clk", 1, &clk_input_length-2), 0)!=-1)
    ( 
      &match=1
    )
  )
  else if (&wild_head==1)
  (
    if (STRING.MID("vpu_vdp_clk", &clk_itr_length-&clk_input_length+1, &clk_input_length-1)==STRING.CUT("&clk", 1))
    ( 
      &match=1
    )
  )
  else if (&wild_tail==1)
  (
    if (STRING.MID("vpu_vdp_clk", 0, &clk_input_length-1)==STRING.CUT("&clk", -1))
    ( 
      &match=1
    )
  )	  
  else if ("vpu_vdp_clk"=="&clk")
  (
    &match=1
  )
  
  if (&match==1)
  (
    &clk_test=&CLK_TEST_VPU_VDP_CLK
    &clk_reg=&HWIO_MMSS_VPU_VDP_CBCR_ADDR
    &clk_reg_name="MMSS_VPU_VDP_CBCR"
    &clk_name="vpu_vdp_clk"
    &clk_reg_cbcr_type="sm_pscbc"

    gosub Print_Clk_Info_Line
  )
  
; Setting appropriate access mode for non-MSS clocks
&clk_access_mod="eahb:"

  &match=0
  &wild_head=0
  &wild_tail=0
  &clk_input_length=STRING.LENGTH("&clk")
  &clk_itr_length=STRING.LENGTH("apcs_c0_clk")

  if (STRING.SCAN("&clk", "*", 0)==0)
  (
    &wild_head=1
  )
  if (STRING.SCAN("&clk", "*", 1)==(STRING.LENGTH("&clk")-1))
  (
    &wild_tail=1
  )

  if ((&wild_head==1)&&(&wild_tail==1))
  (
    if (STRING.SCAN("apcs_c0_clk", STRING.MID("&clk", 1, &clk_input_length-2), 0)!=-1)
    ( 
      &match=1
    )
  )
  else if (&wild_head==1)
  (
    if (STRING.MID("apcs_c0_clk", &clk_itr_length-&clk_input_length+1, &clk_input_length-1)==STRING.CUT("&clk", 1))
    ( 
      &match=1
    )
  )
  else if (&wild_tail==1)
  (
    if (STRING.MID("apcs_c0_clk", 0, &clk_input_length-1)==STRING.CUT("&clk", -1))
    ( 
      &match=1
    )
  )	  
  else if ("apcs_c0_clk"=="&clk")
  (
    &match=1
  )
  
  ; This clock belongs to the 'cpus' display group.
  if ("cpus"=="&clk")
  (
    &match=1	  
  )
  
  if (&match==1)
  (
    &clk_test=&CLK_TEST_APCS_C0_CLK
    &clk_reg=0
    &clk_reg_name="No CBCR"
    &clk_name="apcs_c0_clk"
    &clk_reg_cbcr_type=""

    gosub Print_Clk_Info_Line
  )
  
  &match=0
  &wild_head=0
  &wild_tail=0
  &clk_input_length=STRING.LENGTH("&clk")
  &clk_itr_length=STRING.LENGTH("apcs_c1_clk")

  if (STRING.SCAN("&clk", "*", 0)==0)
  (
    &wild_head=1
  )
  if (STRING.SCAN("&clk", "*", 1)==(STRING.LENGTH("&clk")-1))
  (
    &wild_tail=1
  )

  if ((&wild_head==1)&&(&wild_tail==1))
  (
    if (STRING.SCAN("apcs_c1_clk", STRING.MID("&clk", 1, &clk_input_length-2), 0)!=-1)
    ( 
      &match=1
    )
  )
  else if (&wild_head==1)
  (
    if (STRING.MID("apcs_c1_clk", &clk_itr_length-&clk_input_length+1, &clk_input_length-1)==STRING.CUT("&clk", 1))
    ( 
      &match=1
    )
  )
  else if (&wild_tail==1)
  (
    if (STRING.MID("apcs_c1_clk", 0, &clk_input_length-1)==STRING.CUT("&clk", -1))
    ( 
      &match=1
    )
  )	  
  else if ("apcs_c1_clk"=="&clk")
  (
    &match=1
  )
  
  ; This clock belongs to the 'cpus' display group.
  if ("cpus"=="&clk")
  (
    &match=1	  
  )
  
  if (&match==1)
  (
    &clk_test=&CLK_TEST_APCS_C1_CLK
    &clk_reg=0
    &clk_reg_name="No CBCR"
    &clk_name="apcs_c1_clk"
    &clk_reg_cbcr_type=""

    gosub Print_Clk_Info_Line
  )
  
  &match=0
  &wild_head=0
  &wild_tail=0
  &clk_input_length=STRING.LENGTH("&clk")
  &clk_itr_length=STRING.LENGTH("apcs_c2_clk")

  if (STRING.SCAN("&clk", "*", 0)==0)
  (
    &wild_head=1
  )
  if (STRING.SCAN("&clk", "*", 1)==(STRING.LENGTH("&clk")-1))
  (
    &wild_tail=1
  )

  if ((&wild_head==1)&&(&wild_tail==1))
  (
    if (STRING.SCAN("apcs_c2_clk", STRING.MID("&clk", 1, &clk_input_length-2), 0)!=-1)
    ( 
      &match=1
    )
  )
  else if (&wild_head==1)
  (
    if (STRING.MID("apcs_c2_clk", &clk_itr_length-&clk_input_length+1, &clk_input_length-1)==STRING.CUT("&clk", 1))
    ( 
      &match=1
    )
  )
  else if (&wild_tail==1)
  (
    if (STRING.MID("apcs_c2_clk", 0, &clk_input_length-1)==STRING.CUT("&clk", -1))
    ( 
      &match=1
    )
  )	  
  else if ("apcs_c2_clk"=="&clk")
  (
    &match=1
  )
  
  ; This clock belongs to the 'cpus' display group.
  if ("cpus"=="&clk")
  (
    &match=1	  
  )
  
  if (&match==1)
  (
    &clk_test=&CLK_TEST_APCS_C2_CLK
    &clk_reg=0
    &clk_reg_name="No CBCR"
    &clk_name="apcs_c2_clk"
    &clk_reg_cbcr_type=""

    gosub Print_Clk_Info_Line
  )
  
  &match=0
  &wild_head=0
  &wild_tail=0
  &clk_input_length=STRING.LENGTH("&clk")
  &clk_itr_length=STRING.LENGTH("apcs_c3_clk")

  if (STRING.SCAN("&clk", "*", 0)==0)
  (
    &wild_head=1
  )
  if (STRING.SCAN("&clk", "*", 1)==(STRING.LENGTH("&clk")-1))
  (
    &wild_tail=1
  )

  if ((&wild_head==1)&&(&wild_tail==1))
  (
    if (STRING.SCAN("apcs_c3_clk", STRING.MID("&clk", 1, &clk_input_length-2), 0)!=-1)
    ( 
      &match=1
    )
  )
  else if (&wild_head==1)
  (
    if (STRING.MID("apcs_c3_clk", &clk_itr_length-&clk_input_length+1, &clk_input_length-1)==STRING.CUT("&clk", 1))
    ( 
      &match=1
    )
  )
  else if (&wild_tail==1)
  (
    if (STRING.MID("apcs_c3_clk", 0, &clk_input_length-1)==STRING.CUT("&clk", -1))
    ( 
      &match=1
    )
  )	  
  else if ("apcs_c3_clk"=="&clk")
  (
    &match=1
  )
  
  ; This clock belongs to the 'cpus' display group.
  if ("cpus"=="&clk")
  (
    &match=1	  
  )
  
  if (&match==1)
  (
    &clk_test=&CLK_TEST_APCS_C3_CLK
    &clk_reg=0
    &clk_reg_name="No CBCR"
    &clk_name="apcs_c3_clk"
    &clk_reg_cbcr_type=""

    gosub Print_Clk_Info_Line
  )
  
  &match=0
  &wild_head=0
  &wild_tail=0
  &clk_input_length=STRING.LENGTH("&clk")
  &clk_itr_length=STRING.LENGTH("apcs_l2_clk")

  if (STRING.SCAN("&clk", "*", 0)==0)
  (
    &wild_head=1
  )
  if (STRING.SCAN("&clk", "*", 1)==(STRING.LENGTH("&clk")-1))
  (
    &wild_tail=1
  )

  if ((&wild_head==1)&&(&wild_tail==1))
  (
    if (STRING.SCAN("apcs_l2_clk", STRING.MID("&clk", 1, &clk_input_length-2), 0)!=-1)
    ( 
      &match=1
    )
  )
  else if (&wild_head==1)
  (
    if (STRING.MID("apcs_l2_clk", &clk_itr_length-&clk_input_length+1, &clk_input_length-1)==STRING.CUT("&clk", 1))
    ( 
      &match=1
    )
  )
  else if (&wild_tail==1)
  (
    if (STRING.MID("apcs_l2_clk", 0, &clk_input_length-1)==STRING.CUT("&clk", -1))
    ( 
      &match=1
    )
  )	  
  else if ("apcs_l2_clk"=="&clk")
  (
    &match=1
  )
  
  ; This clock belongs to the 'cpus' display group.
  if ("cpus"=="&clk")
  (
    &match=1	  
  )
  
  if (&match==1)
  (
    &clk_test=&CLK_TEST_APCS_L2_CLK
    &clk_reg=&HWIO_APCS_L2_CBCR_ADDR
    &clk_reg_name="APCS_L2_CBCR"
    &clk_name="apcs_l2_clk"
    &clk_reg_cbcr_type=""

    gosub Print_Clk_Info_Line
  )
  
  &match=0
  &wild_head=0
  &wild_tail=0
  &clk_input_length=STRING.LENGTH("&clk")
  &clk_itr_length=STRING.LENGTH("apcs_spisleep_clk")

  if (STRING.SCAN("&clk", "*", 0)==0)
  (
    &wild_head=1
  )
  if (STRING.SCAN("&clk", "*", 1)==(STRING.LENGTH("&clk")-1))
  (
    &wild_tail=1
  )

  if ((&wild_head==1)&&(&wild_tail==1))
  (
    if (STRING.SCAN("apcs_spisleep_clk", STRING.MID("&clk", 1, &clk_input_length-2), 0)!=-1)
    ( 
      &match=1
    )
  )
  else if (&wild_head==1)
  (
    if (STRING.MID("apcs_spisleep_clk", &clk_itr_length-&clk_input_length+1, &clk_input_length-1)==STRING.CUT("&clk", 1))
    ( 
      &match=1
    )
  )
  else if (&wild_tail==1)
  (
    if (STRING.MID("apcs_spisleep_clk", 0, &clk_input_length-1)==STRING.CUT("&clk", -1))
    ( 
      &match=1
    )
  )	  
  else if ("apcs_spisleep_clk"=="&clk")
  (
    &match=1
  )
  
  if (&match==1)
  (
    &clk_test=&CLK_TEST_APCS_SPISLEEP_CLK
    &clk_reg=0
    &clk_reg_name="No CBCR"
    &clk_name="apcs_spisleep_clk"
    &clk_reg_cbcr_type=""

    gosub Print_Clk_Info_Line
  )
  
  &match=0
  &wild_head=0
  &wild_tail=0
  &clk_input_length=STRING.LENGTH("&clk")
  &clk_itr_length=STRING.LENGTH("apcs_sysahb_clk")

  if (STRING.SCAN("&clk", "*", 0)==0)
  (
    &wild_head=1
  )
  if (STRING.SCAN("&clk", "*", 1)==(STRING.LENGTH("&clk")-1))
  (
    &wild_tail=1
  )

  if ((&wild_head==1)&&(&wild_tail==1))
  (
    if (STRING.SCAN("apcs_sysahb_clk", STRING.MID("&clk", 1, &clk_input_length-2), 0)!=-1)
    ( 
      &match=1
    )
  )
  else if (&wild_head==1)
  (
    if (STRING.MID("apcs_sysahb_clk", &clk_itr_length-&clk_input_length+1, &clk_input_length-1)==STRING.CUT("&clk", 1))
    ( 
      &match=1
    )
  )
  else if (&wild_tail==1)
  (
    if (STRING.MID("apcs_sysahb_clk", 0, &clk_input_length-1)==STRING.CUT("&clk", -1))
    ( 
      &match=1
    )
  )	  
  else if ("apcs_sysahb_clk"=="&clk")
  (
    &match=1
  )
  
  if (&match==1)
  (
    &clk_test=&CLK_TEST_APCS_SYSAHB_CLK
    &clk_reg=0
    &clk_reg_name="No CBCR"
    &clk_name="apcs_sysahb_clk"
    &clk_reg_cbcr_type=""

    gosub Print_Clk_Info_Line
  )
  
  &match=0
  &wild_head=0
  &wild_tail=0
  &clk_input_length=STRING.LENGTH("&clk")
  &clk_itr_length=STRING.LENGTH("apcs_sysqsb_clk")

  if (STRING.SCAN("&clk", "*", 0)==0)
  (
    &wild_head=1
  )
  if (STRING.SCAN("&clk", "*", 1)==(STRING.LENGTH("&clk")-1))
  (
    &wild_tail=1
  )

  if ((&wild_head==1)&&(&wild_tail==1))
  (
    if (STRING.SCAN("apcs_sysqsb_clk", STRING.MID("&clk", 1, &clk_input_length-2), 0)!=-1)
    ( 
      &match=1
    )
  )
  else if (&wild_head==1)
  (
    if (STRING.MID("apcs_sysqsb_clk", &clk_itr_length-&clk_input_length+1, &clk_input_length-1)==STRING.CUT("&clk", 1))
    ( 
      &match=1
    )
  )
  else if (&wild_tail==1)
  (
    if (STRING.MID("apcs_sysqsb_clk", 0, &clk_input_length-1)==STRING.CUT("&clk", -1))
    ( 
      &match=1
    )
  )	  
  else if ("apcs_sysqsb_clk"=="&clk")
  (
    &match=1
  )
  
  if (&match==1)
  (
    &clk_test=&CLK_TEST_APCS_SYSQSB_CLK
    &clk_reg=0
    &clk_reg_name="No CBCR"
    &clk_name="apcs_sysqsb_clk"
    &clk_reg_cbcr_type=""

    gosub Print_Clk_Info_Line
  )
  
  &match=0
  &wild_head=0
  &wild_tail=0
  &clk_input_length=STRING.LENGTH("&clk")
  &clk_itr_length=STRING.LENGTH("apcs_sysref_clk")

  if (STRING.SCAN("&clk", "*", 0)==0)
  (
    &wild_head=1
  )
  if (STRING.SCAN("&clk", "*", 1)==(STRING.LENGTH("&clk")-1))
  (
    &wild_tail=1
  )

  if ((&wild_head==1)&&(&wild_tail==1))
  (
    if (STRING.SCAN("apcs_sysref_clk", STRING.MID("&clk", 1, &clk_input_length-2), 0)!=-1)
    ( 
      &match=1
    )
  )
  else if (&wild_head==1)
  (
    if (STRING.MID("apcs_sysref_clk", &clk_itr_length-&clk_input_length+1, &clk_input_length-1)==STRING.CUT("&clk", 1))
    ( 
      &match=1
    )
  )
  else if (&wild_tail==1)
  (
    if (STRING.MID("apcs_sysref_clk", 0, &clk_input_length-1)==STRING.CUT("&clk", -1))
    ( 
      &match=1
    )
  )	  
  else if ("apcs_sysref_clk"=="&clk")
  (
    &match=1
  )
  
  if (&match==1)
  (
    &clk_test=&CLK_TEST_APCS_SYSREF_CLK
    &clk_reg=0
    &clk_reg_name="No CBCR"
    &clk_name="apcs_sysref_clk"
    &clk_reg_cbcr_type=""

    gosub Print_Clk_Info_Line
  )
  

  return
  


Set_Clock_Freq_Enter:


  print ""
  print "The selected clock does not support frequency configuration. Returning."
  print ""
  return
  
