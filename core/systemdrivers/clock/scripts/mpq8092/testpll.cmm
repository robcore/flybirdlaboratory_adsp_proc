
;============================================================================
;
; *************** THIS SCRIPT WAS AUTOGENERATED - 11/8/2013 *****************
;
; TARGET
;   mpq8092
;
; SCRIPT
;   testpll.cmm - LPASS
;
; GENERAL DESCRIPTION
;   This script can be used to lookup PLL config/status/frequency values.
;
; FUNCTIONS
;   N/A
;
; INITIALIZATION AND SEQUENCING REQUIREMENTS
;
;      Copyright (c) 2013 by Qualcomm Technologies, Inc.  All Rights Reserved.
;============================================================================

;-----------------------------------------------------------------------------
; Local variables
;-----------------------------------------------------------------------------
local &subscript
local &clk_ref
local &l_val
local &m_val
local &n_val
local &pre_div
local &post_div
local &pll_test
local &pll_early
local &pll_aux2
local &pll_aux
local &pll_main
local &post_div
local &pre_div
local &pll_clk
local &pll_mode
local &pll_status
local &pll_user_ctl
local &vote_reg
local &is_mpss
local &is_q6
local &pll0
local &pll1
local &pll2
local &pll3
local &pll5
local &pll6
local &pll10
local &pll11

;-----------------------------------------------------------------------------
; Define the window
;-----------------------------------------------------------------------------
&subscript=0

ENTRY &subscript

if "&subscript"==""
(
  AREA.RESet
  WINPOS 0. 0. 100% 100%
  AREA.Create CLOCK
  AREA.view CLOCK
)

AREA.Select CLOCK
AREA.Clear CLOCK


;-----------------------------------------------------------------------------
; Error handler
;-----------------------------------------------------------------------------

on ERROR gosub
(
  print "An Error has Occurred"
  
  return
)


print ""
print ""
print "[------------------------------------------------- TEST PLL TOOL -------------------------------------------------]"
print ""


goto Init_Constants
Init_Constants_Done:

Help:

print "1: Configurations"
print "2: Votes"
print "3: Mode/Status Dump"
print ""
print "x: Exit"
print ""


;-----------------------------------------------------------------------------
; Main Menu
;-----------------------------------------------------------------------------

Main_Menu:

print "Enter option (? for help):"
enter &choice
print "&choice"

if "&choice"=="?"
(
  goto Help
)
else if "&choice"=="x"
(
  if "&subscript"==""
  (
    AREA.CLEAR CLOCK
    AREA.RESET
    WINCLEAR
    term.close 
  )
  
  enddo (0==0)
)
else if &choice==1
(
  gosub Display_Configurations
)
else if &choice==2
(
  gosub Display_Votes
)
else if &choice==3
(
  gosub Display_Dump
)
else
(
  print "Invalid selection"
)

GOTO Main_Menu


;-----------------------------------------------------------------------------
; Sub-functions
;-----------------------------------------------------------------------------

Init_Constants:

  &is_mpss=0
  &is_q6=1

  &HWIO_PLL_L_VAL_MASK=0xFF
  &HWIO_PLL_M_VAL_MASK=0x7FFFF
  &HWIO_PLL_N_VAL_MASK=0x7FFFF

  ; GCC PLL Vote Registers
  &HWIO_GCC_RPM_GPLL_ENA_VOTE_ADDR=0xFC401440
  &HWIO_GCC_APCS_GPLL_ENA_VOTE_ADDR=0xFC401480
  &HWIO_GCC_APCS_TZ_GPLL_ENA_VOTE_ADDR=0xFC4014C0
  &HWIO_GCC_LPASS_DSP_GPLL_ENA_VOTE_ADDR=0xFC401540
  &HWIO_GCC_SPARE_GPLL_ENA_VOTE_ADDR=0xFC4015C0

  ; LPASS PLL Vote Registers
  &HWIO_LPASS_LPA_PLL_VOTE_APPS_ADDR=0xFE002000
  &HWIO_LPASS_LPA_PLL_VOTE_LPASSQ6_ADDR=0xFE003000
  
  ; MMSS PLL Vote Registers
  &HWIO_MMSS_PLL_VOTE_APCS_ADDR=0xFD8C0100
  &HWIO_MMSS_PLL_VOTE_RPM_ADDR=0xFD8C4200
  
  &HWIO_GCC_GPLL0_MODE_ADDR=0xFC400000
  &HWIO_GCC_GPLL0_L_VAL_ADDR=0xFC400004
  &HWIO_GCC_GPLL0_M_VAL_ADDR=0xFC400008
  &HWIO_GCC_GPLL0_N_VAL_ADDR=0xFC40000C
  &HWIO_GCC_GPLL0_USER_CTL_ADDR=0xFC400010
  &HWIO_GCC_GPLL0_TEST_CTL_ADDR=0xFC400018
  &HWIO_GCC_GPLL0_STATUS_ADDR=0xFC40001C

  &HWIO_GCC_GPLL1_MODE_ADDR=0xFC400040
  &HWIO_GCC_GPLL1_L_VAL_ADDR=0xFC400044
  &HWIO_GCC_GPLL1_M_VAL_ADDR=0xFC400048
  &HWIO_GCC_GPLL1_N_VAL_ADDR=0xFC40004C
  &HWIO_GCC_GPLL1_USER_CTL_ADDR=0xFC400050
  &HWIO_GCC_GPLL1_TEST_CTL_ADDR=0xFC400058
  &HWIO_GCC_GPLL1_STATUS_ADDR=0xFC40005C

  &HWIO_GCC_GPLL2_MODE_ADDR=0xFC400080
  &HWIO_GCC_GPLL2_L_VAL_ADDR=0xFC400084
  &HWIO_GCC_GPLL2_M_VAL_ADDR=0xFC400088
  &HWIO_GCC_GPLL2_N_VAL_ADDR=0xFC40008C
  &HWIO_GCC_GPLL2_USER_CTL_ADDR=0xFC400090
  &HWIO_GCC_GPLL2_TEST_CTL_ADDR=0xFC400098
  &HWIO_GCC_GPLL2_STATUS_ADDR=0xFC40009C

  &HWIO_GCC_GPLL3_MODE_ADDR=0xFC4000C0
  &HWIO_GCC_GPLL3_L_VAL_ADDR=0xFC4000C4
  &HWIO_GCC_GPLL3_M_VAL_ADDR=0xFC4000C8
  &HWIO_GCC_GPLL3_N_VAL_ADDR=0xFC4000CC
  &HWIO_GCC_GPLL3_USER_CTL_ADDR=0xFC4000D0
  &HWIO_GCC_GPLL3_TEST_CTL_ADDR=0xFC4000D8
  &HWIO_GCC_GPLL3_STATUS_ADDR=0xFC4000DC

  &HWIO_MMSS_MMPLL0_PLL_MODE_ADDR=0xFD8C0000
  &HWIO_MMSS_MMPLL0_PLL_L_VAL_ADDR=0xFD8C0004
  &HWIO_MMSS_MMPLL0_PLL_M_VAL_ADDR=0xFD8C0008
  &HWIO_MMSS_MMPLL0_PLL_N_VAL_ADDR=0xFD8C000C
  &HWIO_MMSS_MMPLL0_PLL_USER_CTL_ADDR=0xFD8C0010
  &HWIO_MMSS_MMPLL0_PLL_TEST_CTL_ADDR=0xFD8C0018
  &HWIO_MMSS_MMPLL0_PLL_STATUS_ADDR=0xFD8C001C

  &HWIO_MMSS_MMPLL1_PLL_MODE_ADDR=0xFD8C0040
  &HWIO_MMSS_MMPLL1_PLL_L_VAL_ADDR=0xFD8C0044
  &HWIO_MMSS_MMPLL1_PLL_M_VAL_ADDR=0xFD8C0048
  &HWIO_MMSS_MMPLL1_PLL_N_VAL_ADDR=0xFD8C004C
  &HWIO_MMSS_MMPLL1_PLL_USER_CTL_ADDR=0xFD8C0050
  &HWIO_MMSS_MMPLL1_PLL_TEST_CTL_ADDR=0xFD8C0058
  &HWIO_MMSS_MMPLL1_PLL_STATUS_ADDR=0xFD8C005C

  &HWIO_MMSS_MMPLL2_PLL_MODE_ADDR=0xFD8C4100
  &HWIO_MMSS_MMPLL2_PLL_L_VAL_ADDR=0xFD8C4104
  &HWIO_MMSS_MMPLL2_PLL_M_VAL_ADDR=0xFD8C4108
  &HWIO_MMSS_MMPLL2_PLL_N_VAL_ADDR=0xFD8C410C
  &HWIO_MMSS_MMPLL2_PLL_USER_CTL_ADDR=0xFD8C4110
  &HWIO_MMSS_MMPLL2_PLL_TEST_CTL_ADDR=0xFD8C4118
  &HWIO_MMSS_MMPLL2_PLL_STATUS_ADDR=0xFD8C411C

  &HWIO_MMSS_MMPLL3_PLL_MODE_ADDR=0xFD8C0080
  &HWIO_MMSS_MMPLL3_PLL_L_VAL_ADDR=0xFD8C0084
  &HWIO_MMSS_MMPLL3_PLL_M_VAL_ADDR=0xFD8C0088
  &HWIO_MMSS_MMPLL3_PLL_N_VAL_ADDR=0xFD8C008C
  &HWIO_MMSS_MMPLL3_PLL_USER_CTL_ADDR=0xFD8C0090
  &HWIO_MMSS_MMPLL3_PLL_TEST_CTL_ADDR=0xFD8C0098
  &HWIO_MMSS_MMPLL3_PLL_STATUS_ADDR=0xFD8C009C

  &HWIO_MMSS_MMPLL6_PLL_MODE_ADDR=0xFD8C00E0
  &HWIO_MMSS_MMPLL6_PLL_L_VAL_ADDR=0xFD8C00E4
  &HWIO_MMSS_MMPLL6_PLL_M_VAL_ADDR=0xFD8C00E8
  &HWIO_MMSS_MMPLL6_PLL_N_VAL_ADDR=0xFD8C00EC
  &HWIO_MMSS_MMPLL6_PLL_USER_CTL_ADDR=0xFD8C00F0
  &HWIO_MMSS_MMPLL6_PLL_TEST_CTL_ADDR=0xFD8C00F8
  &HWIO_MMSS_MMPLL6_PLL_STATUS_ADDR=0xFD8C00FC

  &HWIO_LPASS_LPAAUDIO_PLL_MODE_ADDR=0xFE000000
  &HWIO_LPASS_LPAAUDIO_PLL_L_VAL_ADDR=0xFE000004
  &HWIO_LPASS_LPAAUDIO_PLL_M_VAL_ADDR=0xFE000008
  &HWIO_LPASS_LPAAUDIO_PLL_N_VAL_ADDR=0xFE00000C
  &HWIO_LPASS_LPAAUDIO_PLL_USER_CTL_ADDR=0xFE000010
  &HWIO_LPASS_LPAAUDIO_PLL_TEST_CTL_ADDR=0xFE000018
  &HWIO_LPASS_LPAAUDIO_PLL_STATUS_ADDR=0xFE00001C
  
  &HWIO_LPASS_LPAQ6_PLL_MODE_ADDR=0xFE001000
  &HWIO_LPASS_LPAQ6_PLL_L_VAL_ADDR=0xFE001004
  &HWIO_LPASS_LPAQ6_PLL_M_VAL_ADDR=0xFE001008
  &HWIO_LPASS_LPAQ6_PLL_N_VAL_ADDR=0xFE00100C
  &HWIO_LPASS_LPAQ6_PLL_USER_CTL_ADDR=0xFE001010
  &HWIO_LPASS_LPAQ6_PLL_TEST_CTL_ADDR=0xFE001018
  &HWIO_LPASS_LPAQ6_PLL_STATUS_ADDR=0xFE00101C

  &HWIO_APCS_ALIAS0_PLL_MODE_ADDR=0xF908A000
  &HWIO_APCS_ALIAS0_PLL_L_VAL_ADDR=0xF908A004
  &HWIO_APCS_ALIAS0_PLL_M_VAL_ADDR=0xF908A008
  &HWIO_APCS_ALIAS0_PLL_N_VAL_ADDR=0xF908A00C
  &HWIO_APCS_ALIAS0_PLL_USER_CTL_ADDR=0xF908A010
  &HWIO_APCS_ALIAS0_PLL_TEST_CTL_ADDR=0xF908A018
  &HWIO_APCS_ALIAS0_PLL_STATUS_ADDR=0xF908A01C
  
  &HWIO_APCS_ALIAS1_PLL_MODE_ADDR=0xF909A000
  &HWIO_APCS_ALIAS1_PLL_L_VAL_ADDR=0xF909A004
  &HWIO_APCS_ALIAS1_PLL_M_VAL_ADDR=0xF909A008
  &HWIO_APCS_ALIAS1_PLL_N_VAL_ADDR=0xF909A00C
  &HWIO_APCS_ALIAS1_PLL_USER_CTL_ADDR=0xF909A010
  &HWIO_APCS_ALIAS1_PLL_TEST_CTL_ADDR=0xF909A018
  &HWIO_APCS_ALIAS1_PLL_STATUS_ADDR=0xF909A01C
  
  &HWIO_APCS_ALIAS2_PLL_MODE_ADDR=0xF90AA000
  &HWIO_APCS_ALIAS2_PLL_L_VAL_ADDR=0xF90AA004
  &HWIO_APCS_ALIAS2_PLL_M_VAL_ADDR=0xF90AA008
  &HWIO_APCS_ALIAS2_PLL_N_VAL_ADDR=0xF90AA00C
  &HWIO_APCS_ALIAS2_PLL_USER_CTL_ADDR=0xF90AA010
  &HWIO_APCS_ALIAS2_PLL_TEST_CTL_ADDR=0xF90AA018
  &HWIO_APCS_ALIAS2_PLL_STATUS_ADDR=0xF90AA01C
  
  &HWIO_APCS_ALIAS3_PLL_MODE_ADDR=0xF90BA000
  &HWIO_APCS_ALIAS3_PLL_L_VAL_ADDR=0xF90BA004
  &HWIO_APCS_ALIAS3_PLL_M_VAL_ADDR=0xF90BA008
  &HWIO_APCS_ALIAS3_PLL_N_VAL_ADDR=0xF90BA00C
  &HWIO_APCS_ALIAS3_PLL_USER_CTL_ADDR=0xF90BA010
  &HWIO_APCS_ALIAS3_PLL_TEST_CTL_ADDR=0xF90BA018
  &HWIO_APCS_ALIAS3_PLL_STATUS_ADDR=0xF90BA01C
  
  &HWIO_APCS_L2_PLL_MODE_ADDR=0xF9016000
  &HWIO_APCS_L2_PLL_L_VAL_ADDR=0xF9016004
  &HWIO_APCS_L2_PLL_M_VAL_ADDR=0xF9016008
  &HWIO_APCS_L2_PLL_N_VAL_ADDR=0xF901600C
  &HWIO_APCS_L2_PLL_USER_CTL_ADDR=0xF9016010
  &HWIO_APCS_L2_PLL_TEST_CTL_ADDR=0xF9016018
  &HWIO_APCS_L2_PLL_STATUS_ADDR=0xF901601C
  
  &HWIO_BCC_PLL0_MODE_ADDR=0xFC744000
  &HWIO_BCC_PLL0_L_VAL_ADDR=0xFC744004
  &HWIO_BCC_PLL0_M_VAL_ADDR=0xFC744008
  &HWIO_BCC_PLL0_N_VAL_ADDR=0xFC74400C
  &HWIO_BCC_PLL0_USER_CTL_ADDR=0xFC744010
  &HWIO_BCC_PLL0_TEST_CTL_ADDR=0xFC744018
  &HWIO_BCC_PLL0_STATUS_ADDR=0xFC74401C
		  
  &HWIO_BCC_PLL1_MODE_ADDR=0xFC744020
  &HWIO_BCC_PLL1_L_VAL_ADDR=0xFC744024
  &HWIO_BCC_PLL1_M_VAL_ADDR=0xFC744028
  &HWIO_BCC_PLL1_N_VAL_ADDR=0xFC74402C
  &HWIO_BCC_PLL1_USER_CTL_ADDR=0xFC744030
  &HWIO_BCC_PLL1_TEST_CTL_ADDR=0xFC744038
  &HWIO_BCC_PLL1_STATUS_ADDR=0xFC74403C
  
  goto Init_Constants_Done
  
Format_Dump_Registers:

  ENTRY &num &use &mode_reg &mode_val &status_reg &status_val &user_ctl_reg &user_ctl_val &test_ctl_reg &test_ctl_val
  
  &num=FORMAT.DECIMAL(0x2, &num)
  &mode_reg=FORMAT.HEX(0x8, &mode_reg)
  &mode_val=FORMAT.HEX(0x8, &mode_val)
  &status_reg=FORMAT.HEX(0x8, &status_reg)
  &status_val=FORMAT.HEX(0x8, &status_val)
  &user_ctl_reg=FORMAT.HEX(0x8, &user_ctl_reg)
  &user_ctl_val=FORMAT.HEX(0x8, &user_ctl_val)
  &test_ctl_reg=FORMAT.HEX(0x8, &test_ctl_reg)
  &test_ctl_val=FORMAT.HEX(0x8, &test_ctl_val)

  print "&num" "  " &use "  | 0x&mode_reg : 0x&mode_val |    | 0x&status_reg : 0x&status_val |    | 0x&user_ctl_reg : 0x&user_ctl_val |    | 0x&test_ctl_reg : 0x&test_ctl_val |"

  return
  

;-----------------------------------------------------------------------------
; Display the dump of mode/status registers.
;-----------------------------------------------------------------------------

Display_Dump:

  ; Display the PLL mode and status registers.
 
  print "                 _________________________      _________________________      _________________________      _________________________ "
  print "                /          MODE           \    /         STATUS          \    /        USER CTL         \    /        TEST CTL         "
  print "                |-------------------------|    |-------------------------|    |-------------------------|    |-------------------------|" 
  print "PLL    USE      |    Address : Value      |    |    Address : Value      |    |    Address : Value      |    |    Address : Value      |"

  print "--- ----------  |-------------------------|    |-------------------------|    |-------------------------|    |-------------------------|" 

  &mode_reg=&HWIO_GCC_GPLL0_MODE_ADDR
  &mode_val=data.long(eahb:&mode_reg)
  &status_reg=&HWIO_GCC_GPLL0_STATUS_ADDR
  &status_val=data.long(eahb:&status_reg)
  &user_ctl_reg=&HWIO_GCC_GPLL0_USER_CTL_ADDR
  &user_ctl_val=data.long(eahb:&user_ctl_reg)
  &test_ctl_reg=&HWIO_GCC_GPLL0_TEST_CTL_ADDR
  &test_ctl_val=data.long(eahb:&test_ctl_reg)
  gosub Format_Dump_Registers 0. "GPLL0     " &mode_reg &mode_val &status_reg &status_val &user_ctl_reg &user_ctl_val &test_ctl_reg &test_ctl_val

  print "--- ----------  |-------------------------|    |-------------------------|    |-------------------------|    |-------------------------|" 
  
  &mode_reg=&HWIO_GCC_GPLL1_MODE_ADDR
  &mode_val=data.long(eahb:&mode_reg)
  &status_reg=&HWIO_GCC_GPLL1_STATUS_ADDR
  &status_val=data.long(eahb:&status_reg)
  &user_ctl_reg=&HWIO_GCC_GPLL1_USER_CTL_ADDR
  &user_ctl_val=data.long(eahb:&user_ctl_reg)
  &test_ctl_reg=&HWIO_GCC_GPLL1_TEST_CTL_ADDR
  &test_ctl_val=data.long(eahb:&test_ctl_reg)
  gosub Format_Dump_Registers 1. "GPLL1     " &mode_reg &mode_val &status_reg &status_val &user_ctl_reg &user_ctl_val &test_ctl_reg &test_ctl_val
  
  print "--- ----------  |-------------------------|    |-------------------------|    |-------------------------|    |-------------------------|" 
  
  &mode_reg=&HWIO_GCC_GPLL2_MODE_ADDR
  &mode_val=data.long(eahb:&mode_reg)
  &status_reg=&HWIO_GCC_GPLL2_STATUS_ADDR
  &status_val=data.long(eahb:&status_reg)
  &user_ctl_reg=&HWIO_GCC_GPLL2_USER_CTL_ADDR
  &user_ctl_val=data.long(eahb:&user_ctl_reg)
  &test_ctl_reg=&HWIO_GCC_GPLL2_TEST_CTL_ADDR
  &test_ctl_val=data.long(eahb:&test_ctl_reg)
  gosub Format_Dump_Registers 2. "GPLL2     " &mode_reg &mode_val &status_reg &status_val &user_ctl_reg &user_ctl_val &test_ctl_reg &test_ctl_val
  
  print "--- ----------  |-------------------------|    |-------------------------|    |-------------------------|    |-------------------------|" 
  
  &mode_reg=&HWIO_GCC_GPLL3_MODE_ADDR
  &mode_val=data.long(eahb:&mode_reg)
  &status_reg=&HWIO_GCC_GPLL3_STATUS_ADDR
  &status_val=data.long(eahb:&status_reg)
  &user_ctl_reg=&HWIO_GCC_GPLL3_USER_CTL_ADDR
  &user_ctl_val=data.long(eahb:&user_ctl_reg)
  &test_ctl_reg=&HWIO_GCC_GPLL3_TEST_CTL_ADDR
  &test_ctl_val=data.long(eahb:&test_ctl_reg)
  gosub Format_Dump_Registers 3. "GPLL3     " &mode_reg &mode_val &status_reg &status_val &user_ctl_reg &user_ctl_val &test_ctl_reg &test_ctl_val

  print "--- ----------  |-------------------------|    |-------------------------|    |-------------------------|    |-------------------------|" 
  
  &mode_reg=&HWIO_MMSS_MMPLL0_PLL_MODE_ADDR
  &mode_val=data.long(eahb:&mode_reg)
  &status_reg=&HWIO_MMSS_MMPLL0_PLL_STATUS_ADDR
  &status_val=data.long(eahb:&status_reg)
  &user_ctl_reg=&HWIO_MMSS_MMPLL0_PLL_USER_CTL_ADDR
  &user_ctl_val=data.long(eahb:&user_ctl_reg)
  &test_ctl_reg=&HWIO_MMSS_MMPLL0_PLL_TEST_CTL_ADDR
  &test_ctl_val=data.long(eahb:&test_ctl_reg)
  gosub Format_Dump_Registers 5. "MMPLL0    " &mode_reg &mode_val &status_reg &status_val &user_ctl_reg &user_ctl_val &test_ctl_reg &test_ctl_val
  
  print "--- ----------  |-------------------------|    |-------------------------|    |-------------------------|    |-------------------------|" 
  
  &mode_reg=&HWIO_MMSS_MMPLL1_PLL_MODE_ADDR
  &mode_val=data.long(eahb:&mode_reg)
  &status_reg=&HWIO_MMSS_MMPLL1_PLL_STATUS_ADDR
  &status_val=data.long(eahb:&status_reg)
  &user_ctl_reg=&HWIO_MMSS_MMPLL1_PLL_USER_CTL_ADDR
  &user_ctl_val=data.long(eahb:&user_ctl_reg)
  &test_ctl_reg=&HWIO_MMSS_MMPLL1_PLL_TEST_CTL_ADDR
  &test_ctl_val=data.long(eahb:&test_ctl_reg)
  gosub Format_Dump_Registers 6. "MMPLL1    " &mode_reg &mode_val &status_reg &status_val &user_ctl_reg &user_ctl_val &test_ctl_reg &test_ctl_val
  
  print "--- ----------  |-------------------------|    |-------------------------|    |-------------------------|    |-------------------------|" 
  
  &mode_reg=&HWIO_MMSS_MMPLL2_PLL_MODE_ADDR
  &mode_val=data.long(eahb:&mode_reg)
  &status_reg=&HWIO_MMSS_MMPLL2_PLL_STATUS_ADDR
  &status_val=data.long(eahb:&status_reg)
  &user_ctl_reg=&HWIO_MMSS_MMPLL2_PLL_USER_CTL_ADDR
  &user_ctl_val=data.long(eahb:&user_ctl_reg)
  &test_ctl_reg=&HWIO_MMSS_MMPLL2_PLL_TEST_CTL_ADDR
  &test_ctl_val=data.long(eahb:&test_ctl_reg)
  gosub Format_Dump_Registers 7. "MMPLL2    " &mode_reg &mode_val &status_reg &status_val &user_ctl_reg &user_ctl_val &test_ctl_reg &test_ctl_val
  
  print "--- ----------  |-------------------------|    |-------------------------|    |-------------------------|    |-------------------------|" 
  
  &mode_reg=&HWIO_MMSS_MMPLL3_PLL_MODE_ADDR
  &mode_val=data.long(eahb:&mode_reg)
  &status_reg=&HWIO_MMSS_MMPLL3_PLL_STATUS_ADDR
  &status_val=data.long(eahb:&status_reg)
  &user_ctl_reg=&HWIO_MMSS_MMPLL3_PLL_USER_CTL_ADDR
  &user_ctl_val=data.long(eahb:&user_ctl_reg)
  &test_ctl_reg=&HWIO_MMSS_MMPLL3_PLL_TEST_CTL_ADDR
  &test_ctl_val=data.long(eahb:&test_ctl_reg)
  gosub Format_Dump_Registers 8. "MMPLL3    " &mode_reg &mode_val &status_reg &status_val &user_ctl_reg &user_ctl_val &test_ctl_reg &test_ctl_val

  print "--- ----------  |-------------------------|    |-------------------------|    |-------------------------|    |-------------------------|" 
  
  &mode_reg=&HWIO_MMSS_MMPLL6_PLL_MODE_ADDR
  &mode_val=data.long(eahb:&mode_reg)
  &status_reg=&HWIO_MMSS_MMPLL6_PLL_STATUS_ADDR
  &status_val=data.long(eahb:&status_reg)
  &user_ctl_reg=&HWIO_MMSS_MMPLL6_PLL_USER_CTL_ADDR
  &user_ctl_val=data.long(eahb:&user_ctl_reg)
  &test_ctl_reg=&HWIO_MMSS_MMPLL6_PLL_TEST_CTL_ADDR
  &test_ctl_val=data.long(eahb:&test_ctl_reg)
  gosub Format_Dump_Registers 9. "MMPLL6    " &mode_reg &mode_val &status_reg &status_val &user_ctl_reg &user_ctl_val &test_ctl_reg &test_ctl_val

  print "--- ----------  |-------------------------|    |-------------------------|    |-------------------------|    |-------------------------|" 
  
  &mode_reg=&HWIO_LPASS_LPAAUDIO_PLL_MODE_ADDR
  &mode_val=data.long(eahb:&mode_reg)
  &status_reg=&HWIO_LPASS_LPAAUDIO_PLL_STATUS_ADDR
  &status_val=data.long(eahb:&status_reg)
  &user_ctl_reg=&HWIO_LPASS_LPAAUDIO_PLL_USER_CTL_ADDR
  &user_ctl_val=data.long(eahb:&user_ctl_reg)
  &test_ctl_reg=&HWIO_LPASS_LPAAUDIO_PLL_TEST_CTL_ADDR
  &test_ctl_val=data.long(eahb:&test_ctl_reg)
  gosub Format_Dump_Registers 10. "LPAPLL1   " &mode_reg &mode_val &status_reg &status_val &user_ctl_reg &user_ctl_val &test_ctl_reg &test_ctl_val
  
  print "--- ----------  |-------------------------|    |-------------------------|    |-------------------------|    |-------------------------|" 
  
  &mode_reg=&HWIO_LPASS_LPAQ6_PLL_MODE_ADDR
  &mode_status=data.long(eahb:&mode_reg)
  &status_reg=&HWIO_LPASS_LPAQ6_PLL_STATUS_ADDR
  &status_val=data.long(eahb:&status_reg)
  &user_ctl_reg=&HWIO_LPASS_LPAQ6_PLL_USER_CTL_ADDR
  &user_ctl_val=data.long(eahb:&user_ctl_reg)
  &test_ctl_reg=&HWIO_LPASS_LPAQ6_PLL_TEST_CTL_ADDR
  &test_ctl_val=data.long(eahb:&test_ctl_reg)
  gosub Format_Dump_Registers 11. "LPAPLL2   " &mode_reg &mode_val &status_reg &status_val &user_ctl_reg &user_ctl_val &test_ctl_reg &test_ctl_val
  
  print "--- ----------  |-------------------------|    |-------------------------|    |-------------------------|    |-------------------------|" 

  &mode_reg=&HWIO_APCS_ALIAS0_PLL_MODE_ADDR
  &mode_val=data.long(eahb:&mode_reg)
  &status_reg=&HWIO_APCS_ALIAS0_PLL_STATUS_ADDR
  &status_val=data.long(eahb:&status_reg)
  &user_ctl_reg=&HWIO_APCS_ALIAS0_PLL_USER_CTL_ADDR
  &user_ctl_val=data.long(eahb:&user_ctl_reg)
  &test_ctl_reg=&HWIO_APCS_ALIAS0_PLL_TEST_CTL_ADDR
  &test_ctl_val=data.long(eahb:&test_ctl_reg)
  gosub Format_Dump_Registers 12. "Krait CPU0" &mode_reg &mode_val &status_reg &status_val &user_ctl_reg &user_ctl_val &test_ctl_reg &test_ctl_val
  
  print "--- ----------  |-------------------------|    |-------------------------|    |-------------------------|    |-------------------------|" 
  
  &mode_reg=&HWIO_APCS_ALIAS1_PLL_MODE_ADDR
  &mode_val=data.long(eahb:&mode_reg)
  &status_reg=&HWIO_APCS_ALIAS1_PLL_STATUS_ADDR
  &status_val=data.long(eahb:&status_reg)
  &user_ctl_reg=&HWIO_APCS_ALIAS1_PLL_USER_CTL_ADDR
  &user_ctl_val=data.long(eahb:&user_ctl_reg)
  &test_ctl_reg=&HWIO_APCS_ALIAS1_PLL_TEST_CTL_ADDR
  &test_ctl_val=data.long(eahb:&test_ctl_reg)
  gosub Format_Dump_Registers 13. "Krait CPU1" &mode_reg &mode_val &status_reg &status_val &user_ctl_reg &user_ctl_val &test_ctl_reg &test_ctl_val
  
  print "--- ----------  |-------------------------|    |-------------------------|    |-------------------------|    |-------------------------|" 
  
  &mode_reg=&HWIO_APCS_ALIAS2_PLL_MODE_ADDR
  &mode_val=data.long(eahb:&mode_reg)
  &status_reg=&HWIO_APCS_ALIAS2_PLL_STATUS_ADDR
  &status_val=data.long(eahb:&status_reg)
  &user_ctl_reg=&HWIO_APCS_ALIAS2_PLL_USER_CTL_ADDR
  &user_ctl_val=data.long(eahb:&user_ctl_reg)
  &test_ctl_reg=&HWIO_APCS_ALIAS2_PLL_TEST_CTL_ADDR
  &test_ctl_val=data.long(eahb:&test_ctl_reg)
  gosub Format_Dump_Registers 14. "Krait CPU2" &mode_reg &mode_val &status_reg &status_val &user_ctl_reg &user_ctl_val &test_ctl_reg &test_ctl_val
  
  print "--- ----------  |-------------------------|    |-------------------------|    |-------------------------|    |-------------------------|" 
  
  &mode_reg=&HWIO_APCS_ALIAS3_PLL_MODE_ADDR
  &mode_val=data.long(eahb:&mode_reg)
  &status_reg=&HWIO_APCS_ALIAS3_PLL_STATUS_ADDR
  &status_val=data.long(eahb:&status_reg)
  &user_ctl_reg=&HWIO_APCS_ALIAS3_PLL_USER_CTL_ADDR
  &user_ctl_val=data.long(eahb:&user_ctl_reg)
  &test_ctl_reg=&HWIO_APCS_ALIAS3_PLL_TEST_CTL_ADDR
  &test_ctl_val=data.long(eahb:&test_ctl_reg)
  gosub Format_Dump_Registers 15. "Krait CPU3" &mode_reg &mode_val &status_reg &status_val &user_ctl_reg &user_ctl_val &test_ctl_reg &test_ctl_val
  
  print "--- ----------  |-------------------------|    |-------------------------|    |-------------------------|    |-------------------------|" 
  
  &mode_reg=&HWIO_APCS_L2_PLL_MODE_ADDR
  &mode_val=data.long(eahb:&mode_reg)
  &status_reg=&HWIO_APCS_L2_PLL_STATUS_ADDR
  &status_val=data.long(eahb:&status_reg)
  &user_ctl_reg=&HWIO_APCS_L2_PLL_USER_CTL_ADDR
  &user_ctl_val=data.long(eahb:&user_ctl_reg)
  &test_ctl_reg=&HWIO_APCS_L2_PLL_TEST_CTL_ADDR
  &test_ctl_val=data.long(eahb:&test_ctl_reg)
  gosub Format_Dump_Registers 16. "Krait L2  " &mode_reg &mode_val &status_reg &status_val &user_ctl_reg &user_ctl_val &test_ctl_reg &test_ctl_val
  
  print "--- ----------  |-------------------------|    |-------------------------|    |-------------------------|    |-------------------------|" 
  
  &mode_reg=&HWIO_BCC_PLL0_MODE_ADDR
  &mode_val=data.long(eahb:&mode_reg)
  &status_reg=&HWIO_BCC_PLL0_STATUS_ADDR
  &status_val=data.long(eahb:&status_reg)
  &user_ctl_reg=&HWIO_BCC_PLL0_USER_CTL_ADDR
  &user_ctl_val=data.long(eahb:&user_ctl_reg)
  &test_ctl_reg=&HWIO_BCC_PLL0_TEST_CTL_ADDR
  &test_ctl_val=data.long(eahb:&test_ctl_reg)
  gosub Format_Dump_Registers 2. "BCCPLL0    " &mode_reg &mode_val &status_reg &status_val &user_ctl_reg &user_ctl_val &test_ctl_reg &test_ctl_val
  
  print "--- ----------  |-------------------------|    |-------------------------|    |-------------------------|    |-------------------------|" 
  
  &mode_reg=&HWIO_BCC_PLL1_MODE_ADDR
  &mode_val=data.long(eahb:&mode_reg)
  &status_reg=&HWIO_BCC_PLL1_STATUS_ADDR
  &status_val=data.long(eahb:&status_reg)
  &user_ctl_reg=&HWIO_BCC_PLL1_USER_CTL_ADDR
  &user_ctl_val=data.long(eahb:&user_ctl_reg)
  &test_ctl_reg=&HWIO_BCC_PLL1_TEST_CTL_ADDR
  &test_ctl_val=data.long(eahb:&test_ctl_reg)
  gosub Format_Dump_Registers 3. "BCCPLL1    " &mode_reg &mode_val &status_reg &status_val &user_ctl_reg &user_ctl_val &test_ctl_reg &test_ctl_val
  
  print "--- ----------  |-------------------------|    |-------------------------|    |-------------------------|    |-------------------------|" 
  print "" 
  print "" 
  
  return
  
;-----------------------------------------------------------------------------
; Calculate Pre-div and Post-Div for those SR PLLs; where
; Pre div  [14:12]
; Post-Div [9:8]
;-----------------------------------------------------------------------------

Calculate_Pre_Post_Div_SR:

  if (&pll_user_ctl&0x7000)==0x0000
    &pre_div=1
  else if (&pll_user_ctl&0x7000)==0x1000
    &pre_div=2
  else if (&pll_user_ctl&0x7000)==0x2000
    &pre_div=3
  else if (&pll_user_ctl&0x7000)==0x3000
    &pre_div=4
  else if (&pll_user_ctl&0x7000)==0x4000
    &pre_div=5
  else if (&pll_user_ctl&0x7000)==0x5000
    &pre_div=6
  else if (&pll_user_ctl&0x7000)==0x6000
    &pre_div=7
  else
    &pre_div=8

  if (&pll_user_ctl&0x300)==0x000
    &post_div=1
  else if (&pll_user_ctl&0x300)==0x100
    &post_div=2
  else
    &post_div=4

  return


;-----------------------------------------------------------------------------
; Calculate Pre-div and Post-Div for those TSR2 PLLs; where
; Pre div  [12]
; Post-Div [9:8]
;-----------------------------------------------------------------------------

Calculate_Pre_Post_Div_SR2:

  if (&pll_user_ctl&0x1000)==0x0000
    &pre_div=1
  else
    &pre_div=2

  if (&pll_user_ctl&0x300)==0x000
    &post_div=1
  else if (&pll_user_ctl&0x300)==0x100
    &post_div=2
  else
    &post_div=4

  return


;-----------------------------------------------------------------------------
; Calculate Pre-div and Post-Div for those HF PLLs; where
; Pre div  [12]
; Post-Div [9:8]
;-----------------------------------------------------------------------------

Calculate_Pre_Post_Div_HF:

  if (&pll_user_ctl&0x1000)==0x0000
    &pre_div=1
  else
    &pre_div=2

  if (&pll_user_ctl&0x300)==0x000
    &post_div=1
  else if (&pll_user_ctl&0x300)==0x100
    &post_div=2
  else
    &post_div=4


  return


;-----------------------------------------------------------------------------
; Calculate Clock
; PLL_REF_XO_SEL[4]
; 0: PXO (27)
; 1: CXO (19.2)
;-----------------------------------------------------------------------------

Calculate_Clk:

  &clk_ref=19.2

  return


;-----------------------------------------------------------------------------
; Calculate Clock_WCSS 
; PLL_REF_XO_SEL[5:4]
; 0: CXO (19.2)
; 1: RF_24MHZ_XO_SRC (24.0)
;-----------------------------------------------------------------------------

Calculate_Clk_WCSS:
  if (&pll_clk&0x30)==0
    &clk_ref=19.2
  else
    &clk_ref=24.0

  return


;-----------------------------------------------------------------------------
; Calculate if MAIN/EARLY/BIST/AUX bit are enable or not
; TEST  [4]
; EARLY [3]
; AUX2  [2]
; AUX   [1]
; MAIN  [0]
;-----------------------------------------------------------------------------

Calculate_MAIN_EARLY_BIST_AUX_ENA:

  if (&pll_user_ctl&0x10)==0x10
    &pll_test="ON "
  else
    &pll_test="OFF"

  if (&pll_user_ctl&0x08)==0x08
    &pll_early="ON "
  else
    &pll_early="OFF"

  if (&pll_user_ctl&0x04)==0x04
    &pll_aux2="ON "
  else
    &pll_aux2="OFF"
   
  if (&pll_user_ctl&0x02)==0x02
    &pll_aux="ON "
  else
    &pll_aux="OFF"

  if (&pll_user_ctl&0x01)==0x01
    &pll_main="ON "
  else
    &pll_main="OFF"

  return


;-----------------------------------------------------------------------------
; Display the PLL setting
;-----------------------------------------------------------------------------

Display_PLL:

  if (&pll_status&0x10000)==0x10000
    &pll_state="ON "
  else
    &pll_state="OFF"

  if (&pll_mode&0x100000)==0x100000
    &pll_votable="YES"
  else
    &pll_votable="NO "

  if &n_val==0
    &n_val=1
    
  &clk_freq=FORMAT.FLOAT(10, 6, (&clk_ref*&l_val+&clk_ref*&m_val/&n_val)/&pre_div/&post_div)
  
  print "&pll    &pll_state        &pll_votable        &pll_main        &pll_test        &pll_aux        &pll_aux2        &pll_early  &clk_freq"

  return


;-----------------------------------------------------------------------
; Display Configurations
;-----------------------------------------------------------------------

Display_Configurations:
  print "PLL    USE       STATE     VOTABLE   MAIN_OUT   TEST_OUT    AUX_OUT   AUX2_OUT   EARLY_OUT   CALC FREQ (MHz)"
  print "--- ----------   -----     -------   --------   --------    -------   --------   ---------   ---------------"

  &pll=" 0  GPLL0     "
  &pll_clk=data.long(eahb:&HWIO_GCC_GPLL0_MODE_ADDR)
  &pll_mode=data.long(eahb:&HWIO_GCC_GPLL0_MODE_ADDR)
  &pll_status=data.long(eahb:&HWIO_GCC_GPLL0_STATUS_ADDR)
  &pll_user_ctl=data.long(eahb:&HWIO_GCC_GPLL0_USER_CTL_ADDR)
  &l_val=data.long(eahb:&HWIO_GCC_GPLL0_L_VAL_ADDR)&(&HWIO_PLL_L_VAL_MASK)
  &m_val=data.long(eahb:&HWIO_GCC_GPLL0_M_VAL_ADDR)&(&HWIO_PLL_M_VAL_MASK)
  &n_val=data.long(eahb:&HWIO_GCC_GPLL0_N_VAL_ADDR)&(&HWIO_PLL_N_VAL_MASK)
  gosub Calculate_Clk
  gosub Calculate_Pre_Post_Div_SR
  gosub Calculate_MAIN_EARLY_BIST_AUX_ENA
  gosub Display_PLL

  &pll=" 1  GPLL1     "
  &pll_clk=data.long(eahb:&HWIO_GCC_GPLL1_MODE_ADDR)
  &pll_mode=data.long(eahb:&HWIO_GCC_GPLL1_MODE_ADDR)
  &pll_status=data.long(eahb:&HWIO_GCC_GPLL1_STATUS_ADDR)
  &pll_user_ctl=data.long(eahb:&HWIO_GCC_GPLL1_USER_CTL_ADDR)
  &l_val=data.long(eahb:&HWIO_GCC_GPLL1_L_VAL_ADDR)&(&HWIO_PLL_L_VAL_MASK)
  &m_val=data.long(eahb:&HWIO_GCC_GPLL1_M_VAL_ADDR)&(&HWIO_PLL_M_VAL_MASK)
  &n_val=data.long(eahb:&HWIO_GCC_GPLL1_N_VAL_ADDR)&(&HWIO_PLL_N_VAL_MASK)
  gosub Calculate_Clk
  gosub Calculate_Pre_Post_Div_SR
  gosub Calculate_MAIN_EARLY_BIST_AUX_ENA
  gosub Display_PLL
  
  &pll=" 2  GPLL2     "
  &pll_clk=data.long(eahb:&HWIO_GCC_GPLL2_MODE_ADDR)
  &pll_mode=data.long(eahb:&HWIO_GCC_GPLL2_MODE_ADDR)
  &pll_status=data.long(eahb:&HWIO_GCC_GPLL2_STATUS_ADDR)
  &pll_user_ctl=data.long(eahb:&HWIO_GCC_GPLL2_USER_CTL_ADDR)
  &l_val=data.long(eahb:&HWIO_GCC_GPLL2_L_VAL_ADDR)&(&HWIO_PLL_L_VAL_MASK)
  &m_val=data.long(eahb:&HWIO_GCC_GPLL2_M_VAL_ADDR)&(&HWIO_PLL_M_VAL_MASK)
  &n_val=data.long(eahb:&HWIO_GCC_GPLL2_N_VAL_ADDR)&(&HWIO_PLL_N_VAL_MASK)
  gosub Calculate_Clk
  gosub Calculate_Pre_Post_Div_SR
  gosub Calculate_MAIN_EARLY_BIST_AUX_ENA
  gosub Display_PLL
  
  &pll=" 3  GPLL3     "
  &pll_clk=data.long(eahb:&HWIO_GCC_GPLL3_MODE_ADDR)
  &pll_mode=data.long(eahb:&HWIO_GCC_GPLL3_MODE_ADDR)
  &pll_status=data.long(eahb:&HWIO_GCC_GPLL3_STATUS_ADDR)
  &pll_user_ctl=data.long(eahb:&HWIO_GCC_GPLL3_USER_CTL_ADDR)
  &l_val=data.long(eahb:&HWIO_GCC_GPLL3_L_VAL_ADDR)&(&HWIO_PLL_L_VAL_MASK)
  &m_val=data.long(eahb:&HWIO_GCC_GPLL3_M_VAL_ADDR)&(&HWIO_PLL_M_VAL_MASK)
  &n_val=data.long(eahb:&HWIO_GCC_GPLL3_N_VAL_ADDR)&(&HWIO_PLL_N_VAL_MASK)
  gosub Calculate_Clk
  gosub Calculate_Pre_Post_Div_SR
  gosub Calculate_MAIN_EARLY_BIST_AUX_ENA
  gosub Display_PLL

  &pll=" 4  GPLL4     "
  &pll_clk=data.long(eahb:&HWIO_GCC_GPLL4_MODE_ADDR)
  &pll_mode=data.long(eahb:&HWIO_GCC_GPLL4_MODE_ADDR)
  &pll_status=data.long(eahb:&HWIO_GCC_GPLL4_STATUS_ADDR)
  &pll_user_ctl=data.long(eahb:&HWIO_GCC_GPLL4_USER_CTL_ADDR)
  &l_val=data.long(eahb:&HWIO_GCC_GPLL4_L_VAL_ADDR)&(&HWIO_PLL_L_VAL_MASK)
  &m_val=data.long(eahb:&HWIO_GCC_GPLL4_M_VAL_ADDR)&(&HWIO_PLL_M_VAL_MASK)
  &n_val=data.long(eahb:&HWIO_GCC_GPLL4_N_VAL_ADDR)&(&HWIO_PLL_N_VAL_MASK)
  gosub Calculate_Clk
  gosub Calculate_Pre_Post_Div_SR
  gosub Calculate_MAIN_EARLY_BIST_AUX_ENA
  gosub Display_PLL

  &pll=" 5  MMPLL0    "
  &pll_clk=data.long(eahb:&HWIO_MMSS_MMPLL0_PLL_MODE_ADDR)
  &pll_mode=data.long(eahb:&HWIO_MMSS_MMPLL0_PLL_MODE_ADDR)
  &pll_status=data.long(eahb:&HWIO_MMSS_MMPLL0_PLL_STATUS_ADDR)
  &pll_user_ctl=data.long(eahb:&HWIO_MMSS_MMPLL0_PLL_USER_CTL_ADDR)
  &l_val=data.long(eahb:&HWIO_MMSS_MMPLL0_PLL_L_VAL_ADDR)&(&HWIO_PLL_L_VAL_MASK)
  &m_val=data.long(eahb:&HWIO_MMSS_MMPLL0_PLL_M_VAL_ADDR)&(&HWIO_PLL_M_VAL_MASK)
  &n_val=data.long(eahb:&HWIO_MMSS_MMPLL0_PLL_N_VAL_ADDR)&(&HWIO_PLL_N_VAL_MASK)
  gosub Calculate_Clk
  gosub Calculate_Pre_Post_Div_SR
  gosub Calculate_MAIN_EARLY_BIST_AUX_ENA
  gosub Display_PLL
  
  &pll=" 6  MMPLL1    "
  &pll_clk=data.long(eahb:&HWIO_MMSS_MMPLL1_PLL_MODE_ADDR)
  &pll_mode=data.long(eahb:&HWIO_MMSS_MMPLL1_PLL_MODE_ADDR)
  &pll_status=data.long(eahb:&HWIO_MMSS_MMPLL1_PLL_STATUS_ADDR)
  &pll_user_ctl=data.long(eahb:&HWIO_MMSS_MMPLL1_PLL_USER_CTL_ADDR)
  &l_val=data.long(eahb:&HWIO_MMSS_MMPLL1_PLL_L_VAL_ADDR)&(&HWIO_PLL_L_VAL_MASK)
  &m_val=data.long(eahb:&HWIO_MMSS_MMPLL1_PLL_M_VAL_ADDR)&(&HWIO_PLL_M_VAL_MASK)
  &n_val=data.long(eahb:&HWIO_MMSS_MMPLL1_PLL_N_VAL_ADDR)&(&HWIO_PLL_N_VAL_MASK)
  gosub Calculate_Clk
  gosub Calculate_Pre_Post_Div_SR
  gosub Calculate_MAIN_EARLY_BIST_AUX_ENA
  gosub Display_PLL
  
  &pll=" 7  MMPLL2    "
  &pll_clk=data.long(eahb:&HWIO_MMSS_MMPLL2_PLL_MODE_ADDR)
  &pll_mode=data.long(eahb:&HWIO_MMSS_MMPLL2_PLL_MODE_ADDR)
  &pll_status=data.long(eahb:&HWIO_MMSS_MMPLL2_PLL_STATUS_ADDR)
  &pll_user_ctl=data.long(eahb:&HWIO_MMSS_MMPLL2_PLL_USER_CTL_ADDR)
  &l_val=data.long(eahb:&HWIO_MMSS_MMPLL2_PLL_L_VAL_ADDR)&(&HWIO_PLL_L_VAL_MASK)
  &m_val=data.long(eahb:&HWIO_MMSS_MMPLL2_PLL_M_VAL_ADDR)&(&HWIO_PLL_M_VAL_MASK)
  &n_val=data.long(eahb:&HWIO_MMSS_MMPLL2_PLL_N_VAL_ADDR)&(&HWIO_PLL_N_VAL_MASK)
  gosub Calculate_Clk
  gosub Calculate_Pre_Post_Div_SR
  gosub Calculate_MAIN_EARLY_BIST_AUX_ENA
  gosub Display_PLL
  
  &pll=" 8  MMPLL3    "
  &pll_clk=data.long(eahb:&HWIO_MMSS_MMPLL3_PLL_MODE_ADDR)
  &pll_mode=data.long(eahb:&HWIO_MMSS_MMPLL3_PLL_MODE_ADDR)
  &pll_status=data.long(eahb:&HWIO_MMSS_MMPLL3_PLL_STATUS_ADDR)
  &pll_user_ctl=data.long(eahb:&HWIO_MMSS_MMPLL3_PLL_USER_CTL_ADDR)
  &l_val=data.long(eahb:&HWIO_MMSS_MMPLL3_PLL_L_VAL_ADDR)&(&HWIO_PLL_L_VAL_MASK)
  &m_val=data.long(eahb:&HWIO_MMSS_MMPLL3_PLL_M_VAL_ADDR)&(&HWIO_PLL_M_VAL_MASK)
  &n_val=data.long(eahb:&HWIO_MMSS_MMPLL3_PLL_N_VAL_ADDR)&(&HWIO_PLL_N_VAL_MASK)
  gosub Calculate_Clk
  gosub Calculate_Pre_Post_Div_SR
  gosub Calculate_MAIN_EARLY_BIST_AUX_ENA
  gosub Display_PLL

  &pll=" 9  MMPLL4    "
  &pll_clk=data.long(eahb:&HWIO_MMSS_MMPLL4_PLL_MODE_ADDR)
  &pll_mode=data.long(eahb:&HWIO_MMSS_MMPLL4_PLL_MODE_ADDR)
  &pll_status=data.long(eahb:&HWIO_MMSS_MMPLL4_PLL_STATUS_ADDR)
  &pll_user_ctl=data.long(eahb:&HWIO_MMSS_MMPLL4_PLL_USER_CTL_ADDR)
  &l_val=data.long(eahb:&HWIO_MMSS_MMPLL4_PLL_L_VAL_ADDR)&(&HWIO_PLL_L_VAL_MASK)
  &m_val=data.long(eahb:&HWIO_MMSS_MMPLL4_PLL_M_VAL_ADDR)&(&HWIO_PLL_M_VAL_MASK)
  &n_val=data.long(eahb:&HWIO_MMSS_MMPLL4_PLL_N_VAL_ADDR)&(&HWIO_PLL_N_VAL_MASK)
  gosub Calculate_Clk
  gosub Calculate_Pre_Post_Div_SR
  gosub Calculate_MAIN_EARLY_BIST_AUX_ENA
  gosub Display_PLL

  &pll="10  LPAPLL1   "
  &pll_clk=data.long(eahb:&HWIO_LPASS_LPAAUDIO_PLL_MODE_ADDR)
  &pll_mode=data.long(eahb:&HWIO_LPASS_LPAAUDIO_PLL_MODE_ADDR)
  &pll_status=data.long(eahb:&HWIO_LPASS_LPAAUDIO_PLL_STATUS_ADDR)
  &pll_user_ctl=data.long(eahb:&HWIO_LPASS_LPAAUDIO_PLL_USER_CTL_ADDR)
  &l_val=data.long(eahb:&HWIO_LPASS_LPAAUDIO_PLL_L_VAL_ADDR)&(&HWIO_PLL_L_VAL_MASK)
  &m_val=data.long(eahb:&HWIO_LPASS_LPAAUDIO_PLL_M_VAL_ADDR)&(&HWIO_PLL_M_VAL_MASK)
  &n_val=data.long(eahb:&HWIO_LPASS_LPAAUDIO_PLL_N_VAL_ADDR)&(&HWIO_PLL_N_VAL_MASK)
  gosub Calculate_Clk
  gosub Calculate_Pre_Post_Div_SR
  gosub Calculate_MAIN_EARLY_BIST_AUX_ENA
  gosub Display_PLL
  
  &pll="11  LPAPLL2   "
  &pll_clk=data.long(eahb:&HWIO_LPASS_LPAQ6_PLL_MODE_ADDR)
  &pll_mode=data.long(eahb:&HWIO_LPASS_LPAQ6_PLL_MODE_ADDR)
  &pll_status=data.long(eahb:&HWIO_LPASS_LPAQ6_PLL_STATUS_ADDR)
  &pll_user_ctl=data.long(eahb:&HWIO_LPASS_LPAQ6_PLL_USER_CTL_ADDR)
  &l_val=data.long(eahb:&HWIO_LPASS_LPAQ6_PLL_L_VAL_ADDR)&(&HWIO_PLL_L_VAL_MASK)
  &m_val=data.long(eahb:&HWIO_LPASS_LPAQ6_PLL_M_VAL_ADDR)&(&HWIO_PLL_M_VAL_MASK)
  &n_val=data.long(eahb:&HWIO_LPASS_LPAQ6_PLL_N_VAL_ADDR)&(&HWIO_PLL_N_VAL_MASK)
  gosub Calculate_Clk
  gosub Calculate_Pre_Post_Div_SR
  gosub Calculate_MAIN_EARLY_BIST_AUX_ENA
  gosub Display_PLL

  &pll="12  Krait CPU0"
  &pll_clk=data.long(eahb:&HWIO_APCS_ALIAS0_PLL_MODE_ADDR)
  &pll_mode=data.long(eahb:&HWIO_APCS_ALIAS0_PLL_MODE_ADDR)
  &pll_status=data.long(eahb:&HWIO_APCS_ALIAS0_PLL_STATUS_ADDR)
  &pll_user_ctl=data.long(eahb:&HWIO_APCS_ALIAS0_PLL_USER_CTL_ADDR)
  &l_val=data.long(eahb:&HWIO_APCS_ALIAS0_PLL_L_VAL_ADDR)&(&HWIO_PLL_L_VAL_MASK)
  &m_val=data.long(eahb:&HWIO_APCS_ALIAS0_PLL_M_VAL_ADDR)&(&HWIO_PLL_M_VAL_MASK)
  &n_val=data.long(eahb:&HWIO_APCS_ALIAS0_PLL_N_VAL_ADDR)&(&HWIO_PLL_N_VAL_MASK)
  gosub Calculate_Clk
  gosub Calculate_Pre_Post_Div_HF
  gosub Calculate_MAIN_EARLY_BIST_AUX_ENA
  gosub Display_PLL
  
  &pll="13  Krait CPU1"
  &pll_clk=data.long(eahb:&HWIO_APCS_ALIAS1_PLL_MODE_ADDR)
  &pll_mode=data.long(eahb:&HWIO_APCS_ALIAS1_PLL_MODE_ADDR)
  &pll_status=data.long(eahb:&HWIO_APCS_ALIAS1_PLL_STATUS_ADDR)
  &pll_user_ctl=data.long(eahb:&HWIO_APCS_ALIAS1_PLL_USER_CTL_ADDR)
  &l_val=data.long(eahb:&HWIO_APCS_ALIAS1_PLL_L_VAL_ADDR)&(&HWIO_PLL_L_VAL_MASK)
  &m_val=data.long(eahb:&HWIO_APCS_ALIAS1_PLL_M_VAL_ADDR)&(&HWIO_PLL_M_VAL_MASK)
  &n_val=data.long(eahb:&HWIO_APCS_ALIAS1_PLL_N_VAL_ADDR)&(&HWIO_PLL_N_VAL_MASK)
  gosub Calculate_Clk
  gosub Calculate_Pre_Post_Div_HF
  gosub Calculate_MAIN_EARLY_BIST_AUX_ENA
  gosub Display_PLL
  
  &pll="14  Krait CPU2"
  &pll_clk=data.long(eahb:&HWIO_APCS_ALIAS2_PLL_MODE_ADDR)
  &pll_mode=data.long(eahb:&HWIO_APCS_ALIAS2_PLL_MODE_ADDR)
  &pll_status=data.long(eahb:&HWIO_APCS_ALIAS2_PLL_STATUS_ADDR)
  &pll_user_ctl=data.long(eahb:&HWIO_APCS_ALIAS2_PLL_USER_CTL_ADDR)
  &l_val=data.long(eahb:&HWIO_APCS_ALIAS2_PLL_L_VAL_ADDR)&(&HWIO_PLL_L_VAL_MASK)
  &m_val=data.long(eahb:&HWIO_APCS_ALIAS2_PLL_M_VAL_ADDR)&(&HWIO_PLL_M_VAL_MASK)
  &n_val=data.long(eahb:&HWIO_APCS_ALIAS2_PLL_N_VAL_ADDR)&(&HWIO_PLL_N_VAL_MASK)
  gosub Calculate_Clk
  gosub Calculate_Pre_Post_Div_HF
  gosub Calculate_MAIN_EARLY_BIST_AUX_ENA
  gosub Display_PLL
  
  &pll="15  Krait CPU3"
  &pll_clk=data.long(eahb:&HWIO_APCS_ALIAS3_PLL_MODE_ADDR)
  &pll_mode=data.long(eahb:&HWIO_APCS_ALIAS3_PLL_MODE_ADDR)
  &pll_status=data.long(eahb:&HWIO_APCS_ALIAS3_PLL_STATUS_ADDR)
  &pll_user_ctl=data.long(eahb:&HWIO_APCS_ALIAS3_PLL_USER_CTL_ADDR)
  &l_val=data.long(eahb:&HWIO_APCS_ALIAS3_PLL_L_VAL_ADDR)&(&HWIO_PLL_L_VAL_MASK)
  &m_val=data.long(eahb:&HWIO_APCS_ALIAS3_PLL_M_VAL_ADDR)&(&HWIO_PLL_M_VAL_MASK)
  &n_val=data.long(eahb:&HWIO_APCS_ALIAS3_PLL_N_VAL_ADDR)&(&HWIO_PLL_N_VAL_MASK)
  gosub Calculate_Clk
  gosub Calculate_Pre_Post_Div_HF
  gosub Calculate_MAIN_EARLY_BIST_AUX_ENA
  gosub Display_PLL
  
  &pll="16  Krait L2  " 
  &pll_clk=data.long(eahb:&HWIO_APCS_L2_PLL_MODE_ADDR)
  &pll_mode=data.long(eahb:&HWIO_APCS_L2_PLL_MODE_ADDR)
  &pll_status=data.long(eahb:&HWIO_APCS_L2_PLL_STATUS_ADDR)
  &pll_user_ctl=data.long(eahb:&HWIO_APCS_L2_PLL_USER_CTL_ADDR)
  &l_val=data.long(eahb:&HWIO_APCS_L2_PLL_L_VAL_ADDR)&(&HWIO_PLL_L_VAL_MASK)
  &m_val=data.long(eahb:&HWIO_APCS_L2_PLL_M_VAL_ADDR)&(&HWIO_PLL_M_VAL_MASK)
  &n_val=data.long(eahb:&HWIO_APCS_L2_PLL_N_VAL_ADDR)&(&HWIO_PLL_N_VAL_MASK)
  gosub Calculate_Clk
  gosub Calculate_Pre_Post_Div_HF
  gosub Calculate_MAIN_EARLY_BIST_AUX_ENA
  gosub Display_PLL
  
  &pll="17  BCCPLL0   "
  &pll_clk=data.long(eahb:&HWIO_BCC_PLL0_MODE_ADDR)
  &pll_mode=data.long(eahb:&HWIO_BCC_PLL0_MODE_ADDR)
  &pll_status=data.long(eahb:&HWIO_BCC_PLL0_STATUS_ADDR)
  &pll_user_ctl=data.long(eahb:&HWIO_BCC_PLL0_USER_CTL_ADDR)
  &l_val=data.long(eahb:&HWIO_BCC_PLL0_L_VAL_ADDR)&(&HWIO_PLL_L_VAL_MASK)
  &m_val=data.long(eahb:&HWIO_BCC_PLL0_M_VAL_ADDR)&(&HWIO_PLL_M_VAL_MASK)
  &n_val=data.long(eahb:&HWIO_BCC_PLL0_N_VAL_ADDR)&(&HWIO_PLL_N_VAL_MASK)
  gosub Calculate_Clk
  gosub Calculate_Pre_Post_Div_SR
  gosub Calculate_MAIN_EARLY_BIST_AUX_ENA
  gosub Display_PLL

  &pll="18  BCCPLL1   "
  &pll_clk=data.long(eahb:&HWIO_GCC_GPLL1_MODE_ADDR)
  &pll_mode=data.long(eahb:&HWIO_GCC_GPLL1_MODE_ADDR)
  &pll_status=data.long(eahb:&HWIO_GCC_GPLL1_STATUS_ADDR)
  &pll_user_ctl=data.long(eahb:&HWIO_GCC_GPLL1_USER_CTL_ADDR)
  &l_val=data.long(eahb:&HWIO_GCC_GPLL1_L_VAL_ADDR)&(&HWIO_PLL_L_VAL_MASK)
  &m_val=data.long(eahb:&HWIO_GCC_GPLL1_M_VAL_ADDR)&(&HWIO_PLL_M_VAL_MASK)
  &n_val=data.long(eahb:&HWIO_GCC_GPLL1_N_VAL_ADDR)&(&HWIO_PLL_N_VAL_MASK)
  gosub Calculate_Clk
  gosub Calculate_Pre_Post_Div_SR2
  gosub Calculate_MAIN_EARLY_BIST_AUX_ENA
  gosub Display_PLL

  print " "
  print " "
  
  return
  
  
;-----------------------------------------------------------------------
; Get votes for GCC shared PLL's
;-----------------------------------------------------------------------

Get_PLL_Vote_GCC:

  &temp_reg=data.long(&access_mode_gcc_vote&vote_reg)
  
  if (&temp_reg&0x1)==0x1
    &pll0="Y"
  else
    &pll0=" "

  if (&temp_reg&0x2)==0x2
    &pll1="Y"
  else
    &pll1=" "

  if (&temp_reg&0x4)==0x4
    &pll2="Y"
  else
    &pll2=" "

  if (&temp_reg&0x8)==0x8
    &pll3="Y"
  else
    &pll3=" "

  return
  

;-----------------------------------------------------------------------
; Get votes for LPASS shared PLL's
;-----------------------------------------------------------------------

Get_PLL_Vote_LPASS:
  &temp_reg=data.long(eahb:&vote_reg)
  
  if (&temp_reg&0x1)==0x1
    &pll10="Y"
  else
    &pll10=" "
    
  if (&temp_reg&0x2)==0x2
    &pll11="Y"
  else
    &pll11=" "
    
  return
  

;-----------------------------------------------------------------------
; Get votes for MM shared PLL's
;-----------------------------------------------------------------------

Get_PLL_Vote_MM:
  &temp_reg=data.long(eahb:&vote_reg)
  
  if (&temp_reg&0x1)==0x1
    &pll5="Y"
  else
    &pll5=" "
    
  if (&temp_reg&0x2)==0x2
    &pll6="Y"
  else
    &pll6=" "
    
  return
  

Display_PLL_Vote:

  print "&image  |  &pll0  |  &pll1  |  &pll2  |  &pll3  |  &pll5  |  &pll6  |  &pll10  |  &pll11  |  "
  return
  
  
Reset_PLL_Votes:

  &pll0=" "
  &pll1=" "
  &pll2=" "
  &pll3=" "
  &pll4=" "
  &pll5=" "
  &pll6=" "
  &pll10=" "
  &pll11=" "

  return
  
 
Display_Votes:

  print " ___________      ______ _____ _____ _____ _____ _____ _____ _____    "
  print "|\          \    |\     \     \     \     \     \     \     \     \   "
  print "| \          \   | \  0  \  1  \  2  \  3  \  5  \  6  \  10 \ 11  \  "
  print "|  \__________\  |  \_____\_____\_____\_____\_____\_____\_____\_____\ "
  print "|  |          |__|  |     |     |     |     |     |     |     |     | "
  
  gosub Reset_PLL_Votes
  &image="|\ |  RPM     |  |"
  
  ; Get RPM votes on GCC PLL's
  &vote_reg=&HWIO_GCC_RPM_GPLL_ENA_VOTE_ADDR
  &access_mode_gcc_vote="a:"
  gosub Get_PLL_Vote_GCC
  
  ; Get RPM votes on MM PLL's
  &vote_reg=&HWIO_MMSS_PLL_VOTE_RPM_ADDR
  gosub Get_PLL_Vote_MM
  
  gosub Display_PLL_Vote
  
  print "| \|__________|  | \|_____|_____|_____|_____|_____|_____|_____|_____| "
  print "|  |          |__|  |     |     |     |     |     |     |     |     | "
  
  gosub Reset_PLL_Votes
  &image="|\ |  APCS    |  |"
  
  ; Get APCS votes on GCC PLL's
  &vote_reg=&HWIO_GCC_APCS_GPLL_ENA_VOTE_ADDR
  &access_mode_gcc_vote="a:"
  gosub Get_PLL_Vote_GCC
  
  ; Get APCS votes on LPASS PLL's
  &vote_reg=&HWIO_LPASS_LPA_PLL_VOTE_APPS_ADDR
  gosub Get_PLL_Vote_LPASS
  
  ; Get APCS votes on MM PLL's
  &vote_reg=&HWIO_MMSS_PLL_VOTE_APCS_ADDR
  gosub Get_PLL_Vote_MM
  
  gosub Display_PLL_Vote

if (&is_q6==0)
(
  print "| \|__________|  | \|_____|_____|_____|_____|_____|_____|_____|_____| "
  print "|  |          |__|  |     |     |     |     |     |     |     |     | "
  
  gosub Reset_PLL_Votes
  &image="|\ |  APCS TZ |  |"
  
  ; Get APCS TZ votes on GCC PLL's
  &vote_reg=&HWIO_GCC_APCS_TZ_GPLL_ENA_VOTE_ADDR
  &access_mode_gcc_vote="a:"
  gosub Get_PLL_Vote_GCC
  
  gosub Display_PLL_Vote
)

  print "| \|__________|  | \|_____|_____|_____|_____|_____|_____|_____|_____| "
  print "|  |          |__|  |     |     |     |     |     |     |     |     | "
  
  gosub Reset_PLL_Votes
  &image="|\ |  LPASS   |  |"
  
  ; Get LPASS votes on GCC PLL's
  &vote_reg=&HWIO_GCC_LPASS_DSP_GPLL_ENA_VOTE_ADDR
  &access_mode_gcc_vote="a:"
  gosub Get_PLL_Vote_GCC
  
  ; Get LPASS votes on LPASS PLL's
  &vote_reg=&HWIO_LPASS_LPA_PLL_VOTE_LPASSQ6_ADDR
  gosub Get_PLL_Vote_LPASS
  
  gosub Display_PLL_Vote

if (&is_q6==0)
(
  print "| \|__________|  | \|_____|_____|_____|_____|_____|_____|_____|_____| "
  print "|  |          |__|  |     |     |     |     |     |     |     |     | "
  
  gosub Reset_PLL_Votes
  &image=" \ |  SHARE   |   "
  
  ; Get SHARE votes on GCC PLL's
  &vote_reg=&HWIO_GCC_SPARE_GPLL_ENA_VOTE_ADDR
  &access_mode_gcc_vote="a:"
  gosub Get_PLL_Vote_GCC
  
  gosub Display_PLL_Vote
)

  print "  \|__________|    \|_____|_____|_____|_____|_____|_____|_____|_____| "
                       
                        
  print " "
  print " "

  return


