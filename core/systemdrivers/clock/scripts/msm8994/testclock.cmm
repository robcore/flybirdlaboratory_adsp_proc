
;============================================================================
;
; *************** THIS SCRIPT WAS AUTOGENERATED - 04/07/2014   ****************
;
; TARGET
;
;
; SCRIPT
;   TESTCLOCK.CMM
;
; GENERAL DESCRIPTION
;   This script can be used to route specific clocks to the clock test output.
;
; FUNCTIONS
;   N/A
;
;    Copyright (c) 2014 by QUALCOMM Technologies Inc.  All Rights Reserved.
;============================================================================



;-----------------------------------------------------------------------------
; Local variables
;-----------------------------------------------------------------------------

local &clk
local &choice
local &clk_name
local &clk_state
local &clk_freq
local &clk_freq_str
local &header_printed
local &choice_handled
local &old_choice
local &clk_test
local &clk_reg
local &clk_reg_str
local &clk_reg_name
local &print_if_off
local &clk_reg_val
local &clk_reg_val_str
local &clk_reg_cbcr_type
local &state_change
local &print_menu
local &input_file
local &input_line
local &input_file_prompt
local &clock_count
local &multiplier
local &tcxo_count
local &match
local &clk_access_mode
local &testclock_cmd_arg0
local &testclock_cmd_arg1
local &testclock_cmd_arg2
local &testclock_cmd_arg3
local &testclock_cmd_arg4
local &clk_cmd_rcgr_addr
local &clk_cfg_rcgr_addr
local &clk_cmd_rcgr_val
local &clk_cfg_rcgr_val
local &clk_src_name
local &clk_src_sel
local &clk_src_div
local &clk_m_addr
local &clk_n_addr
local &clk_d_addr
local &clk_m_val
local &clk_n_val
local &clk_2d_val


; Register access modes for each subsystem
&gcc_access_mode="a" 
&lpass_access_mode="a" 

;-----------------------------------------------------------------------------
; Initialize autogenerated constants
;-----------------------------------------------------------------------------

goto Init_Constants


Init_Constants:


;GCC clock registers
&HWIO_GCC_GCC_AHB_CBCR_ADDR=0xfc4010c0
&HWIO_GCC_BAM_DMA_AHB_CBCR_ADDR=0xfc400d44
&HWIO_GCC_BAM_DMA_INACTIVITY_TIMERS_CBCR_ADDR=0xfc400d48
&HWIO_GCC_BIMC_CFG_AHB_CBCR_ADDR=0xfc40110c
&HWIO_GCC_BIMC_CBCR_ADDR=0xfc401118
&HWIO_GCC_BIMC_DDR_CH0_CBCR_ADDR=0xfc4011a8
&HWIO_GCC_BIMC_DDR_CH1_CBCR_ADDR=0xfc4011ac
&HWIO_GCC_BIMC_DDR_CPLL0_CBCR_ADDR=0xfc401184
&HWIO_GCC_BIMC_DDR_CPLL1_CBCR_ADDR=0xfc401188
&HWIO_GCC_BIMC_GFX_CBCR_ADDR=0xfc4011b0
&HWIO_GCC_BIMC_KPSS_AXI_CBCR_ADDR=0xfc40111c
&HWIO_GCC_BIMC_SLEEP_CBCR_ADDR=0xfc401110
&HWIO_GCC_BIMC_SYSNOC_AXI_CBCR_ADDR=0xfc401114
&HWIO_GCC_BIMC_XO_CBCR_ADDR=0xfc401108
&HWIO_GCC_BLSP1_AHB_CBCR_ADDR=0xfc4005c4
&HWIO_GCC_BLSP1_QUP1_I2C_APPS_CBCR_ADDR=0xfc400648
&HWIO_GCC_BLSP1_QUP1_SPI_APPS_CBCR_ADDR=0xfc400644
&HWIO_GCC_BLSP1_QUP2_I2C_APPS_CBCR_ADDR=0xfc4006c8
&HWIO_GCC_BLSP1_QUP2_SPI_APPS_CBCR_ADDR=0xfc4006c4
&HWIO_GCC_BLSP1_QUP3_I2C_APPS_CBCR_ADDR=0xfc400748
&HWIO_GCC_BLSP1_QUP3_SPI_APPS_CBCR_ADDR=0xfc400744
&HWIO_GCC_BLSP1_QUP4_I2C_APPS_CBCR_ADDR=0xfc4007c8
&HWIO_GCC_BLSP1_QUP4_SPI_APPS_CBCR_ADDR=0xfc4007c4
&HWIO_GCC_BLSP1_QUP5_I2C_APPS_CBCR_ADDR=0xfc400848
&HWIO_GCC_BLSP1_QUP5_SPI_APPS_CBCR_ADDR=0xfc400844
&HWIO_GCC_BLSP1_QUP6_I2C_APPS_CBCR_ADDR=0xfc4008c8
&HWIO_GCC_BLSP1_QUP6_SPI_APPS_CBCR_ADDR=0xfc4008c4
&HWIO_GCC_BLSP1_SLEEP_CBCR_ADDR=0xfc4005c8
&HWIO_GCC_BLSP1_UART1_APPS_CBCR_ADDR=0xfc400684
&HWIO_GCC_BLSP1_UART1_SIM_CBCR_ADDR=0xfc400688
&HWIO_GCC_BLSP1_UART2_APPS_CBCR_ADDR=0xfc400704
&HWIO_GCC_BLSP1_UART2_SIM_CBCR_ADDR=0xfc400708
&HWIO_GCC_BLSP1_UART3_APPS_CBCR_ADDR=0xfc400784
&HWIO_GCC_BLSP1_UART3_SIM_CBCR_ADDR=0xfc400788
&HWIO_GCC_BLSP1_UART4_APPS_CBCR_ADDR=0xfc400804
&HWIO_GCC_BLSP1_UART4_SIM_CBCR_ADDR=0xfc400808
&HWIO_GCC_BLSP1_UART5_APPS_CBCR_ADDR=0xfc400884
&HWIO_GCC_BLSP1_UART5_SIM_CBCR_ADDR=0xfc400888
&HWIO_GCC_BLSP1_UART6_APPS_CBCR_ADDR=0xfc400904
&HWIO_GCC_BLSP1_UART6_SIM_CBCR_ADDR=0xfc400908
&HWIO_GCC_BLSP2_AHB_CBCR_ADDR=0xfc400944
&HWIO_GCC_BLSP2_QUP1_I2C_APPS_CBCR_ADDR=0xfc400988
&HWIO_GCC_BLSP2_QUP1_SPI_APPS_CBCR_ADDR=0xfc400984
&HWIO_GCC_BLSP2_QUP2_I2C_APPS_CBCR_ADDR=0xfc400a08
&HWIO_GCC_BLSP2_QUP2_SPI_APPS_CBCR_ADDR=0xfc400a04
&HWIO_GCC_BLSP2_QUP3_I2C_APPS_CBCR_ADDR=0xfc400a88
&HWIO_GCC_BLSP2_QUP3_SPI_APPS_CBCR_ADDR=0xfc400a84
&HWIO_GCC_BLSP2_QUP4_I2C_APPS_CBCR_ADDR=0xfc400b08
&HWIO_GCC_BLSP2_QUP4_SPI_APPS_CBCR_ADDR=0xfc400b04
&HWIO_GCC_BLSP2_QUP5_I2C_APPS_CBCR_ADDR=0xfc400b88
&HWIO_GCC_BLSP2_QUP5_SPI_APPS_CBCR_ADDR=0xfc400b84
&HWIO_GCC_BLSP2_QUP6_I2C_APPS_CBCR_ADDR=0xfc400c08
&HWIO_GCC_BLSP2_QUP6_SPI_APPS_CBCR_ADDR=0xfc400c04
&HWIO_GCC_BLSP2_SLEEP_CBCR_ADDR=0xfc400948
&HWIO_GCC_BLSP2_UART1_APPS_CBCR_ADDR=0xfc4009c4
&HWIO_GCC_BLSP2_UART1_SIM_CBCR_ADDR=0xfc4009c8
&HWIO_GCC_BLSP2_UART2_APPS_CBCR_ADDR=0xfc400a44
&HWIO_GCC_BLSP2_UART2_SIM_CBCR_ADDR=0xfc400a48
&HWIO_GCC_BLSP2_UART3_APPS_CBCR_ADDR=0xfc400ac4
&HWIO_GCC_BLSP2_UART3_SIM_CBCR_ADDR=0xfc400ac8
&HWIO_GCC_BLSP2_UART4_APPS_CBCR_ADDR=0xfc400b44
&HWIO_GCC_BLSP2_UART4_SIM_CBCR_ADDR=0xfc400b48
&HWIO_GCC_BLSP2_UART5_APPS_CBCR_ADDR=0xfc400bc4
&HWIO_GCC_BLSP2_UART5_SIM_CBCR_ADDR=0xfc400bc8
&HWIO_GCC_BLSP2_UART6_APPS_CBCR_ADDR=0xfc400c44
&HWIO_GCC_BLSP2_UART6_SIM_CBCR_ADDR=0xfc400c48
&HWIO_GCC_BOOT_ROM_AHB_CBCR_ADDR=0xfc400e04
&HWIO_GCC_CE1_AHB_CBCR_ADDR=0xfc40104c
&HWIO_GCC_CE1_AXI_CBCR_ADDR=0xfc401048
&HWIO_GCC_CE1_CBCR_ADDR=0xfc401044
&HWIO_GCC_CE2_AHB_CBCR_ADDR=0xfc40108c
&HWIO_GCC_CE2_AXI_CBCR_ADDR=0xfc401088
&HWIO_GCC_CE2_CBCR_ADDR=0xfc401084
&HWIO_GCC_CE3_AHB_CBCR_ADDR=0xfc401d0c
&HWIO_GCC_CE3_AXI_CBCR_ADDR=0xfc401d08
&HWIO_GCC_CE3_CBCR_ADDR=0xfc401d04
&HWIO_GCC_CFG_NOC_AHB_CBCR_ADDR=0xfc400144
&HWIO_GCC_CFG_NOC_DDR_CFG_CBCR_ADDR=0xfc400148
&HWIO_GCC_CFG_NOC_RPM_AHB_CBCR_ADDR=0xfc40014c
&HWIO_GCC_CNOC_BUS_TIMEOUT0_AHB_CBCR_ADDR=0xfc4012c4
&HWIO_GCC_CNOC_BUS_TIMEOUT1_AHB_CBCR_ADDR=0xfc4012cc
&HWIO_GCC_CNOC_BUS_TIMEOUT2_AHB_CBCR_ADDR=0xfc4012d4
&HWIO_GCC_CNOC_BUS_TIMEOUT3_AHB_CBCR_ADDR=0xfc4012dc
&HWIO_GCC_CNOC_BUS_TIMEOUT4_AHB_CBCR_ADDR=0xfc4012e4
&HWIO_GCC_CNOC_BUS_TIMEOUT5_AHB_CBCR_ADDR=0xfc4012ec
&HWIO_GCC_CNOC_BUS_TIMEOUT6_AHB_CBCR_ADDR=0xfc4012f4
&HWIO_GCC_CNOC_BUS_TIMEOUT7_AHB_CBCR_ADDR=0xfc4012fc
&HWIO_GCC_DCD_XO_CBCR_ADDR=0xfc401c04
&HWIO_GCC_DDR_DIM_CFG_CBCR_ADDR=0xfc401180
&HWIO_GCC_DDR_DIM_SLEEP_CBCR_ADDR=0xfc40118c
&HWIO_GCC_DEHR_CBCR_ADDR=0xfc401304
&HWIO_GCC_GP1_CBCR_ADDR=0xfc401900
&HWIO_GCC_GP2_CBCR_ADDR=0xfc401940
&HWIO_GCC_GP3_CBCR_ADDR=0xfc401980
&HWIO_GCC_GCC_IM_SLEEP_CBCR_ADDR=0xfc4010cc
&HWIO_GCC_IMEM_AXI_CBCR_ADDR=0xfc400204
&HWIO_GCC_IMEM_CFG_AHB_CBCR_ADDR=0xfc400208
&HWIO_GCC_IPA_AHB_CBCR_ADDR=0xfc4018cc
&HWIO_GCC_IPA_CBCR_ADDR=0xfc4018c8
&HWIO_GCC_IPA_SLEEP_CBCR_ADDR=0xfc4018d0
&HWIO_GCC_KPSS_AHB_CBCR_ADDR=0xfc401204
&HWIO_GCC_KPSS_AXI_CBCR_ADDR=0xfc401208
&HWIO_GCC_LPASS_MPORT_AXI_CBCR_ADDR=0xfc4011c4
&HWIO_GCC_LPASS_Q6_AXI_CBCR_ADDR=0xfc4011c0
&HWIO_GCC_LPASS_SWAY_CBCR_ADDR=0xfc4011c8
&HWIO_GCC_MMSS_BIMC_GFX_CBCR_ADDR=0xfc400250
&HWIO_GCC_MMSS_NOC_AT_CBCR_ADDR=0xfc40024c
&HWIO_GCC_MMSS_NOC_CFG_AHB_CBCR_ADDR=0xfc400248
&HWIO_GCC_MPM_AHB_CBCR_ADDR=0xfc400ec8
&HWIO_GCC_MSG_RAM_AHB_CBCR_ADDR=0xfc400e44
&HWIO_GCC_MSS_CFG_AHB_CBCR_ADDR=0xfc400280
&HWIO_GCC_MSS_Q6_BIMC_AXI_CBCR_ADDR=0xfc400284
&HWIO_GCC_NOC_CONF_XPU_AHB_CBCR_ADDR=0xfc4001c0
&HWIO_GCC_OBT_ODT_CBCR_ADDR=0xfc401cd8
&HWIO_GCC_OCMEM_SYS_NOC_AXI_CBCR_ADDR=0xfc400244
&HWIO_GCC_PCIE_0_AUX_CBCR_ADDR=0xfc401ad4
&HWIO_GCC_PCIE_0_CFG_AHB_CBCR_ADDR=0xfc401ad0
&HWIO_GCC_PCIE_0_MSTR_AXI_CBCR_ADDR=0xfc401acc
&HWIO_GCC_PCIE_0_PIPE_CBCR_ADDR=0xfc401ad8
&HWIO_GCC_PCIE_0_SLV_AXI_CBCR_ADDR=0xfc401ac8
&HWIO_GCC_PCIE_1_AUX_CBCR_ADDR=0xfc401b54
&HWIO_GCC_PCIE_1_CFG_AHB_CBCR_ADDR=0xfc401b50
&HWIO_GCC_PCIE_1_MSTR_AXI_CBCR_ADDR=0xfc401b4c
&HWIO_GCC_PCIE_1_PIPE_CBCR_ADDR=0xfc401b58
&HWIO_GCC_PCIE_1_SLV_AXI_CBCR_ADDR=0xfc401b48
&HWIO_GCC_PDM2_CBCR_ADDR=0xfc400ccc
&HWIO_GCC_PDM_AHB_CBCR_ADDR=0xfc400cc4
&HWIO_GCC_PDM_XO4_CBCR_ADDR=0xfc400cc8
&HWIO_GCC_PERIPH_NOC_AHB_CBCR_ADDR=0xfc400184
&HWIO_GCC_PERIPH_NOC_AT_CBCR_ADDR=0xfc40018c
&HWIO_GCC_PERIPH_NOC_CFG_AHB_CBCR_ADDR=0xfc400188
&HWIO_GCC_PERIPH_NOC_MPU_CFG_AHB_CBCR_ADDR=0xfc401340
&HWIO_GCC_PERIPH_XPU_AHB_CBCR_ADDR=0xfc400c80
&HWIO_GCC_PNOC_BUS_TIMEOUT0_AHB_CBCR_ADDR=0xfc401284
&HWIO_GCC_PNOC_BUS_TIMEOUT1_AHB_CBCR_ADDR=0xfc40128c
&HWIO_GCC_PNOC_BUS_TIMEOUT2_AHB_CBCR_ADDR=0xfc401294
&HWIO_GCC_PNOC_BUS_TIMEOUT3_AHB_CBCR_ADDR=0xfc40129c
&HWIO_GCC_PNOC_BUS_TIMEOUT4_AHB_CBCR_ADDR=0xfc4012a4
&HWIO_GCC_PRNG_AHB_CBCR_ADDR=0xfc400d04
&HWIO_GCC_QDSS_AT_CBCR_ADDR=0xfc40030c
&HWIO_GCC_QDSS_CFG_AHB_CBCR_ADDR=0xfc400308
&HWIO_GCC_QDSS_DAP_AHB_CBCR_ADDR=0xfc400304
&HWIO_GCC_QDSS_DAP_CBCR_ADDR=0xfc400324
&HWIO_GCC_QDSS_ETR_USB_CBCR_ADDR=0xfc400310
&HWIO_GCC_QDSS_RBCPR_XPU_AHB_CBCR_ADDR=0xfc4002c0
&HWIO_GCC_QDSS_STM_CBCR_ADDR=0xfc400314
&HWIO_GCC_QDSS_TRACECLKIN_CBCR_ADDR=0xfc400318
&HWIO_GCC_QDSS_TSCTR_DIV16_CBCR_ADDR=0xfc400330
&HWIO_GCC_QDSS_TSCTR_DIV2_CBCR_ADDR=0xfc40031c
&HWIO_GCC_QDSS_TSCTR_DIV3_CBCR_ADDR=0xfc400320
&HWIO_GCC_QDSS_TSCTR_DIV4_CBCR_ADDR=0xfc400328
&HWIO_GCC_QDSS_TSCTR_DIV8_CBCR_ADDR=0xfc40032c
&HWIO_GCC_RBCPR_CX_AHB_CBCR_ADDR=0xfc401388
&HWIO_GCC_RBCPR_CX_CBCR_ADDR=0xfc401384
&HWIO_GCC_RBCPR_MX_AHB_CBCR_ADDR=0xfc4013c8
&HWIO_GCC_RBCPR_MX_CBCR_ADDR=0xfc4013c4
&HWIO_GCC_RPM_BUS_AHB_CBCR_ADDR=0xfc400f04
&HWIO_GCC_RPM_PROC_HCLK_CBCR_ADDR=0xfc400f00
&HWIO_GCC_RPM_SLEEP_CBCR_ADDR=0xfc400f08
&HWIO_GCC_RPM_TIMER_CBCR_ADDR=0xfc400f0c
&HWIO_GCC_SDCC1_AHB_CBCR_ADDR=0xfc4004c8
&HWIO_GCC_SDCC1_APPS_CBCR_ADDR=0xfc4004c4
&HWIO_GCC_SDCC2_AHB_CBCR_ADDR=0xfc400508
&HWIO_GCC_SDCC2_APPS_CBCR_ADDR=0xfc400504
&HWIO_GCC_SDCC3_AHB_CBCR_ADDR=0xfc400548
&HWIO_GCC_SDCC3_APPS_CBCR_ADDR=0xfc400544
&HWIO_GCC_SDCC4_AHB_CBCR_ADDR=0xfc400588
&HWIO_GCC_SDCC4_APPS_CBCR_ADDR=0xfc400584
&HWIO_GCC_SEC_CTRL_ACC_CBCR_ADDR=0xfc400f44
&HWIO_GCC_SEC_CTRL_AHB_CBCR_ADDR=0xfc400f48
&HWIO_GCC_SEC_CTRL_BOOT_ROM_PATCH_CBCR_ADDR=0xfc400f54
&HWIO_GCC_SEC_CTRL_CBCR_ADDR=0xfc400f4c
&HWIO_GCC_SEC_CTRL_SENSE_CBCR_ADDR=0xfc400f50
&HWIO_GCC_SNOC_BUS_TIMEOUT0_AHB_CBCR_ADDR=0xfc401244
&HWIO_GCC_SNOC_BUS_TIMEOUT1_AHB_CBCR_ADDR=0xfc401254
&HWIO_GCC_SNOC_BUS_TIMEOUT2_AHB_CBCR_ADDR=0xfc40124c
&HWIO_GCC_SNOC_BUS_TIMEOUT3_AHB_CBCR_ADDR=0xfc40125c
&HWIO_GCC_SNOC_CNOC_AHB_CBCR_ADDR=0xfc400110
&HWIO_GCC_SNOC_PNOC_AHB_CBCR_ADDR=0xfc400114
&HWIO_GCC_SPDM_BIMC_CY_CBCR_ADDR=0xfc401010
&HWIO_GCC_SPDM_CFG_AHB_CBCR_ADDR=0xfc401004
&HWIO_GCC_SPDM_DEBUG_CY_CBCR_ADDR=0xfc401018
&HWIO_GCC_SPDM_FF_CBCR_ADDR=0xfc40100c
&HWIO_GCC_SPDM_MSTR_AHB_CBCR_ADDR=0xfc401008
&HWIO_GCC_SPDM_PNOC_CY_CBCR_ADDR=0xfc40101c
&HWIO_GCC_SPDM_RPM_CY_CBCR_ADDR=0xfc401020
&HWIO_GCC_SPDM_SNOC_CY_CBCR_ADDR=0xfc401014
&HWIO_GCC_SPMI_AHB_CBCR_ADDR=0xfc400fcc
&HWIO_GCC_SPMI_CNOC_AHB_CBCR_ADDR=0xfc400fc8
&HWIO_GCC_SPMI_SER_CBCR_ADDR=0xfc400fc4
&HWIO_GCC_SYS_NOC_AT_CBCR_ADDR=0xfc400118
&HWIO_GCC_SYS_NOC_AXI_CBCR_ADDR=0xfc400104
&HWIO_GCC_SYS_NOC_IPA_AXI_CBCR_ADDR=0xfc4018e8
&HWIO_GCC_SYS_NOC_KPSS_AHB_CBCR_ADDR=0xfc40010c
&HWIO_GCC_SYS_NOC_QDSS_STM_AXI_CBCR_ADDR=0xfc400108
&HWIO_GCC_SYS_NOC_UFS_AXI_CBCR_ADDR=0xfc401d7c
&HWIO_GCC_SYS_NOC_USB3_AXI_CBCR_ADDR=0xfc4003fc
&HWIO_GCC_TCSR_AHB_CBCR_ADDR=0xfc400dc4
&HWIO_GCC_TLMM_AHB_CBCR_ADDR=0xfc400e84
&HWIO_GCC_TLMM_CBCR_ADDR=0xfc400e88
&HWIO_GCC_TSIF_AHB_CBCR_ADDR=0xfc400d84
&HWIO_GCC_TSIF_INACTIVITY_TIMERS_CBCR_ADDR=0xfc400d8c
&HWIO_GCC_TSIF_REF_CBCR_ADDR=0xfc400d88
&HWIO_GCC_UFS_AHB_CBCR_ADDR=0xfc401d4c
&HWIO_GCC_UFS_AXI_CBCR_ADDR=0xfc401d48
&HWIO_GCC_UFS_RX_CFG_CBCR_ADDR=0xfc401d54
&HWIO_GCC_UFS_RX_SYMBOL_0_CBCR_ADDR=0xfc401d60
&HWIO_GCC_UFS_RX_SYMBOL_1_CBCR_ADDR=0xfc401d64
&HWIO_GCC_UFS_TX_CFG_CBCR_ADDR=0xfc401d50
&HWIO_GCC_UFS_TX_SYMBOL_0_CBCR_ADDR=0xfc401d58
&HWIO_GCC_UFS_TX_SYMBOL_1_CBCR_ADDR=0xfc401d5c
&HWIO_GCC_USB2_HS_PHY_SLEEP_CBCR_ADDR=0xfc4004ac
&HWIO_GCC_USB30_MASTER_CBCR_ADDR=0xfc4003c8
&HWIO_GCC_USB30_MOCK_UTMI_CBCR_ADDR=0xfc4003d0
&HWIO_GCC_USB30_SLEEP_CBCR_ADDR=0xfc4003cc
&HWIO_GCC_USB3_PHY_AUX_CBCR_ADDR=0xfc401408
&HWIO_GCC_USB3_PHY_PIPE_CBCR_ADDR=0xfc40140c
&HWIO_GCC_USB_HS_AHB_CBCR_ADDR=0xfc400488
&HWIO_GCC_USB_HS_INACTIVITY_TIMERS_CBCR_ADDR=0xfc40048c
&HWIO_GCC_USB_HS_SYSTEM_CBCR_ADDR=0xfc400484
&HWIO_GCC_USB_PHY_CFG_AHB2PHY_CBCR_ADDR=0xfc401a84
&HWIO_GCC_VS_CBCR_ADDR=0xfc401e84
&HWIO_GCC_GCC_XO_CBCR_ADDR=0xfc4010c4
&HWIO_GCC_GCC_XO_DIV4_CBCR_ADDR=0xfc4010c8

;LPASS clock registers
&HWIO_LPASS_AUDIO_CORE_AON_CLK_CBCR_ADDR=0xfe02f000
&HWIO_LPASS_AUDIO_CORE_AVSYNC_AVTIMER_XO_CBCR_ADDR=0xfe01a014
&HWIO_LPASS_AUDIO_CORE_AVSYNC_CSR_CBCR_ADDR=0xfe01a000
&HWIO_LPASS_AUDIO_CORE_BCR_SLP_CBCR_ADDR=0xfe004004
&HWIO_LPASS_AUDIO_CORE_CSR_CBCR_ADDR=0xfe01d000
&HWIO_LPASS_AUDIO_CORE_DML_CBCR_ADDR=0xfe01e000
&HWIO_LPASS_AUDIO_CORE_GDSC_XO_CBCR_ADDR=0xfe007004
&HWIO_LPASS_AUDIO_CORE_IXFABRIC_CBCR_ADDR=0xfe01b000
&HWIO_LPASS_AUDIO_CORE_IXFABRIC_SPDMTM_CSR_CBCR_ADDR=0xfe028000
&HWIO_LPASS_AUDIO_CORE_LPAIF_CODEC_SPKR_EBIT_CBCR_ADDR=0xfe00a01c
&HWIO_LPASS_AUDIO_CORE_LPAIF_CODEC_SPKR_IBIT_CBCR_ADDR=0xfe00a018
&HWIO_LPASS_AUDIO_CORE_LPAIF_CODEC_SPKR_OSR_CBCR_ADDR=0xfe00a014
&HWIO_LPASS_AUDIO_CORE_LPAIF_CSR_CBCR_ADDR=0xfe009004
&HWIO_LPASS_AUDIO_CORE_LPAIF_DMA_CBCR_ADDR=0xfe009000
&HWIO_LPASS_AUDIO_CORE_LPAIF_PCM0_EBIT_CBCR_ADDR=0xfe00f018
&HWIO_LPASS_AUDIO_CORE_LPAIF_PCM0_IBIT_CBCR_ADDR=0xfe00f014
&HWIO_LPASS_AUDIO_CORE_LPAIF_PCM1_EBIT_CBCR_ADDR=0xfe010018
&HWIO_LPASS_AUDIO_CORE_LPAIF_PCM1_IBIT_CBCR_ADDR=0xfe010014
&HWIO_LPASS_AUDIO_CORE_LPAIF_PCM_DATA_OE_CBCR_ADDR=0xfe013014
&HWIO_LPASS_AUDIO_CORE_LPAIF_PRI_EBIT_CBCR_ADDR=0xfe00b01c
&HWIO_LPASS_AUDIO_CORE_LPAIF_PRI_IBIT_CBCR_ADDR=0xfe00b018
&HWIO_LPASS_AUDIO_CORE_LPAIF_PRI_OSR_CBCR_ADDR=0xfe00b014
&HWIO_LPASS_AUDIO_CORE_LPAIF_QUAD_EBIT_CBCR_ADDR=0xfe00e01c
&HWIO_LPASS_AUDIO_CORE_LPAIF_QUAD_IBIT_CBCR_ADDR=0xfe00e018
&HWIO_LPASS_AUDIO_CORE_LPAIF_QUAD_OSR_CBCR_ADDR=0xfe00e014
&HWIO_LPASS_AUDIO_CORE_LPAIF_SEC_EBIT_CBCR_ADDR=0xfe00c01c
&HWIO_LPASS_AUDIO_CORE_LPAIF_SEC_IBIT_CBCR_ADDR=0xfe00c018
&HWIO_LPASS_AUDIO_CORE_LPAIF_SEC_OSR_CBCR_ADDR=0xfe00c014
&HWIO_LPASS_AUDIO_CORE_LPAIF_TER_EBIT_CBCR_ADDR=0xfe00d01c
&HWIO_LPASS_AUDIO_CORE_LPAIF_TER_IBIT_CBCR_ADDR=0xfe00d018
&HWIO_LPASS_AUDIO_CORE_LPAIF_TER_OSR_CBCR_ADDR=0xfe00d014
&HWIO_LPASS_AUDIO_CORE_LPM_CBCR_ADDR=0xfe019000
&HWIO_LPASS_AUDIO_CORE_RESAMPLER_CORE_CBCR_ADDR=0xfe011014
&HWIO_LPASS_AUDIO_CORE_RESAMPLER_LFABIF_CBCR_ADDR=0xfe011018
&HWIO_LPASS_AUDIO_CORE_SECURITY_CBCR_ADDR=0xfe021000
&HWIO_LPASS_AUDIO_CORE_SLIMBUS2_CORE_CBCR_ADDR=0xfe012814
&HWIO_LPASS_AUDIO_CORE_SLIMBUS2_LFABIF_CBCR_ADDR=0xfe012818
&HWIO_LPASS_AUDIO_CORE_SLIMBUS_CORE_CBCR_ADDR=0xfe012014
&HWIO_LPASS_AUDIO_CORE_SLIMBUS_LFABIF_CBCR_ADDR=0xfe012018
&HWIO_LPASS_AUDIO_CORE_SYSNOC_CBCR_ADDR=0xfe01f000
&HWIO_LPASS_AUDIO_CORE_TIMEOUT_CBCR_ADDR=0xfe020000
&HWIO_LPASS_AUDIO_WRAPPER_AON_CLK_CBCR_ADDR=0xfe02f004
&HWIO_LPASS_AUDIO_WRAPPER_BR_CBCR_ADDR=0xfe024000
&HWIO_LPASS_AUDIO_WRAPPER_EFABRIC_CBCR_ADDR=0xfe01b004
&HWIO_LPASS_AUDIO_WRAPPER_EFABRIC_SPDMTM_CSR_CBCR_ADDR=0xfe028004
&HWIO_LPASS_AUDIO_WRAPPER_LCC_CSR_CBCR_ADDR=0xfe023000
&HWIO_LPASS_AUDIO_WRAPPER_PRI_MCLK_CBCR_ADDR=0xfe00b034
&HWIO_LPASS_AUDIO_WRAPPER_QUAD_MCLK_CBCR_ADDR=0xfe00e034
&HWIO_LPASS_AUDIO_WRAPPER_SEC_MCLK_CBCR_ADDR=0xfe00c034
&HWIO_LPASS_AUDIO_WRAPPER_SECURITY_CBCR_ADDR=0xfe021004
&HWIO_LPASS_AUDIO_WRAPPER_SMEM_CBCR_ADDR=0xfe025000
&HWIO_LPASS_AUDIO_WRAPPER_STM_XO_CBCR_ADDR=0xfe027000
&HWIO_LPASS_AUDIO_WRAPPER_SYSNOC_SWAY_CBCR_ADDR=0xfe01f004
&HWIO_LPASS_AUDIO_WRAPPER_TER_MCLK_CBCR_ADDR=0xfe00d034
&HWIO_LPASS_AUDIO_WRAPPER_TIMEOUT_CBCR_ADDR=0xfe020004
&HWIO_LPASS_Q6_SPDM_CBCR_ADDR=0xfe016014
&HWIO_LPASS_Q6SS_AHB_LFABIF_CBCR_ADDR=0xfe022000
&HWIO_LPASS_Q6SS_AHBM_CBCR_ADDR=0xfe022004
&HWIO_LPASS_Q6SS_BCR_SLP_CBCR_ADDR=0xfe006004
&HWIO_LPASS_Q6SS_SLP_CBCR_ADDR=0xfe026004
&HWIO_LPASS_Q6SS_TCM_SLAVE_CBCR_ADDR=0xfe01c000
&HWIO_LPASS_Q6SS_XO_CBCR_ADDR=0xfe026000

; CMD and CFG RCGRs for clocks with configurable frequencies
&HWIO_GCC_ACC_CMD_RCGR_ADDR=0xfc400f80
&HWIO_GCC_ACC_CFG_RCGR_ADDR=0xfc400f84
&HWIO_GCC_BIMC_CORE_KPSS_AXI_CMD_RCGR_ADDR=0xfc401158
&HWIO_GCC_BIMC_CORE_KPSS_AXI_CFG_RCGR_ADDR=0xfc40115c
&HWIO_GCC_BLSP1_QUP1_I2C_APPS_CMD_RCGR_ADDR=0xfc400660
&HWIO_GCC_BLSP1_QUP1_I2C_APPS_CFG_RCGR_ADDR=0xfc400664
&HWIO_GCC_BLSP1_QUP1_SPI_APPS_CMD_RCGR_ADDR=0xfc40064c
&HWIO_GCC_BLSP1_QUP1_SPI_APPS_CFG_RCGR_ADDR=0xfc400650
&HWIO_GCC_BLSP1_QUP2_I2C_APPS_CMD_RCGR_ADDR=0xfc4006e0
&HWIO_GCC_BLSP1_QUP2_I2C_APPS_CFG_RCGR_ADDR=0xfc4006e4
&HWIO_GCC_BLSP1_QUP2_SPI_APPS_CMD_RCGR_ADDR=0xfc4006cc
&HWIO_GCC_BLSP1_QUP2_SPI_APPS_CFG_RCGR_ADDR=0xfc4006d0
&HWIO_GCC_BLSP1_QUP3_I2C_APPS_CMD_RCGR_ADDR=0xfc400760
&HWIO_GCC_BLSP1_QUP3_I2C_APPS_CFG_RCGR_ADDR=0xfc400764
&HWIO_GCC_BLSP1_QUP3_SPI_APPS_CMD_RCGR_ADDR=0xfc40074c
&HWIO_GCC_BLSP1_QUP3_SPI_APPS_CFG_RCGR_ADDR=0xfc400750
&HWIO_GCC_BLSP1_QUP4_I2C_APPS_CMD_RCGR_ADDR=0xfc4007e0
&HWIO_GCC_BLSP1_QUP4_I2C_APPS_CFG_RCGR_ADDR=0xfc4007e4
&HWIO_GCC_BLSP1_QUP4_SPI_APPS_CMD_RCGR_ADDR=0xfc4007cc
&HWIO_GCC_BLSP1_QUP4_SPI_APPS_CFG_RCGR_ADDR=0xfc4007d0
&HWIO_GCC_BLSP1_QUP5_I2C_APPS_CMD_RCGR_ADDR=0xfc400860
&HWIO_GCC_BLSP1_QUP5_I2C_APPS_CFG_RCGR_ADDR=0xfc400864
&HWIO_GCC_BLSP1_QUP5_SPI_APPS_CMD_RCGR_ADDR=0xfc40084c
&HWIO_GCC_BLSP1_QUP5_SPI_APPS_CFG_RCGR_ADDR=0xfc400850
&HWIO_GCC_BLSP1_QUP6_I2C_APPS_CMD_RCGR_ADDR=0xfc4008e0
&HWIO_GCC_BLSP1_QUP6_I2C_APPS_CFG_RCGR_ADDR=0xfc4008e4
&HWIO_GCC_BLSP1_QUP6_SPI_APPS_CMD_RCGR_ADDR=0xfc4008cc
&HWIO_GCC_BLSP1_QUP6_SPI_APPS_CFG_RCGR_ADDR=0xfc4008d0
&HWIO_GCC_BLSP1_UART1_APPS_CMD_RCGR_ADDR=0xfc40068c
&HWIO_GCC_BLSP1_UART1_APPS_CFG_RCGR_ADDR=0xfc400690
&HWIO_GCC_BLSP1_UART2_APPS_CMD_RCGR_ADDR=0xfc40070c
&HWIO_GCC_BLSP1_UART2_APPS_CFG_RCGR_ADDR=0xfc400710
&HWIO_GCC_BLSP1_UART3_APPS_CMD_RCGR_ADDR=0xfc40078c
&HWIO_GCC_BLSP1_UART3_APPS_CFG_RCGR_ADDR=0xfc400790
&HWIO_GCC_BLSP1_UART4_APPS_CMD_RCGR_ADDR=0xfc40080c
&HWIO_GCC_BLSP1_UART4_APPS_CFG_RCGR_ADDR=0xfc400810
&HWIO_GCC_BLSP1_UART5_APPS_CMD_RCGR_ADDR=0xfc40088c
&HWIO_GCC_BLSP1_UART5_APPS_CFG_RCGR_ADDR=0xfc400890
&HWIO_GCC_BLSP1_UART6_APPS_CMD_RCGR_ADDR=0xfc40090c
&HWIO_GCC_BLSP1_UART6_APPS_CFG_RCGR_ADDR=0xfc400910
&HWIO_GCC_BLSP2_QUP1_I2C_APPS_CMD_RCGR_ADDR=0xfc4009a0
&HWIO_GCC_BLSP2_QUP1_I2C_APPS_CFG_RCGR_ADDR=0xfc4009a4
&HWIO_GCC_BLSP2_QUP1_SPI_APPS_CMD_RCGR_ADDR=0xfc40098c
&HWIO_GCC_BLSP2_QUP1_SPI_APPS_CFG_RCGR_ADDR=0xfc400990
&HWIO_GCC_BLSP2_QUP2_I2C_APPS_CMD_RCGR_ADDR=0xfc400a20
&HWIO_GCC_BLSP2_QUP2_I2C_APPS_CFG_RCGR_ADDR=0xfc400a24
&HWIO_GCC_BLSP2_QUP2_SPI_APPS_CMD_RCGR_ADDR=0xfc400a0c
&HWIO_GCC_BLSP2_QUP2_SPI_APPS_CFG_RCGR_ADDR=0xfc400a10
&HWIO_GCC_BLSP2_QUP3_I2C_APPS_CMD_RCGR_ADDR=0xfc400aa0
&HWIO_GCC_BLSP2_QUP3_I2C_APPS_CFG_RCGR_ADDR=0xfc400aa4
&HWIO_GCC_BLSP2_QUP3_SPI_APPS_CMD_RCGR_ADDR=0xfc400a8c
&HWIO_GCC_BLSP2_QUP3_SPI_APPS_CFG_RCGR_ADDR=0xfc400a90
&HWIO_GCC_BLSP2_QUP4_I2C_APPS_CMD_RCGR_ADDR=0xfc400b20
&HWIO_GCC_BLSP2_QUP4_I2C_APPS_CFG_RCGR_ADDR=0xfc400b24
&HWIO_GCC_BLSP2_QUP4_SPI_APPS_CMD_RCGR_ADDR=0xfc400b0c
&HWIO_GCC_BLSP2_QUP4_SPI_APPS_CFG_RCGR_ADDR=0xfc400b10
&HWIO_GCC_BLSP2_QUP5_I2C_APPS_CMD_RCGR_ADDR=0xfc400ba0
&HWIO_GCC_BLSP2_QUP5_I2C_APPS_CFG_RCGR_ADDR=0xfc400ba4
&HWIO_GCC_BLSP2_QUP5_SPI_APPS_CMD_RCGR_ADDR=0xfc400b8c
&HWIO_GCC_BLSP2_QUP5_SPI_APPS_CFG_RCGR_ADDR=0xfc400b90
&HWIO_GCC_BLSP2_QUP6_I2C_APPS_CMD_RCGR_ADDR=0xfc400c20
&HWIO_GCC_BLSP2_QUP6_I2C_APPS_CFG_RCGR_ADDR=0xfc400c24
&HWIO_GCC_BLSP2_QUP6_SPI_APPS_CMD_RCGR_ADDR=0xfc400c0c
&HWIO_GCC_BLSP2_QUP6_SPI_APPS_CFG_RCGR_ADDR=0xfc400c10
&HWIO_GCC_BLSP2_UART1_APPS_CMD_RCGR_ADDR=0xfc4009cc
&HWIO_GCC_BLSP2_UART1_APPS_CFG_RCGR_ADDR=0xfc4009d0
&HWIO_GCC_BLSP2_UART2_APPS_CMD_RCGR_ADDR=0xfc400a4c
&HWIO_GCC_BLSP2_UART2_APPS_CFG_RCGR_ADDR=0xfc400a50
&HWIO_GCC_BLSP2_UART3_APPS_CMD_RCGR_ADDR=0xfc400acc
&HWIO_GCC_BLSP2_UART3_APPS_CFG_RCGR_ADDR=0xfc400ad0
&HWIO_GCC_BLSP2_UART4_APPS_CMD_RCGR_ADDR=0xfc400b4c
&HWIO_GCC_BLSP2_UART4_APPS_CFG_RCGR_ADDR=0xfc400b50
&HWIO_GCC_BLSP2_UART5_APPS_CMD_RCGR_ADDR=0xfc400bcc
&HWIO_GCC_BLSP2_UART5_APPS_CFG_RCGR_ADDR=0xfc400bd0
&HWIO_GCC_BLSP2_UART6_APPS_CMD_RCGR_ADDR=0xfc400c4c
&HWIO_GCC_BLSP2_UART6_APPS_CFG_RCGR_ADDR=0xfc400c50
&HWIO_GCC_BLSP_UART_SIM_CMD_RCGR_ADDR=0xfc400600
&HWIO_GCC_BLSP_UART_SIM_CFG_RCGR_ADDR=0xfc400604
&HWIO_GCC_CE1_CMD_RCGR_ADDR=0xfc401050
&HWIO_GCC_CE1_CFG_RCGR_ADDR=0xfc401054
&HWIO_GCC_CE2_CMD_RCGR_ADDR=0xfc401090
&HWIO_GCC_CE2_CFG_RCGR_ADDR=0xfc401094
&HWIO_GCC_CE3_CMD_RCGR_ADDR=0xfc401d10
&HWIO_GCC_CE3_CFG_RCGR_ADDR=0xfc401d14
&HWIO_GCC_CONFIG_NOC_CMD_RCGR_ADDR=0xfc400150
&HWIO_GCC_CONFIG_NOC_CFG_RCGR_ADDR=0xfc400154
&HWIO_GCC_GP1_CMD_RCGR_ADDR=0xfc401904
&HWIO_GCC_GP1_CFG_RCGR_ADDR=0xfc401908
&HWIO_GCC_GP2_CMD_RCGR_ADDR=0xfc401944
&HWIO_GCC_GP2_CFG_RCGR_ADDR=0xfc401948
&HWIO_GCC_GP3_CMD_RCGR_ADDR=0xfc401984
&HWIO_GCC_GP3_CFG_RCGR_ADDR=0xfc401988
&HWIO_GCC_IPA_CMD_RCGR_ADDR=0xfc4018d4
&HWIO_GCC_IPA_CFG_RCGR_ADDR=0xfc4018d8
&HWIO_GCC_KPSS_AHB_CMD_RCGR_ADDR=0xfc40120c
&HWIO_GCC_KPSS_AHB_CFG_RCGR_ADDR=0xfc401210
&HWIO_GCC_PCIE_0_AUX_CMD_RCGR_ADDR=0xfc401b00
&HWIO_GCC_PCIE_0_AUX_CFG_RCGR_ADDR=0xfc401b04
&HWIO_GCC_PCIE_1_AUX_CMD_RCGR_ADDR=0xfc401b80
&HWIO_GCC_PCIE_1_AUX_CFG_RCGR_ADDR=0xfc401b84
&HWIO_GCC_PDM2_CMD_RCGR_ADDR=0xfc400cd0
&HWIO_GCC_PDM2_CFG_RCGR_ADDR=0xfc400cd4
&HWIO_GCC_PERIPH_NOC_CMD_RCGR_ADDR=0xfc400190
&HWIO_GCC_PERIPH_NOC_CFG_RCGR_ADDR=0xfc400194
&HWIO_GCC_QDSS_AT_CMD_RCGR_ADDR=0xfc400340
&HWIO_GCC_QDSS_AT_CFG_RCGR_ADDR=0xfc400344
&HWIO_GCC_QDSS_STM_CMD_RCGR_ADDR=0xfc400358
&HWIO_GCC_QDSS_STM_CFG_RCGR_ADDR=0xfc40035c
&HWIO_GCC_QDSS_TRACECLKIN_CMD_RCGR_ADDR=0xfc400380
&HWIO_GCC_QDSS_TRACECLKIN_CFG_RCGR_ADDR=0xfc400384
&HWIO_GCC_QDSS_TSCTR_CMD_RCGR_ADDR=0xfc400398
&HWIO_GCC_QDSS_TSCTR_CFG_RCGR_ADDR=0xfc40039c
&HWIO_GCC_RBCPR_CX_CMD_RCGR_ADDR=0xfc40138c
&HWIO_GCC_RBCPR_CX_CFG_RCGR_ADDR=0xfc401390
&HWIO_GCC_RBCPR_MX_CMD_RCGR_ADDR=0xfc4013cc
&HWIO_GCC_RBCPR_MX_CFG_RCGR_ADDR=0xfc4013d0
&HWIO_GCC_RPM_CMD_RCGR_ADDR=0xfc400f10
&HWIO_GCC_RPM_CFG_RCGR_ADDR=0xfc400f14
&HWIO_GCC_SDCC1_APPS_CMD_RCGR_ADDR=0xfc4004d0
&HWIO_GCC_SDCC1_APPS_CFG_RCGR_ADDR=0xfc4004d4
&HWIO_GCC_SDCC2_APPS_CMD_RCGR_ADDR=0xfc400510
&HWIO_GCC_SDCC2_APPS_CFG_RCGR_ADDR=0xfc400514
&HWIO_GCC_SDCC3_APPS_CMD_RCGR_ADDR=0xfc400550
&HWIO_GCC_SDCC3_APPS_CFG_RCGR_ADDR=0xfc400554
&HWIO_GCC_SDCC4_APPS_CMD_RCGR_ADDR=0xfc400590
&HWIO_GCC_SDCC4_APPS_CFG_RCGR_ADDR=0xfc400594
&HWIO_GCC_SEC_CTRL_CMD_RCGR_ADDR=0xfc400f98
&HWIO_GCC_SEC_CTRL_CFG_RCGR_ADDR=0xfc400f9c
&HWIO_GCC_SPMI_AHB_CMD_RCGR_ADDR=0xfc400fe8
&HWIO_GCC_SPMI_AHB_CFG_RCGR_ADDR=0xfc400fec
&HWIO_GCC_SPMI_SER_CMD_RCGR_ADDR=0xfc400fd0
&HWIO_GCC_SPMI_SER_CFG_RCGR_ADDR=0xfc400fd4
&HWIO_GCC_SYSTEM_NOC_CMD_RCGR_ADDR=0xfc40011c
&HWIO_GCC_SYSTEM_NOC_CFG_RCGR_ADDR=0xfc400120
&HWIO_GCC_TSIF_REF_CMD_RCGR_ADDR=0xfc400d90
&HWIO_GCC_TSIF_REF_CFG_RCGR_ADDR=0xfc400d94
&HWIO_GCC_UFS_AXI_CMD_RCGR_ADDR=0xfc401d68
&HWIO_GCC_UFS_AXI_CFG_RCGR_ADDR=0xfc401d6c
&HWIO_GCC_USB30_MASTER_CMD_RCGR_ADDR=0xfc4003d4
&HWIO_GCC_USB30_MASTER_CFG_RCGR_ADDR=0xfc4003d8
&HWIO_GCC_USB30_MOCK_UTMI_CMD_RCGR_ADDR=0xfc4003e8
&HWIO_GCC_USB30_MOCK_UTMI_CFG_RCGR_ADDR=0xfc4003ec
&HWIO_GCC_USB3_PHY_AUX_CMD_RCGR_ADDR=0xfc401414
&HWIO_GCC_USB3_PHY_AUX_CFG_RCGR_ADDR=0xfc401418
&HWIO_GCC_USB_HS_SYSTEM_CMD_RCGR_ADDR=0xfc400490
&HWIO_GCC_USB_HS_SYSTEM_CFG_RCGR_ADDR=0xfc400494
&HWIO_GCC_VS_CMD_RCGR_ADDR=0xfc401e88
&HWIO_GCC_VS_CFG_RCGR_ADDR=0xfc401e8c
&HWIO_LPASS_AHBFABRIC_CMD_RCGR_ADDR=0xfe018000
&HWIO_LPASS_AHBFABRIC_CFG_RCGR_ADDR=0xfe018004
&HWIO_LPASS_LPAIF_PCM0_CMD_RCGR_ADDR=0xfe00f000
&HWIO_LPASS_LPAIF_PCM0_CFG_RCGR_ADDR=0xfe00f004
&HWIO_LPASS_LPAIF_PCM1_CMD_RCGR_ADDR=0xfe010000
&HWIO_LPASS_LPAIF_PCM1_CFG_RCGR_ADDR=0xfe010004
&HWIO_LPASS_LPAIF_PCMOE_CMD_RCGR_ADDR=0xfe013000
&HWIO_LPASS_LPAIF_PCMOE_CFG_RCGR_ADDR=0xfe013004
&HWIO_LPASS_LPAIF_PRI_CMD_RCGR_ADDR=0xfe00b000
&HWIO_LPASS_LPAIF_PRI_CFG_RCGR_ADDR=0xfe00b004
&HWIO_LPASS_LPAIF_QUAD_CMD_RCGR_ADDR=0xfe00e000
&HWIO_LPASS_LPAIF_QUAD_CFG_RCGR_ADDR=0xfe00e004
&HWIO_LPASS_LPAIF_SEC_CMD_RCGR_ADDR=0xfe00c000
&HWIO_LPASS_LPAIF_SEC_CFG_RCGR_ADDR=0xfe00c004
&HWIO_LPASS_LPAIF_SPKR_CMD_RCGR_ADDR=0xfe00a000
&HWIO_LPASS_LPAIF_SPKR_CFG_RCGR_ADDR=0xfe00a004
&HWIO_LPASS_LPAIF_TER_CMD_RCGR_ADDR=0xfe00d000
&HWIO_LPASS_LPAIF_TER_CFG_RCGR_ADDR=0xfe00d004
&HWIO_LPASS_PRI_MCLK_CMD_RCGR_ADDR=0xfe00b020
&HWIO_LPASS_PRI_MCLK_CFG_RCGR_ADDR=0xfe00b024
&HWIO_LPASS_Q6CORE_CMD_RCGR_ADDR=0xfe014000
&HWIO_LPASS_Q6CORE_CFG_RCGR_ADDR=0xfe014004
&HWIO_LPASS_Q6_SPDM_CMD_RCGR_ADDR=0xfe016000
&HWIO_LPASS_Q6_SPDM_CFG_RCGR_ADDR=0xfe016004
&HWIO_LPASS_QUAD_MCLK_CMD_RCGR_ADDR=0xfe00e020
&HWIO_LPASS_QUAD_MCLK_CFG_RCGR_ADDR=0xfe00e024
&HWIO_LPASS_RESAMPLER_CMD_RCGR_ADDR=0xfe011000
&HWIO_LPASS_RESAMPLER_CFG_RCGR_ADDR=0xfe011004
&HWIO_LPASS_SEC_MCLK_CMD_RCGR_ADDR=0xfe00c020
&HWIO_LPASS_SEC_MCLK_CFG_RCGR_ADDR=0xfe00c024
&HWIO_LPASS_TER_MCLK_CMD_RCGR_ADDR=0xfe00d020
&HWIO_LPASS_TER_MCLK_CFG_RCGR_ADDR=0xfe00d024

; Utility registers
&HWIO_GCC_CLOCK_FRQ_MEASURE_CTL_ADDR=0xfc401884
&HWIO_GCC_CLOCK_FRQ_MEASURE_STATUS_ADDR=0xfc401888
&HWIO_GCC_GCC_XO_DIV4_CBCR_ADDR=0xfc4010c8
&HWIO_GCC_PLLTEST_PAD_CFG_ADDR=0xfc40188c
&HWIO_TLMM_GPIO_CFG0_ADDR=0xfd511000


; Constants for setting clock frequencies
&HAL_CLK_CMD_CFG_UPDATE_FMSK=0x1
&HAL_CLK_CFG_CGR_SRC_SEL_SHFT=0x8
&HAL_CLK_CFG_CGR_SRC_DIV_SHFT=0x0
&HAL_CLK_CFG_CGR_SRC_SEL_FMSK=0x700
&HAL_CLK_CFG_CGR_SRC_DIV_FMSK=0x1f
&HAL_CLK_CFG_CGR_MODE_FMSK=0x3000
&HAL_CLK_CFG_CFG_DUAL_EDGE_MODE_VAL=0x2
&HAL_CLK_CFG_CGR_MODE_SHFT=0xc
&HAL_CLK_M_REG_OFFSET=0x8
&HAL_CLK_N_REG_OFFSET=0xc
&HAL_CLK_D_REG_OFFSET=0x10


; Test Masks
&CLK_TEST_TYPE_MASK=(0x00007FFF)
&CLK_TEST_SEL_MASK=(0x000F0000)
&CLK_TEST_SUB_MUX_MASK=(0xF0000000)

; GCC Debug register
&HWIO_GCC_GCC_DEBUG_CLK_CTL_ADDR=0xfc401880

; GCC Test Mask
&CLK_GCC_TEST=(0x1<<0x10)

; LPASS Debug register
&HWIO_LPASS_DBG_CLK_ADDR=0xfe032000

; LPASS Test Mask
&CLK_LPASS_TEST=(0x2<<0x10)

; LPASS Submuxes
&HWIO_LPASS_QDSP6SS_TEST_CLK_CTL_ADDR=0xfe202010
&CLK_LPASS_SUB_MUX_Q6=(0x1<<0x1C)

; GCC test clocks
&CLK_TEST_GCC_SEC_CTRL_ACC_CLK=(&CLK_GCC_TEST|0x120)
&CLK_TEST_GCC_BIMC_CLK=(&CLK_GCC_TEST|0x154)
&CLK_TEST_GCC_BIMC_DDR_CPLL0_CLK=(&CLK_GCC_TEST|0x159)
&CLK_TEST_GCC_BIMC_DDR_CPLL1_CLK=(&CLK_GCC_TEST|0x15A)
&CLK_TEST_GCC_BIMC_XO_CLK=(&CLK_GCC_TEST|0x150)
&CLK_TEST_GCC_CFG_NOC_DDR_CFG_CLK=(&CLK_GCC_TEST|0x009)
&CLK_TEST_GCC_CNOC_BUS_TIMEOUT5_AHB_CLK=(&CLK_GCC_TEST|0x185)
&CLK_TEST_GCC_DDR_DIM_CFG_CLK=(&CLK_GCC_TEST|0x158)
&CLK_TEST_GCC_BIMC_KPSS_AXI_CLK=(&CLK_GCC_TEST|0x155)
&CLK_TEST_GCC_KPSS_AXI_CLK=(&CLK_GCC_TEST|0x169)
&CLK_TEST_GCC_BIMC_KPSS_CCI_AXI_CLK=(&CLK_GCC_TEST|0x156)
&CLK_TEST_GCC_KPSS_CCI_AXI_CLK=(&CLK_GCC_TEST|0x16A)
&CLK_TEST_GCC_BLSP1_QUP1_I2C_APPS_CLK=(&CLK_GCC_TEST|0x08B)
&CLK_TEST_GCC_BLSP1_QUP1_SPI_APPS_CLK=(&CLK_GCC_TEST|0x08A)
&CLK_TEST_GCC_BLSP1_QUP2_I2C_APPS_CLK=(&CLK_GCC_TEST|0x090)
&CLK_TEST_GCC_BLSP1_QUP2_SPI_APPS_CLK=(&CLK_GCC_TEST|0x08E)
&CLK_TEST_GCC_BLSP1_QUP3_I2C_APPS_CLK=(&CLK_GCC_TEST|0x094)
&CLK_TEST_GCC_BLSP1_QUP3_SPI_APPS_CLK=(&CLK_GCC_TEST|0x093)
&CLK_TEST_GCC_BLSP1_QUP4_I2C_APPS_CLK=(&CLK_GCC_TEST|0x099)
&CLK_TEST_GCC_BLSP1_QUP4_SPI_APPS_CLK=(&CLK_GCC_TEST|0x098)
&CLK_TEST_GCC_BLSP1_QUP5_I2C_APPS_CLK=(&CLK_GCC_TEST|0x09D)
&CLK_TEST_GCC_BLSP1_QUP5_SPI_APPS_CLK=(&CLK_GCC_TEST|0x09C)
&CLK_TEST_GCC_BLSP1_QUP6_I2C_APPS_CLK=(&CLK_GCC_TEST|0x0A2)
&CLK_TEST_GCC_BLSP1_QUP6_SPI_APPS_CLK=(&CLK_GCC_TEST|0x0A1)
&CLK_TEST_GCC_BLSP1_UART1_APPS_CLK=(&CLK_GCC_TEST|0x08C)
&CLK_TEST_GCC_BLSP1_UART2_APPS_CLK=(&CLK_GCC_TEST|0x091)
&CLK_TEST_GCC_BLSP1_UART3_APPS_CLK=(&CLK_GCC_TEST|0x095)
&CLK_TEST_GCC_BLSP1_UART4_APPS_CLK=(&CLK_GCC_TEST|0x09A)
&CLK_TEST_GCC_BLSP1_UART5_APPS_CLK=(&CLK_GCC_TEST|0x09E)
&CLK_TEST_GCC_BLSP1_UART6_APPS_CLK=(&CLK_GCC_TEST|0x0A3)
&CLK_TEST_GCC_BLSP2_QUP1_I2C_APPS_CLK=(&CLK_GCC_TEST|0x0AB)
&CLK_TEST_GCC_BLSP2_QUP1_SPI_APPS_CLK=(&CLK_GCC_TEST|0x0AA)
&CLK_TEST_GCC_BLSP2_QUP2_I2C_APPS_CLK=(&CLK_GCC_TEST|0x0B0)
&CLK_TEST_GCC_BLSP2_QUP2_SPI_APPS_CLK=(&CLK_GCC_TEST|0x0AE)
&CLK_TEST_GCC_BLSP2_QUP3_I2C_APPS_CLK=(&CLK_GCC_TEST|0x0B4)
&CLK_TEST_GCC_BLSP2_QUP3_SPI_APPS_CLK=(&CLK_GCC_TEST|0x0B3)
&CLK_TEST_GCC_BLSP2_QUP4_I2C_APPS_CLK=(&CLK_GCC_TEST|0x0B9)
&CLK_TEST_GCC_BLSP2_QUP4_SPI_APPS_CLK=(&CLK_GCC_TEST|0x0B8)
&CLK_TEST_GCC_BLSP2_QUP5_I2C_APPS_CLK=(&CLK_GCC_TEST|0x0BD)
&CLK_TEST_GCC_BLSP2_QUP5_SPI_APPS_CLK=(&CLK_GCC_TEST|0x0BC)
&CLK_TEST_GCC_BLSP2_QUP6_I2C_APPS_CLK=(&CLK_GCC_TEST|0x0C2)
&CLK_TEST_GCC_BLSP2_QUP6_SPI_APPS_CLK=(&CLK_GCC_TEST|0x0C1)
&CLK_TEST_GCC_BLSP2_UART1_APPS_CLK=(&CLK_GCC_TEST|0x0AC)
&CLK_TEST_GCC_BLSP2_UART2_APPS_CLK=(&CLK_GCC_TEST|0x0B1)
&CLK_TEST_GCC_BLSP2_UART3_APPS_CLK=(&CLK_GCC_TEST|0x0B5)
&CLK_TEST_GCC_BLSP2_UART4_APPS_CLK=(&CLK_GCC_TEST|0x0BA)
&CLK_TEST_GCC_BLSP2_UART5_APPS_CLK=(&CLK_GCC_TEST|0x0BE)
&CLK_TEST_GCC_BLSP2_UART6_APPS_CLK=(&CLK_GCC_TEST|0x0C3)
&CLK_TEST_GCC_BLSP1_UART1_SIM_CLK=(&CLK_GCC_TEST|0x08D)
&CLK_TEST_GCC_BLSP1_UART2_SIM_CLK=(&CLK_GCC_TEST|0x092)
&CLK_TEST_GCC_BLSP1_UART3_SIM_CLK=(&CLK_GCC_TEST|0x096)
&CLK_TEST_GCC_BLSP1_UART4_SIM_CLK=(&CLK_GCC_TEST|0x09B)
&CLK_TEST_GCC_BLSP1_UART5_SIM_CLK=(&CLK_GCC_TEST|0x0A0)
&CLK_TEST_GCC_BLSP1_UART6_SIM_CLK=(&CLK_GCC_TEST|0x0A4)
&CLK_TEST_GCC_BLSP2_UART1_SIM_CLK=(&CLK_GCC_TEST|0x0AD)
&CLK_TEST_GCC_BLSP2_UART2_SIM_CLK=(&CLK_GCC_TEST|0x0B2)
&CLK_TEST_GCC_BLSP2_UART3_SIM_CLK=(&CLK_GCC_TEST|0x0B6)
&CLK_TEST_GCC_BLSP2_UART4_SIM_CLK=(&CLK_GCC_TEST|0x0BB)
&CLK_TEST_GCC_BLSP2_UART5_SIM_CLK=(&CLK_GCC_TEST|0x0C0)
&CLK_TEST_GCC_BLSP2_UART6_SIM_CLK=(&CLK_GCC_TEST|0x0C4)
&CLK_TEST_GCC_CE1_CLK=(&CLK_GCC_TEST|0x138)
&CLK_TEST_GCC_CE2_CLK=(&CLK_GCC_TEST|0x140)
&CLK_TEST_GCC_CE3_CLK=(&CLK_GCC_TEST|0x228)
&CLK_TEST_GCC_AHB_CLK=(&CLK_GCC_TEST|0x148)
&CLK_TEST_GCC_BIMC_CFG_AHB_CLK=(&CLK_GCC_TEST|0x151)
&CLK_TEST_GCC_BOOT_ROM_AHB_CLK=(&CLK_GCC_TEST|0x0F8)
&CLK_TEST_GCC_CE1_AHB_CLK=(&CLK_GCC_TEST|0x13A)
&CLK_TEST_GCC_CE2_AHB_CLK=(&CLK_GCC_TEST|0x142)
&CLK_TEST_GCC_CE3_AHB_CLK=(&CLK_GCC_TEST|0x22A)
&CLK_TEST_GCC_CFG_NOC_AHB_CLK=(&CLK_GCC_TEST|0x008)
&CLK_TEST_GCC_CNOC_BUS_TIMEOUT0_AHB_CLK=(&CLK_GCC_TEST|0x180)
&CLK_TEST_GCC_CNOC_BUS_TIMEOUT1_AHB_CLK=(&CLK_GCC_TEST|0x181)
&CLK_TEST_GCC_CNOC_BUS_TIMEOUT2_AHB_CLK=(&CLK_GCC_TEST|0x182)
&CLK_TEST_GCC_CNOC_BUS_TIMEOUT3_AHB_CLK=(&CLK_GCC_TEST|0x183)
&CLK_TEST_GCC_CNOC_BUS_TIMEOUT4_AHB_CLK=(&CLK_GCC_TEST|0x184)
&CLK_TEST_GCC_CNOC_BUS_TIMEOUT7_AHB_CLK=(&CLK_GCC_TEST|0x187)
&CLK_TEST_GCC_DEHR_CLK=(&CLK_GCC_TEST|0x188)
&CLK_TEST_GCC_IMEM_CFG_AHB_CLK=(&CLK_GCC_TEST|0x021)
&CLK_TEST_GCC_IPA_AHB_CLK=(&CLK_GCC_TEST|0x219)
&CLK_TEST_GCC_MMSS_NOC_CFG_AHB_CLK=(&CLK_GCC_TEST|0x029)
&CLK_TEST_GCC_MPM_AHB_CLK=(&CLK_GCC_TEST|0x110)
&CLK_TEST_GCC_MSG_RAM_AHB_CLK=(&CLK_GCC_TEST|0x100)
&CLK_TEST_GCC_MSS_CFG_AHB_CLK=(&CLK_GCC_TEST|0x030)
&CLK_TEST_GCC_NOC_CONF_XPU_AHB_CLK=(&CLK_GCC_TEST|0x018)
&CLK_TEST_GCC_PCIE_0_CFG_AHB_CLK=(&CLK_GCC_TEST|0x1EA)
&CLK_TEST_GCC_PCIE_1_CFG_AHB_CLK=(&CLK_GCC_TEST|0x1F2)
&CLK_TEST_GCC_PERIPH_NOC_CFG_AHB_CLK=(&CLK_GCC_TEST|0x011)
&CLK_TEST_GCC_QDSS_CFG_AHB_CLK=(&CLK_GCC_TEST|0x041)
&CLK_TEST_GCC_QDSS_DAP_AHB_CLK=(&CLK_GCC_TEST|0x040)
&CLK_TEST_GCC_QDSS_RBCPR_XPU_AHB_CLK=(&CLK_GCC_TEST|0x038)
&CLK_TEST_GCC_RBCPR_CX_AHB_CLK=(&CLK_GCC_TEST|0x191)
&CLK_TEST_GCC_RBCPR_MX_AHB_CLK=(&CLK_GCC_TEST|0x209)
&CLK_TEST_GCC_SEC_CTRL_AHB_CLK=(&CLK_GCC_TEST|0x121)
&CLK_TEST_GCC_SEC_CTRL_BOOT_ROM_PATCH_CLK=(&CLK_GCC_TEST|0x124)
&CLK_TEST_GCC_SNOC_CNOC_AHB_CLK=(&CLK_GCC_TEST|0x003)
&CLK_TEST_GCC_SPDM_CFG_AHB_CLK=(&CLK_GCC_TEST|0x130)
&CLK_TEST_GCC_SPDM_MSTR_AHB_CLK=(&CLK_GCC_TEST|0x131)
&CLK_TEST_GCC_SPMI_CNOC_AHB_CLK=(&CLK_GCC_TEST|0x129)
&CLK_TEST_GCC_TCSR_AHB_CLK=(&CLK_GCC_TEST|0x0F0)
&CLK_TEST_GCC_TLMM_AHB_CLK=(&CLK_GCC_TEST|0x108)
&CLK_TEST_GCC_TLMM_CLK=(&CLK_GCC_TEST|0x109)
&CLK_TEST_GCC_UFS_AHB_CLK=(&CLK_GCC_TEST|0x231)
&CLK_TEST_GCC_DCD_XO_CLK=(&CLK_GCC_TEST|0x210)
&CLK_TEST_GCC_BAM_DMA_INACTIVITY_TIMERS_CLK=(&CLK_GCC_TEST|0x0E1)
&CLK_TEST_GCC_BIMC_SLEEP_CLK=(&CLK_GCC_TEST|0x152)
&CLK_TEST_GCC_BLSP1_SLEEP_CLK=(&CLK_GCC_TEST|0x089)
&CLK_TEST_GCC_BLSP2_SLEEP_CLK=(&CLK_GCC_TEST|0x0A9)
&CLK_TEST_GCC_DDR_DIM_SLEEP_CLK=(&CLK_GCC_TEST|0x15B)
&CLK_TEST_GCC_IM_SLEEP_CLK=(&CLK_GCC_TEST|0x14B)
&CLK_TEST_GCC_IPA_SLEEP_CLK=(&CLK_GCC_TEST|0x21A)
&CLK_TEST_GCC_RPM_SLEEP_CLK=(&CLK_GCC_TEST|0x11B)
&CLK_TEST_GCC_TSIF_INACTIVITY_TIMERS_CLK=(&CLK_GCC_TEST|0x0EA)
&CLK_TEST_GCC_USB2_HS_PHY_SLEEP_CLK=(&CLK_GCC_TEST|0x063)
&CLK_TEST_GCC_USB30_SLEEP_CLK=(&CLK_GCC_TEST|0x051)
&CLK_TEST_GCC_USB_HS_INACTIVITY_TIMERS_CLK=(&CLK_GCC_TEST|0x062)
&CLK_TEST_GCC_XO_CLK=(&CLK_GCC_TEST|0x149)
&CLK_TEST_GCC_XO_DIV4_CLK=(&CLK_GCC_TEST|0x14A)
&CLK_TEST_GCC_IPA_CLK=(&CLK_GCC_TEST|0x218)
&CLK_TEST_GCC_SYS_NOC_IPA_AXI_CLK=(&CLK_GCC_TEST|0x059)
&CLK_TEST_GCC_KPSS_AHB_CLK=(&CLK_GCC_TEST|0x168)
&CLK_TEST_GCC_SNOC_BUS_TIMEOUT0_AHB_CLK=(&CLK_GCC_TEST|0x170)
&CLK_TEST_GCC_SYS_NOC_KPSS_AHB_CLK=(&CLK_GCC_TEST|0x002)
&CLK_TEST_GCC_BIMC_GFX_CLK=(&CLK_GCC_TEST|0x15E)
&CLK_TEST_GCC_MMSS_BIMC_GFX_CLK=(&CLK_GCC_TEST|0x02C)
&CLK_TEST_GCC_MSS_Q6_BIMC_AXI_CLK=(&CLK_GCC_TEST|0x031)
&CLK_TEST_GCC_OBT_ODT_CLK=(&CLK_GCC_TEST|0x220)
&CLK_TEST_GCC_PCIE_0_AUX_CLK=(&CLK_GCC_TEST|0x1EB)
&CLK_TEST_GCC_PCIE_0_PIPE_CLK=(&CLK_GCC_TEST|0x1EC)
&CLK_TEST_GCC_PCIE_1_AUX_CLK=(&CLK_GCC_TEST|0x1F3)
&CLK_TEST_GCC_PCIE_1_PIPE_CLK=(&CLK_GCC_TEST|0x1F4)
&CLK_TEST_GCC_PDM_XO4_CLK=(&CLK_GCC_TEST|0x0D1)
&CLK_TEST_GCC_PDM2_CLK=(&CLK_GCC_TEST|0x0D2)
&CLK_TEST_GCC_BAM_DMA_AHB_CLK=(&CLK_GCC_TEST|0x0E0)
&CLK_TEST_GCC_BLSP1_AHB_CLK=(&CLK_GCC_TEST|0x088)
&CLK_TEST_GCC_BLSP2_AHB_CLK=(&CLK_GCC_TEST|0x0A8)
&CLK_TEST_GCC_PDM_AHB_CLK=(&CLK_GCC_TEST|0x0D0)
&CLK_TEST_GCC_PERIPH_NOC_AHB_CLK=(&CLK_GCC_TEST|0x010)
&CLK_TEST_GCC_PERIPH_NOC_MPU_CFG_AHB_CLK=(&CLK_GCC_TEST|0x0C9)
&CLK_TEST_GCC_PERIPH_XPU_AHB_CLK=(&CLK_GCC_TEST|0x0C8)
&CLK_TEST_GCC_PNOC_BUS_TIMEOUT0_AHB_CLK=(&CLK_GCC_TEST|0x178)
&CLK_TEST_GCC_PNOC_BUS_TIMEOUT1_AHB_CLK=(&CLK_GCC_TEST|0x179)
&CLK_TEST_GCC_PNOC_BUS_TIMEOUT2_AHB_CLK=(&CLK_GCC_TEST|0x17A)
&CLK_TEST_GCC_PNOC_BUS_TIMEOUT3_AHB_CLK=(&CLK_GCC_TEST|0x17B)
&CLK_TEST_GCC_PNOC_BUS_TIMEOUT4_AHB_CLK=(&CLK_GCC_TEST|0x17C)
&CLK_TEST_GCC_PRNG_AHB_CLK=(&CLK_GCC_TEST|0x0D8)
&CLK_TEST_GCC_SDCC1_AHB_CLK=(&CLK_GCC_TEST|0x069)
&CLK_TEST_GCC_SDCC2_AHB_CLK=(&CLK_GCC_TEST|0x071)
&CLK_TEST_GCC_SDCC3_AHB_CLK=(&CLK_GCC_TEST|0x079)
&CLK_TEST_GCC_SDCC4_AHB_CLK=(&CLK_GCC_TEST|0x081)
&CLK_TEST_GCC_SNOC_PNOC_AHB_CLK=(&CLK_GCC_TEST|0x004)
&CLK_TEST_GCC_TSIF_AHB_CLK=(&CLK_GCC_TEST|0x0E8)
&CLK_TEST_GCC_USB_HS_AHB_CLK=(&CLK_GCC_TEST|0x061)
&CLK_TEST_GCC_USB_PHY_CFG_AHB2PHY_CLK=(&CLK_GCC_TEST|0x064)
&CLK_TEST_GCC_MMSS_NOC_AT_CLK=(&CLK_GCC_TEST|0x02A)
&CLK_TEST_GCC_PERIPH_NOC_AT_CLK=(&CLK_GCC_TEST|0x012)
&CLK_TEST_GCC_QDSS_AT_CLK=(&CLK_GCC_TEST|0x042)
&CLK_TEST_GCC_SYS_NOC_AT_CLK=(&CLK_GCC_TEST|0x005)
&CLK_TEST_GCC_QDSS_DAP_CLK=(&CLK_GCC_TEST|0x049)
&CLK_TEST_GCC_QDSS_STM_CLK=(&CLK_GCC_TEST|0x044)
&CLK_TEST_GCC_SYS_NOC_QDSS_STM_AXI_CLK=(&CLK_GCC_TEST|0x001)
&CLK_TEST_GCC_QDSS_TRACECLKIN_CLK=(&CLK_GCC_TEST|0x045)
&CLK_TEST_GCC_QDSS_TSCTR_DIV2_CLK=(&CLK_GCC_TEST|0x046)
&CLK_TEST_GCC_QDSS_TSCTR_DIV4_CLK=(&CLK_GCC_TEST|0x04A)
&CLK_TEST_GCC_QDSS_TSCTR_DIV16_CLK=(&CLK_GCC_TEST|0x04C)
&CLK_TEST_GCC_QDSS_TSCTR_DIV3_CLK=(&CLK_GCC_TEST|0x048)
&CLK_TEST_GCC_QDSS_TSCTR_DIV8_CLK=(&CLK_GCC_TEST|0x04B)
&CLK_TEST_GCC_RBCPR_CX_CLK=(&CLK_GCC_TEST|0x190)
&CLK_TEST_GCC_RBCPR_MX_CLK=(&CLK_GCC_TEST|0x208)
&CLK_TEST_GCC_CFG_NOC_RPM_AHB_CLK=(&CLK_GCC_TEST|0x00A)
&CLK_TEST_GCC_CNOC_BUS_TIMEOUT6_AHB_CLK=(&CLK_GCC_TEST|0x186)
&CLK_TEST_GCC_RPM_BUS_AHB_CLK=(&CLK_GCC_TEST|0x11A)
&CLK_TEST_GCC_RPM_PROC_FCLK=(&CLK_GCC_TEST|0x118)
&CLK_TEST_GCC_RPM_PROC_HCLK=(&CLK_GCC_TEST|0x119)
&CLK_TEST_GCC_RPM_TIMER_CLK=(&CLK_GCC_TEST|0x11C)
&CLK_TEST_GCC_SDCC1_APPS_CLK=(&CLK_GCC_TEST|0x068)
&CLK_TEST_GCC_SDCC2_APPS_CLK=(&CLK_GCC_TEST|0x070)
&CLK_TEST_GCC_SDCC3_APPS_CLK=(&CLK_GCC_TEST|0x078)
&CLK_TEST_GCC_SDCC4_APPS_CLK=(&CLK_GCC_TEST|0x080)
&CLK_TEST_GCC_SEC_CTRL_CLK=(&CLK_GCC_TEST|0x122)
&CLK_TEST_GCC_SEC_CTRL_SENSE_CLK=(&CLK_GCC_TEST|0x123)
&CLK_TEST_GCC_SPDM_BIMC_CY_CLK=(&CLK_GCC_TEST|0x133)
&CLK_TEST_GCC_SPDM_FF_CLK=(&CLK_GCC_TEST|0x132)
&CLK_TEST_GCC_SPDM_PNOC_CY_CLK=(&CLK_GCC_TEST|0x135)
&CLK_TEST_GCC_SPDM_RPM_CY_CLK=(&CLK_GCC_TEST|0x136)
&CLK_TEST_GCC_SPDM_SNOC_CY_CLK=(&CLK_GCC_TEST|0x134)
&CLK_TEST_GCC_SPMI_AHB_CLK=(&CLK_GCC_TEST|0x12A)
&CLK_TEST_GCC_SPMI_SER_CLK=(&CLK_GCC_TEST|0x128)
&CLK_TEST_GCC_BIMC_SYSNOC_AXI_CLK=(&CLK_GCC_TEST|0x153)
&CLK_TEST_GCC_CE1_AXI_CLK=(&CLK_GCC_TEST|0x139)
&CLK_TEST_GCC_CE2_AXI_CLK=(&CLK_GCC_TEST|0x141)
&CLK_TEST_GCC_CE3_AXI_CLK=(&CLK_GCC_TEST|0x229)
&CLK_TEST_GCC_IMEM_AXI_CLK=(&CLK_GCC_TEST|0x020)
&CLK_TEST_GCC_LPASS_MPORT_AXI_CLK=(&CLK_GCC_TEST|0x162)
&CLK_TEST_GCC_LPASS_Q6_AXI_CLK=(&CLK_GCC_TEST|0x160)
&CLK_TEST_GCC_LPASS_SWAY_CLK=(&CLK_GCC_TEST|0x163)
&CLK_TEST_GCC_OCMEM_SYS_NOC_AXI_CLK=(&CLK_GCC_TEST|0x028)
&CLK_TEST_GCC_PCIE_0_MSTR_AXI_CLK=(&CLK_GCC_TEST|0x1E9)
&CLK_TEST_GCC_PCIE_0_SLV_AXI_CLK=(&CLK_GCC_TEST|0x1E8)
&CLK_TEST_GCC_PCIE_1_MSTR_AXI_CLK=(&CLK_GCC_TEST|0x1F1)
&CLK_TEST_GCC_PCIE_1_SLV_AXI_CLK=(&CLK_GCC_TEST|0x1F0)
&CLK_TEST_GCC_QDSS_ETR_USB_CLK=(&CLK_GCC_TEST|0x043)
&CLK_TEST_GCC_SNOC_BUS_TIMEOUT1_AHB_CLK=(&CLK_GCC_TEST|0x172)
&CLK_TEST_GCC_SNOC_BUS_TIMEOUT3_AHB_CLK=(&CLK_GCC_TEST|0x173)
&CLK_TEST_GCC_SYS_NOC_AXI_CLK=(&CLK_GCC_TEST|0x000)
&CLK_TEST_GCC_CFG_NOC_TIC_CLK=(&CLK_GCC_TEST|0x00B)
&CLK_TEST_GCC_TSIF_REF_CLK=(&CLK_GCC_TEST|0x0E9)
&CLK_TEST_GCC_SYS_NOC_UFS_AXI_CLK=(&CLK_GCC_TEST|0x058)
&CLK_TEST_GCC_UFS_AXI_CLK=(&CLK_GCC_TEST|0x230)
&CLK_TEST_GCC_UFS_RX_CFG_CLK=(&CLK_GCC_TEST|0x233)
&CLK_TEST_GCC_UFS_TX_CFG_CLK=(&CLK_GCC_TEST|0x232)
&CLK_TEST_GCC_SNOC_BUS_TIMEOUT2_AHB_CLK=(&CLK_GCC_TEST|0x171)
&CLK_TEST_GCC_SYS_NOC_USB3_AXI_CLK=(&CLK_GCC_TEST|0x006)
&CLK_TEST_GCC_USB30_MASTER_CLK=(&CLK_GCC_TEST|0x050)
&CLK_TEST_GCC_USB30_MOCK_UTMI_CLK=(&CLK_GCC_TEST|0x052)
&CLK_TEST_GCC_USB3_PHY_AUX_CLK=(&CLK_GCC_TEST|0x053)
&CLK_TEST_GCC_USB_HS_SYSTEM_CLK=(&CLK_GCC_TEST|0x060)
&CLK_TEST_GCC_VS_CLK=(&CLK_GCC_TEST|0x200)
&CLK_TEST_GPLL0_DTEST=(&CLK_GCC_TEST|0x1C0)
&CLK_TEST_GPLL0_LOCK_DET=(&CLK_GCC_TEST|0x1C1)
&CLK_TEST_GPLL1_DTEST=(&CLK_GCC_TEST|0x1C2)
&CLK_TEST_GPLL1_LOCK_DET=(&CLK_GCC_TEST|0x1C3)
&CLK_TEST_GPLL2_DTEST=(&CLK_GCC_TEST|0x1C4)
&CLK_TEST_GPLL2_LOCK_DET=(&CLK_GCC_TEST|0x1C5)
&CLK_TEST_GPLL3_DTEST=(&CLK_GCC_TEST|0x1C6)
&CLK_TEST_GPLL3_LOCK_DET=(&CLK_GCC_TEST|0x1C7)
&CLK_TEST_GPLL4_DTEST=(&CLK_GCC_TEST|0x1D8)
&CLK_TEST_GPLL4_LOCK_DET=(&CLK_GCC_TEST|0x1D9)
&CLK_TEST_KPSS_GCC_DBG_CLK=(&CLK_GCC_TEST|0x16B)
&CLK_TEST_KPSS_GCC_RINGOSC_CLK=(&CLK_GCC_TEST|0x1D0)
&CLK_TEST_LPASS_GCC_DBG_CLK=(&CLK_GCC_TEST|0x161)
&CLK_TEST_MMSS_GCC_DBG_CLK=(&CLK_GCC_TEST|0x02B)
&CLK_TEST_MPM_GCC_TEMP_SENSOR_RINGOSC_CLK=(&CLK_GCC_TEST|0x1C8)
&CLK_TEST_MSS_GCC_DBG_CLK=(&CLK_GCC_TEST|0x032)
&CLK_TEST_PCIE_0_PIPE_CLK=(&CLK_GCC_TEST|0x1ED)
&CLK_TEST_PCIE_0_PIPE_CLK=(&CLK_GCC_TEST|0x1ED)
&CLK_TEST_PCIE_1_PIPE_CLK=(&CLK_GCC_TEST|0x1F5)
&CLK_TEST_PCIE_1_PIPE_CLK=(&CLK_GCC_TEST|0x1F5)
&CLK_TEST_QUSB2PHY_CLK_480M_TEST=(&CLK_GCC_TEST|0x1A0)
&CLK_TEST_UFS_RX_SYMBOL_0_CLK=(&CLK_GCC_TEST|0x23A)
&CLK_TEST_UFS_RX_SYMBOL_0_CLK=(&CLK_GCC_TEST|0x23A)
&CLK_TEST_UFS_RX_SYMBOL_1_CLK=(&CLK_GCC_TEST|0x23B)
&CLK_TEST_UFS_RX_SYMBOL_1_CLK=(&CLK_GCC_TEST|0x23B)
&CLK_TEST_UFS_TX_SYMBOL_0_CLK=(&CLK_GCC_TEST|0x238)
&CLK_TEST_UFS_TX_SYMBOL_0_CLK=(&CLK_GCC_TEST|0x238)
&CLK_TEST_UFS_TX_SYMBOL_1_CLK=(&CLK_GCC_TEST|0x239)
&CLK_TEST_UFS_TX_SYMBOL_1_CLK=(&CLK_GCC_TEST|0x239)
&CLK_TEST_USB2_PHY_WRAPPER_GCC_USB30_UTMI_CLK=(&CLK_GCC_TEST|0x056)
&CLK_TEST_USB3_PHY_WRAPPER_GCC_USB3_PIPE_CLK=(&CLK_GCC_TEST|0x055)
&CLK_TEST_USB_HSPW_GCC_480_TEST_CLK=(&CLK_GCC_TEST|0x198)

; LPASS test clocks
&CLK_TEST_AHBFABRIC_CLK_SRC=(&CLK_LPASS_TEST|0x01A)
&CLK_TEST_AHB_SPDMTM_CLK=(&CLK_LPASS_TEST|0x051)
&CLK_TEST_AUDIO_CORE_AON_CLK=(&CLK_LPASS_TEST|0x056)
&CLK_TEST_AUDIO_CORE_AVSYNC_CSR_CLK=(&CLK_LPASS_TEST|0x02F)
&CLK_TEST_AUDIO_CORE_CSR_CLK=(&CLK_LPASS_TEST|0x042)
&CLK_TEST_AUDIO_CORE_DML_CLK=(&CLK_LPASS_TEST|0x048)
&CLK_TEST_AUDIO_CORE_IXFABRIC_CLK=(&CLK_LPASS_TEST|0x049)
&CLK_TEST_AUDIO_CORE_IXFABRIC_SPDMTM_CSR_CLK=(&CLK_LPASS_TEST|0x041)
&CLK_TEST_AUDIO_CORE_LPAIF_CSR_CLK=(&CLK_LPASS_TEST|0x037)
&CLK_TEST_AUDIO_CORE_LPAIF_DMA_CLK=(&CLK_LPASS_TEST|0x038)
&CLK_TEST_AUDIO_CORE_LPM_CLK=(&CLK_LPASS_TEST|0x047)
&CLK_TEST_AUDIO_CORE_RESAMPLER_LFABIF_CLK=(&CLK_LPASS_TEST|0x03C)
&CLK_TEST_AUDIO_CORE_SECURITY_CLK=(&CLK_LPASS_TEST|0x03A)
&CLK_TEST_AUDIO_CORE_SLIMBUS2_LFABIF_CLK=(&CLK_LPASS_TEST|0x067)
&CLK_TEST_AUDIO_CORE_SLIMBUS_LFABIF_CLK=(&CLK_LPASS_TEST|0x03E)
&CLK_TEST_AUDIO_CORE_SYSNOC_CLK=(&CLK_LPASS_TEST|0x01F)
&CLK_TEST_AUDIO_CORE_TIMEOUT_CLK=(&CLK_LPASS_TEST|0x039)
&CLK_TEST_AUDIO_WRAPPER_AON_CLK=(&CLK_LPASS_TEST|0x057)
&CLK_TEST_AUDIO_WRAPPER_BR_CLK=(&CLK_LPASS_TEST|0x022)
&CLK_TEST_AUDIO_WRAPPER_EFABRIC_CLK=(&CLK_LPASS_TEST|0x025)
&CLK_TEST_AUDIO_WRAPPER_EFABRIC_SPDMTM_CSR_CLK=(&CLK_LPASS_TEST|0x024)
&CLK_TEST_AUDIO_WRAPPER_LCC_CSR_CLK=(&CLK_LPASS_TEST|0x027)
&CLK_TEST_AUDIO_WRAPPER_SECURITY_CLK=(&CLK_LPASS_TEST|0x026)
&CLK_TEST_AUDIO_WRAPPER_SMEM_CLK=(&CLK_LPASS_TEST|0x021)
&CLK_TEST_AUDIO_WRAPPER_TIMEOUT_CLK=(&CLK_LPASS_TEST|0x020)
&CLK_TEST_Q6SS_AHB_LFABIF_CLK=(&CLK_LPASS_TEST|0x01E)
&CLK_TEST_Q6SS_AHBM_CLK=(&CLK_LPASS_TEST|0x01D)
&CLK_TEST_Q6SS_TCM_SLAVE_CLK=(&CLK_LPASS_TEST|0x058)
&CLK_TEST_AVTIMER_XO_CLK_SRC=(&CLK_LPASS_TEST|0x050)
&CLK_TEST_AUDIO_CORE_AVSYNC_AVTIMER_XO_CLK=(&CLK_LPASS_TEST|0x052)
&CLK_TEST_GDSC_XO_CLK_SRC=(&CLK_LPASS_TEST|0x00C)
&CLK_TEST_AUDIO_CORE_GDSC_XO_CLK=(&CLK_LPASS_TEST|0x028)
&CLK_TEST_LPAIF_PCM0_CLK_SRC=(&CLK_LPASS_TEST|0x013)
&CLK_TEST_LPAIF_PCM1_CLK_SRC=(&CLK_LPASS_TEST|0x012)
&CLK_TEST_LPAIF_PCMOE_CLK_SRC=(&CLK_LPASS_TEST|0x00F)
&CLK_TEST_AUDIO_CORE_LPAIF_PCM_DATA_OE_CLK=(&CLK_LPASS_TEST|0x030)
&CLK_TEST_LPAIF_PRI_CLK_SRC=(&CLK_LPASS_TEST|0x017)
&CLK_TEST_LPAIF_QUAD_CLK_SRC=(&CLK_LPASS_TEST|0x014)
&CLK_TEST_LPAIF_SEC_CLK_SRC=(&CLK_LPASS_TEST|0x016)
&CLK_TEST_LPAIF_SPKR_CLK_SRC=(&CLK_LPASS_TEST|0x018)
&CLK_TEST_LPAIF_TER_CLK_SRC=(&CLK_LPASS_TEST|0x015)
&CLK_TEST_PRI_MCLK_CLK_SRC=(&CLK_LPASS_TEST|0x060)
&CLK_TEST_AUDIO_WRAPPER_PRI_MCLK_CLK=(&CLK_LPASS_TEST|0x064)
&CLK_TEST_Q6_SPDM_CLK_SRC=(&CLK_LPASS_TEST|0x007)
&CLK_TEST_Q6_SPDM_CLK=(&CLK_LPASS_TEST|0x01C)
&CLK_TEST_Q6SS_BCR_SLP_CLK_SRC=(&CLK_LPASS_TEST|0x009)
&CLK_TEST_AUDIO_CORE_BCR_SLP_CLK=(&CLK_LPASS_TEST|0x029)
&CLK_TEST_Q6SS_BCR_SLP_CLK=(&CLK_LPASS_TEST|0x01B)
&CLK_TEST_Q6_XO_CLK_SRC=(&CLK_LPASS_TEST|0x00D)
&CLK_TEST_QUAD_MCLK_CLK_SRC=(&CLK_LPASS_TEST|0x05D)
&CLK_TEST_AUDIO_WRAPPER_QUAD_MCLK_CLK=(&CLK_LPASS_TEST|0x061)
&CLK_TEST_RESAMPLER_CLK_SRC=(&CLK_LPASS_TEST|0x006)
&CLK_TEST_AUDIO_CORE_RESAMPLER_CORE_CLK=(&CLK_LPASS_TEST|0x03B)
&CLK_TEST_SEC_MCLK_CLK_SRC=(&CLK_LPASS_TEST|0x05F)
&CLK_TEST_AUDIO_WRAPPER_SEC_MCLK_CLK=(&CLK_LPASS_TEST|0x063)
&CLK_TEST_SLEEP_CLK_SRC=(&CLK_LPASS_TEST|0x00A)
&CLK_TEST_SLIMBUS_CLK_SRC=(&CLK_LPASS_TEST|0x011)
&CLK_TEST_AUDIO_CORE_SLIMBUS_CORE_CLK=(&CLK_LPASS_TEST|0x03D)
&CLK_TEST_SLIMBUS2_CLK_SRC=(&CLK_LPASS_TEST|0x05D)
&CLK_TEST_AUDIO_CORE_SLIMBUS2_CORE_CLK=(&CLK_LPASS_TEST|0x05E)
&CLK_TEST_STM_XO_CLK_SRC=(&CLK_LPASS_TEST|0x00B)
&CLK_TEST_TER_MCLK_CLK_SRC=(&CLK_LPASS_TEST|0x05E)
&CLK_TEST_AUDIO_WRAPPER_TER_MCLK_CLK=(&CLK_LPASS_TEST|0x062)
&CLK_TEST_LPASS_QDSP6SS_Q6_CORE_CLK=(&CLK_LPASS_TEST|&CLK_LPASS_SUB_MUX_Q6|0x1)
&CLK_TEST_LPASS_QDSP6SS_AXI_M_CLK=(&CLK_LPASS_TEST|&CLK_LPASS_SUB_MUX_Q6|0x2)
&CLK_TEST_LPASS_QDSP6SS_LDO_NMO_OUT=(&CLK_LPASS_TEST|&CLK_LPASS_SUB_MUX_Q6|0x3)
&CLK_TEST_LPASS_QDSP6SS_AHB_M_CLK=(&CLK_LPASS_TEST|&CLK_LPASS_SUB_MUX_Q6|0x4)
&CLK_TEST_LPASS_QDSP6SS_AHB_S_CLK=(&CLK_LPASS_TEST|&CLK_LPASS_SUB_MUX_Q6|0x5)
&CLK_TEST_LPASS_QDSP6SS_XO_CLK=(&CLK_LPASS_TEST|&CLK_LPASS_SUB_MUX_Q6|0x6)
&CLK_TEST_LPASS_QDSP6SS_SLEEP_CLK=(&CLK_LPASS_TEST|&CLK_LPASS_SUB_MUX_Q6|0x7)
&CLK_TEST_LPASS_QDSP6SS_JTAG_TCK=(&CLK_LPASS_TEST|&CLK_LPASS_SUB_MUX_Q6|0x8)
&CLK_TEST_LPASS_QDSP6SS_ATB_CLK=(&CLK_LPASS_TEST|&CLK_LPASS_SUB_MUX_Q6|0x9)
&CLK_TEST_LPASS_QDSP6SS_APB_CLK=(&CLK_LPASS_TEST|&CLK_LPASS_SUB_MUX_Q6|0xA)
&CLK_TEST_LPASS_QDSP6SS_TIMESTAMP_CLK=(&CLK_LPASS_TEST|&CLK_LPASS_SUB_MUX_Q6|0xB)

;-----------------------------------------------------------------------------
; Define the window
;-----------------------------------------------------------------------------

&testclock_cmd_arg0=""
&testclock_cmd_arg1=""
&testclock_cmd_arg2=""
&testclock_cmd_arg3=""
&testclock_cmd_arg4=""

ENTRY &testclock_cmd_arg0 &testclock_cmd_arg1 &testclock_cmd_arg2 &testclock_cmd_arg3 &testclock_cmd_arg4

; Create a new area window if the script was not invoked in menu mode.
if ("&testclock_cmd_arg0"!="menu")
(
  AREA.RESet
  WINPOS 0. 0. 50% 100%
  AREA.Create CLOCK 120. 1000.
  AREA.view CLOCK
)

AREA.Select CLOCK
AREA.Clear CLOCK



;-----------------------------------------------------------------------------
; Print banner and go to main menu
;-----------------------------------------------------------------------------

print " "
print "[----------------------------------------------- Clock Test ----------------------------------------------]"
print " "

;-----------------------------------------------------------------------------
; Read input
;-----------------------------------------------------------------------------

ON ERROR gosub
(
  print "Error occurred processing &clk"
  return
)

&print_if_off=1
&print_menu=1

Main_Menu:
; Only print main menu when it isn't disabled
if (&print_menu!=0)
(
  print " "
  print "Version: <04/07/2014>"
  print "Clock (? for list): "
)
else
(
  ; re-enable the main menu after this choice is handled
  &print_menu=1
)

testclock_cmd_arg0:
  if ("&testclock_cmd_arg0"!="")&&(("&testclock_cmd_arg0"!="menu"))
  (
    &choice="&testclock_cmd_arg0"
    &testclock_cmd_arg0=""
    goto Handle_Choice
  )
  else if ("&testclock_cmd_arg0"=="menu")
  (
    goto Handle_Choice
  )
testclock_cmd_arg1:
  if ("&testclock_cmd_arg1"!="")
  (
    &choice="&testclock_cmd_arg1"
    &testclock_cmd_arg1=""
    goto Handle_Choice
  )
testclock_cmd_arg2:
  if ("&testclock_cmd_arg2"!="")
  (
    &choice="&testclock_cmd_arg2"
    &testclock_cmd_arg2=""
    goto Handle_Choice
  )
testclock_cmd_arg3:
  if ("&testclock_cmd_arg3"!="")
  (
    &choice="&testclock_cmd_arg3"
    &testclock_cmd_arg3=""
    goto Handle_Choice
  )
testclock_cmd_arg4:
  if ("&testclock_cmd_arg4"!="")
  (
    &choice="&testclock_cmd_arg4"
    &testclock_cmd_arg4=""
    goto Handle_Choice
  )



;-----------------------------------------------------------------------------
; Handle choice
;-----------------------------------------------------------------------------

Handle_Choice:

  if ("&choice"=="")
  (
    enter &choice
  )

  &header_printed=0
  &choice_handled=0
  &state_change=""
  &input_file_prompt=1

  ; Exit
  if "&choice"=="?"
  (
    gosub Help
    &choice_handled=1
    
    ; Disable the main menu when displaying the help window
    &print_menu=0
  )
  else if "&choice"=="x"
  (
    ; Close the window if the script was not invoked in menu mode.
    if "&testclock_cmd_arg0"=="menu"
    (
      enddo (0==0)
    )
    else
    (
      WINCLEAR TOP
      enddo (0==0)
    )
  )
  else if ("&choice"==".")||("&choice"=="")
  (
    if "&old_choice"==""
    (
      &old_choice="?"
      
      ; disable the main menu when displaying the help window
      &print_menu=0
    )
    &choice="&old_choice"
    gosub Handle_Choice
  )

  ;-----------------------------------------------------------------------------
  ; Check for enabling the clock test output on GPIOs
  ;-----------------------------------------------------------------------------

  if "&choice"=="gpio"
  (
    ; Configure HS GPIO
    ; data.set &gcc_access_mode:&HWIO_TLMM_GPIO_CFG0_ADDR %LONG 0x1D0
    ; print "GPIO 0 configured and output enabled"

    ; Enable the gcc_dbg_clk on PLLTEST.
    data.set &gcc_access_mode:&HWIO_GCC_PLLTEST_PAD_CFG_ADDR %LONG 0x1200
    print "PLLTEST_PAD configured for GCC debug clock output"

    &choice_handled=1
  )

  if ("&choice"=="on")||("&choice"=="off")||("&choice"=="set")
  (
    &state_change="&choice"
    &choice="&old_choice"
    
    ; do not prompt user for input file again for on/off choice
    if ("&choice"=="file")
    (
      &input_file_prompt=0
    )
  )

  ;-----------------------------------------------------------------------------
  ; Check for file input with a list of clocks
  ;-----------------------------------------------------------------------------

  if ("&choice"=="file")
  (
    if (&input_file_prompt==1)
    (
      print "Enter input file [c:\temp\testclock.txt]: "
      enter &input_file
      if "&input_file"==""
      (
        &input_file="c:\temp\testclock.txt"
      )
    )
    print "Operating on list of clocks from &input_file"
    OPEN #1 &input_file /Read
    READ #1 %line &input_line
    WHILE !EOF()
    (
      gosub Find_Print_Clock &input_line
      
      READ #1 %line &input_line
    )
    CLOSE #1
    
    &choice_handled=1
  )


  ;-----------------------------------------------------------------------------
  ; Check for dumping all or all/on clocks
  ;-----------------------------------------------------------------------------

  if ("&choice"=="all")||("&choice"=="all_on")
  (
    if ("&choice"=="all_on")
    (
      &print_if_off=0
    )
    else
    (
      &print_if_off=1
    )

    gosub Print_All

    &print_if_off=1
    &choice_handled=1
  )

  if (&choice_handled!=1)
  (
    gosub Print_All_SS
  )

  ;-----------------------------------------------------------------------------
  ; If nothing else, then assume it was a clock name
  ;-----------------------------------------------------------------------------

  if (&choice_handled!=1)
  (
    gosub Find_Print_Clock &choice
  )

  &old_choice="&choice"
  &choice=""
  goto Main_Menu




;-----------------------------------------------------------------------------
; Display help
;-----------------------------------------------------------------------------

Help:

  ;-----------------------------------------------------------------------------
  ; Display available clock sources that can be output to the clock test output
  ; and prompt for selection.
  ;-----------------------------------------------------------------------------

  AREA.Create HELP 130. 1000.
  AREA.View HELP
  AREA.Select HELP
  winresize 130. 24.

  print " "
  print " "
  gosub Print_Clock_Help
  print ""
  print "*** Clock groups***   "
  print "  all        - all clocks"
  print "  all_on     - all clocks that are on"
  print "  <ss>_all   - all subsystem clocks"
  print "  <wildcard> - search query"
  print "  file       - file specifying enumerated clocks (separated by newlines)"
  print "  on/off     - modifies on/off state of previously selected clock(s)"
  print "  set        - sets the clock to one of supported frequencies"
  print "  buses      - show all bus clocks"
  print "  cpus       - show all cpu clocks"
  
  print "*** Other options ***"
  print "  x   - exit"
  print "  ?   - help"
  print "  .   - repeat (also carriage return without any arguments)" 
  print "*** Debug options ***"
  print "   gpio       - enable GPIO's for clock output"
  print ""

  AREA.Select CLOCK

  return


;-----------------------------------------------------------------------------
; Determine clock frequency.
;-----------------------------------------------------------------------------

Calc_Clock_Freq:

  local &l2cpucpselr_val
  local &l2cpucpcpdr_val

  ; Disable auto-gating on L2 clock to get accurate frequency.
  ;if (cpu()=="KRAIT")&&(&clk_test==&CLK_TEST_APCS_L2_CLK)
  ;(
  ;  &l2cpucpselr_val=data.long(c15:0x360f)
  ;  data.set c15:0x360f %LONG 0x500
  ;  &l2cpucpcpdr_val=data.long(c15:0x370f)
  ;  data.set c15:0x370f %LONG (&l2cpucpcpdr_val|0xc00)
  ;)

  ; Set the divide by 4 in DEBUG_CLK_CTL
  &dbg_clk_ctl=data.long(&gcc_access_mode:&HWIO_GCC_GCC_DEBUG_CLK_CTL_ADDR)
  &dbg_clk_ctl=&dbg_clk_ctl|0x00003000
  data.set &gcc_access_mode:&HWIO_GCC_GCC_DEBUG_CLK_CTL_ADDR %LONG &dbg_clk_ctl

  ; Save current values
  &xo_div4_cbcr=data.long(&gcc_access_mode:&HWIO_GCC_GCC_XO_DIV4_CBCR_ADDR)
  
  ; Measure a short run
  &multiplier=4
  &tcxo_count=0x800
  
  ; Config XO DIV4 comparator clock
  data.set &gcc_access_mode:&HWIO_GCC_GCC_XO_DIV4_CBCR_ADDR %LONG data.long(&gcc_access_mode:&HWIO_GCC_GCC_XO_DIV4_CBCR_ADDR)|0x1
  
  ; Start with the counter disabled 
  &measure_ctl=data.long(&gcc_access_mode:&HWIO_GCC_CLOCK_FRQ_MEASURE_CTL_ADDR)
  &measure_ctl=&measure_ctl&~0x1FFFFF
  data.set &gcc_access_mode:&HWIO_GCC_CLOCK_FRQ_MEASURE_CTL_ADDR %LONG &measure_ctl
  
  ; Program the starting counter value, high enough to get good accuracy
  &measure_ctl=&measure_ctl|&tcxo_count
  
  ; Start the counting
  &measure_ctl=&measure_ctl|0x100000
  data.set &gcc_access_mode:&HWIO_GCC_CLOCK_FRQ_MEASURE_CTL_ADDR %LONG &measure_ctl
  
  ; Wait for the counters to finish
  wait 1.ms
  while (data.long(&gcc_access_mode:&HWIO_GCC_CLOCK_FRQ_MEASURE_STATUS_ADDR)&0x2000000)==0
  (
  )
  
  ; Turn off the test clock and read the clock count
  &measure_ctl=data.long(&gcc_access_mode:&HWIO_GCC_CLOCK_FRQ_MEASURE_CTL_ADDR)
  data.set &gcc_access_mode:&HWIO_GCC_CLOCK_FRQ_MEASURE_CTL_ADDR %LONG (&measure_ctl&~0x100000)
  
  &short_clock_count=data.long(&gcc_access_mode:&HWIO_GCC_CLOCK_FRQ_MEASURE_STATUS_ADDR)&0x1FFFFFF
  
  ; Restore the registers
  data.set &gcc_access_mode:&HWIO_GCC_GCC_XO_DIV4_CBCR_ADDR %LONG &xo_div4_cbcr
 
  ; Now do a longer count and compare
  ; Save current values
  &xo_div4_cbcr=data.long(&gcc_access_mode:&HWIO_GCC_GCC_XO_DIV4_CBCR_ADDR)
  
  &multiplier=4
  &tcxo_count=0x8000
  
  ; Config XO DIV4 comparator clock
  data.set &gcc_access_mode:&HWIO_GCC_GCC_XO_DIV4_CBCR_ADDR %LONG data.long(&gcc_access_mode:&HWIO_GCC_GCC_XO_DIV4_CBCR_ADDR)|0x1
  
  ; Start with the counter disabled 
  &measure_ctl=data.long(&gcc_access_mode:&HWIO_GCC_CLOCK_FRQ_MEASURE_CTL_ADDR)
  &measure_ctl=&measure_ctl&~0x1FFFFF
  data.set &gcc_access_mode:&HWIO_GCC_CLOCK_FRQ_MEASURE_CTL_ADDR %LONG &measure_ctl
  
  ; Program the starting counter value, high enough to get good accuracy
  &measure_ctl=&measure_ctl|&tcxo_count
  
  ; Start the counting
  &measure_ctl=&measure_ctl|0x100000
  data.set &gcc_access_mode:&HWIO_GCC_CLOCK_FRQ_MEASURE_CTL_ADDR %LONG &measure_ctl
  
  ; Wait for the counters to finish
  wait 1.ms
  while (data.long(&gcc_access_mode:&HWIO_GCC_CLOCK_FRQ_MEASURE_STATUS_ADDR)&0x2000000)==0
  (
  )
  
  ; Turn off the test clock and read the clock count
  &measure_ctl=data.long(&gcc_access_mode:&HWIO_GCC_CLOCK_FRQ_MEASURE_CTL_ADDR)
  data.set &gcc_access_mode:&HWIO_GCC_CLOCK_FRQ_MEASURE_CTL_ADDR %LONG (&measure_ctl&~0x100000)
  
  &clock_count=data.long(&gcc_access_mode:&HWIO_GCC_CLOCK_FRQ_MEASURE_STATUS_ADDR)&0x1FFFFFF
  
  ; Calculate the frequency.  Function is provided by
  ; Power Control 42.8.1.2 Measurement technique
  ; f ring = f tcxo/4 * (Nring + 1.5) / (TCtcxo + 3.5)
  ;
  ; The formula below is the equivalent one converted
  ; to integer arithmetic.
  ; 
  ; We add half of the denominator value to the dividend
  ; to guard against rounding errors inherent to
  ; integer arithmetic.
  ;
  
  if &clock_count==&short_clock_count
  (
    &clk_freq=0
  )
  else
  (
    &clk_freq=4.800*(&multiplier)*(&clock_count+1.5)/(&tcxo_count+3.5)
  )
  
  ; Restore the registers
  data.set &gcc_access_mode:&HWIO_GCC_GCC_XO_DIV4_CBCR_ADDR %LONG &xo_div4_cbcr
  
  ; Clear the divide by 4 in DEBUG_CLK_CTL to make the scope view of the clock
  ; the correct frequency
  &dbg_clk_ctl=data.long(&gcc_access_mode:&HWIO_GCC_GCC_DEBUG_CLK_CTL_ADDR)
  &dbg_clk_ctl=&dbg_clk_ctl&~0x00003000
  data.set &gcc_access_mode:&HWIO_GCC_GCC_DEBUG_CLK_CTL_ADDR %LONG &dbg_clk_ctl

  ; Restore the original auto-gating behavior.
  ;if (cpu()=="KRAIT")&&(&clk_test==&CLK_TEST_APCS_L2_CLK)
  ;(
  ;  data.set c15:0x370f %LONG &l2cpucpcpdr_val
  ;  data.set c15:0x360f %LONG &l2cpucpselr_val
  ;)

  return




PRINT_SET_CLOCK_FREQ_WARNING:

  print ""
  print "Warning: This feature is in beta and does not account for voltage requirements. Clock driver state will be out of sync."
  print ""

  return



;-----------------------------------------------------------------------------
; Set clock frequency.
;-----------------------------------------------------------------------------

Set_Clock_Freq:

  ; Use testpll.cmm to turn on required source
  do testpll.cmm on &clk_src_name

  ; Convert src divider to appropriate register value
  if (&clk_src_div!=0)
  (
    &clk_src_div=&clk_src_div-1
  )

  ; Read current cmd_rcgr and cfg_rcgr values
  &clk_cmd_rcgr_val=data.long(&clk_access_mode:&clk_cmd_rcgr_addr)
  &clk_cfg_rcgr_val=data.long(&clk_access_mode:&clk_cfg_rcgr_addr)

  ; Clear src_sel, src_div, and mode fields
  &clk_cfg_rcgr_val=&clk_cfg_rcgr_val&~(&HAL_CLK_CFG_CGR_SRC_SEL_FMSK|&HAL_CLK_CFG_CGR_SRC_DIV_FMSK|&HAL_CLK_CFG_CGR_MODE_FMSK)

  ; Program src_sel and src_div
  &clk_cfg_rcgr_val=&clk_cfg_rcgr_val|((&clk_src_sel<<&HAL_CLK_CFG_CGR_SRC_SEL_SHFT)&(&HAL_CLK_CFG_CGR_SRC_SEL_FMSK))
  &clk_cfg_rcgr_val=&clk_cfg_rcgr_val|((&clk_src_div<<&HAL_CLK_CFG_CGR_SRC_DIV_SHFT)&(&HAL_CLK_CFG_CGR_SRC_DIV_FMSK))

  ; Program M, N, D registers if necessary
  if (&clk_m_val!=0.)&&(&clk_m_val<&clk_n_val)
  (
    &clk_m_addr=&clk_cmd_rcgr_addr+&HAL_CLK_M_REG_OFFSET
    &clk_n_addr=&clk_cmd_rcgr_addr+&HAL_CLK_N_REG_OFFSET
    &clk_2d_addr=&clk_cmd_rcgr_addr+&HAL_CLK_D_REG_OFFSET

    ; Write to M register
    data.set &clk_access_mode:&clk_m_addr %long &clk_m_val
    
    ; Write to N register
    data.set &clk_access_mode:&clk_n_addr %long ~(&clk_n_val-&clk_m_val)
    
    ; Write to D register
    data.set &clk_access_mode:&clk_2d_addr %long ~&clk_2d_val
    
    ; Dual edge mode
    &clk_cfg_rcgr_val=&clk_cfg_rcgr_val|((&HAL_CLK_CFG_CFG_DUAL_EDGE_MODE_VAL<<&HAL_CLK_CFG_CGR_MODE_SHFT)&(&HAL_CLK_CFG_CGR_MODE_FMSK))
  )
  
  ; Write to cfg_rcgr
  data.set &clk_access_mode:&clk_cfg_rcgr_addr %long &clk_cfg_rcgr_val

  ; Write to cmd_rcgr to trigger update
  data.set &clk_access_mode:&clk_cmd_rcgr_addr %long (&clk_cmd_rcgr_val|&HAL_CLK_CMD_CFG_UPDATE_FMSK)

  ; Wait for update to finish
  wait 1.ms
  while (data.long(&clk_access_mode:&clk_cmd_rcgr_addr)&(&HAL_CLK_CMD_CFG_UPDATE_FMSK))!=0
  (
  )

  return




;-----------------------------------------------------------------------------
; Display clock info header
;-----------------------------------------------------------------------------

Print_Header:

  if &header_printed==0
  (
    print ""
    print "Clock                                      State      Frequency (MHz)         CBCR Addr : Value        CBCR Type "
    print "---------------------------------------------------------------------------------------------------------------- "

    &header_printed=1
  )

  return




;-----------------------------------------------------------------------------
; Display clock info line
;-----------------------------------------------------------------------------

Print_Clk_Info_Line:

  &is_on=0
  &clk_freq=0
  &clk_reg_val=0


  ;-----------------------------------------------------------------------------
  ; Toggle clock state if requested
  ;-----------------------------------------------------------------------------
  if (&clk_reg!=0)
  (
    if "&state_change"=="on"
    (
      data.set &clk_access_mode:&clk_reg %LONG (data.long(&clk_access_mode:&clk_reg)|0x00000001)
    )
    else if "&state_change"=="off"
    (
      data.set &clk_access_mode:&clk_reg %LONG (data.long(&clk_access_mode:&clk_reg)&~(0x00000001))
    )
  )

  if "&state_change"=="set"
  (
    gosub Set_Clock_Freq_Enter
  )

  ;-----------------------------------------------------------------------------
  ; Print the clock header
  ;-----------------------------------------------------------------------------
  gosub Print_Header

  ;-----------------------------------------------------------------------------
  ; Test if clock is on
  ;-----------------------------------------------------------------------------
  
  if (&clk_reg!=0)
  (
    if (data.long(&clk_access_mode:&clk_reg)&(0x80000000))==0x0
    (
      &clk_state="ON "
      &is_on=1
    )
    else
    (
      &clk_state="OFF"
      &is_on=0
    )
  )
  else
  (
    &clk_state=" ? " 
    &is_on=1
  )
  
  ;-----------------------------------------------------------------------------
  ; Calculate the clock frequency based on the TCXO counter
  ;-----------------------------------------------------------------------------

  if (&clk_test!=0)&&(&is_on==1)
  (
    gosub Program_Clk_Test

    gosub Calc_Clock_Freq

    if (&clk_freq==0)
    (
      &clk_freq_str=FORMAT.DECIMAL(14., 0x0)
    )
    else
    (
      &clk_freq_str=FORMAT.FLOAT(12., 0x6, &clk_freq) 
    )
  )
  else if (&is_on==0)
  (
    &clk_freq_str=FORMAT.DECIMAL(14., 0x0)
  )
  else
  (
    &clk_freq_str="  Not Testable"
  )
  
  if (&print_if_off==1)||(&is_on==0x1)
  (
    if (&clk_reg!=0)
    (
      &clk_reg_val=FORMAT.HEX(0x8, data.long(&clk_access_mode:&clk_reg))
      &clk_reg_val_str="0x&clk_reg_val"
      
      &clk_reg=FORMAT.HEX(0x8, &clk_reg)
      &clk_reg_str="0x&clk_reg"
    )
    else
    (
      &clk_reg_str="----------" 
      &clk_reg_val_str="----------"
    )

    ; Format clock name width

    &left_width="                                           "
    &padding=STRING.CUT("&left_width", STRING.LEN("&clk_name"))

    print "&clk_name&padding &clk_state       &clk_freq_str         &clk_reg_str : &clk_reg_val_str   &clk_reg_cbcr_type"
  )

  return



;-----------------------------------------------------------------------------
; Program the clk_test register
;-----------------------------------------------------------------------------

Program_Clk_Test:

  &testval=&clk_test&(&CLK_TEST_TYPE_MASK)
  &selval=&clk_test&(&CLK_TEST_SEL_MASK)
  &submuxval=&clk_test&(&CLK_TEST_SUB_MUX_MASK)

  ; GCC
  if &selval==&CLK_GCC_TEST
  (

    ; Clear the debug field bits and set default register value
    &gcc_gcc_debug_clk_ctl_reg=&HWIO_GCC_GCC_DEBUG_CLK_CTL_ADDR
    &gcc_gcc_debug_clk_ctl_val=data.long(&gcc_access_mode:&gcc_gcc_debug_clk_ctl_reg)
    &gcc_gcc_debug_clk_ctl_val=&gcc_gcc_debug_clk_ctl_val&~(0x3FF<<0x0)
    &gcc_gcc_debug_clk_ctl_val=&gcc_gcc_debug_clk_ctl_val|0x10000


    ; Program debug register to select test clock
    data.set &gcc_access_mode:&gcc_gcc_debug_clk_ctl_reg %long &gcc_gcc_debug_clk_ctl_val|(&testval&0x3FF)<<0x0

  )

  ; LPASS
  else if &selval==&CLK_LPASS_TEST
  (

    ; Default the top level GCC debug mux
    &gcc_gcc_debug_clk_ctl_reg=&HWIO_GCC_GCC_DEBUG_CLK_CTL_ADDR
    &gcc_gcc_debug_clk_ctl_val=data.long(&gcc_access_mode:&gcc_gcc_debug_clk_ctl_reg)
    &gcc_gcc_debug_clk_ctl_val=&gcc_gcc_debug_clk_ctl_val&~(0x3FF<<0x0)
    &gcc_gcc_debug_clk_ctl_val=&gcc_gcc_debug_clk_ctl_val|0x10000

    ; Configure the top level GCC debug mux to select LPASS
    data.set &gcc_access_mode:&gcc_gcc_debug_clk_ctl_reg %LONG &gcc_gcc_debug_clk_ctl_val|(0x161&0x3FF)

    ; Clear the debug field bits and set default register value
    &lpass_dbg_clk_reg=&HWIO_LPASS_DBG_CLK_ADDR
    &lpass_dbg_clk_val=data.long(&lpass_access_mode:&lpass_dbg_clk_reg)
    &lpass_dbg_clk_val=&lpass_dbg_clk_val&~(0xFFFF<<0x0)
    &lpass_dbg_clk_val=&lpass_dbg_clk_val|0x100000

    if &submuxval==&CLK_LPASS_SUB_MUX_Q6
    (
      ; Configure the LPASS debug mux to select the Q6 submux
      data.set &lpass_access_mode:&lpass_dbg_clk_reg %long &lpass_dbg_clk_val|0x1

      ; Default Q6 submux register
      &lpass_qdsp6ss_test_clk_ctl_reg=&HWIO_LPASS_QDSP6SS_TEST_CLK_CTL_ADDR
      &lpass_qdsp6ss_test_clk_ctl_val=data.long(&lpass_access_mode:&lpass_qdsp6ss_test_clk_ctl_reg)
      &lpass_qdsp6ss_test_clk_ctl_val=&lpass_qdsp6ss_test_clk_ctl_val&~(0x1F<<0x0)
      &lpass_qdsp6ss_test_clk_ctl_val=&lpass_qdsp6ss_test_clk_ctl_val|0x40

      ; Configure Q6 submux to select test clock
      data.set &lpass_access_mode:&lpass_qdsp6ss_test_clk_ctl_reg %long &lpass_qdsp6ss_test_clk_ctl_val|(&testval&0x1F)<<0x0
    )

    ; No submuxes
    else
    (
      ; Program debug register to select test clock
      data.set &lpass_access_mode:&lpass_dbg_clk_reg %long &lpass_dbg_clk_val|(&testval&0xFFFF)<<0x0
    )

  )
 
  return
  


Print_Clock_Help:


  print ""
  print "*****************************************************  GCC   ******************************************************"

  print ""
  print "[ BIMC ]" 
  print " gcc_bimc_xo_clk                    gcc_cfg_noc_ddr_cfg_clk            gcc_cnoc_bus_timeout5_ahb_clk       " 
  print " gcc_ddr_dim_cfg_clk                gcc_bimc_clk                        " 
  print ""
  print "[ BLSP1 ]" 
  print " gcc_blsp1_uart1_sim_clk            gcc_blsp1_uart2_sim_clk            gcc_blsp1_uart3_sim_clk             " 
  print " gcc_blsp1_uart4_sim_clk            gcc_blsp1_uart5_sim_clk            gcc_blsp1_uart6_sim_clk             " 
  print " gcc_blsp2_uart1_sim_clk            gcc_blsp2_uart2_sim_clk            gcc_blsp2_uart3_sim_clk             " 
  print " gcc_blsp2_uart4_sim_clk            gcc_blsp2_uart5_sim_clk            gcc_blsp2_uart6_sim_clk             " 
  print ""
  print "[ BLSP1_QUP1 ]" 
  print " gcc_blsp1_qup1_i2c_apps_clk        gcc_blsp1_qup1_spi_apps_clk         " 
  print ""
  print "[ BLSP1_QUP2 ]" 
  print " gcc_blsp1_qup2_spi_apps_clk        gcc_blsp1_qup2_i2c_apps_clk         " 
  print ""
  print "[ BLSP1_QUP3 ]" 
  print " gcc_blsp1_qup3_spi_apps_clk        gcc_blsp1_qup3_i2c_apps_clk         " 
  print ""
  print "[ BLSP1_QUP4 ]" 
  print " gcc_blsp1_qup4_spi_apps_clk        gcc_blsp1_qup4_i2c_apps_clk         " 
  print ""
  print "[ BLSP1_QUP5 ]" 
  print " gcc_blsp1_qup5_i2c_apps_clk        gcc_blsp1_qup5_spi_apps_clk         " 
  print ""
  print "[ BLSP1_QUP6 ]" 
  print " gcc_blsp1_qup6_spi_apps_clk        gcc_blsp1_qup6_i2c_apps_clk         " 
  print ""
  print "[ BLSP1_UART1 ]" 
  print " gcc_blsp1_uart1_apps_clk            " 
  print ""
  print "[ BLSP1_UART2 ]" 
  print " gcc_blsp1_uart2_apps_clk            " 
  print ""
  print "[ BLSP1_UART3 ]" 
  print " gcc_blsp1_uart3_apps_clk            " 
  print ""
  print "[ BLSP1_UART4 ]" 
  print " gcc_blsp1_uart4_apps_clk            " 
  print ""
  print "[ BLSP1_UART5 ]" 
  print " gcc_blsp1_uart5_apps_clk            " 
  print ""
  print "[ BLSP1_UART6 ]" 
  print " gcc_blsp1_uart6_apps_clk            " 
  print ""
  print "[ BLSP2_QUP1 ]" 
  print " gcc_blsp2_qup1_i2c_apps_clk        gcc_blsp2_qup1_spi_apps_clk         " 
  print ""
  print "[ BLSP2_QUP2 ]" 
  print " gcc_blsp2_qup2_i2c_apps_clk        gcc_blsp2_qup2_spi_apps_clk         " 
  print ""
  print "[ BLSP2_QUP3 ]" 
  print " gcc_blsp2_qup3_i2c_apps_clk        gcc_blsp2_qup3_spi_apps_clk         " 
  print ""
  print "[ BLSP2_QUP4 ]" 
  print " gcc_blsp2_qup4_i2c_apps_clk        gcc_blsp2_qup4_spi_apps_clk         " 
  print ""
  print "[ BLSP2_QUP5 ]" 
  print " gcc_blsp2_qup5_i2c_apps_clk        gcc_blsp2_qup5_spi_apps_clk         " 
  print ""
  print "[ BLSP2_QUP6 ]" 
  print " gcc_blsp2_qup6_spi_apps_clk        gcc_blsp2_qup6_i2c_apps_clk         " 
  print ""
  print "[ BLSP2_UART1 ]" 
  print " gcc_blsp2_uart1_apps_clk            " 
  print ""
  print "[ BLSP2_UART2 ]" 
  print " gcc_blsp2_uart2_apps_clk            " 
  print ""
  print "[ BLSP2_UART3 ]" 
  print " gcc_blsp2_uart3_apps_clk            " 
  print ""
  print "[ BLSP2_UART4 ]" 
  print " gcc_blsp2_uart4_apps_clk            " 
  print ""
  print "[ BLSP2_UART5 ]" 
  print " gcc_blsp2_uart5_apps_clk            " 
  print ""
  print "[ BLSP2_UART6 ]" 
  print " gcc_blsp2_uart6_apps_clk            " 
  print ""
  print "[ CE1 ]" 
  print " gcc_ce1_clk                         " 
  print ""
  print "[ CE2 ]" 
  print " gcc_ce2_clk                         " 
  print ""
  print "[ CE3 ]" 
  print " gcc_ce3_clk                         " 
  print ""
  print "[ CONFIG_NOC ]" 
  print " gcc_cfg_noc_tic_clk                gcc_tic_clk                        gcc_ahb_clk                         " 
  print " gcc_bimc_cfg_ahb_clk               gcc_boot_rom_ahb_clk               gcc_ce1_ahb_clk                     " 
  print " gcc_ce2_ahb_clk                    gcc_ce3_ahb_clk                    gcc_cfg_noc_ahb_clk                 " 
  print " gcc_cnoc_bus_timeout0_ahb_clk      gcc_cnoc_bus_timeout1_ahb_clk      gcc_cnoc_bus_timeout2_ahb_clk       " 
  print " gcc_cnoc_bus_timeout3_ahb_clk      gcc_cnoc_bus_timeout4_ahb_clk      gcc_cnoc_bus_timeout7_ahb_clk       " 
  print " gcc_dehr_clk                       gcc_imem_cfg_ahb_clk               gcc_ipa_ahb_clk                     " 
  print " gcc_mmss_noc_cfg_ahb_clk           gcc_mpm_ahb_clk                    gcc_msg_ram_ahb_clk                 " 
  print " gcc_mss_cfg_ahb_clk                gcc_noc_conf_xpu_ahb_clk           gcc_pcie_0_cfg_ahb_clk              " 
  print " gcc_pcie_1_cfg_ahb_clk             gcc_periph_noc_cfg_ahb_clk         gcc_qdss_cfg_ahb_clk                " 
  print " gcc_qdss_dap_ahb_clk               gcc_qdss_rbcpr_xpu_ahb_clk         gcc_rbcpr_cx_ahb_clk                " 
  print " gcc_rbcpr_mx_ahb_clk               gcc_sec_ctrl_ahb_clk               gcc_sec_ctrl_boot_rom_patch_clk     " 
  print " gcc_snoc_cnoc_ahb_clk              gcc_spdm_cfg_ahb_clk               gcc_spdm_mstr_ahb_clk               " 
  print " gcc_spmi_cnoc_ahb_clk              gcc_tcsr_ahb_clk                   gcc_tlmm_ahb_clk                    " 
  print " gcc_tlmm_clk                       gcc_ufs_ahb_clk                     " 
  print ""
  print "[ DCD ]" 
  print " gcc_dcd_xo_clk                      " 
  print ""
  print "[ DDR_DIM_WRAPPER ]" 
  print " gcc_bimc_ddr_cpll0_clk             gcc_bimc_ddr_cpll1_clk              " 
  print ""
  print "[ GCC ]" 
  print " gcc_bam_dma_inactivity_timers_clk  gcc_bimc_sleep_clk                 gcc_blsp1_sleep_clk                 " 
  print " gcc_blsp2_sleep_clk                gcc_ddr_dim_sleep_clk              gcc_im_sleep_clk                    " 
  print " gcc_ipa_sleep_clk                  gcc_rpm_sleep_clk                  gcc_tsif_inactivity_timers_clk      " 
  print " gcc_usb2_hs_phy_sleep_clk          gcc_usb30_sleep_clk                gcc_usb_hs_inactivity_timers_clk    " 
  print " gcc_xo_clk                         gcc_xo_div4_clk                     " 
  print ""
  print "[ GP1 ]" 
  print " gcc_gp1_clk                         " 
  print ""
  print "[ GP2 ]" 
  print " gcc_gp2_clk                         " 
  print ""
  print "[ GP3 ]" 
  print " gcc_gp3_clk                         " 
  print ""
  print "[ IPA ]" 
  print " gcc_ipa_clk                        gcc_sys_noc_ipa_axi_clk             " 
  print ""
  print "[ KPSS ]" 
  print " gcc_bimc_kpss_axi_clk              gcc_kpss_axi_clk                   gcc_kpss_ahb_clk                    " 
  print " gcc_snoc_bus_timeout0_ahb_clk      gcc_sys_noc_kpss_ahb_clk           gcc_bimc_kpss_cci_axi_clk           " 
  print " gcc_kpss_cci_axi_clk                " 
  print ""
  print "[ MMSS ]" 
  print " gcc_bimc_gfx_clk                   gcc_mmss_bimc_gfx_clk               " 
  print ""
  print "[ MSS ]" 
  print " gcc_mss_q6_bimc_axi_clk             " 
  print ""
  print "[ OBT_ODT ]" 
  print " gcc_obt_odt_clk                     " 
  print ""
  print "[ PCIE_0 ]" 
  print " gcc_pcie_0_aux_clk                 gcc_pcie_0_pipe_clk                 " 
  print ""
  print "[ PCIE_1 ]" 
  print " gcc_pcie_1_aux_clk                 gcc_pcie_1_pipe_clk                 " 
  print ""
  print "[ PDM ]" 
  print " gcc_pdm2_clk                       gcc_pdm_xo4_clk                     " 
  print ""
  print "[ PERIPH_NOC ]" 
  print " gcc_bam_dma_ahb_clk                gcc_blsp1_ahb_clk                  gcc_blsp2_ahb_clk                   " 
  print " gcc_pdm_ahb_clk                    gcc_periph_noc_ahb_clk             gcc_periph_noc_mpu_cfg_ahb_clk      " 
  print " gcc_periph_xpu_ahb_clk             gcc_pnoc_bus_timeout0_ahb_clk      gcc_pnoc_bus_timeout1_ahb_clk       " 
  print " gcc_pnoc_bus_timeout2_ahb_clk      gcc_pnoc_bus_timeout3_ahb_clk      gcc_pnoc_bus_timeout4_ahb_clk       " 
  print " gcc_prng_ahb_clk                   gcc_sdcc1_ahb_clk                  gcc_sdcc2_ahb_clk                   " 
  print " gcc_sdcc3_ahb_clk                  gcc_sdcc4_ahb_clk                  gcc_snoc_pnoc_ahb_clk               " 
  print " gcc_tsif_ahb_clk                   gcc_usb_hs_ahb_clk                 gcc_usb_phy_cfg_ahb2phy_clk         " 
  print ""
  print "[ QDSS ]" 
  print " gcc_qdss_dap_clk                   gcc_qdss_tsctr_div8_clk            gcc_qdss_tsctr_div2_clk             " 
  print " gcc_qdss_tsctr_div16_clk           gcc_qdss_stm_clk                   gcc_sys_noc_qdss_stm_axi_clk        " 
  print " gcc_qdss_tsctr_div4_clk            gcc_qdss_tsctr_div3_clk            gcc_qdss_traceclkin_clk             " 
  print " gcc_mmss_noc_at_clk                gcc_periph_noc_at_clk              gcc_qdss_at_clk                     " 
  print " gcc_sys_noc_at_clk                  " 
  print ""
  print "[ RBCPR_CX ]" 
  print " gcc_rbcpr_cx_clk                    " 
  print ""
  print "[ RBCPR_MX ]" 
  print " gcc_rbcpr_mx_clk                    " 
  print ""
  print "[ RPM ]" 
  print " gcc_cfg_noc_rpm_ahb_clk            gcc_cnoc_bus_timeout6_ahb_clk      gcc_rpm_bus_ahb_clk                 " 
  print " gcc_rpm_proc_fclk                  gcc_rpm_proc_hclk                  gcc_rpm_timer_clk                   " 
  print ""
  print "[ SDCC1 ]" 
  print " gcc_sdcc1_apps_clk                  " 
  print ""
  print "[ SDCC2 ]" 
  print " gcc_sdcc2_apps_clk                  " 
  print ""
  print "[ SDCC3 ]" 
  print " gcc_sdcc3_apps_clk                  " 
  print ""
  print "[ SDCC4 ]" 
  print " gcc_sdcc4_apps_clk                  " 
  print ""
  print "[ SEC_CTRL ]" 
  print " gcc_sec_ctrl_clk                   gcc_sec_ctrl_sense_clk             gcc_sec_ctrl_acc_clk                " 
  print " sec_ctrl_acc_clk_src                " 
  print ""
  print "[ SPDM ]" 
  print " gcc_spdm_ff_clk                    gcc_spdm_snoc_cy_clk               gcc_spdm_debug_cy_clk               " 
  print " gcc_spdm_bimc_cy_clk               gcc_spdm_rpm_cy_clk                gcc_spdm_pnoc_cy_clk                " 
  print ""
  print "[ SPMI ]" 
  print " gcc_spmi_ahb_clk                   gcc_spmi_ser_clk                    " 
  print ""
  print "[ SYSTEM_NOC ]" 
  print " gcc_bimc_sysnoc_axi_clk            gcc_ce1_axi_clk                    gcc_ce2_axi_clk                     " 
  print " gcc_ce3_axi_clk                    gcc_imem_axi_clk                   gcc_lpass_mport_axi_clk             " 
  print " gcc_lpass_q6_axi_clk               gcc_lpass_sway_clk                 gcc_ocmem_sys_noc_axi_clk           " 
  print " gcc_pcie_0_mstr_axi_clk            gcc_pcie_0_slv_axi_clk             gcc_pcie_1_mstr_axi_clk             " 
  print " gcc_pcie_1_slv_axi_clk             gcc_qdss_etr_usb_clk               gcc_snoc_bus_timeout1_ahb_clk       " 
  print " gcc_snoc_bus_timeout3_ahb_clk      gcc_sys_noc_axi_clk                 " 
  print ""
  print "[ TSIF ]" 
  print " gcc_tsif_ref_clk                    " 
  print ""
  print "[ UFS ]" 
  print " gcc_ufs_rx_cfg_clk                 gcc_sys_noc_ufs_axi_clk            gcc_ufs_axi_clk                     " 
  print " gcc_ufs_tx_cfg_clk                  " 
  print ""
  print "[ USB_30 ]" 
  print " gcc_usb30_mock_utmi_clk            gcc_snoc_bus_timeout2_ahb_clk      gcc_sys_noc_usb3_axi_clk            " 
  print " gcc_usb30_master_clk               gcc_usb3_phy_aux_clk                " 
  print ""
  print "[ USB_HS ]" 
  print " gcc_usb_hs_system_clk               " 
  print ""
  print "[ VS ]" 
  print " gcc_vs_clk                          " 
  print ""
  print "[ EXT ]" 
  print " gpll0_dtest                        gpll0_lock_det                     gpll1_dtest                         " 
  print " gpll1_lock_det                     gpll2_dtest                        gpll2_lock_det                      " 
  print " gpll3_dtest                        gpll3_lock_det                     gpll4_dtest                         " 
  print " gpll4_lock_det                     kpss_gcc_dbg_clk                   kpss_gcc_ringosc_clk                " 
  print " lpass_gcc_dbg_clk                  mmss_gcc_dbg_clk                   mpm_gcc_temp_sensor_ringosc_clk     " 
  print " mss_gcc_dbg_clk                    pcie_0_pipe_clk                    pcie_0_pipe_clk                     " 
  print " pcie_1_pipe_clk                    pcie_1_pipe_clk                    qusb2phy_clk_480m_test              " 
  print " ufs_rx_symbol_0_clk                ufs_rx_symbol_0_clk                ufs_rx_symbol_1_clk                 " 
  print " ufs_rx_symbol_1_clk                ufs_tx_symbol_0_clk                ufs_tx_symbol_0_clk                 " 
  print " ufs_tx_symbol_1_clk                ufs_tx_symbol_1_clk                usb2_phy_wrapper_gcc_usb30_utmi_clk " 
  print " usb3_phy_wrapper_gcc_usb3_pipe_clk usb_hspw_gcc_480_test_clk           " 

  print ""
  print "***************************************************** LPASS  ******************************************************"

  print ""
  print "[ AUDIO_CORE_LPAIF_PCM_DATA_OE ]" 
  print " lpaif_pcmoe_clk_src                audio_core_lpaif_pcm_data_oe_clk    " 
  print ""
  print "[ BUS ]" 
  print " ahbfabric_clk_src                  ahb_spdmtm_clk                     audio_core_aon_clk                  " 
  print " audio_core_avsync_csr_clk          audio_core_csr_clk                 audio_core_dml_clk                  " 
  print " audio_core_ixfabric_clk            audio_core_ixfabric_spdmtm_csr_clk audio_core_lpaif_csr_clk            " 
  print " audio_core_lpaif_dma_clk           audio_core_lpm_clk                 audio_core_resampler_lfabif_clk     " 
  print " audio_core_security_clk            audio_core_slimbus2_lfabif_clk     audio_core_slimbus_lfabif_clk       " 
  print " audio_core_sysnoc_clk              audio_core_timeout_clk             audio_wrapper_aon_clk               " 
  print " audio_wrapper_br_clk               audio_wrapper_efabric_clk          audio_wrapper_efabric_spdmtm_csr_clk " 
  print " audio_wrapper_lcc_csr_clk          audio_wrapper_security_clk         audio_wrapper_smem_clk              " 
  print " audio_wrapper_sysnoc_sway_clk      audio_wrapper_timeout_clk          q6ss_ahb_lfabif_clk                 " 
  print " q6ss_ahbm_clk                      q6ss_tcm_slave_clk                  " 
  print ""
  print "[ CXO ]" 
  print " q6_xo_clk_src                      q6ss_xo_clk                        gdsc_xo_clk_src                     " 
  print " audio_core_gdsc_xo_clk             stm_xo_clk_src                     audio_wrapper_stm_xo_clk            " 
  print " avtimer_xo_clk_src                 audio_core_avsync_avtimer_xo_clk    " 
  print ""
  print "[ PRIMARY MI2S ]" 
  print " lpaif_pri_clk_src                  audio_core_lpaif_pri_ibit_clk      audio_core_lpaif_pri_osr_clk        " 
  print " pri_mclk_clk_src                   audio_wrapper_pri_mclk_clk          " 
  print ""
  print "[ PRIMARY PCM ]" 
  print " lpaif_pcm0_clk_src                 audio_core_lpaif_pcm0_ibit_clk      " 
  print ""
  print "[ Q6 CORE ]" 
  print "  " 
  print ""
  print "[ QUATERNARY MI2S ]" 
  print " quad_mclk_clk_src                  audio_wrapper_quad_mclk_clk        lpaif_quad_clk_src                  " 
  print " audio_core_lpaif_quad_ibit_clk     audio_core_lpaif_quad_osr_clk       " 
  print ""
  print "[ RESAMPLER ]" 
  print " resampler_clk_src                  audio_core_resampler_core_clk       " 
  print ""
  print "[ SECONDARY MI2S ]" 
  print " lpaif_sec_clk_src                  audio_core_lpaif_sec_ibit_clk      audio_core_lpaif_sec_osr_clk        " 
  print " sec_mclk_clk_src                   audio_wrapper_sec_mclk_clk          " 
  print ""
  print "[ SECONDARY PCM ]" 
  print " lpaif_pcm1_clk_src                 audio_core_lpaif_pcm1_ibit_clk      " 
  print ""
  print "[ SLEEP ]" 
  print " sleep_clk_src                      q6ss_slp_clk                       q6ss_bcr_slp_clk_src                " 
  print " audio_core_bcr_slp_clk             q6ss_bcr_slp_clk                    " 
  print ""
  print "[ SLIMBUS ]" 
  print " slimbus_clk_src                    audio_core_slimbus_core_clk         " 
  print ""
  print "[ SLIMBUS2 ]" 
  print " slimbus2_clk_src                   audio_core_slimbus2_core_clk        " 
  print ""
  print "[ SPDM ]" 
  print " q6_spdm_clk_src                    q6_spdm_clk                         " 
  print ""
  print "[ SPEAKER I2S ]" 
  print " lpaif_spkr_clk_src                 audio_core_lpaif_codec_spkr_ibit_clkaudio_core_lpaif_codec_spkr_osr_clk " 
  print ""
  print "[ TERTIARY MI2S ]" 
  print " lpaif_ter_clk_src                  audio_core_lpaif_ter_ibit_clk      audio_core_lpaif_ter_osr_clk        " 
  print " ter_mclk_clk_src                   audio_wrapper_ter_mclk_clk          " 
  print ""
  print "[ LPASS_QDSP6_CORE ]" 
  print " lpass_qdsp6ss_q6_core_clk          lpass_qdsp6ss_axi_m_clk            lpass_qdsp6ss_ldo_nmo_out           " 
  print " lpass_qdsp6ss_ahb_m_clk            lpass_qdsp6ss_ahb_s_clk            lpass_qdsp6ss_xo_clk                " 
  print " lpass_qdsp6ss_sleep_clk            lpass_qdsp6ss_jtag_tck             lpass_qdsp6ss_atb_clk               " 
  print " lpass_qdsp6ss_apb_clk              lpass_qdsp6ss_timestamp_clk         " 
  print ""
  print "[ EXT ]" 
  print "  " 

  return



Print_ALL:

  gosub Find_Print_Clock gcc_sec_ctrl_acc_clk
  gosub Find_Print_Clock sec_ctrl_acc_clk_src
  gosub Find_Print_Clock gcc_bimc_clk
  gosub Find_Print_Clock gcc_bimc_ddr_cpll0_clk
  gosub Find_Print_Clock gcc_bimc_ddr_cpll1_clk
  gosub Find_Print_Clock gcc_bimc_xo_clk
  gosub Find_Print_Clock gcc_cfg_noc_ddr_cfg_clk
  gosub Find_Print_Clock gcc_cnoc_bus_timeout5_ahb_clk
  gosub Find_Print_Clock gcc_ddr_dim_cfg_clk
  gosub Find_Print_Clock gcc_bimc_kpss_axi_clk
  gosub Find_Print_Clock gcc_kpss_axi_clk
  gosub Find_Print_Clock gcc_bimc_kpss_cci_axi_clk
  gosub Find_Print_Clock gcc_kpss_cci_axi_clk
  gosub Find_Print_Clock gcc_blsp1_qup1_i2c_apps_clk
  gosub Find_Print_Clock gcc_blsp1_qup1_spi_apps_clk
  gosub Find_Print_Clock gcc_blsp1_qup2_i2c_apps_clk
  gosub Find_Print_Clock gcc_blsp1_qup2_spi_apps_clk
  gosub Find_Print_Clock gcc_blsp1_qup3_i2c_apps_clk
  gosub Find_Print_Clock gcc_blsp1_qup3_spi_apps_clk
  gosub Find_Print_Clock gcc_blsp1_qup4_i2c_apps_clk
  gosub Find_Print_Clock gcc_blsp1_qup4_spi_apps_clk
  gosub Find_Print_Clock gcc_blsp1_qup5_i2c_apps_clk
  gosub Find_Print_Clock gcc_blsp1_qup5_spi_apps_clk
  gosub Find_Print_Clock gcc_blsp1_qup6_i2c_apps_clk
  gosub Find_Print_Clock gcc_blsp1_qup6_spi_apps_clk
  gosub Find_Print_Clock gcc_blsp1_uart1_apps_clk
  gosub Find_Print_Clock gcc_blsp1_uart2_apps_clk
  gosub Find_Print_Clock gcc_blsp1_uart3_apps_clk
  gosub Find_Print_Clock gcc_blsp1_uart4_apps_clk
  gosub Find_Print_Clock gcc_blsp1_uart5_apps_clk
  gosub Find_Print_Clock gcc_blsp1_uart6_apps_clk
  gosub Find_Print_Clock gcc_blsp2_qup1_i2c_apps_clk
  gosub Find_Print_Clock gcc_blsp2_qup1_spi_apps_clk
  gosub Find_Print_Clock gcc_blsp2_qup2_i2c_apps_clk
  gosub Find_Print_Clock gcc_blsp2_qup2_spi_apps_clk
  gosub Find_Print_Clock gcc_blsp2_qup3_i2c_apps_clk
  gosub Find_Print_Clock gcc_blsp2_qup3_spi_apps_clk
  gosub Find_Print_Clock gcc_blsp2_qup4_i2c_apps_clk
  gosub Find_Print_Clock gcc_blsp2_qup4_spi_apps_clk
  gosub Find_Print_Clock gcc_blsp2_qup5_i2c_apps_clk
  gosub Find_Print_Clock gcc_blsp2_qup5_spi_apps_clk
  gosub Find_Print_Clock gcc_blsp2_qup6_i2c_apps_clk
  gosub Find_Print_Clock gcc_blsp2_qup6_spi_apps_clk
  gosub Find_Print_Clock gcc_blsp2_uart1_apps_clk
  gosub Find_Print_Clock gcc_blsp2_uart2_apps_clk
  gosub Find_Print_Clock gcc_blsp2_uart3_apps_clk
  gosub Find_Print_Clock gcc_blsp2_uart4_apps_clk
  gosub Find_Print_Clock gcc_blsp2_uart5_apps_clk
  gosub Find_Print_Clock gcc_blsp2_uart6_apps_clk
  gosub Find_Print_Clock gcc_blsp1_uart1_sim_clk
  gosub Find_Print_Clock gcc_blsp1_uart2_sim_clk
  gosub Find_Print_Clock gcc_blsp1_uart3_sim_clk
  gosub Find_Print_Clock gcc_blsp1_uart4_sim_clk
  gosub Find_Print_Clock gcc_blsp1_uart5_sim_clk
  gosub Find_Print_Clock gcc_blsp1_uart6_sim_clk
  gosub Find_Print_Clock gcc_blsp2_uart1_sim_clk
  gosub Find_Print_Clock gcc_blsp2_uart2_sim_clk
  gosub Find_Print_Clock gcc_blsp2_uart3_sim_clk
  gosub Find_Print_Clock gcc_blsp2_uart4_sim_clk
  gosub Find_Print_Clock gcc_blsp2_uart5_sim_clk
  gosub Find_Print_Clock gcc_blsp2_uart6_sim_clk
  gosub Find_Print_Clock gcc_ce1_clk
  gosub Find_Print_Clock gcc_ce2_clk
  gosub Find_Print_Clock gcc_ce3_clk
  gosub Find_Print_Clock gcc_ahb_clk
  gosub Find_Print_Clock gcc_bimc_cfg_ahb_clk
  gosub Find_Print_Clock gcc_boot_rom_ahb_clk
  gosub Find_Print_Clock gcc_ce1_ahb_clk
  gosub Find_Print_Clock gcc_ce2_ahb_clk
  gosub Find_Print_Clock gcc_ce3_ahb_clk
  gosub Find_Print_Clock gcc_cfg_noc_ahb_clk
  gosub Find_Print_Clock gcc_cnoc_bus_timeout0_ahb_clk
  gosub Find_Print_Clock gcc_cnoc_bus_timeout1_ahb_clk
  gosub Find_Print_Clock gcc_cnoc_bus_timeout2_ahb_clk
  gosub Find_Print_Clock gcc_cnoc_bus_timeout3_ahb_clk
  gosub Find_Print_Clock gcc_cnoc_bus_timeout4_ahb_clk
  gosub Find_Print_Clock gcc_cnoc_bus_timeout7_ahb_clk
  gosub Find_Print_Clock gcc_dehr_clk
  gosub Find_Print_Clock gcc_imem_cfg_ahb_clk
  gosub Find_Print_Clock gcc_ipa_ahb_clk
  gosub Find_Print_Clock gcc_mmss_noc_cfg_ahb_clk
  gosub Find_Print_Clock gcc_mpm_ahb_clk
  gosub Find_Print_Clock gcc_msg_ram_ahb_clk
  gosub Find_Print_Clock gcc_mss_cfg_ahb_clk
  gosub Find_Print_Clock gcc_noc_conf_xpu_ahb_clk
  gosub Find_Print_Clock gcc_pcie_0_cfg_ahb_clk
  gosub Find_Print_Clock gcc_pcie_1_cfg_ahb_clk
  gosub Find_Print_Clock gcc_periph_noc_cfg_ahb_clk
  gosub Find_Print_Clock gcc_qdss_cfg_ahb_clk
  gosub Find_Print_Clock gcc_qdss_dap_ahb_clk
  gosub Find_Print_Clock gcc_qdss_rbcpr_xpu_ahb_clk
  gosub Find_Print_Clock gcc_rbcpr_cx_ahb_clk
  gosub Find_Print_Clock gcc_rbcpr_mx_ahb_clk
  gosub Find_Print_Clock gcc_sec_ctrl_ahb_clk
  gosub Find_Print_Clock gcc_sec_ctrl_boot_rom_patch_clk
  gosub Find_Print_Clock gcc_snoc_cnoc_ahb_clk
  gosub Find_Print_Clock gcc_spdm_cfg_ahb_clk
  gosub Find_Print_Clock gcc_spdm_mstr_ahb_clk
  gosub Find_Print_Clock gcc_spmi_cnoc_ahb_clk
  gosub Find_Print_Clock gcc_tcsr_ahb_clk
  gosub Find_Print_Clock gcc_tlmm_ahb_clk
  gosub Find_Print_Clock gcc_tlmm_clk
  gosub Find_Print_Clock gcc_ufs_ahb_clk
  gosub Find_Print_Clock gcc_dcd_xo_clk
  gosub Find_Print_Clock gcc_bam_dma_inactivity_timers_clk
  gosub Find_Print_Clock gcc_bimc_sleep_clk
  gosub Find_Print_Clock gcc_blsp1_sleep_clk
  gosub Find_Print_Clock gcc_blsp2_sleep_clk
  gosub Find_Print_Clock gcc_ddr_dim_sleep_clk
  gosub Find_Print_Clock gcc_im_sleep_clk
  gosub Find_Print_Clock gcc_ipa_sleep_clk
  gosub Find_Print_Clock gcc_rpm_sleep_clk
  gosub Find_Print_Clock gcc_tsif_inactivity_timers_clk
  gosub Find_Print_Clock gcc_usb2_hs_phy_sleep_clk
  gosub Find_Print_Clock gcc_usb30_sleep_clk
  gosub Find_Print_Clock gcc_usb_hs_inactivity_timers_clk
  gosub Find_Print_Clock gcc_xo_clk
  gosub Find_Print_Clock gcc_xo_div4_clk
  gosub Find_Print_Clock gcc_gp1_clk
  gosub Find_Print_Clock gcc_gp2_clk
  gosub Find_Print_Clock gcc_gp3_clk
  gosub Find_Print_Clock gcc_ipa_clk
  gosub Find_Print_Clock gcc_sys_noc_ipa_axi_clk
  gosub Find_Print_Clock gcc_kpss_ahb_clk
  gosub Find_Print_Clock gcc_snoc_bus_timeout0_ahb_clk
  gosub Find_Print_Clock gcc_sys_noc_kpss_ahb_clk
  gosub Find_Print_Clock gcc_bimc_gfx_clk
  gosub Find_Print_Clock gcc_mmss_bimc_gfx_clk
  gosub Find_Print_Clock gcc_mss_q6_bimc_axi_clk
  gosub Find_Print_Clock gcc_obt_odt_clk
  gosub Find_Print_Clock gcc_pcie_0_aux_clk
  gosub Find_Print_Clock gcc_pcie_0_pipe_clk
  gosub Find_Print_Clock gcc_pcie_1_aux_clk
  gosub Find_Print_Clock gcc_pcie_1_pipe_clk
  gosub Find_Print_Clock gcc_pdm_xo4_clk
  gosub Find_Print_Clock gcc_pdm2_clk
  gosub Find_Print_Clock gcc_bam_dma_ahb_clk
  gosub Find_Print_Clock gcc_blsp1_ahb_clk
  gosub Find_Print_Clock gcc_blsp2_ahb_clk
  gosub Find_Print_Clock gcc_pdm_ahb_clk
  gosub Find_Print_Clock gcc_periph_noc_ahb_clk
  gosub Find_Print_Clock gcc_periph_noc_mpu_cfg_ahb_clk
  gosub Find_Print_Clock gcc_periph_xpu_ahb_clk
  gosub Find_Print_Clock gcc_pnoc_bus_timeout0_ahb_clk
  gosub Find_Print_Clock gcc_pnoc_bus_timeout1_ahb_clk
  gosub Find_Print_Clock gcc_pnoc_bus_timeout2_ahb_clk
  gosub Find_Print_Clock gcc_pnoc_bus_timeout3_ahb_clk
  gosub Find_Print_Clock gcc_pnoc_bus_timeout4_ahb_clk
  gosub Find_Print_Clock gcc_prng_ahb_clk
  gosub Find_Print_Clock gcc_sdcc1_ahb_clk
  gosub Find_Print_Clock gcc_sdcc2_ahb_clk
  gosub Find_Print_Clock gcc_sdcc3_ahb_clk
  gosub Find_Print_Clock gcc_sdcc4_ahb_clk
  gosub Find_Print_Clock gcc_snoc_pnoc_ahb_clk
  gosub Find_Print_Clock gcc_tsif_ahb_clk
  gosub Find_Print_Clock gcc_usb_hs_ahb_clk
  gosub Find_Print_Clock gcc_usb_phy_cfg_ahb2phy_clk
  gosub Find_Print_Clock gcc_mmss_noc_at_clk
  gosub Find_Print_Clock gcc_periph_noc_at_clk
  gosub Find_Print_Clock gcc_qdss_at_clk
  gosub Find_Print_Clock gcc_sys_noc_at_clk
  gosub Find_Print_Clock gcc_qdss_dap_clk
  gosub Find_Print_Clock gcc_qdss_stm_clk
  gosub Find_Print_Clock gcc_sys_noc_qdss_stm_axi_clk
  gosub Find_Print_Clock gcc_qdss_traceclkin_clk
  gosub Find_Print_Clock gcc_qdss_tsctr_div2_clk
  gosub Find_Print_Clock gcc_qdss_tsctr_div4_clk
  gosub Find_Print_Clock gcc_qdss_tsctr_div16_clk
  gosub Find_Print_Clock gcc_qdss_tsctr_div3_clk
  gosub Find_Print_Clock gcc_qdss_tsctr_div8_clk
  gosub Find_Print_Clock gcc_rbcpr_cx_clk
  gosub Find_Print_Clock gcc_rbcpr_mx_clk
  gosub Find_Print_Clock gcc_cfg_noc_rpm_ahb_clk
  gosub Find_Print_Clock gcc_cnoc_bus_timeout6_ahb_clk
  gosub Find_Print_Clock gcc_rpm_bus_ahb_clk
  gosub Find_Print_Clock gcc_rpm_proc_fclk
  gosub Find_Print_Clock gcc_rpm_proc_hclk
  gosub Find_Print_Clock gcc_rpm_timer_clk
  gosub Find_Print_Clock gcc_sdcc1_apps_clk
  gosub Find_Print_Clock gcc_sdcc2_apps_clk
  gosub Find_Print_Clock gcc_sdcc3_apps_clk
  gosub Find_Print_Clock gcc_sdcc4_apps_clk
  gosub Find_Print_Clock gcc_sec_ctrl_clk
  gosub Find_Print_Clock gcc_sec_ctrl_sense_clk
  gosub Find_Print_Clock gcc_spdm_bimc_cy_clk
  gosub Find_Print_Clock gcc_spdm_debug_cy_clk
  gosub Find_Print_Clock gcc_spdm_ff_clk
  gosub Find_Print_Clock gcc_spdm_pnoc_cy_clk
  gosub Find_Print_Clock gcc_spdm_rpm_cy_clk
  gosub Find_Print_Clock gcc_spdm_snoc_cy_clk
  gosub Find_Print_Clock gcc_spmi_ahb_clk
  gosub Find_Print_Clock gcc_spmi_ser_clk
  gosub Find_Print_Clock gcc_bimc_sysnoc_axi_clk
  gosub Find_Print_Clock gcc_ce1_axi_clk
  gosub Find_Print_Clock gcc_ce2_axi_clk
  gosub Find_Print_Clock gcc_ce3_axi_clk
  gosub Find_Print_Clock gcc_imem_axi_clk
  gosub Find_Print_Clock gcc_lpass_mport_axi_clk
  gosub Find_Print_Clock gcc_lpass_q6_axi_clk
  gosub Find_Print_Clock gcc_lpass_sway_clk
  gosub Find_Print_Clock gcc_ocmem_sys_noc_axi_clk
  gosub Find_Print_Clock gcc_pcie_0_mstr_axi_clk
  gosub Find_Print_Clock gcc_pcie_0_slv_axi_clk
  gosub Find_Print_Clock gcc_pcie_1_mstr_axi_clk
  gosub Find_Print_Clock gcc_pcie_1_slv_axi_clk
  gosub Find_Print_Clock gcc_qdss_etr_usb_clk
  gosub Find_Print_Clock gcc_snoc_bus_timeout1_ahb_clk
  gosub Find_Print_Clock gcc_snoc_bus_timeout3_ahb_clk
  gosub Find_Print_Clock gcc_sys_noc_axi_clk
  gosub Find_Print_Clock gcc_cfg_noc_tic_clk
  gosub Find_Print_Clock gcc_tic_clk
  gosub Find_Print_Clock gcc_tsif_ref_clk
  gosub Find_Print_Clock gcc_sys_noc_ufs_axi_clk
  gosub Find_Print_Clock gcc_ufs_axi_clk
  gosub Find_Print_Clock gcc_ufs_rx_cfg_clk
  gosub Find_Print_Clock gcc_ufs_tx_cfg_clk
  gosub Find_Print_Clock gcc_snoc_bus_timeout2_ahb_clk
  gosub Find_Print_Clock gcc_sys_noc_usb3_axi_clk
  gosub Find_Print_Clock gcc_usb30_master_clk
  gosub Find_Print_Clock gcc_usb30_mock_utmi_clk
  gosub Find_Print_Clock gcc_usb3_phy_aux_clk
  gosub Find_Print_Clock gcc_usb_hs_system_clk
  gosub Find_Print_Clock gcc_vs_clk
  gosub Find_Print_Clock gpll0_dtest
  gosub Find_Print_Clock gpll0_lock_det
  gosub Find_Print_Clock gpll1_dtest
  gosub Find_Print_Clock gpll1_lock_det
  gosub Find_Print_Clock gpll2_dtest
  gosub Find_Print_Clock gpll2_lock_det
  gosub Find_Print_Clock gpll3_dtest
  gosub Find_Print_Clock gpll3_lock_det
  gosub Find_Print_Clock gpll4_dtest
  gosub Find_Print_Clock gpll4_lock_det
  gosub Find_Print_Clock kpss_gcc_dbg_clk
  gosub Find_Print_Clock kpss_gcc_ringosc_clk
  gosub Find_Print_Clock lpass_gcc_dbg_clk
  gosub Find_Print_Clock mmss_gcc_dbg_clk
  gosub Find_Print_Clock mpm_gcc_temp_sensor_ringosc_clk
  gosub Find_Print_Clock mss_gcc_dbg_clk
  gosub Find_Print_Clock pcie_0_pipe_clk
  gosub Find_Print_Clock pcie_0_pipe_clk
  gosub Find_Print_Clock pcie_1_pipe_clk
  gosub Find_Print_Clock pcie_1_pipe_clk
  gosub Find_Print_Clock qusb2phy_clk_480m_test
  gosub Find_Print_Clock ufs_rx_symbol_0_clk
  gosub Find_Print_Clock ufs_rx_symbol_0_clk
  gosub Find_Print_Clock ufs_rx_symbol_1_clk
  gosub Find_Print_Clock ufs_rx_symbol_1_clk
  gosub Find_Print_Clock ufs_tx_symbol_0_clk
  gosub Find_Print_Clock ufs_tx_symbol_0_clk
  gosub Find_Print_Clock ufs_tx_symbol_1_clk
  gosub Find_Print_Clock ufs_tx_symbol_1_clk
  gosub Find_Print_Clock usb2_phy_wrapper_gcc_usb30_utmi_clk
  gosub Find_Print_Clock usb3_phy_wrapper_gcc_usb3_pipe_clk
  gosub Find_Print_Clock usb_hspw_gcc_480_test_clk
  gosub Find_Print_Clock ahbfabric_clk_src
  gosub Find_Print_Clock ahb_spdmtm_clk
  gosub Find_Print_Clock audio_core_aon_clk
  gosub Find_Print_Clock audio_core_avsync_csr_clk
  gosub Find_Print_Clock audio_core_csr_clk
  gosub Find_Print_Clock audio_core_dml_clk
  gosub Find_Print_Clock audio_core_ixfabric_clk
  gosub Find_Print_Clock audio_core_ixfabric_spdmtm_csr_clk
  gosub Find_Print_Clock audio_core_lpaif_csr_clk
  gosub Find_Print_Clock audio_core_lpaif_dma_clk
  gosub Find_Print_Clock audio_core_lpm_clk
  gosub Find_Print_Clock audio_core_resampler_lfabif_clk
  gosub Find_Print_Clock audio_core_security_clk
  gosub Find_Print_Clock audio_core_slimbus2_lfabif_clk
  gosub Find_Print_Clock audio_core_slimbus_lfabif_clk
  gosub Find_Print_Clock audio_core_sysnoc_clk
  gosub Find_Print_Clock audio_core_timeout_clk
  gosub Find_Print_Clock audio_wrapper_aon_clk
  gosub Find_Print_Clock audio_wrapper_br_clk
  gosub Find_Print_Clock audio_wrapper_efabric_clk
  gosub Find_Print_Clock audio_wrapper_efabric_spdmtm_csr_clk
  gosub Find_Print_Clock audio_wrapper_lcc_csr_clk
  gosub Find_Print_Clock audio_wrapper_security_clk
  gosub Find_Print_Clock audio_wrapper_smem_clk
  gosub Find_Print_Clock audio_wrapper_sysnoc_sway_clk
  gosub Find_Print_Clock audio_wrapper_timeout_clk
  gosub Find_Print_Clock q6ss_ahb_lfabif_clk
  gosub Find_Print_Clock q6ss_ahbm_clk
  gosub Find_Print_Clock q6ss_tcm_slave_clk
  gosub Find_Print_Clock avtimer_xo_clk_src
  gosub Find_Print_Clock audio_core_avsync_avtimer_xo_clk
  gosub Find_Print_Clock gdsc_xo_clk_src
  gosub Find_Print_Clock audio_core_gdsc_xo_clk
  gosub Find_Print_Clock lpaif_pcm0_clk_src
  gosub Find_Print_Clock audio_core_lpaif_pcm0_ibit_clk
  gosub Find_Print_Clock lpaif_pcm1_clk_src
  gosub Find_Print_Clock audio_core_lpaif_pcm1_ibit_clk
  gosub Find_Print_Clock lpaif_pcmoe_clk_src
  gosub Find_Print_Clock audio_core_lpaif_pcm_data_oe_clk
  gosub Find_Print_Clock lpaif_pri_clk_src
  gosub Find_Print_Clock audio_core_lpaif_pri_ibit_clk
  gosub Find_Print_Clock audio_core_lpaif_pri_osr_clk
  gosub Find_Print_Clock lpaif_quad_clk_src
  gosub Find_Print_Clock audio_core_lpaif_quad_ibit_clk
  gosub Find_Print_Clock audio_core_lpaif_quad_osr_clk
  gosub Find_Print_Clock lpaif_sec_clk_src
  gosub Find_Print_Clock audio_core_lpaif_sec_ibit_clk
  gosub Find_Print_Clock audio_core_lpaif_sec_osr_clk
  gosub Find_Print_Clock lpaif_spkr_clk_src
  gosub Find_Print_Clock audio_core_lpaif_codec_spkr_ibit_clk
  gosub Find_Print_Clock audio_core_lpaif_codec_spkr_osr_clk
  gosub Find_Print_Clock lpaif_ter_clk_src
  gosub Find_Print_Clock audio_core_lpaif_ter_ibit_clk
  gosub Find_Print_Clock audio_core_lpaif_ter_osr_clk
  gosub Find_Print_Clock pri_mclk_clk_src
  gosub Find_Print_Clock audio_wrapper_pri_mclk_clk
  gosub Find_Print_Clock q6_spdm_clk_src
  gosub Find_Print_Clock q6_spdm_clk
  gosub Find_Print_Clock q6ss_bcr_slp_clk_src
  gosub Find_Print_Clock audio_core_bcr_slp_clk
  gosub Find_Print_Clock q6ss_bcr_slp_clk
  gosub Find_Print_Clock q6_xo_clk_src
  gosub Find_Print_Clock q6ss_xo_clk
  gosub Find_Print_Clock quad_mclk_clk_src
  gosub Find_Print_Clock audio_wrapper_quad_mclk_clk
  gosub Find_Print_Clock resampler_clk_src
  gosub Find_Print_Clock audio_core_resampler_core_clk
  gosub Find_Print_Clock sec_mclk_clk_src
  gosub Find_Print_Clock audio_wrapper_sec_mclk_clk
  gosub Find_Print_Clock sleep_clk_src
  gosub Find_Print_Clock q6ss_slp_clk
  gosub Find_Print_Clock slimbus_clk_src
  gosub Find_Print_Clock audio_core_slimbus_core_clk
  gosub Find_Print_Clock slimbus2_clk_src
  gosub Find_Print_Clock audio_core_slimbus2_core_clk
  gosub Find_Print_Clock stm_xo_clk_src
  gosub Find_Print_Clock audio_wrapper_stm_xo_clk
  gosub Find_Print_Clock ter_mclk_clk_src
  gosub Find_Print_Clock audio_wrapper_ter_mclk_clk
  gosub Find_Print_Clock lpass_qdsp6ss_q6_core_clk
  gosub Find_Print_Clock lpass_qdsp6ss_axi_m_clk
  gosub Find_Print_Clock lpass_qdsp6ss_ldo_nmo_out
  gosub Find_Print_Clock lpass_qdsp6ss_ahb_m_clk
  gosub Find_Print_Clock lpass_qdsp6ss_ahb_s_clk
  gosub Find_Print_Clock lpass_qdsp6ss_xo_clk
  gosub Find_Print_Clock lpass_qdsp6ss_sleep_clk
  gosub Find_Print_Clock lpass_qdsp6ss_jtag_tck
  gosub Find_Print_Clock lpass_qdsp6ss_atb_clk
  gosub Find_Print_Clock lpass_qdsp6ss_apb_clk
  gosub Find_Print_Clock lpass_qdsp6ss_timestamp_clk

  return



Print_All_SS:

  if ("&choice"=="gcc_all")
  (
  gosub Find_Print_Clock gcc_sec_ctrl_acc_clk
  gosub Find_Print_Clock sec_ctrl_acc_clk_src
  gosub Find_Print_Clock gcc_bimc_clk
  gosub Find_Print_Clock gcc_bimc_ddr_cpll0_clk
  gosub Find_Print_Clock gcc_bimc_ddr_cpll1_clk
  gosub Find_Print_Clock gcc_bimc_xo_clk
  gosub Find_Print_Clock gcc_cfg_noc_ddr_cfg_clk
  gosub Find_Print_Clock gcc_cnoc_bus_timeout5_ahb_clk
  gosub Find_Print_Clock gcc_ddr_dim_cfg_clk
  gosub Find_Print_Clock gcc_bimc_kpss_axi_clk
  gosub Find_Print_Clock gcc_kpss_axi_clk
  gosub Find_Print_Clock gcc_bimc_kpss_cci_axi_clk
  gosub Find_Print_Clock gcc_kpss_cci_axi_clk
  gosub Find_Print_Clock gcc_blsp1_qup1_i2c_apps_clk
  gosub Find_Print_Clock gcc_blsp1_qup1_spi_apps_clk
  gosub Find_Print_Clock gcc_blsp1_qup2_i2c_apps_clk
  gosub Find_Print_Clock gcc_blsp1_qup2_spi_apps_clk
  gosub Find_Print_Clock gcc_blsp1_qup3_i2c_apps_clk
  gosub Find_Print_Clock gcc_blsp1_qup3_spi_apps_clk
  gosub Find_Print_Clock gcc_blsp1_qup4_i2c_apps_clk
  gosub Find_Print_Clock gcc_blsp1_qup4_spi_apps_clk
  gosub Find_Print_Clock gcc_blsp1_qup5_i2c_apps_clk
  gosub Find_Print_Clock gcc_blsp1_qup5_spi_apps_clk
  gosub Find_Print_Clock gcc_blsp1_qup6_i2c_apps_clk
  gosub Find_Print_Clock gcc_blsp1_qup6_spi_apps_clk
  gosub Find_Print_Clock gcc_blsp1_uart1_apps_clk
  gosub Find_Print_Clock gcc_blsp1_uart2_apps_clk
  gosub Find_Print_Clock gcc_blsp1_uart3_apps_clk
  gosub Find_Print_Clock gcc_blsp1_uart4_apps_clk
  gosub Find_Print_Clock gcc_blsp1_uart5_apps_clk
  gosub Find_Print_Clock gcc_blsp1_uart6_apps_clk
  gosub Find_Print_Clock gcc_blsp2_qup1_i2c_apps_clk
  gosub Find_Print_Clock gcc_blsp2_qup1_spi_apps_clk
  gosub Find_Print_Clock gcc_blsp2_qup2_i2c_apps_clk
  gosub Find_Print_Clock gcc_blsp2_qup2_spi_apps_clk
  gosub Find_Print_Clock gcc_blsp2_qup3_i2c_apps_clk
  gosub Find_Print_Clock gcc_blsp2_qup3_spi_apps_clk
  gosub Find_Print_Clock gcc_blsp2_qup4_i2c_apps_clk
  gosub Find_Print_Clock gcc_blsp2_qup4_spi_apps_clk
  gosub Find_Print_Clock gcc_blsp2_qup5_i2c_apps_clk
  gosub Find_Print_Clock gcc_blsp2_qup5_spi_apps_clk
  gosub Find_Print_Clock gcc_blsp2_qup6_i2c_apps_clk
  gosub Find_Print_Clock gcc_blsp2_qup6_spi_apps_clk
  gosub Find_Print_Clock gcc_blsp2_uart1_apps_clk
  gosub Find_Print_Clock gcc_blsp2_uart2_apps_clk
  gosub Find_Print_Clock gcc_blsp2_uart3_apps_clk
  gosub Find_Print_Clock gcc_blsp2_uart4_apps_clk
  gosub Find_Print_Clock gcc_blsp2_uart5_apps_clk
  gosub Find_Print_Clock gcc_blsp2_uart6_apps_clk
  gosub Find_Print_Clock gcc_blsp1_uart1_sim_clk
  gosub Find_Print_Clock gcc_blsp1_uart2_sim_clk
  gosub Find_Print_Clock gcc_blsp1_uart3_sim_clk
  gosub Find_Print_Clock gcc_blsp1_uart4_sim_clk
  gosub Find_Print_Clock gcc_blsp1_uart5_sim_clk
  gosub Find_Print_Clock gcc_blsp1_uart6_sim_clk
  gosub Find_Print_Clock gcc_blsp2_uart1_sim_clk
  gosub Find_Print_Clock gcc_blsp2_uart2_sim_clk
  gosub Find_Print_Clock gcc_blsp2_uart3_sim_clk
  gosub Find_Print_Clock gcc_blsp2_uart4_sim_clk
  gosub Find_Print_Clock gcc_blsp2_uart5_sim_clk
  gosub Find_Print_Clock gcc_blsp2_uart6_sim_clk
  gosub Find_Print_Clock gcc_ce1_clk
  gosub Find_Print_Clock gcc_ce2_clk
  gosub Find_Print_Clock gcc_ce3_clk
  gosub Find_Print_Clock gcc_ahb_clk
  gosub Find_Print_Clock gcc_bimc_cfg_ahb_clk
  gosub Find_Print_Clock gcc_boot_rom_ahb_clk
  gosub Find_Print_Clock gcc_ce1_ahb_clk
  gosub Find_Print_Clock gcc_ce2_ahb_clk
  gosub Find_Print_Clock gcc_ce3_ahb_clk
  gosub Find_Print_Clock gcc_cfg_noc_ahb_clk
  gosub Find_Print_Clock gcc_cnoc_bus_timeout0_ahb_clk
  gosub Find_Print_Clock gcc_cnoc_bus_timeout1_ahb_clk
  gosub Find_Print_Clock gcc_cnoc_bus_timeout2_ahb_clk
  gosub Find_Print_Clock gcc_cnoc_bus_timeout3_ahb_clk
  gosub Find_Print_Clock gcc_cnoc_bus_timeout4_ahb_clk
  gosub Find_Print_Clock gcc_cnoc_bus_timeout7_ahb_clk
  gosub Find_Print_Clock gcc_dehr_clk
  gosub Find_Print_Clock gcc_imem_cfg_ahb_clk
  gosub Find_Print_Clock gcc_ipa_ahb_clk
  gosub Find_Print_Clock gcc_mmss_noc_cfg_ahb_clk
  gosub Find_Print_Clock gcc_mpm_ahb_clk
  gosub Find_Print_Clock gcc_msg_ram_ahb_clk
  gosub Find_Print_Clock gcc_mss_cfg_ahb_clk
  gosub Find_Print_Clock gcc_noc_conf_xpu_ahb_clk
  gosub Find_Print_Clock gcc_pcie_0_cfg_ahb_clk
  gosub Find_Print_Clock gcc_pcie_1_cfg_ahb_clk
  gosub Find_Print_Clock gcc_periph_noc_cfg_ahb_clk
  gosub Find_Print_Clock gcc_qdss_cfg_ahb_clk
  gosub Find_Print_Clock gcc_qdss_dap_ahb_clk
  gosub Find_Print_Clock gcc_qdss_rbcpr_xpu_ahb_clk
  gosub Find_Print_Clock gcc_rbcpr_cx_ahb_clk
  gosub Find_Print_Clock gcc_rbcpr_mx_ahb_clk
  gosub Find_Print_Clock gcc_sec_ctrl_ahb_clk
  gosub Find_Print_Clock gcc_sec_ctrl_boot_rom_patch_clk
  gosub Find_Print_Clock gcc_snoc_cnoc_ahb_clk
  gosub Find_Print_Clock gcc_spdm_cfg_ahb_clk
  gosub Find_Print_Clock gcc_spdm_mstr_ahb_clk
  gosub Find_Print_Clock gcc_spmi_cnoc_ahb_clk
  gosub Find_Print_Clock gcc_tcsr_ahb_clk
  gosub Find_Print_Clock gcc_tlmm_ahb_clk
  gosub Find_Print_Clock gcc_tlmm_clk
  gosub Find_Print_Clock gcc_ufs_ahb_clk
  gosub Find_Print_Clock gcc_dcd_xo_clk
  gosub Find_Print_Clock gcc_bam_dma_inactivity_timers_clk
  gosub Find_Print_Clock gcc_bimc_sleep_clk
  gosub Find_Print_Clock gcc_blsp1_sleep_clk
  gosub Find_Print_Clock gcc_blsp2_sleep_clk
  gosub Find_Print_Clock gcc_ddr_dim_sleep_clk
  gosub Find_Print_Clock gcc_im_sleep_clk
  gosub Find_Print_Clock gcc_ipa_sleep_clk
  gosub Find_Print_Clock gcc_rpm_sleep_clk
  gosub Find_Print_Clock gcc_tsif_inactivity_timers_clk
  gosub Find_Print_Clock gcc_usb2_hs_phy_sleep_clk
  gosub Find_Print_Clock gcc_usb30_sleep_clk
  gosub Find_Print_Clock gcc_usb_hs_inactivity_timers_clk
  gosub Find_Print_Clock gcc_xo_clk
  gosub Find_Print_Clock gcc_xo_div4_clk
  gosub Find_Print_Clock gcc_gp1_clk
  gosub Find_Print_Clock gcc_gp2_clk
  gosub Find_Print_Clock gcc_gp3_clk
  gosub Find_Print_Clock gcc_ipa_clk
  gosub Find_Print_Clock gcc_sys_noc_ipa_axi_clk
  gosub Find_Print_Clock gcc_kpss_ahb_clk
  gosub Find_Print_Clock gcc_snoc_bus_timeout0_ahb_clk
  gosub Find_Print_Clock gcc_sys_noc_kpss_ahb_clk
  gosub Find_Print_Clock gcc_bimc_gfx_clk
  gosub Find_Print_Clock gcc_mmss_bimc_gfx_clk
  gosub Find_Print_Clock gcc_mss_q6_bimc_axi_clk
  gosub Find_Print_Clock gcc_obt_odt_clk
  gosub Find_Print_Clock gcc_pcie_0_aux_clk
  gosub Find_Print_Clock gcc_pcie_0_pipe_clk
  gosub Find_Print_Clock gcc_pcie_1_aux_clk
  gosub Find_Print_Clock gcc_pcie_1_pipe_clk
  gosub Find_Print_Clock gcc_pdm_xo4_clk
  gosub Find_Print_Clock gcc_pdm2_clk
  gosub Find_Print_Clock gcc_bam_dma_ahb_clk
  gosub Find_Print_Clock gcc_blsp1_ahb_clk
  gosub Find_Print_Clock gcc_blsp2_ahb_clk
  gosub Find_Print_Clock gcc_pdm_ahb_clk
  gosub Find_Print_Clock gcc_periph_noc_ahb_clk
  gosub Find_Print_Clock gcc_periph_noc_mpu_cfg_ahb_clk
  gosub Find_Print_Clock gcc_periph_xpu_ahb_clk
  gosub Find_Print_Clock gcc_pnoc_bus_timeout0_ahb_clk
  gosub Find_Print_Clock gcc_pnoc_bus_timeout1_ahb_clk
  gosub Find_Print_Clock gcc_pnoc_bus_timeout2_ahb_clk
  gosub Find_Print_Clock gcc_pnoc_bus_timeout3_ahb_clk
  gosub Find_Print_Clock gcc_pnoc_bus_timeout4_ahb_clk
  gosub Find_Print_Clock gcc_prng_ahb_clk
  gosub Find_Print_Clock gcc_sdcc1_ahb_clk
  gosub Find_Print_Clock gcc_sdcc2_ahb_clk
  gosub Find_Print_Clock gcc_sdcc3_ahb_clk
  gosub Find_Print_Clock gcc_sdcc4_ahb_clk
  gosub Find_Print_Clock gcc_snoc_pnoc_ahb_clk
  gosub Find_Print_Clock gcc_tsif_ahb_clk
  gosub Find_Print_Clock gcc_usb_hs_ahb_clk
  gosub Find_Print_Clock gcc_usb_phy_cfg_ahb2phy_clk
  gosub Find_Print_Clock gcc_mmss_noc_at_clk
  gosub Find_Print_Clock gcc_periph_noc_at_clk
  gosub Find_Print_Clock gcc_qdss_at_clk
  gosub Find_Print_Clock gcc_sys_noc_at_clk
  gosub Find_Print_Clock gcc_qdss_dap_clk
  gosub Find_Print_Clock gcc_qdss_stm_clk
  gosub Find_Print_Clock gcc_sys_noc_qdss_stm_axi_clk
  gosub Find_Print_Clock gcc_qdss_traceclkin_clk
  gosub Find_Print_Clock gcc_qdss_tsctr_div2_clk
  gosub Find_Print_Clock gcc_qdss_tsctr_div4_clk
  gosub Find_Print_Clock gcc_qdss_tsctr_div16_clk
  gosub Find_Print_Clock gcc_qdss_tsctr_div3_clk
  gosub Find_Print_Clock gcc_qdss_tsctr_div8_clk
  gosub Find_Print_Clock gcc_rbcpr_cx_clk
  gosub Find_Print_Clock gcc_rbcpr_mx_clk
  gosub Find_Print_Clock gcc_cfg_noc_rpm_ahb_clk
  gosub Find_Print_Clock gcc_cnoc_bus_timeout6_ahb_clk
  gosub Find_Print_Clock gcc_rpm_bus_ahb_clk
  gosub Find_Print_Clock gcc_rpm_proc_fclk
  gosub Find_Print_Clock gcc_rpm_proc_hclk
  gosub Find_Print_Clock gcc_rpm_timer_clk
  gosub Find_Print_Clock gcc_sdcc1_apps_clk
  gosub Find_Print_Clock gcc_sdcc2_apps_clk
  gosub Find_Print_Clock gcc_sdcc3_apps_clk
  gosub Find_Print_Clock gcc_sdcc4_apps_clk
  gosub Find_Print_Clock gcc_sec_ctrl_clk
  gosub Find_Print_Clock gcc_sec_ctrl_sense_clk
  gosub Find_Print_Clock gcc_spdm_bimc_cy_clk
  gosub Find_Print_Clock gcc_spdm_debug_cy_clk
  gosub Find_Print_Clock gcc_spdm_ff_clk
  gosub Find_Print_Clock gcc_spdm_pnoc_cy_clk
  gosub Find_Print_Clock gcc_spdm_rpm_cy_clk
  gosub Find_Print_Clock gcc_spdm_snoc_cy_clk
  gosub Find_Print_Clock gcc_spmi_ahb_clk
  gosub Find_Print_Clock gcc_spmi_ser_clk
  gosub Find_Print_Clock gcc_bimc_sysnoc_axi_clk
  gosub Find_Print_Clock gcc_ce1_axi_clk
  gosub Find_Print_Clock gcc_ce2_axi_clk
  gosub Find_Print_Clock gcc_ce3_axi_clk
  gosub Find_Print_Clock gcc_imem_axi_clk
  gosub Find_Print_Clock gcc_lpass_mport_axi_clk
  gosub Find_Print_Clock gcc_lpass_q6_axi_clk
  gosub Find_Print_Clock gcc_lpass_sway_clk
  gosub Find_Print_Clock gcc_ocmem_sys_noc_axi_clk
  gosub Find_Print_Clock gcc_pcie_0_mstr_axi_clk
  gosub Find_Print_Clock gcc_pcie_0_slv_axi_clk
  gosub Find_Print_Clock gcc_pcie_1_mstr_axi_clk
  gosub Find_Print_Clock gcc_pcie_1_slv_axi_clk
  gosub Find_Print_Clock gcc_qdss_etr_usb_clk
  gosub Find_Print_Clock gcc_snoc_bus_timeout1_ahb_clk
  gosub Find_Print_Clock gcc_snoc_bus_timeout3_ahb_clk
  gosub Find_Print_Clock gcc_sys_noc_axi_clk
  gosub Find_Print_Clock gcc_cfg_noc_tic_clk
  gosub Find_Print_Clock gcc_tic_clk
  gosub Find_Print_Clock gcc_tsif_ref_clk
  gosub Find_Print_Clock gcc_sys_noc_ufs_axi_clk
  gosub Find_Print_Clock gcc_ufs_axi_clk
  gosub Find_Print_Clock gcc_ufs_rx_cfg_clk
  gosub Find_Print_Clock gcc_ufs_tx_cfg_clk
  gosub Find_Print_Clock gcc_snoc_bus_timeout2_ahb_clk
  gosub Find_Print_Clock gcc_sys_noc_usb3_axi_clk
  gosub Find_Print_Clock gcc_usb30_master_clk
  gosub Find_Print_Clock gcc_usb30_mock_utmi_clk
  gosub Find_Print_Clock gcc_usb3_phy_aux_clk
  gosub Find_Print_Clock gcc_usb_hs_system_clk
  gosub Find_Print_Clock gcc_vs_clk
  gosub Find_Print_Clock gpll0_dtest
  gosub Find_Print_Clock gpll0_lock_det
  gosub Find_Print_Clock gpll1_dtest
  gosub Find_Print_Clock gpll1_lock_det
  gosub Find_Print_Clock gpll2_dtest
  gosub Find_Print_Clock gpll2_lock_det
  gosub Find_Print_Clock gpll3_dtest
  gosub Find_Print_Clock gpll3_lock_det
  gosub Find_Print_Clock gpll4_dtest
  gosub Find_Print_Clock gpll4_lock_det
  gosub Find_Print_Clock kpss_gcc_dbg_clk
  gosub Find_Print_Clock kpss_gcc_ringosc_clk
  gosub Find_Print_Clock lpass_gcc_dbg_clk
  gosub Find_Print_Clock mmss_gcc_dbg_clk
  gosub Find_Print_Clock mpm_gcc_temp_sensor_ringosc_clk
  gosub Find_Print_Clock mss_gcc_dbg_clk
  gosub Find_Print_Clock pcie_0_pipe_clk
  gosub Find_Print_Clock pcie_0_pipe_clk
  gosub Find_Print_Clock pcie_1_pipe_clk
  gosub Find_Print_Clock pcie_1_pipe_clk
  gosub Find_Print_Clock qusb2phy_clk_480m_test
  gosub Find_Print_Clock ufs_rx_symbol_0_clk
  gosub Find_Print_Clock ufs_rx_symbol_0_clk
  gosub Find_Print_Clock ufs_rx_symbol_1_clk
  gosub Find_Print_Clock ufs_rx_symbol_1_clk
  gosub Find_Print_Clock ufs_tx_symbol_0_clk
  gosub Find_Print_Clock ufs_tx_symbol_0_clk
  gosub Find_Print_Clock ufs_tx_symbol_1_clk
  gosub Find_Print_Clock ufs_tx_symbol_1_clk
  gosub Find_Print_Clock usb2_phy_wrapper_gcc_usb30_utmi_clk
  gosub Find_Print_Clock usb3_phy_wrapper_gcc_usb3_pipe_clk
  gosub Find_Print_Clock usb_hspw_gcc_480_test_clk
    &choice_handled=1
    return
  )
  if ("&choice"=="lpass_all")
  (
  gosub Find_Print_Clock ahbfabric_clk_src
  gosub Find_Print_Clock ahb_spdmtm_clk
  gosub Find_Print_Clock audio_core_aon_clk
  gosub Find_Print_Clock audio_core_avsync_csr_clk
  gosub Find_Print_Clock audio_core_csr_clk
  gosub Find_Print_Clock audio_core_dml_clk
  gosub Find_Print_Clock audio_core_ixfabric_clk
  gosub Find_Print_Clock audio_core_ixfabric_spdmtm_csr_clk
  gosub Find_Print_Clock audio_core_lpaif_csr_clk
  gosub Find_Print_Clock audio_core_lpaif_dma_clk
  gosub Find_Print_Clock audio_core_lpm_clk
  gosub Find_Print_Clock audio_core_resampler_lfabif_clk
  gosub Find_Print_Clock audio_core_security_clk
  gosub Find_Print_Clock audio_core_slimbus2_lfabif_clk
  gosub Find_Print_Clock audio_core_slimbus_lfabif_clk
  gosub Find_Print_Clock audio_core_sysnoc_clk
  gosub Find_Print_Clock audio_core_timeout_clk
  gosub Find_Print_Clock audio_wrapper_aon_clk
  gosub Find_Print_Clock audio_wrapper_br_clk
  gosub Find_Print_Clock audio_wrapper_efabric_clk
  gosub Find_Print_Clock audio_wrapper_efabric_spdmtm_csr_clk
  gosub Find_Print_Clock audio_wrapper_lcc_csr_clk
  gosub Find_Print_Clock audio_wrapper_security_clk
  gosub Find_Print_Clock audio_wrapper_smem_clk
  gosub Find_Print_Clock audio_wrapper_sysnoc_sway_clk
  gosub Find_Print_Clock audio_wrapper_timeout_clk
  gosub Find_Print_Clock q6ss_ahb_lfabif_clk
  gosub Find_Print_Clock q6ss_ahbm_clk
  gosub Find_Print_Clock q6ss_tcm_slave_clk
  gosub Find_Print_Clock avtimer_xo_clk_src
  gosub Find_Print_Clock audio_core_avsync_avtimer_xo_clk
  gosub Find_Print_Clock gdsc_xo_clk_src
  gosub Find_Print_Clock audio_core_gdsc_xo_clk
  gosub Find_Print_Clock lpaif_pcm0_clk_src
  gosub Find_Print_Clock audio_core_lpaif_pcm0_ibit_clk
  gosub Find_Print_Clock lpaif_pcm1_clk_src
  gosub Find_Print_Clock audio_core_lpaif_pcm1_ibit_clk
  gosub Find_Print_Clock lpaif_pcmoe_clk_src
  gosub Find_Print_Clock audio_core_lpaif_pcm_data_oe_clk
  gosub Find_Print_Clock lpaif_pri_clk_src
  gosub Find_Print_Clock audio_core_lpaif_pri_ibit_clk
  gosub Find_Print_Clock audio_core_lpaif_pri_osr_clk
  gosub Find_Print_Clock lpaif_quad_clk_src
  gosub Find_Print_Clock audio_core_lpaif_quad_ibit_clk
  gosub Find_Print_Clock audio_core_lpaif_quad_osr_clk
  gosub Find_Print_Clock lpaif_sec_clk_src
  gosub Find_Print_Clock audio_core_lpaif_sec_ibit_clk
  gosub Find_Print_Clock audio_core_lpaif_sec_osr_clk
  gosub Find_Print_Clock lpaif_spkr_clk_src
  gosub Find_Print_Clock audio_core_lpaif_codec_spkr_ibit_clk
  gosub Find_Print_Clock audio_core_lpaif_codec_spkr_osr_clk
  gosub Find_Print_Clock lpaif_ter_clk_src
  gosub Find_Print_Clock audio_core_lpaif_ter_ibit_clk
  gosub Find_Print_Clock audio_core_lpaif_ter_osr_clk
  gosub Find_Print_Clock pri_mclk_clk_src
  gosub Find_Print_Clock audio_wrapper_pri_mclk_clk
  gosub Find_Print_Clock q6_spdm_clk_src
  gosub Find_Print_Clock q6_spdm_clk
  gosub Find_Print_Clock q6ss_bcr_slp_clk_src
  gosub Find_Print_Clock audio_core_bcr_slp_clk
  gosub Find_Print_Clock q6ss_bcr_slp_clk
  gosub Find_Print_Clock q6_xo_clk_src
  gosub Find_Print_Clock q6ss_xo_clk
  gosub Find_Print_Clock quad_mclk_clk_src
  gosub Find_Print_Clock audio_wrapper_quad_mclk_clk
  gosub Find_Print_Clock resampler_clk_src
  gosub Find_Print_Clock audio_core_resampler_core_clk
  gosub Find_Print_Clock sec_mclk_clk_src
  gosub Find_Print_Clock audio_wrapper_sec_mclk_clk
  gosub Find_Print_Clock sleep_clk_src
  gosub Find_Print_Clock q6ss_slp_clk
  gosub Find_Print_Clock slimbus_clk_src
  gosub Find_Print_Clock audio_core_slimbus_core_clk
  gosub Find_Print_Clock slimbus2_clk_src
  gosub Find_Print_Clock audio_core_slimbus2_core_clk
  gosub Find_Print_Clock stm_xo_clk_src
  gosub Find_Print_Clock audio_wrapper_stm_xo_clk
  gosub Find_Print_Clock ter_mclk_clk_src
  gosub Find_Print_Clock audio_wrapper_ter_mclk_clk
  gosub Find_Print_Clock lpass_qdsp6ss_q6_core_clk
  gosub Find_Print_Clock lpass_qdsp6ss_axi_m_clk
  gosub Find_Print_Clock lpass_qdsp6ss_ldo_nmo_out
  gosub Find_Print_Clock lpass_qdsp6ss_ahb_m_clk
  gosub Find_Print_Clock lpass_qdsp6ss_ahb_s_clk
  gosub Find_Print_Clock lpass_qdsp6ss_xo_clk
  gosub Find_Print_Clock lpass_qdsp6ss_sleep_clk
  gosub Find_Print_Clock lpass_qdsp6ss_jtag_tck
  gosub Find_Print_Clock lpass_qdsp6ss_atb_clk
  gosub Find_Print_Clock lpass_qdsp6ss_apb_clk
  gosub Find_Print_Clock lpass_qdsp6ss_timestamp_clk
    &choice_handled=1
    return
  )

  return



;-----------------------------------------------------------------------------
; Find clocks that match what the user entered and print their information 
;-----------------------------------------------------------------------------

Find_Print_Clock:

ENTRY &clk

&clk_test=0
&clk_reg=0
&clk_reg_name=""


  ; Set appropriate access mode for GCC registers 
  &clk_access_mode="&gcc_access_mode"

  &match=0
  &wild_head=0
  &wild_tail=0
  &clk_input_length=STRING.LENGTH("&clk")
  &clk_itr_length=STRING.LENGTH("gcc_sec_ctrl_acc_clk")

  if (STRING.SCAN("&clk", "*", 0)==0)
  (
    &wild_head=1
  )
  if (STRING.SCAN("&clk", "*", 1)==(STRING.LENGTH("&clk")-1))
  (
    &wild_tail=1
  )

  if ((&wild_head==1)&&(&wild_tail==1))
  (
    if (STRING.SCAN("gcc_sec_ctrl_acc_clk", STRING.MID("&clk", 1, &clk_input_length-2), 0)!=-1)
    ( 
      &match=1
    )
  )
  else if (&wild_head==1)
  (
    if (STRING.MID("gcc_sec_ctrl_acc_clk", &clk_itr_length-&clk_input_length+1, &clk_input_length-1)==STRING.CUT("&clk", 1))
    ( 
      &match=1
    )
  )
  else if (&wild_tail==1)
  (
    if (STRING.MID("gcc_sec_ctrl_acc_clk", 0, &clk_input_length-1)==STRING.CUT("&clk", -1))
    ( 
      &match=1
    )
  )	  
  else if ("gcc_sec_ctrl_acc_clk"=="&clk")
  (
    &match=1
  )
  
  if (&match==1)
  (
    &clk_test=&CLK_TEST_GCC_SEC_CTRL_ACC_CLK
    &clk_reg=&HWIO_GCC_SEC_CTRL_ACC_CBCR_ADDR
    &clk_reg_name="GCC_SEC_CTRL_ACC_CBCR"
    &clk_name="gcc_sec_ctrl_acc_clk"
    &clk_reg_cbcr_type="sm_pscbc"

    gosub Print_Clk_Info_Line
  )

  &match=0
  &wild_head=0
  &wild_tail=0
  &clk_input_length=STRING.LENGTH("&clk")
  &clk_itr_length=STRING.LENGTH("sec_ctrl_acc_clk_src")

  if (STRING.SCAN("&clk", "*", 0)==0)
  (
    &wild_head=1
  )
  if (STRING.SCAN("&clk", "*", 1)==(STRING.LENGTH("&clk")-1))
  (
    &wild_tail=1
  )

  if ((&wild_head==1)&&(&wild_tail==1))
  (
    if (STRING.SCAN("sec_ctrl_acc_clk_src", STRING.MID("&clk", 1, &clk_input_length-2), 0)!=-1)
    ( 
      &match=1
    )
  )
  else if (&wild_head==1)
  (
    if (STRING.MID("sec_ctrl_acc_clk_src", &clk_itr_length-&clk_input_length+1, &clk_input_length-1)==STRING.CUT("&clk", 1))
    ( 
      &match=1
    )
  )
  else if (&wild_tail==1)
  (
    if (STRING.MID("sec_ctrl_acc_clk_src", 0, &clk_input_length-1)==STRING.CUT("&clk", -1))
    ( 
      &match=1
    )
  )	  
  else if ("sec_ctrl_acc_clk_src"=="&clk")
  (
    &match=1
  )
  
  if (&match==1)
  (
    &clk_test=0
    &clk_reg=0
    &clk_reg_name="No CBCR"
    &clk_name="sec_ctrl_acc_clk_src"
    &clk_reg_cbcr_type=""

    gosub Print_Clk_Info_Line
  )

  &match=0
  &wild_head=0
  &wild_tail=0
  &clk_input_length=STRING.LENGTH("&clk")
  &clk_itr_length=STRING.LENGTH("gcc_bimc_clk")

  if (STRING.SCAN("&clk", "*", 0)==0)
  (
    &wild_head=1
  )
  if (STRING.SCAN("&clk", "*", 1)==(STRING.LENGTH("&clk")-1))
  (
    &wild_tail=1
  )

  if ((&wild_head==1)&&(&wild_tail==1))
  (
    if (STRING.SCAN("gcc_bimc_clk", STRING.MID("&clk", 1, &clk_input_length-2), 0)!=-1)
    ( 
      &match=1
    )
  )
  else if (&wild_head==1)
  (
    if (STRING.MID("gcc_bimc_clk", &clk_itr_length-&clk_input_length+1, &clk_input_length-1)==STRING.CUT("&clk", 1))
    ( 
      &match=1
    )
  )
  else if (&wild_tail==1)
  (
    if (STRING.MID("gcc_bimc_clk", 0, &clk_input_length-1)==STRING.CUT("&clk", -1))
    ( 
      &match=1
    )
  )	  
  else if ("gcc_bimc_clk"=="&clk")||("buses"=="&clk")
  (
    &match=1
  )
  
  if (&match==1)
  (
    &clk_test=&CLK_TEST_GCC_BIMC_CLK
    &clk_reg=&HWIO_GCC_BIMC_CBCR_ADDR
    &clk_reg_name="GCC_BIMC_CBCR"
    &clk_name="gcc_bimc_clk"
    &clk_reg_cbcr_type="sm_cbc"

    gosub Print_Clk_Info_Line
  )

  &match=0
  &wild_head=0
  &wild_tail=0
  &clk_input_length=STRING.LENGTH("&clk")
  &clk_itr_length=STRING.LENGTH("gcc_bimc_ddr_cpll0_clk")

  if (STRING.SCAN("&clk", "*", 0)==0)
  (
    &wild_head=1
  )
  if (STRING.SCAN("&clk", "*", 1)==(STRING.LENGTH("&clk")-1))
  (
    &wild_tail=1
  )

  if ((&wild_head==1)&&(&wild_tail==1))
  (
    if (STRING.SCAN("gcc_bimc_ddr_cpll0_clk", STRING.MID("&clk", 1, &clk_input_length-2), 0)!=-1)
    ( 
      &match=1
    )
  )
  else if (&wild_head==1)
  (
    if (STRING.MID("gcc_bimc_ddr_cpll0_clk", &clk_itr_length-&clk_input_length+1, &clk_input_length-1)==STRING.CUT("&clk", 1))
    ( 
      &match=1
    )
  )
  else if (&wild_tail==1)
  (
    if (STRING.MID("gcc_bimc_ddr_cpll0_clk", 0, &clk_input_length-1)==STRING.CUT("&clk", -1))
    ( 
      &match=1
    )
  )	  
  else if ("gcc_bimc_ddr_cpll0_clk"=="&clk")
  (
    &match=1
  )
  
  if (&match==1)
  (
    &clk_test=&CLK_TEST_GCC_BIMC_DDR_CPLL0_CLK
    &clk_reg=&HWIO_GCC_BIMC_DDR_CPLL0_CBCR_ADDR
    &clk_reg_name="GCC_BIMC_DDR_CPLL0_CBCR"
    &clk_name="gcc_bimc_ddr_cpll0_clk"
    &clk_reg_cbcr_type="sm_cbc"

    gosub Print_Clk_Info_Line
  )

  &match=0
  &wild_head=0
  &wild_tail=0
  &clk_input_length=STRING.LENGTH("&clk")
  &clk_itr_length=STRING.LENGTH("gcc_bimc_ddr_cpll1_clk")

  if (STRING.SCAN("&clk", "*", 0)==0)
  (
    &wild_head=1
  )
  if (STRING.SCAN("&clk", "*", 1)==(STRING.LENGTH("&clk")-1))
  (
    &wild_tail=1
  )

  if ((&wild_head==1)&&(&wild_tail==1))
  (
    if (STRING.SCAN("gcc_bimc_ddr_cpll1_clk", STRING.MID("&clk", 1, &clk_input_length-2), 0)!=-1)
    ( 
      &match=1
    )
  )
  else if (&wild_head==1)
  (
    if (STRING.MID("gcc_bimc_ddr_cpll1_clk", &clk_itr_length-&clk_input_length+1, &clk_input_length-1)==STRING.CUT("&clk", 1))
    ( 
      &match=1
    )
  )
  else if (&wild_tail==1)
  (
    if (STRING.MID("gcc_bimc_ddr_cpll1_clk", 0, &clk_input_length-1)==STRING.CUT("&clk", -1))
    ( 
      &match=1
    )
  )	  
  else if ("gcc_bimc_ddr_cpll1_clk"=="&clk")
  (
    &match=1
  )
  
  if (&match==1)
  (
    &clk_test=&CLK_TEST_GCC_BIMC_DDR_CPLL1_CLK
    &clk_reg=&HWIO_GCC_BIMC_DDR_CPLL1_CBCR_ADDR
    &clk_reg_name="GCC_BIMC_DDR_CPLL1_CBCR"
    &clk_name="gcc_bimc_ddr_cpll1_clk"
    &clk_reg_cbcr_type="sm_cbc"

    gosub Print_Clk_Info_Line
  )

  &match=0
  &wild_head=0
  &wild_tail=0
  &clk_input_length=STRING.LENGTH("&clk")
  &clk_itr_length=STRING.LENGTH("gcc_bimc_xo_clk")

  if (STRING.SCAN("&clk", "*", 0)==0)
  (
    &wild_head=1
  )
  if (STRING.SCAN("&clk", "*", 1)==(STRING.LENGTH("&clk")-1))
  (
    &wild_tail=1
  )

  if ((&wild_head==1)&&(&wild_tail==1))
  (
    if (STRING.SCAN("gcc_bimc_xo_clk", STRING.MID("&clk", 1, &clk_input_length-2), 0)!=-1)
    ( 
      &match=1
    )
  )
  else if (&wild_head==1)
  (
    if (STRING.MID("gcc_bimc_xo_clk", &clk_itr_length-&clk_input_length+1, &clk_input_length-1)==STRING.CUT("&clk", 1))
    ( 
      &match=1
    )
  )
  else if (&wild_tail==1)
  (
    if (STRING.MID("gcc_bimc_xo_clk", 0, &clk_input_length-1)==STRING.CUT("&clk", -1))
    ( 
      &match=1
    )
  )	  
  else if ("gcc_bimc_xo_clk"=="&clk")
  (
    &match=1
  )
  
  if (&match==1)
  (
    &clk_test=&CLK_TEST_GCC_BIMC_XO_CLK
    &clk_reg=&HWIO_GCC_BIMC_XO_CBCR_ADDR
    &clk_reg_name="GCC_BIMC_XO_CBCR"
    &clk_name="gcc_bimc_xo_clk"
    &clk_reg_cbcr_type="sm_cbc"

    gosub Print_Clk_Info_Line
  )

  &match=0
  &wild_head=0
  &wild_tail=0
  &clk_input_length=STRING.LENGTH("&clk")
  &clk_itr_length=STRING.LENGTH("gcc_cfg_noc_ddr_cfg_clk")

  if (STRING.SCAN("&clk", "*", 0)==0)
  (
    &wild_head=1
  )
  if (STRING.SCAN("&clk", "*", 1)==(STRING.LENGTH("&clk")-1))
  (
    &wild_tail=1
  )

  if ((&wild_head==1)&&(&wild_tail==1))
  (
    if (STRING.SCAN("gcc_cfg_noc_ddr_cfg_clk", STRING.MID("&clk", 1, &clk_input_length-2), 0)!=-1)
    ( 
      &match=1
    )
  )
  else if (&wild_head==1)
  (
    if (STRING.MID("gcc_cfg_noc_ddr_cfg_clk", &clk_itr_length-&clk_input_length+1, &clk_input_length-1)==STRING.CUT("&clk", 1))
    ( 
      &match=1
    )
  )
  else if (&wild_tail==1)
  (
    if (STRING.MID("gcc_cfg_noc_ddr_cfg_clk", 0, &clk_input_length-1)==STRING.CUT("&clk", -1))
    ( 
      &match=1
    )
  )	  
  else if ("gcc_cfg_noc_ddr_cfg_clk"=="&clk")
  (
    &match=1
  )
  
  if (&match==1)
  (
    &clk_test=&CLK_TEST_GCC_CFG_NOC_DDR_CFG_CLK
    &clk_reg=&HWIO_GCC_CFG_NOC_DDR_CFG_CBCR_ADDR
    &clk_reg_name="GCC_CFG_NOC_DDR_CFG_CBCR"
    &clk_name="gcc_cfg_noc_ddr_cfg_clk"
    &clk_reg_cbcr_type="sm_cbc"

    gosub Print_Clk_Info_Line
  )

  &match=0
  &wild_head=0
  &wild_tail=0
  &clk_input_length=STRING.LENGTH("&clk")
  &clk_itr_length=STRING.LENGTH("gcc_cnoc_bus_timeout5_ahb_clk")

  if (STRING.SCAN("&clk", "*", 0)==0)
  (
    &wild_head=1
  )
  if (STRING.SCAN("&clk", "*", 1)==(STRING.LENGTH("&clk")-1))
  (
    &wild_tail=1
  )

  if ((&wild_head==1)&&(&wild_tail==1))
  (
    if (STRING.SCAN("gcc_cnoc_bus_timeout5_ahb_clk", STRING.MID("&clk", 1, &clk_input_length-2), 0)!=-1)
    ( 
      &match=1
    )
  )
  else if (&wild_head==1)
  (
    if (STRING.MID("gcc_cnoc_bus_timeout5_ahb_clk", &clk_itr_length-&clk_input_length+1, &clk_input_length-1)==STRING.CUT("&clk", 1))
    ( 
      &match=1
    )
  )
  else if (&wild_tail==1)
  (
    if (STRING.MID("gcc_cnoc_bus_timeout5_ahb_clk", 0, &clk_input_length-1)==STRING.CUT("&clk", -1))
    ( 
      &match=1
    )
  )	  
  else if ("gcc_cnoc_bus_timeout5_ahb_clk"=="&clk")
  (
    &match=1
  )
  
  if (&match==1)
  (
    &clk_test=&CLK_TEST_GCC_CNOC_BUS_TIMEOUT5_AHB_CLK
    &clk_reg=&HWIO_GCC_CNOC_BUS_TIMEOUT5_AHB_CBCR_ADDR
    &clk_reg_name="GCC_CNOC_BUS_TIMEOUT5_AHB_CBCR"
    &clk_name="gcc_cnoc_bus_timeout5_ahb_clk"
    &clk_reg_cbcr_type="sm_cbc"

    gosub Print_Clk_Info_Line
  )

  &match=0
  &wild_head=0
  &wild_tail=0
  &clk_input_length=STRING.LENGTH("&clk")
  &clk_itr_length=STRING.LENGTH("gcc_ddr_dim_cfg_clk")

  if (STRING.SCAN("&clk", "*", 0)==0)
  (
    &wild_head=1
  )
  if (STRING.SCAN("&clk", "*", 1)==(STRING.LENGTH("&clk")-1))
  (
    &wild_tail=1
  )

  if ((&wild_head==1)&&(&wild_tail==1))
  (
    if (STRING.SCAN("gcc_ddr_dim_cfg_clk", STRING.MID("&clk", 1, &clk_input_length-2), 0)!=-1)
    ( 
      &match=1
    )
  )
  else if (&wild_head==1)
  (
    if (STRING.MID("gcc_ddr_dim_cfg_clk", &clk_itr_length-&clk_input_length+1, &clk_input_length-1)==STRING.CUT("&clk", 1))
    ( 
      &match=1
    )
  )
  else if (&wild_tail==1)
  (
    if (STRING.MID("gcc_ddr_dim_cfg_clk", 0, &clk_input_length-1)==STRING.CUT("&clk", -1))
    ( 
      &match=1
    )
  )	  
  else if ("gcc_ddr_dim_cfg_clk"=="&clk")
  (
    &match=1
  )
  
  if (&match==1)
  (
    &clk_test=&CLK_TEST_GCC_DDR_DIM_CFG_CLK
    &clk_reg=&HWIO_GCC_DDR_DIM_CFG_CBCR_ADDR
    &clk_reg_name="GCC_DDR_DIM_CFG_CBCR"
    &clk_name="gcc_ddr_dim_cfg_clk"
    &clk_reg_cbcr_type="sm_cbc"

    gosub Print_Clk_Info_Line
  )

  &match=0
  &wild_head=0
  &wild_tail=0
  &clk_input_length=STRING.LENGTH("&clk")
  &clk_itr_length=STRING.LENGTH("gcc_bimc_kpss_axi_clk")

  if (STRING.SCAN("&clk", "*", 0)==0)
  (
    &wild_head=1
  )
  if (STRING.SCAN("&clk", "*", 1)==(STRING.LENGTH("&clk")-1))
  (
    &wild_tail=1
  )

  if ((&wild_head==1)&&(&wild_tail==1))
  (
    if (STRING.SCAN("gcc_bimc_kpss_axi_clk", STRING.MID("&clk", 1, &clk_input_length-2), 0)!=-1)
    ( 
      &match=1
    )
  )
  else if (&wild_head==1)
  (
    if (STRING.MID("gcc_bimc_kpss_axi_clk", &clk_itr_length-&clk_input_length+1, &clk_input_length-1)==STRING.CUT("&clk", 1))
    ( 
      &match=1
    )
  )
  else if (&wild_tail==1)
  (
    if (STRING.MID("gcc_bimc_kpss_axi_clk", 0, &clk_input_length-1)==STRING.CUT("&clk", -1))
    ( 
      &match=1
    )
  )	  
  else if ("gcc_bimc_kpss_axi_clk"=="&clk")
  (
    &match=1
  )
  
  if (&match==1)
  (
    &clk_test=&CLK_TEST_GCC_BIMC_KPSS_AXI_CLK
    &clk_reg=&HWIO_GCC_BIMC_KPSS_AXI_CBCR_ADDR
    &clk_reg_name="GCC_BIMC_KPSS_AXI_CBCR"
    &clk_name="gcc_bimc_kpss_axi_clk"
    &clk_reg_cbcr_type="sm_cbc"

    gosub Print_Clk_Info_Line
  )

  &match=0
  &wild_head=0
  &wild_tail=0
  &clk_input_length=STRING.LENGTH("&clk")
  &clk_itr_length=STRING.LENGTH("gcc_kpss_axi_clk")

  if (STRING.SCAN("&clk", "*", 0)==0)
  (
    &wild_head=1
  )
  if (STRING.SCAN("&clk", "*", 1)==(STRING.LENGTH("&clk")-1))
  (
    &wild_tail=1
  )

  if ((&wild_head==1)&&(&wild_tail==1))
  (
    if (STRING.SCAN("gcc_kpss_axi_clk", STRING.MID("&clk", 1, &clk_input_length-2), 0)!=-1)
    ( 
      &match=1
    )
  )
  else if (&wild_head==1)
  (
    if (STRING.MID("gcc_kpss_axi_clk", &clk_itr_length-&clk_input_length+1, &clk_input_length-1)==STRING.CUT("&clk", 1))
    ( 
      &match=1
    )
  )
  else if (&wild_tail==1)
  (
    if (STRING.MID("gcc_kpss_axi_clk", 0, &clk_input_length-1)==STRING.CUT("&clk", -1))
    ( 
      &match=1
    )
  )	  
  else if ("gcc_kpss_axi_clk"=="&clk")
  (
    &match=1
  )
  
  if (&match==1)
  (
    &clk_test=&CLK_TEST_GCC_KPSS_AXI_CLK
    &clk_reg=&HWIO_GCC_KPSS_AXI_CBCR_ADDR
    &clk_reg_name="GCC_KPSS_AXI_CBCR"
    &clk_name="gcc_kpss_axi_clk"
    &clk_reg_cbcr_type="sm_cbc"

    gosub Print_Clk_Info_Line
  )

  &match=0
  &wild_head=0
  &wild_tail=0
  &clk_input_length=STRING.LENGTH("&clk")
  &clk_itr_length=STRING.LENGTH("gcc_bimc_kpss_cci_axi_clk")

  if (STRING.SCAN("&clk", "*", 0)==0)
  (
    &wild_head=1
  )
  if (STRING.SCAN("&clk", "*", 1)==(STRING.LENGTH("&clk")-1))
  (
    &wild_tail=1
  )

  if ((&wild_head==1)&&(&wild_tail==1))
  (
    if (STRING.SCAN("gcc_bimc_kpss_cci_axi_clk", STRING.MID("&clk", 1, &clk_input_length-2), 0)!=-1)
    ( 
      &match=1
    )
  )
  else if (&wild_head==1)
  (
    if (STRING.MID("gcc_bimc_kpss_cci_axi_clk", &clk_itr_length-&clk_input_length+1, &clk_input_length-1)==STRING.CUT("&clk", 1))
    ( 
      &match=1
    )
  )
  else if (&wild_tail==1)
  (
    if (STRING.MID("gcc_bimc_kpss_cci_axi_clk", 0, &clk_input_length-1)==STRING.CUT("&clk", -1))
    ( 
      &match=1
    )
  )	  
  else if ("gcc_bimc_kpss_cci_axi_clk"=="&clk")
  (
    &match=1
  )
  
  if (&match==1)
  (
    &clk_test=&CLK_TEST_GCC_BIMC_KPSS_CCI_AXI_CLK
    &clk_reg=0
    &clk_reg_name="No CBCR"
    &clk_name="gcc_bimc_kpss_cci_axi_clk"
    &clk_reg_cbcr_type=""

    gosub Print_Clk_Info_Line
  )

  &match=0
  &wild_head=0
  &wild_tail=0
  &clk_input_length=STRING.LENGTH("&clk")
  &clk_itr_length=STRING.LENGTH("gcc_kpss_cci_axi_clk")

  if (STRING.SCAN("&clk", "*", 0)==0)
  (
    &wild_head=1
  )
  if (STRING.SCAN("&clk", "*", 1)==(STRING.LENGTH("&clk")-1))
  (
    &wild_tail=1
  )

  if ((&wild_head==1)&&(&wild_tail==1))
  (
    if (STRING.SCAN("gcc_kpss_cci_axi_clk", STRING.MID("&clk", 1, &clk_input_length-2), 0)!=-1)
    ( 
      &match=1
    )
  )
  else if (&wild_head==1)
  (
    if (STRING.MID("gcc_kpss_cci_axi_clk", &clk_itr_length-&clk_input_length+1, &clk_input_length-1)==STRING.CUT("&clk", 1))
    ( 
      &match=1
    )
  )
  else if (&wild_tail==1)
  (
    if (STRING.MID("gcc_kpss_cci_axi_clk", 0, &clk_input_length-1)==STRING.CUT("&clk", -1))
    ( 
      &match=1
    )
  )	  
  else if ("gcc_kpss_cci_axi_clk"=="&clk")
  (
    &match=1
  )
  
  if (&match==1)
  (
    &clk_test=&CLK_TEST_GCC_KPSS_CCI_AXI_CLK
    &clk_reg=0
    &clk_reg_name="No CBCR"
    &clk_name="gcc_kpss_cci_axi_clk"
    &clk_reg_cbcr_type=""

    gosub Print_Clk_Info_Line
  )

  &match=0
  &wild_head=0
  &wild_tail=0
  &clk_input_length=STRING.LENGTH("&clk")
  &clk_itr_length=STRING.LENGTH("gcc_blsp1_qup1_i2c_apps_clk")

  if (STRING.SCAN("&clk", "*", 0)==0)
  (
    &wild_head=1
  )
  if (STRING.SCAN("&clk", "*", 1)==(STRING.LENGTH("&clk")-1))
  (
    &wild_tail=1
  )

  if ((&wild_head==1)&&(&wild_tail==1))
  (
    if (STRING.SCAN("gcc_blsp1_qup1_i2c_apps_clk", STRING.MID("&clk", 1, &clk_input_length-2), 0)!=-1)
    ( 
      &match=1
    )
  )
  else if (&wild_head==1)
  (
    if (STRING.MID("gcc_blsp1_qup1_i2c_apps_clk", &clk_itr_length-&clk_input_length+1, &clk_input_length-1)==STRING.CUT("&clk", 1))
    ( 
      &match=1
    )
  )
  else if (&wild_tail==1)
  (
    if (STRING.MID("gcc_blsp1_qup1_i2c_apps_clk", 0, &clk_input_length-1)==STRING.CUT("&clk", -1))
    ( 
      &match=1
    )
  )	  
  else if ("gcc_blsp1_qup1_i2c_apps_clk"=="&clk")
  (
    &match=1
  )
  
  if (&match==1)
  (
    &clk_test=&CLK_TEST_GCC_BLSP1_QUP1_I2C_APPS_CLK
    &clk_reg=&HWIO_GCC_BLSP1_QUP1_I2C_APPS_CBCR_ADDR
    &clk_reg_name="GCC_BLSP1_QUP1_I2C_APPS_CBCR"
    &clk_name="gcc_blsp1_qup1_i2c_apps_clk"
    &clk_reg_cbcr_type="sm_cbc"

    gosub Print_Clk_Info_Line
  )

  &match=0
  &wild_head=0
  &wild_tail=0
  &clk_input_length=STRING.LENGTH("&clk")
  &clk_itr_length=STRING.LENGTH("gcc_blsp1_qup1_spi_apps_clk")

  if (STRING.SCAN("&clk", "*", 0)==0)
  (
    &wild_head=1
  )
  if (STRING.SCAN("&clk", "*", 1)==(STRING.LENGTH("&clk")-1))
  (
    &wild_tail=1
  )

  if ((&wild_head==1)&&(&wild_tail==1))
  (
    if (STRING.SCAN("gcc_blsp1_qup1_spi_apps_clk", STRING.MID("&clk", 1, &clk_input_length-2), 0)!=-1)
    ( 
      &match=1
    )
  )
  else if (&wild_head==1)
  (
    if (STRING.MID("gcc_blsp1_qup1_spi_apps_clk", &clk_itr_length-&clk_input_length+1, &clk_input_length-1)==STRING.CUT("&clk", 1))
    ( 
      &match=1
    )
  )
  else if (&wild_tail==1)
  (
    if (STRING.MID("gcc_blsp1_qup1_spi_apps_clk", 0, &clk_input_length-1)==STRING.CUT("&clk", -1))
    ( 
      &match=1
    )
  )	  
  else if ("gcc_blsp1_qup1_spi_apps_clk"=="&clk")
  (
    &match=1
  )
  
  if (&match==1)
  (
    &clk_test=&CLK_TEST_GCC_BLSP1_QUP1_SPI_APPS_CLK
    &clk_reg=&HWIO_GCC_BLSP1_QUP1_SPI_APPS_CBCR_ADDR
    &clk_reg_name="GCC_BLSP1_QUP1_SPI_APPS_CBCR"
    &clk_name="gcc_blsp1_qup1_spi_apps_clk"
    &clk_reg_cbcr_type="sm_cbc"

    gosub Print_Clk_Info_Line
  )

  &match=0
  &wild_head=0
  &wild_tail=0
  &clk_input_length=STRING.LENGTH("&clk")
  &clk_itr_length=STRING.LENGTH("gcc_blsp1_qup2_i2c_apps_clk")

  if (STRING.SCAN("&clk", "*", 0)==0)
  (
    &wild_head=1
  )
  if (STRING.SCAN("&clk", "*", 1)==(STRING.LENGTH("&clk")-1))
  (
    &wild_tail=1
  )

  if ((&wild_head==1)&&(&wild_tail==1))
  (
    if (STRING.SCAN("gcc_blsp1_qup2_i2c_apps_clk", STRING.MID("&clk", 1, &clk_input_length-2), 0)!=-1)
    ( 
      &match=1
    )
  )
  else if (&wild_head==1)
  (
    if (STRING.MID("gcc_blsp1_qup2_i2c_apps_clk", &clk_itr_length-&clk_input_length+1, &clk_input_length-1)==STRING.CUT("&clk", 1))
    ( 
      &match=1
    )
  )
  else if (&wild_tail==1)
  (
    if (STRING.MID("gcc_blsp1_qup2_i2c_apps_clk", 0, &clk_input_length-1)==STRING.CUT("&clk", -1))
    ( 
      &match=1
    )
  )	  
  else if ("gcc_blsp1_qup2_i2c_apps_clk"=="&clk")
  (
    &match=1
  )
  
  if (&match==1)
  (
    &clk_test=&CLK_TEST_GCC_BLSP1_QUP2_I2C_APPS_CLK
    &clk_reg=&HWIO_GCC_BLSP1_QUP2_I2C_APPS_CBCR_ADDR
    &clk_reg_name="GCC_BLSP1_QUP2_I2C_APPS_CBCR"
    &clk_name="gcc_blsp1_qup2_i2c_apps_clk"
    &clk_reg_cbcr_type="sm_cbc"

    gosub Print_Clk_Info_Line
  )

  &match=0
  &wild_head=0
  &wild_tail=0
  &clk_input_length=STRING.LENGTH("&clk")
  &clk_itr_length=STRING.LENGTH("gcc_blsp1_qup2_spi_apps_clk")

  if (STRING.SCAN("&clk", "*", 0)==0)
  (
    &wild_head=1
  )
  if (STRING.SCAN("&clk", "*", 1)==(STRING.LENGTH("&clk")-1))
  (
    &wild_tail=1
  )

  if ((&wild_head==1)&&(&wild_tail==1))
  (
    if (STRING.SCAN("gcc_blsp1_qup2_spi_apps_clk", STRING.MID("&clk", 1, &clk_input_length-2), 0)!=-1)
    ( 
      &match=1
    )
  )
  else if (&wild_head==1)
  (
    if (STRING.MID("gcc_blsp1_qup2_spi_apps_clk", &clk_itr_length-&clk_input_length+1, &clk_input_length-1)==STRING.CUT("&clk", 1))
    ( 
      &match=1
    )
  )
  else if (&wild_tail==1)
  (
    if (STRING.MID("gcc_blsp1_qup2_spi_apps_clk", 0, &clk_input_length-1)==STRING.CUT("&clk", -1))
    ( 
      &match=1
    )
  )	  
  else if ("gcc_blsp1_qup2_spi_apps_clk"=="&clk")
  (
    &match=1
  )
  
  if (&match==1)
  (
    &clk_test=&CLK_TEST_GCC_BLSP1_QUP2_SPI_APPS_CLK
    &clk_reg=&HWIO_GCC_BLSP1_QUP2_SPI_APPS_CBCR_ADDR
    &clk_reg_name="GCC_BLSP1_QUP2_SPI_APPS_CBCR"
    &clk_name="gcc_blsp1_qup2_spi_apps_clk"
    &clk_reg_cbcr_type="sm_cbc"

    gosub Print_Clk_Info_Line
  )

  &match=0
  &wild_head=0
  &wild_tail=0
  &clk_input_length=STRING.LENGTH("&clk")
  &clk_itr_length=STRING.LENGTH("gcc_blsp1_qup3_i2c_apps_clk")

  if (STRING.SCAN("&clk", "*", 0)==0)
  (
    &wild_head=1
  )
  if (STRING.SCAN("&clk", "*", 1)==(STRING.LENGTH("&clk")-1))
  (
    &wild_tail=1
  )

  if ((&wild_head==1)&&(&wild_tail==1))
  (
    if (STRING.SCAN("gcc_blsp1_qup3_i2c_apps_clk", STRING.MID("&clk", 1, &clk_input_length-2), 0)!=-1)
    ( 
      &match=1
    )
  )
  else if (&wild_head==1)
  (
    if (STRING.MID("gcc_blsp1_qup3_i2c_apps_clk", &clk_itr_length-&clk_input_length+1, &clk_input_length-1)==STRING.CUT("&clk", 1))
    ( 
      &match=1
    )
  )
  else if (&wild_tail==1)
  (
    if (STRING.MID("gcc_blsp1_qup3_i2c_apps_clk", 0, &clk_input_length-1)==STRING.CUT("&clk", -1))
    ( 
      &match=1
    )
  )	  
  else if ("gcc_blsp1_qup3_i2c_apps_clk"=="&clk")
  (
    &match=1
  )
  
  if (&match==1)
  (
    &clk_test=&CLK_TEST_GCC_BLSP1_QUP3_I2C_APPS_CLK
    &clk_reg=&HWIO_GCC_BLSP1_QUP3_I2C_APPS_CBCR_ADDR
    &clk_reg_name="GCC_BLSP1_QUP3_I2C_APPS_CBCR"
    &clk_name="gcc_blsp1_qup3_i2c_apps_clk"
    &clk_reg_cbcr_type="sm_cbc"

    gosub Print_Clk_Info_Line
  )

  &match=0
  &wild_head=0
  &wild_tail=0
  &clk_input_length=STRING.LENGTH("&clk")
  &clk_itr_length=STRING.LENGTH("gcc_blsp1_qup3_spi_apps_clk")

  if (STRING.SCAN("&clk", "*", 0)==0)
  (
    &wild_head=1
  )
  if (STRING.SCAN("&clk", "*", 1)==(STRING.LENGTH("&clk")-1))
  (
    &wild_tail=1
  )

  if ((&wild_head==1)&&(&wild_tail==1))
  (
    if (STRING.SCAN("gcc_blsp1_qup3_spi_apps_clk", STRING.MID("&clk", 1, &clk_input_length-2), 0)!=-1)
    ( 
      &match=1
    )
  )
  else if (&wild_head==1)
  (
    if (STRING.MID("gcc_blsp1_qup3_spi_apps_clk", &clk_itr_length-&clk_input_length+1, &clk_input_length-1)==STRING.CUT("&clk", 1))
    ( 
      &match=1
    )
  )
  else if (&wild_tail==1)
  (
    if (STRING.MID("gcc_blsp1_qup3_spi_apps_clk", 0, &clk_input_length-1)==STRING.CUT("&clk", -1))
    ( 
      &match=1
    )
  )	  
  else if ("gcc_blsp1_qup3_spi_apps_clk"=="&clk")
  (
    &match=1
  )
  
  if (&match==1)
  (
    &clk_test=&CLK_TEST_GCC_BLSP1_QUP3_SPI_APPS_CLK
    &clk_reg=&HWIO_GCC_BLSP1_QUP3_SPI_APPS_CBCR_ADDR
    &clk_reg_name="GCC_BLSP1_QUP3_SPI_APPS_CBCR"
    &clk_name="gcc_blsp1_qup3_spi_apps_clk"
    &clk_reg_cbcr_type="sm_cbc"

    gosub Print_Clk_Info_Line
  )

  &match=0
  &wild_head=0
  &wild_tail=0
  &clk_input_length=STRING.LENGTH("&clk")
  &clk_itr_length=STRING.LENGTH("gcc_blsp1_qup4_i2c_apps_clk")

  if (STRING.SCAN("&clk", "*", 0)==0)
  (
    &wild_head=1
  )
  if (STRING.SCAN("&clk", "*", 1)==(STRING.LENGTH("&clk")-1))
  (
    &wild_tail=1
  )

  if ((&wild_head==1)&&(&wild_tail==1))
  (
    if (STRING.SCAN("gcc_blsp1_qup4_i2c_apps_clk", STRING.MID("&clk", 1, &clk_input_length-2), 0)!=-1)
    ( 
      &match=1
    )
  )
  else if (&wild_head==1)
  (
    if (STRING.MID("gcc_blsp1_qup4_i2c_apps_clk", &clk_itr_length-&clk_input_length+1, &clk_input_length-1)==STRING.CUT("&clk", 1))
    ( 
      &match=1
    )
  )
  else if (&wild_tail==1)
  (
    if (STRING.MID("gcc_blsp1_qup4_i2c_apps_clk", 0, &clk_input_length-1)==STRING.CUT("&clk", -1))
    ( 
      &match=1
    )
  )	  
  else if ("gcc_blsp1_qup4_i2c_apps_clk"=="&clk")
  (
    &match=1
  )
  
  if (&match==1)
  (
    &clk_test=&CLK_TEST_GCC_BLSP1_QUP4_I2C_APPS_CLK
    &clk_reg=&HWIO_GCC_BLSP1_QUP4_I2C_APPS_CBCR_ADDR
    &clk_reg_name="GCC_BLSP1_QUP4_I2C_APPS_CBCR"
    &clk_name="gcc_blsp1_qup4_i2c_apps_clk"
    &clk_reg_cbcr_type="sm_cbc"

    gosub Print_Clk_Info_Line
  )

  &match=0
  &wild_head=0
  &wild_tail=0
  &clk_input_length=STRING.LENGTH("&clk")
  &clk_itr_length=STRING.LENGTH("gcc_blsp1_qup4_spi_apps_clk")

  if (STRING.SCAN("&clk", "*", 0)==0)
  (
    &wild_head=1
  )
  if (STRING.SCAN("&clk", "*", 1)==(STRING.LENGTH("&clk")-1))
  (
    &wild_tail=1
  )

  if ((&wild_head==1)&&(&wild_tail==1))
  (
    if (STRING.SCAN("gcc_blsp1_qup4_spi_apps_clk", STRING.MID("&clk", 1, &clk_input_length-2), 0)!=-1)
    ( 
      &match=1
    )
  )
  else if (&wild_head==1)
  (
    if (STRING.MID("gcc_blsp1_qup4_spi_apps_clk", &clk_itr_length-&clk_input_length+1, &clk_input_length-1)==STRING.CUT("&clk", 1))
    ( 
      &match=1
    )
  )
  else if (&wild_tail==1)
  (
    if (STRING.MID("gcc_blsp1_qup4_spi_apps_clk", 0, &clk_input_length-1)==STRING.CUT("&clk", -1))
    ( 
      &match=1
    )
  )	  
  else if ("gcc_blsp1_qup4_spi_apps_clk"=="&clk")
  (
    &match=1
  )
  
  if (&match==1)
  (
    &clk_test=&CLK_TEST_GCC_BLSP1_QUP4_SPI_APPS_CLK
    &clk_reg=&HWIO_GCC_BLSP1_QUP4_SPI_APPS_CBCR_ADDR
    &clk_reg_name="GCC_BLSP1_QUP4_SPI_APPS_CBCR"
    &clk_name="gcc_blsp1_qup4_spi_apps_clk"
    &clk_reg_cbcr_type="sm_cbc"

    gosub Print_Clk_Info_Line
  )

  &match=0
  &wild_head=0
  &wild_tail=0
  &clk_input_length=STRING.LENGTH("&clk")
  &clk_itr_length=STRING.LENGTH("gcc_blsp1_qup5_i2c_apps_clk")

  if (STRING.SCAN("&clk", "*", 0)==0)
  (
    &wild_head=1
  )
  if (STRING.SCAN("&clk", "*", 1)==(STRING.LENGTH("&clk")-1))
  (
    &wild_tail=1
  )

  if ((&wild_head==1)&&(&wild_tail==1))
  (
    if (STRING.SCAN("gcc_blsp1_qup5_i2c_apps_clk", STRING.MID("&clk", 1, &clk_input_length-2), 0)!=-1)
    ( 
      &match=1
    )
  )
  else if (&wild_head==1)
  (
    if (STRING.MID("gcc_blsp1_qup5_i2c_apps_clk", &clk_itr_length-&clk_input_length+1, &clk_input_length-1)==STRING.CUT("&clk", 1))
    ( 
      &match=1
    )
  )
  else if (&wild_tail==1)
  (
    if (STRING.MID("gcc_blsp1_qup5_i2c_apps_clk", 0, &clk_input_length-1)==STRING.CUT("&clk", -1))
    ( 
      &match=1
    )
  )	  
  else if ("gcc_blsp1_qup5_i2c_apps_clk"=="&clk")
  (
    &match=1
  )
  
  if (&match==1)
  (
    &clk_test=&CLK_TEST_GCC_BLSP1_QUP5_I2C_APPS_CLK
    &clk_reg=&HWIO_GCC_BLSP1_QUP5_I2C_APPS_CBCR_ADDR
    &clk_reg_name="GCC_BLSP1_QUP5_I2C_APPS_CBCR"
    &clk_name="gcc_blsp1_qup5_i2c_apps_clk"
    &clk_reg_cbcr_type="sm_cbc"

    gosub Print_Clk_Info_Line
  )

  &match=0
  &wild_head=0
  &wild_tail=0
  &clk_input_length=STRING.LENGTH("&clk")
  &clk_itr_length=STRING.LENGTH("gcc_blsp1_qup5_spi_apps_clk")

  if (STRING.SCAN("&clk", "*", 0)==0)
  (
    &wild_head=1
  )
  if (STRING.SCAN("&clk", "*", 1)==(STRING.LENGTH("&clk")-1))
  (
    &wild_tail=1
  )

  if ((&wild_head==1)&&(&wild_tail==1))
  (
    if (STRING.SCAN("gcc_blsp1_qup5_spi_apps_clk", STRING.MID("&clk", 1, &clk_input_length-2), 0)!=-1)
    ( 
      &match=1
    )
  )
  else if (&wild_head==1)
  (
    if (STRING.MID("gcc_blsp1_qup5_spi_apps_clk", &clk_itr_length-&clk_input_length+1, &clk_input_length-1)==STRING.CUT("&clk", 1))
    ( 
      &match=1
    )
  )
  else if (&wild_tail==1)
  (
    if (STRING.MID("gcc_blsp1_qup5_spi_apps_clk", 0, &clk_input_length-1)==STRING.CUT("&clk", -1))
    ( 
      &match=1
    )
  )	  
  else if ("gcc_blsp1_qup5_spi_apps_clk"=="&clk")
  (
    &match=1
  )
  
  if (&match==1)
  (
    &clk_test=&CLK_TEST_GCC_BLSP1_QUP5_SPI_APPS_CLK
    &clk_reg=&HWIO_GCC_BLSP1_QUP5_SPI_APPS_CBCR_ADDR
    &clk_reg_name="GCC_BLSP1_QUP5_SPI_APPS_CBCR"
    &clk_name="gcc_blsp1_qup5_spi_apps_clk"
    &clk_reg_cbcr_type="sm_cbc"

    gosub Print_Clk_Info_Line
  )

  &match=0
  &wild_head=0
  &wild_tail=0
  &clk_input_length=STRING.LENGTH("&clk")
  &clk_itr_length=STRING.LENGTH("gcc_blsp1_qup6_i2c_apps_clk")

  if (STRING.SCAN("&clk", "*", 0)==0)
  (
    &wild_head=1
  )
  if (STRING.SCAN("&clk", "*", 1)==(STRING.LENGTH("&clk")-1))
  (
    &wild_tail=1
  )

  if ((&wild_head==1)&&(&wild_tail==1))
  (
    if (STRING.SCAN("gcc_blsp1_qup6_i2c_apps_clk", STRING.MID("&clk", 1, &clk_input_length-2), 0)!=-1)
    ( 
      &match=1
    )
  )
  else if (&wild_head==1)
  (
    if (STRING.MID("gcc_blsp1_qup6_i2c_apps_clk", &clk_itr_length-&clk_input_length+1, &clk_input_length-1)==STRING.CUT("&clk", 1))
    ( 
      &match=1
    )
  )
  else if (&wild_tail==1)
  (
    if (STRING.MID("gcc_blsp1_qup6_i2c_apps_clk", 0, &clk_input_length-1)==STRING.CUT("&clk", -1))
    ( 
      &match=1
    )
  )	  
  else if ("gcc_blsp1_qup6_i2c_apps_clk"=="&clk")
  (
    &match=1
  )
  
  if (&match==1)
  (
    &clk_test=&CLK_TEST_GCC_BLSP1_QUP6_I2C_APPS_CLK
    &clk_reg=&HWIO_GCC_BLSP1_QUP6_I2C_APPS_CBCR_ADDR
    &clk_reg_name="GCC_BLSP1_QUP6_I2C_APPS_CBCR"
    &clk_name="gcc_blsp1_qup6_i2c_apps_clk"
    &clk_reg_cbcr_type="sm_cbc"

    gosub Print_Clk_Info_Line
  )

  &match=0
  &wild_head=0
  &wild_tail=0
  &clk_input_length=STRING.LENGTH("&clk")
  &clk_itr_length=STRING.LENGTH("gcc_blsp1_qup6_spi_apps_clk")

  if (STRING.SCAN("&clk", "*", 0)==0)
  (
    &wild_head=1
  )
  if (STRING.SCAN("&clk", "*", 1)==(STRING.LENGTH("&clk")-1))
  (
    &wild_tail=1
  )

  if ((&wild_head==1)&&(&wild_tail==1))
  (
    if (STRING.SCAN("gcc_blsp1_qup6_spi_apps_clk", STRING.MID("&clk", 1, &clk_input_length-2), 0)!=-1)
    ( 
      &match=1
    )
  )
  else if (&wild_head==1)
  (
    if (STRING.MID("gcc_blsp1_qup6_spi_apps_clk", &clk_itr_length-&clk_input_length+1, &clk_input_length-1)==STRING.CUT("&clk", 1))
    ( 
      &match=1
    )
  )
  else if (&wild_tail==1)
  (
    if (STRING.MID("gcc_blsp1_qup6_spi_apps_clk", 0, &clk_input_length-1)==STRING.CUT("&clk", -1))
    ( 
      &match=1
    )
  )	  
  else if ("gcc_blsp1_qup6_spi_apps_clk"=="&clk")
  (
    &match=1
  )
  
  if (&match==1)
  (
    &clk_test=&CLK_TEST_GCC_BLSP1_QUP6_SPI_APPS_CLK
    &clk_reg=&HWIO_GCC_BLSP1_QUP6_SPI_APPS_CBCR_ADDR
    &clk_reg_name="GCC_BLSP1_QUP6_SPI_APPS_CBCR"
    &clk_name="gcc_blsp1_qup6_spi_apps_clk"
    &clk_reg_cbcr_type="sm_cbc"

    gosub Print_Clk_Info_Line
  )

  &match=0
  &wild_head=0
  &wild_tail=0
  &clk_input_length=STRING.LENGTH("&clk")
  &clk_itr_length=STRING.LENGTH("gcc_blsp1_uart1_apps_clk")

  if (STRING.SCAN("&clk", "*", 0)==0)
  (
    &wild_head=1
  )
  if (STRING.SCAN("&clk", "*", 1)==(STRING.LENGTH("&clk")-1))
  (
    &wild_tail=1
  )

  if ((&wild_head==1)&&(&wild_tail==1))
  (
    if (STRING.SCAN("gcc_blsp1_uart1_apps_clk", STRING.MID("&clk", 1, &clk_input_length-2), 0)!=-1)
    ( 
      &match=1
    )
  )
  else if (&wild_head==1)
  (
    if (STRING.MID("gcc_blsp1_uart1_apps_clk", &clk_itr_length-&clk_input_length+1, &clk_input_length-1)==STRING.CUT("&clk", 1))
    ( 
      &match=1
    )
  )
  else if (&wild_tail==1)
  (
    if (STRING.MID("gcc_blsp1_uart1_apps_clk", 0, &clk_input_length-1)==STRING.CUT("&clk", -1))
    ( 
      &match=1
    )
  )	  
  else if ("gcc_blsp1_uart1_apps_clk"=="&clk")
  (
    &match=1
  )
  
  if (&match==1)
  (
    &clk_test=&CLK_TEST_GCC_BLSP1_UART1_APPS_CLK
    &clk_reg=&HWIO_GCC_BLSP1_UART1_APPS_CBCR_ADDR
    &clk_reg_name="GCC_BLSP1_UART1_APPS_CBCR"
    &clk_name="gcc_blsp1_uart1_apps_clk"
    &clk_reg_cbcr_type="sm_cbc"

    gosub Print_Clk_Info_Line
  )

  &match=0
  &wild_head=0
  &wild_tail=0
  &clk_input_length=STRING.LENGTH("&clk")
  &clk_itr_length=STRING.LENGTH("gcc_blsp1_uart2_apps_clk")

  if (STRING.SCAN("&clk", "*", 0)==0)
  (
    &wild_head=1
  )
  if (STRING.SCAN("&clk", "*", 1)==(STRING.LENGTH("&clk")-1))
  (
    &wild_tail=1
  )

  if ((&wild_head==1)&&(&wild_tail==1))
  (
    if (STRING.SCAN("gcc_blsp1_uart2_apps_clk", STRING.MID("&clk", 1, &clk_input_length-2), 0)!=-1)
    ( 
      &match=1
    )
  )
  else if (&wild_head==1)
  (
    if (STRING.MID("gcc_blsp1_uart2_apps_clk", &clk_itr_length-&clk_input_length+1, &clk_input_length-1)==STRING.CUT("&clk", 1))
    ( 
      &match=1
    )
  )
  else if (&wild_tail==1)
  (
    if (STRING.MID("gcc_blsp1_uart2_apps_clk", 0, &clk_input_length-1)==STRING.CUT("&clk", -1))
    ( 
      &match=1
    )
  )	  
  else if ("gcc_blsp1_uart2_apps_clk"=="&clk")
  (
    &match=1
  )
  
  if (&match==1)
  (
    &clk_test=&CLK_TEST_GCC_BLSP1_UART2_APPS_CLK
    &clk_reg=&HWIO_GCC_BLSP1_UART2_APPS_CBCR_ADDR
    &clk_reg_name="GCC_BLSP1_UART2_APPS_CBCR"
    &clk_name="gcc_blsp1_uart2_apps_clk"
    &clk_reg_cbcr_type="sm_cbc"

    gosub Print_Clk_Info_Line
  )

  &match=0
  &wild_head=0
  &wild_tail=0
  &clk_input_length=STRING.LENGTH("&clk")
  &clk_itr_length=STRING.LENGTH("gcc_blsp1_uart3_apps_clk")

  if (STRING.SCAN("&clk", "*", 0)==0)
  (
    &wild_head=1
  )
  if (STRING.SCAN("&clk", "*", 1)==(STRING.LENGTH("&clk")-1))
  (
    &wild_tail=1
  )

  if ((&wild_head==1)&&(&wild_tail==1))
  (
    if (STRING.SCAN("gcc_blsp1_uart3_apps_clk", STRING.MID("&clk", 1, &clk_input_length-2), 0)!=-1)
    ( 
      &match=1
    )
  )
  else if (&wild_head==1)
  (
    if (STRING.MID("gcc_blsp1_uart3_apps_clk", &clk_itr_length-&clk_input_length+1, &clk_input_length-1)==STRING.CUT("&clk", 1))
    ( 
      &match=1
    )
  )
  else if (&wild_tail==1)
  (
    if (STRING.MID("gcc_blsp1_uart3_apps_clk", 0, &clk_input_length-1)==STRING.CUT("&clk", -1))
    ( 
      &match=1
    )
  )	  
  else if ("gcc_blsp1_uart3_apps_clk"=="&clk")
  (
    &match=1
  )
  
  if (&match==1)
  (
    &clk_test=&CLK_TEST_GCC_BLSP1_UART3_APPS_CLK
    &clk_reg=&HWIO_GCC_BLSP1_UART3_APPS_CBCR_ADDR
    &clk_reg_name="GCC_BLSP1_UART3_APPS_CBCR"
    &clk_name="gcc_blsp1_uart3_apps_clk"
    &clk_reg_cbcr_type="sm_cbc"

    gosub Print_Clk_Info_Line
  )

  &match=0
  &wild_head=0
  &wild_tail=0
  &clk_input_length=STRING.LENGTH("&clk")
  &clk_itr_length=STRING.LENGTH("gcc_blsp1_uart4_apps_clk")

  if (STRING.SCAN("&clk", "*", 0)==0)
  (
    &wild_head=1
  )
  if (STRING.SCAN("&clk", "*", 1)==(STRING.LENGTH("&clk")-1))
  (
    &wild_tail=1
  )

  if ((&wild_head==1)&&(&wild_tail==1))
  (
    if (STRING.SCAN("gcc_blsp1_uart4_apps_clk", STRING.MID("&clk", 1, &clk_input_length-2), 0)!=-1)
    ( 
      &match=1
    )
  )
  else if (&wild_head==1)
  (
    if (STRING.MID("gcc_blsp1_uart4_apps_clk", &clk_itr_length-&clk_input_length+1, &clk_input_length-1)==STRING.CUT("&clk", 1))
    ( 
      &match=1
    )
  )
  else if (&wild_tail==1)
  (
    if (STRING.MID("gcc_blsp1_uart4_apps_clk", 0, &clk_input_length-1)==STRING.CUT("&clk", -1))
    ( 
      &match=1
    )
  )	  
  else if ("gcc_blsp1_uart4_apps_clk"=="&clk")
  (
    &match=1
  )
  
  if (&match==1)
  (
    &clk_test=&CLK_TEST_GCC_BLSP1_UART4_APPS_CLK
    &clk_reg=&HWIO_GCC_BLSP1_UART4_APPS_CBCR_ADDR
    &clk_reg_name="GCC_BLSP1_UART4_APPS_CBCR"
    &clk_name="gcc_blsp1_uart4_apps_clk"
    &clk_reg_cbcr_type="sm_cbc"

    gosub Print_Clk_Info_Line
  )

  &match=0
  &wild_head=0
  &wild_tail=0
  &clk_input_length=STRING.LENGTH("&clk")
  &clk_itr_length=STRING.LENGTH("gcc_blsp1_uart5_apps_clk")

  if (STRING.SCAN("&clk", "*", 0)==0)
  (
    &wild_head=1
  )
  if (STRING.SCAN("&clk", "*", 1)==(STRING.LENGTH("&clk")-1))
  (
    &wild_tail=1
  )

  if ((&wild_head==1)&&(&wild_tail==1))
  (
    if (STRING.SCAN("gcc_blsp1_uart5_apps_clk", STRING.MID("&clk", 1, &clk_input_length-2), 0)!=-1)
    ( 
      &match=1
    )
  )
  else if (&wild_head==1)
  (
    if (STRING.MID("gcc_blsp1_uart5_apps_clk", &clk_itr_length-&clk_input_length+1, &clk_input_length-1)==STRING.CUT("&clk", 1))
    ( 
      &match=1
    )
  )
  else if (&wild_tail==1)
  (
    if (STRING.MID("gcc_blsp1_uart5_apps_clk", 0, &clk_input_length-1)==STRING.CUT("&clk", -1))
    ( 
      &match=1
    )
  )	  
  else if ("gcc_blsp1_uart5_apps_clk"=="&clk")
  (
    &match=1
  )
  
  if (&match==1)
  (
    &clk_test=&CLK_TEST_GCC_BLSP1_UART5_APPS_CLK
    &clk_reg=&HWIO_GCC_BLSP1_UART5_APPS_CBCR_ADDR
    &clk_reg_name="GCC_BLSP1_UART5_APPS_CBCR"
    &clk_name="gcc_blsp1_uart5_apps_clk"
    &clk_reg_cbcr_type="sm_cbc"

    gosub Print_Clk_Info_Line
  )

  &match=0
  &wild_head=0
  &wild_tail=0
  &clk_input_length=STRING.LENGTH("&clk")
  &clk_itr_length=STRING.LENGTH("gcc_blsp1_uart6_apps_clk")

  if (STRING.SCAN("&clk", "*", 0)==0)
  (
    &wild_head=1
  )
  if (STRING.SCAN("&clk", "*", 1)==(STRING.LENGTH("&clk")-1))
  (
    &wild_tail=1
  )

  if ((&wild_head==1)&&(&wild_tail==1))
  (
    if (STRING.SCAN("gcc_blsp1_uart6_apps_clk", STRING.MID("&clk", 1, &clk_input_length-2), 0)!=-1)
    ( 
      &match=1
    )
  )
  else if (&wild_head==1)
  (
    if (STRING.MID("gcc_blsp1_uart6_apps_clk", &clk_itr_length-&clk_input_length+1, &clk_input_length-1)==STRING.CUT("&clk", 1))
    ( 
      &match=1
    )
  )
  else if (&wild_tail==1)
  (
    if (STRING.MID("gcc_blsp1_uart6_apps_clk", 0, &clk_input_length-1)==STRING.CUT("&clk", -1))
    ( 
      &match=1
    )
  )	  
  else if ("gcc_blsp1_uart6_apps_clk"=="&clk")
  (
    &match=1
  )
  
  if (&match==1)
  (
    &clk_test=&CLK_TEST_GCC_BLSP1_UART6_APPS_CLK
    &clk_reg=&HWIO_GCC_BLSP1_UART6_APPS_CBCR_ADDR
    &clk_reg_name="GCC_BLSP1_UART6_APPS_CBCR"
    &clk_name="gcc_blsp1_uart6_apps_clk"
    &clk_reg_cbcr_type="sm_cbc"

    gosub Print_Clk_Info_Line
  )

  &match=0
  &wild_head=0
  &wild_tail=0
  &clk_input_length=STRING.LENGTH("&clk")
  &clk_itr_length=STRING.LENGTH("gcc_blsp2_qup1_i2c_apps_clk")

  if (STRING.SCAN("&clk", "*", 0)==0)
  (
    &wild_head=1
  )
  if (STRING.SCAN("&clk", "*", 1)==(STRING.LENGTH("&clk")-1))
  (
    &wild_tail=1
  )

  if ((&wild_head==1)&&(&wild_tail==1))
  (
    if (STRING.SCAN("gcc_blsp2_qup1_i2c_apps_clk", STRING.MID("&clk", 1, &clk_input_length-2), 0)!=-1)
    ( 
      &match=1
    )
  )
  else if (&wild_head==1)
  (
    if (STRING.MID("gcc_blsp2_qup1_i2c_apps_clk", &clk_itr_length-&clk_input_length+1, &clk_input_length-1)==STRING.CUT("&clk", 1))
    ( 
      &match=1
    )
  )
  else if (&wild_tail==1)
  (
    if (STRING.MID("gcc_blsp2_qup1_i2c_apps_clk", 0, &clk_input_length-1)==STRING.CUT("&clk", -1))
    ( 
      &match=1
    )
  )	  
  else if ("gcc_blsp2_qup1_i2c_apps_clk"=="&clk")
  (
    &match=1
  )
  
  if (&match==1)
  (
    &clk_test=&CLK_TEST_GCC_BLSP2_QUP1_I2C_APPS_CLK
    &clk_reg=&HWIO_GCC_BLSP2_QUP1_I2C_APPS_CBCR_ADDR
    &clk_reg_name="GCC_BLSP2_QUP1_I2C_APPS_CBCR"
    &clk_name="gcc_blsp2_qup1_i2c_apps_clk"
    &clk_reg_cbcr_type="sm_cbc"

    gosub Print_Clk_Info_Line
  )

  &match=0
  &wild_head=0
  &wild_tail=0
  &clk_input_length=STRING.LENGTH("&clk")
  &clk_itr_length=STRING.LENGTH("gcc_blsp2_qup1_spi_apps_clk")

  if (STRING.SCAN("&clk", "*", 0)==0)
  (
    &wild_head=1
  )
  if (STRING.SCAN("&clk", "*", 1)==(STRING.LENGTH("&clk")-1))
  (
    &wild_tail=1
  )

  if ((&wild_head==1)&&(&wild_tail==1))
  (
    if (STRING.SCAN("gcc_blsp2_qup1_spi_apps_clk", STRING.MID("&clk", 1, &clk_input_length-2), 0)!=-1)
    ( 
      &match=1
    )
  )
  else if (&wild_head==1)
  (
    if (STRING.MID("gcc_blsp2_qup1_spi_apps_clk", &clk_itr_length-&clk_input_length+1, &clk_input_length-1)==STRING.CUT("&clk", 1))
    ( 
      &match=1
    )
  )
  else if (&wild_tail==1)
  (
    if (STRING.MID("gcc_blsp2_qup1_spi_apps_clk", 0, &clk_input_length-1)==STRING.CUT("&clk", -1))
    ( 
      &match=1
    )
  )	  
  else if ("gcc_blsp2_qup1_spi_apps_clk"=="&clk")
  (
    &match=1
  )
  
  if (&match==1)
  (
    &clk_test=&CLK_TEST_GCC_BLSP2_QUP1_SPI_APPS_CLK
    &clk_reg=&HWIO_GCC_BLSP2_QUP1_SPI_APPS_CBCR_ADDR
    &clk_reg_name="GCC_BLSP2_QUP1_SPI_APPS_CBCR"
    &clk_name="gcc_blsp2_qup1_spi_apps_clk"
    &clk_reg_cbcr_type="sm_cbc"

    gosub Print_Clk_Info_Line
  )

  &match=0
  &wild_head=0
  &wild_tail=0
  &clk_input_length=STRING.LENGTH("&clk")
  &clk_itr_length=STRING.LENGTH("gcc_blsp2_qup2_i2c_apps_clk")

  if (STRING.SCAN("&clk", "*", 0)==0)
  (
    &wild_head=1
  )
  if (STRING.SCAN("&clk", "*", 1)==(STRING.LENGTH("&clk")-1))
  (
    &wild_tail=1
  )

  if ((&wild_head==1)&&(&wild_tail==1))
  (
    if (STRING.SCAN("gcc_blsp2_qup2_i2c_apps_clk", STRING.MID("&clk", 1, &clk_input_length-2), 0)!=-1)
    ( 
      &match=1
    )
  )
  else if (&wild_head==1)
  (
    if (STRING.MID("gcc_blsp2_qup2_i2c_apps_clk", &clk_itr_length-&clk_input_length+1, &clk_input_length-1)==STRING.CUT("&clk", 1))
    ( 
      &match=1
    )
  )
  else if (&wild_tail==1)
  (
    if (STRING.MID("gcc_blsp2_qup2_i2c_apps_clk", 0, &clk_input_length-1)==STRING.CUT("&clk", -1))
    ( 
      &match=1
    )
  )	  
  else if ("gcc_blsp2_qup2_i2c_apps_clk"=="&clk")
  (
    &match=1
  )
  
  if (&match==1)
  (
    &clk_test=&CLK_TEST_GCC_BLSP2_QUP2_I2C_APPS_CLK
    &clk_reg=&HWIO_GCC_BLSP2_QUP2_I2C_APPS_CBCR_ADDR
    &clk_reg_name="GCC_BLSP2_QUP2_I2C_APPS_CBCR"
    &clk_name="gcc_blsp2_qup2_i2c_apps_clk"
    &clk_reg_cbcr_type="sm_cbc"

    gosub Print_Clk_Info_Line
  )

  &match=0
  &wild_head=0
  &wild_tail=0
  &clk_input_length=STRING.LENGTH("&clk")
  &clk_itr_length=STRING.LENGTH("gcc_blsp2_qup2_spi_apps_clk")

  if (STRING.SCAN("&clk", "*", 0)==0)
  (
    &wild_head=1
  )
  if (STRING.SCAN("&clk", "*", 1)==(STRING.LENGTH("&clk")-1))
  (
    &wild_tail=1
  )

  if ((&wild_head==1)&&(&wild_tail==1))
  (
    if (STRING.SCAN("gcc_blsp2_qup2_spi_apps_clk", STRING.MID("&clk", 1, &clk_input_length-2), 0)!=-1)
    ( 
      &match=1
    )
  )
  else if (&wild_head==1)
  (
    if (STRING.MID("gcc_blsp2_qup2_spi_apps_clk", &clk_itr_length-&clk_input_length+1, &clk_input_length-1)==STRING.CUT("&clk", 1))
    ( 
      &match=1
    )
  )
  else if (&wild_tail==1)
  (
    if (STRING.MID("gcc_blsp2_qup2_spi_apps_clk", 0, &clk_input_length-1)==STRING.CUT("&clk", -1))
    ( 
      &match=1
    )
  )	  
  else if ("gcc_blsp2_qup2_spi_apps_clk"=="&clk")
  (
    &match=1
  )
  
  if (&match==1)
  (
    &clk_test=&CLK_TEST_GCC_BLSP2_QUP2_SPI_APPS_CLK
    &clk_reg=&HWIO_GCC_BLSP2_QUP2_SPI_APPS_CBCR_ADDR
    &clk_reg_name="GCC_BLSP2_QUP2_SPI_APPS_CBCR"
    &clk_name="gcc_blsp2_qup2_spi_apps_clk"
    &clk_reg_cbcr_type="sm_cbc"

    gosub Print_Clk_Info_Line
  )

  &match=0
  &wild_head=0
  &wild_tail=0
  &clk_input_length=STRING.LENGTH("&clk")
  &clk_itr_length=STRING.LENGTH("gcc_blsp2_qup3_i2c_apps_clk")

  if (STRING.SCAN("&clk", "*", 0)==0)
  (
    &wild_head=1
  )
  if (STRING.SCAN("&clk", "*", 1)==(STRING.LENGTH("&clk")-1))
  (
    &wild_tail=1
  )

  if ((&wild_head==1)&&(&wild_tail==1))
  (
    if (STRING.SCAN("gcc_blsp2_qup3_i2c_apps_clk", STRING.MID("&clk", 1, &clk_input_length-2), 0)!=-1)
    ( 
      &match=1
    )
  )
  else if (&wild_head==1)
  (
    if (STRING.MID("gcc_blsp2_qup3_i2c_apps_clk", &clk_itr_length-&clk_input_length+1, &clk_input_length-1)==STRING.CUT("&clk", 1))
    ( 
      &match=1
    )
  )
  else if (&wild_tail==1)
  (
    if (STRING.MID("gcc_blsp2_qup3_i2c_apps_clk", 0, &clk_input_length-1)==STRING.CUT("&clk", -1))
    ( 
      &match=1
    )
  )	  
  else if ("gcc_blsp2_qup3_i2c_apps_clk"=="&clk")
  (
    &match=1
  )
  
  if (&match==1)
  (
    &clk_test=&CLK_TEST_GCC_BLSP2_QUP3_I2C_APPS_CLK
    &clk_reg=&HWIO_GCC_BLSP2_QUP3_I2C_APPS_CBCR_ADDR
    &clk_reg_name="GCC_BLSP2_QUP3_I2C_APPS_CBCR"
    &clk_name="gcc_blsp2_qup3_i2c_apps_clk"
    &clk_reg_cbcr_type="sm_cbc"

    gosub Print_Clk_Info_Line
  )

  &match=0
  &wild_head=0
  &wild_tail=0
  &clk_input_length=STRING.LENGTH("&clk")
  &clk_itr_length=STRING.LENGTH("gcc_blsp2_qup3_spi_apps_clk")

  if (STRING.SCAN("&clk", "*", 0)==0)
  (
    &wild_head=1
  )
  if (STRING.SCAN("&clk", "*", 1)==(STRING.LENGTH("&clk")-1))
  (
    &wild_tail=1
  )

  if ((&wild_head==1)&&(&wild_tail==1))
  (
    if (STRING.SCAN("gcc_blsp2_qup3_spi_apps_clk", STRING.MID("&clk", 1, &clk_input_length-2), 0)!=-1)
    ( 
      &match=1
    )
  )
  else if (&wild_head==1)
  (
    if (STRING.MID("gcc_blsp2_qup3_spi_apps_clk", &clk_itr_length-&clk_input_length+1, &clk_input_length-1)==STRING.CUT("&clk", 1))
    ( 
      &match=1
    )
  )
  else if (&wild_tail==1)
  (
    if (STRING.MID("gcc_blsp2_qup3_spi_apps_clk", 0, &clk_input_length-1)==STRING.CUT("&clk", -1))
    ( 
      &match=1
    )
  )	  
  else if ("gcc_blsp2_qup3_spi_apps_clk"=="&clk")
  (
    &match=1
  )
  
  if (&match==1)
  (
    &clk_test=&CLK_TEST_GCC_BLSP2_QUP3_SPI_APPS_CLK
    &clk_reg=&HWIO_GCC_BLSP2_QUP3_SPI_APPS_CBCR_ADDR
    &clk_reg_name="GCC_BLSP2_QUP3_SPI_APPS_CBCR"
    &clk_name="gcc_blsp2_qup3_spi_apps_clk"
    &clk_reg_cbcr_type="sm_cbc"

    gosub Print_Clk_Info_Line
  )

  &match=0
  &wild_head=0
  &wild_tail=0
  &clk_input_length=STRING.LENGTH("&clk")
  &clk_itr_length=STRING.LENGTH("gcc_blsp2_qup4_i2c_apps_clk")

  if (STRING.SCAN("&clk", "*", 0)==0)
  (
    &wild_head=1
  )
  if (STRING.SCAN("&clk", "*", 1)==(STRING.LENGTH("&clk")-1))
  (
    &wild_tail=1
  )

  if ((&wild_head==1)&&(&wild_tail==1))
  (
    if (STRING.SCAN("gcc_blsp2_qup4_i2c_apps_clk", STRING.MID("&clk", 1, &clk_input_length-2), 0)!=-1)
    ( 
      &match=1
    )
  )
  else if (&wild_head==1)
  (
    if (STRING.MID("gcc_blsp2_qup4_i2c_apps_clk", &clk_itr_length-&clk_input_length+1, &clk_input_length-1)==STRING.CUT("&clk", 1))
    ( 
      &match=1
    )
  )
  else if (&wild_tail==1)
  (
    if (STRING.MID("gcc_blsp2_qup4_i2c_apps_clk", 0, &clk_input_length-1)==STRING.CUT("&clk", -1))
    ( 
      &match=1
    )
  )	  
  else if ("gcc_blsp2_qup4_i2c_apps_clk"=="&clk")
  (
    &match=1
  )
  
  if (&match==1)
  (
    &clk_test=&CLK_TEST_GCC_BLSP2_QUP4_I2C_APPS_CLK
    &clk_reg=&HWIO_GCC_BLSP2_QUP4_I2C_APPS_CBCR_ADDR
    &clk_reg_name="GCC_BLSP2_QUP4_I2C_APPS_CBCR"
    &clk_name="gcc_blsp2_qup4_i2c_apps_clk"
    &clk_reg_cbcr_type="sm_cbc"

    gosub Print_Clk_Info_Line
  )

  &match=0
  &wild_head=0
  &wild_tail=0
  &clk_input_length=STRING.LENGTH("&clk")
  &clk_itr_length=STRING.LENGTH("gcc_blsp2_qup4_spi_apps_clk")

  if (STRING.SCAN("&clk", "*", 0)==0)
  (
    &wild_head=1
  )
  if (STRING.SCAN("&clk", "*", 1)==(STRING.LENGTH("&clk")-1))
  (
    &wild_tail=1
  )

  if ((&wild_head==1)&&(&wild_tail==1))
  (
    if (STRING.SCAN("gcc_blsp2_qup4_spi_apps_clk", STRING.MID("&clk", 1, &clk_input_length-2), 0)!=-1)
    ( 
      &match=1
    )
  )
  else if (&wild_head==1)
  (
    if (STRING.MID("gcc_blsp2_qup4_spi_apps_clk", &clk_itr_length-&clk_input_length+1, &clk_input_length-1)==STRING.CUT("&clk", 1))
    ( 
      &match=1
    )
  )
  else if (&wild_tail==1)
  (
    if (STRING.MID("gcc_blsp2_qup4_spi_apps_clk", 0, &clk_input_length-1)==STRING.CUT("&clk", -1))
    ( 
      &match=1
    )
  )	  
  else if ("gcc_blsp2_qup4_spi_apps_clk"=="&clk")
  (
    &match=1
  )
  
  if (&match==1)
  (
    &clk_test=&CLK_TEST_GCC_BLSP2_QUP4_SPI_APPS_CLK
    &clk_reg=&HWIO_GCC_BLSP2_QUP4_SPI_APPS_CBCR_ADDR
    &clk_reg_name="GCC_BLSP2_QUP4_SPI_APPS_CBCR"
    &clk_name="gcc_blsp2_qup4_spi_apps_clk"
    &clk_reg_cbcr_type="sm_cbc"

    gosub Print_Clk_Info_Line
  )

  &match=0
  &wild_head=0
  &wild_tail=0
  &clk_input_length=STRING.LENGTH("&clk")
  &clk_itr_length=STRING.LENGTH("gcc_blsp2_qup5_i2c_apps_clk")

  if (STRING.SCAN("&clk", "*", 0)==0)
  (
    &wild_head=1
  )
  if (STRING.SCAN("&clk", "*", 1)==(STRING.LENGTH("&clk")-1))
  (
    &wild_tail=1
  )

  if ((&wild_head==1)&&(&wild_tail==1))
  (
    if (STRING.SCAN("gcc_blsp2_qup5_i2c_apps_clk", STRING.MID("&clk", 1, &clk_input_length-2), 0)!=-1)
    ( 
      &match=1
    )
  )
  else if (&wild_head==1)
  (
    if (STRING.MID("gcc_blsp2_qup5_i2c_apps_clk", &clk_itr_length-&clk_input_length+1, &clk_input_length-1)==STRING.CUT("&clk", 1))
    ( 
      &match=1
    )
  )
  else if (&wild_tail==1)
  (
    if (STRING.MID("gcc_blsp2_qup5_i2c_apps_clk", 0, &clk_input_length-1)==STRING.CUT("&clk", -1))
    ( 
      &match=1
    )
  )	  
  else if ("gcc_blsp2_qup5_i2c_apps_clk"=="&clk")
  (
    &match=1
  )
  
  if (&match==1)
  (
    &clk_test=&CLK_TEST_GCC_BLSP2_QUP5_I2C_APPS_CLK
    &clk_reg=&HWIO_GCC_BLSP2_QUP5_I2C_APPS_CBCR_ADDR
    &clk_reg_name="GCC_BLSP2_QUP5_I2C_APPS_CBCR"
    &clk_name="gcc_blsp2_qup5_i2c_apps_clk"
    &clk_reg_cbcr_type="sm_cbc"

    gosub Print_Clk_Info_Line
  )

  &match=0
  &wild_head=0
  &wild_tail=0
  &clk_input_length=STRING.LENGTH("&clk")
  &clk_itr_length=STRING.LENGTH("gcc_blsp2_qup5_spi_apps_clk")

  if (STRING.SCAN("&clk", "*", 0)==0)
  (
    &wild_head=1
  )
  if (STRING.SCAN("&clk", "*", 1)==(STRING.LENGTH("&clk")-1))
  (
    &wild_tail=1
  )

  if ((&wild_head==1)&&(&wild_tail==1))
  (
    if (STRING.SCAN("gcc_blsp2_qup5_spi_apps_clk", STRING.MID("&clk", 1, &clk_input_length-2), 0)!=-1)
    ( 
      &match=1
    )
  )
  else if (&wild_head==1)
  (
    if (STRING.MID("gcc_blsp2_qup5_spi_apps_clk", &clk_itr_length-&clk_input_length+1, &clk_input_length-1)==STRING.CUT("&clk", 1))
    ( 
      &match=1
    )
  )
  else if (&wild_tail==1)
  (
    if (STRING.MID("gcc_blsp2_qup5_spi_apps_clk", 0, &clk_input_length-1)==STRING.CUT("&clk", -1))
    ( 
      &match=1
    )
  )	  
  else if ("gcc_blsp2_qup5_spi_apps_clk"=="&clk")
  (
    &match=1
  )
  
  if (&match==1)
  (
    &clk_test=&CLK_TEST_GCC_BLSP2_QUP5_SPI_APPS_CLK
    &clk_reg=&HWIO_GCC_BLSP2_QUP5_SPI_APPS_CBCR_ADDR
    &clk_reg_name="GCC_BLSP2_QUP5_SPI_APPS_CBCR"
    &clk_name="gcc_blsp2_qup5_spi_apps_clk"
    &clk_reg_cbcr_type="sm_cbc"

    gosub Print_Clk_Info_Line
  )

  &match=0
  &wild_head=0
  &wild_tail=0
  &clk_input_length=STRING.LENGTH("&clk")
  &clk_itr_length=STRING.LENGTH("gcc_blsp2_qup6_i2c_apps_clk")

  if (STRING.SCAN("&clk", "*", 0)==0)
  (
    &wild_head=1
  )
  if (STRING.SCAN("&clk", "*", 1)==(STRING.LENGTH("&clk")-1))
  (
    &wild_tail=1
  )

  if ((&wild_head==1)&&(&wild_tail==1))
  (
    if (STRING.SCAN("gcc_blsp2_qup6_i2c_apps_clk", STRING.MID("&clk", 1, &clk_input_length-2), 0)!=-1)
    ( 
      &match=1
    )
  )
  else if (&wild_head==1)
  (
    if (STRING.MID("gcc_blsp2_qup6_i2c_apps_clk", &clk_itr_length-&clk_input_length+1, &clk_input_length-1)==STRING.CUT("&clk", 1))
    ( 
      &match=1
    )
  )
  else if (&wild_tail==1)
  (
    if (STRING.MID("gcc_blsp2_qup6_i2c_apps_clk", 0, &clk_input_length-1)==STRING.CUT("&clk", -1))
    ( 
      &match=1
    )
  )	  
  else if ("gcc_blsp2_qup6_i2c_apps_clk"=="&clk")
  (
    &match=1
  )
  
  if (&match==1)
  (
    &clk_test=&CLK_TEST_GCC_BLSP2_QUP6_I2C_APPS_CLK
    &clk_reg=&HWIO_GCC_BLSP2_QUP6_I2C_APPS_CBCR_ADDR
    &clk_reg_name="GCC_BLSP2_QUP6_I2C_APPS_CBCR"
    &clk_name="gcc_blsp2_qup6_i2c_apps_clk"
    &clk_reg_cbcr_type="sm_cbc"

    gosub Print_Clk_Info_Line
  )

  &match=0
  &wild_head=0
  &wild_tail=0
  &clk_input_length=STRING.LENGTH("&clk")
  &clk_itr_length=STRING.LENGTH("gcc_blsp2_qup6_spi_apps_clk")

  if (STRING.SCAN("&clk", "*", 0)==0)
  (
    &wild_head=1
  )
  if (STRING.SCAN("&clk", "*", 1)==(STRING.LENGTH("&clk")-1))
  (
    &wild_tail=1
  )

  if ((&wild_head==1)&&(&wild_tail==1))
  (
    if (STRING.SCAN("gcc_blsp2_qup6_spi_apps_clk", STRING.MID("&clk", 1, &clk_input_length-2), 0)!=-1)
    ( 
      &match=1
    )
  )
  else if (&wild_head==1)
  (
    if (STRING.MID("gcc_blsp2_qup6_spi_apps_clk", &clk_itr_length-&clk_input_length+1, &clk_input_length-1)==STRING.CUT("&clk", 1))
    ( 
      &match=1
    )
  )
  else if (&wild_tail==1)
  (
    if (STRING.MID("gcc_blsp2_qup6_spi_apps_clk", 0, &clk_input_length-1)==STRING.CUT("&clk", -1))
    ( 
      &match=1
    )
  )	  
  else if ("gcc_blsp2_qup6_spi_apps_clk"=="&clk")
  (
    &match=1
  )
  
  if (&match==1)
  (
    &clk_test=&CLK_TEST_GCC_BLSP2_QUP6_SPI_APPS_CLK
    &clk_reg=&HWIO_GCC_BLSP2_QUP6_SPI_APPS_CBCR_ADDR
    &clk_reg_name="GCC_BLSP2_QUP6_SPI_APPS_CBCR"
    &clk_name="gcc_blsp2_qup6_spi_apps_clk"
    &clk_reg_cbcr_type="sm_cbc"

    gosub Print_Clk_Info_Line
  )

  &match=0
  &wild_head=0
  &wild_tail=0
  &clk_input_length=STRING.LENGTH("&clk")
  &clk_itr_length=STRING.LENGTH("gcc_blsp2_uart1_apps_clk")

  if (STRING.SCAN("&clk", "*", 0)==0)
  (
    &wild_head=1
  )
  if (STRING.SCAN("&clk", "*", 1)==(STRING.LENGTH("&clk")-1))
  (
    &wild_tail=1
  )

  if ((&wild_head==1)&&(&wild_tail==1))
  (
    if (STRING.SCAN("gcc_blsp2_uart1_apps_clk", STRING.MID("&clk", 1, &clk_input_length-2), 0)!=-1)
    ( 
      &match=1
    )
  )
  else if (&wild_head==1)
  (
    if (STRING.MID("gcc_blsp2_uart1_apps_clk", &clk_itr_length-&clk_input_length+1, &clk_input_length-1)==STRING.CUT("&clk", 1))
    ( 
      &match=1
    )
  )
  else if (&wild_tail==1)
  (
    if (STRING.MID("gcc_blsp2_uart1_apps_clk", 0, &clk_input_length-1)==STRING.CUT("&clk", -1))
    ( 
      &match=1
    )
  )	  
  else if ("gcc_blsp2_uart1_apps_clk"=="&clk")
  (
    &match=1
  )
  
  if (&match==1)
  (
    &clk_test=&CLK_TEST_GCC_BLSP2_UART1_APPS_CLK
    &clk_reg=&HWIO_GCC_BLSP2_UART1_APPS_CBCR_ADDR
    &clk_reg_name="GCC_BLSP2_UART1_APPS_CBCR"
    &clk_name="gcc_blsp2_uart1_apps_clk"
    &clk_reg_cbcr_type="sm_cbc"

    gosub Print_Clk_Info_Line
  )

  &match=0
  &wild_head=0
  &wild_tail=0
  &clk_input_length=STRING.LENGTH("&clk")
  &clk_itr_length=STRING.LENGTH("gcc_blsp2_uart2_apps_clk")

  if (STRING.SCAN("&clk", "*", 0)==0)
  (
    &wild_head=1
  )
  if (STRING.SCAN("&clk", "*", 1)==(STRING.LENGTH("&clk")-1))
  (
    &wild_tail=1
  )

  if ((&wild_head==1)&&(&wild_tail==1))
  (
    if (STRING.SCAN("gcc_blsp2_uart2_apps_clk", STRING.MID("&clk", 1, &clk_input_length-2), 0)!=-1)
    ( 
      &match=1
    )
  )
  else if (&wild_head==1)
  (
    if (STRING.MID("gcc_blsp2_uart2_apps_clk", &clk_itr_length-&clk_input_length+1, &clk_input_length-1)==STRING.CUT("&clk", 1))
    ( 
      &match=1
    )
  )
  else if (&wild_tail==1)
  (
    if (STRING.MID("gcc_blsp2_uart2_apps_clk", 0, &clk_input_length-1)==STRING.CUT("&clk", -1))
    ( 
      &match=1
    )
  )	  
  else if ("gcc_blsp2_uart2_apps_clk"=="&clk")
  (
    &match=1
  )
  
  if (&match==1)
  (
    &clk_test=&CLK_TEST_GCC_BLSP2_UART2_APPS_CLK
    &clk_reg=&HWIO_GCC_BLSP2_UART2_APPS_CBCR_ADDR
    &clk_reg_name="GCC_BLSP2_UART2_APPS_CBCR"
    &clk_name="gcc_blsp2_uart2_apps_clk"
    &clk_reg_cbcr_type="sm_cbc"

    gosub Print_Clk_Info_Line
  )

  &match=0
  &wild_head=0
  &wild_tail=0
  &clk_input_length=STRING.LENGTH("&clk")
  &clk_itr_length=STRING.LENGTH("gcc_blsp2_uart3_apps_clk")

  if (STRING.SCAN("&clk", "*", 0)==0)
  (
    &wild_head=1
  )
  if (STRING.SCAN("&clk", "*", 1)==(STRING.LENGTH("&clk")-1))
  (
    &wild_tail=1
  )

  if ((&wild_head==1)&&(&wild_tail==1))
  (
    if (STRING.SCAN("gcc_blsp2_uart3_apps_clk", STRING.MID("&clk", 1, &clk_input_length-2), 0)!=-1)
    ( 
      &match=1
    )
  )
  else if (&wild_head==1)
  (
    if (STRING.MID("gcc_blsp2_uart3_apps_clk", &clk_itr_length-&clk_input_length+1, &clk_input_length-1)==STRING.CUT("&clk", 1))
    ( 
      &match=1
    )
  )
  else if (&wild_tail==1)
  (
    if (STRING.MID("gcc_blsp2_uart3_apps_clk", 0, &clk_input_length-1)==STRING.CUT("&clk", -1))
    ( 
      &match=1
    )
  )	  
  else if ("gcc_blsp2_uart3_apps_clk"=="&clk")
  (
    &match=1
  )
  
  if (&match==1)
  (
    &clk_test=&CLK_TEST_GCC_BLSP2_UART3_APPS_CLK
    &clk_reg=&HWIO_GCC_BLSP2_UART3_APPS_CBCR_ADDR
    &clk_reg_name="GCC_BLSP2_UART3_APPS_CBCR"
    &clk_name="gcc_blsp2_uart3_apps_clk"
    &clk_reg_cbcr_type="sm_cbc"

    gosub Print_Clk_Info_Line
  )

  &match=0
  &wild_head=0
  &wild_tail=0
  &clk_input_length=STRING.LENGTH("&clk")
  &clk_itr_length=STRING.LENGTH("gcc_blsp2_uart4_apps_clk")

  if (STRING.SCAN("&clk", "*", 0)==0)
  (
    &wild_head=1
  )
  if (STRING.SCAN("&clk", "*", 1)==(STRING.LENGTH("&clk")-1))
  (
    &wild_tail=1
  )

  if ((&wild_head==1)&&(&wild_tail==1))
  (
    if (STRING.SCAN("gcc_blsp2_uart4_apps_clk", STRING.MID("&clk", 1, &clk_input_length-2), 0)!=-1)
    ( 
      &match=1
    )
  )
  else if (&wild_head==1)
  (
    if (STRING.MID("gcc_blsp2_uart4_apps_clk", &clk_itr_length-&clk_input_length+1, &clk_input_length-1)==STRING.CUT("&clk", 1))
    ( 
      &match=1
    )
  )
  else if (&wild_tail==1)
  (
    if (STRING.MID("gcc_blsp2_uart4_apps_clk", 0, &clk_input_length-1)==STRING.CUT("&clk", -1))
    ( 
      &match=1
    )
  )	  
  else if ("gcc_blsp2_uart4_apps_clk"=="&clk")
  (
    &match=1
  )
  
  if (&match==1)
  (
    &clk_test=&CLK_TEST_GCC_BLSP2_UART4_APPS_CLK
    &clk_reg=&HWIO_GCC_BLSP2_UART4_APPS_CBCR_ADDR
    &clk_reg_name="GCC_BLSP2_UART4_APPS_CBCR"
    &clk_name="gcc_blsp2_uart4_apps_clk"
    &clk_reg_cbcr_type="sm_cbc"

    gosub Print_Clk_Info_Line
  )

  &match=0
  &wild_head=0
  &wild_tail=0
  &clk_input_length=STRING.LENGTH("&clk")
  &clk_itr_length=STRING.LENGTH("gcc_blsp2_uart5_apps_clk")

  if (STRING.SCAN("&clk", "*", 0)==0)
  (
    &wild_head=1
  )
  if (STRING.SCAN("&clk", "*", 1)==(STRING.LENGTH("&clk")-1))
  (
    &wild_tail=1
  )

  if ((&wild_head==1)&&(&wild_tail==1))
  (
    if (STRING.SCAN("gcc_blsp2_uart5_apps_clk", STRING.MID("&clk", 1, &clk_input_length-2), 0)!=-1)
    ( 
      &match=1
    )
  )
  else if (&wild_head==1)
  (
    if (STRING.MID("gcc_blsp2_uart5_apps_clk", &clk_itr_length-&clk_input_length+1, &clk_input_length-1)==STRING.CUT("&clk", 1))
    ( 
      &match=1
    )
  )
  else if (&wild_tail==1)
  (
    if (STRING.MID("gcc_blsp2_uart5_apps_clk", 0, &clk_input_length-1)==STRING.CUT("&clk", -1))
    ( 
      &match=1
    )
  )	  
  else if ("gcc_blsp2_uart5_apps_clk"=="&clk")
  (
    &match=1
  )
  
  if (&match==1)
  (
    &clk_test=&CLK_TEST_GCC_BLSP2_UART5_APPS_CLK
    &clk_reg=&HWIO_GCC_BLSP2_UART5_APPS_CBCR_ADDR
    &clk_reg_name="GCC_BLSP2_UART5_APPS_CBCR"
    &clk_name="gcc_blsp2_uart5_apps_clk"
    &clk_reg_cbcr_type="sm_cbc"

    gosub Print_Clk_Info_Line
  )

  &match=0
  &wild_head=0
  &wild_tail=0
  &clk_input_length=STRING.LENGTH("&clk")
  &clk_itr_length=STRING.LENGTH("gcc_blsp2_uart6_apps_clk")

  if (STRING.SCAN("&clk", "*", 0)==0)
  (
    &wild_head=1
  )
  if (STRING.SCAN("&clk", "*", 1)==(STRING.LENGTH("&clk")-1))
  (
    &wild_tail=1
  )

  if ((&wild_head==1)&&(&wild_tail==1))
  (
    if (STRING.SCAN("gcc_blsp2_uart6_apps_clk", STRING.MID("&clk", 1, &clk_input_length-2), 0)!=-1)
    ( 
      &match=1
    )
  )
  else if (&wild_head==1)
  (
    if (STRING.MID("gcc_blsp2_uart6_apps_clk", &clk_itr_length-&clk_input_length+1, &clk_input_length-1)==STRING.CUT("&clk", 1))
    ( 
      &match=1
    )
  )
  else if (&wild_tail==1)
  (
    if (STRING.MID("gcc_blsp2_uart6_apps_clk", 0, &clk_input_length-1)==STRING.CUT("&clk", -1))
    ( 
      &match=1
    )
  )	  
  else if ("gcc_blsp2_uart6_apps_clk"=="&clk")
  (
    &match=1
  )
  
  if (&match==1)
  (
    &clk_test=&CLK_TEST_GCC_BLSP2_UART6_APPS_CLK
    &clk_reg=&HWIO_GCC_BLSP2_UART6_APPS_CBCR_ADDR
    &clk_reg_name="GCC_BLSP2_UART6_APPS_CBCR"
    &clk_name="gcc_blsp2_uart6_apps_clk"
    &clk_reg_cbcr_type="sm_cbc"

    gosub Print_Clk_Info_Line
  )

  &match=0
  &wild_head=0
  &wild_tail=0
  &clk_input_length=STRING.LENGTH("&clk")
  &clk_itr_length=STRING.LENGTH("gcc_blsp1_uart1_sim_clk")

  if (STRING.SCAN("&clk", "*", 0)==0)
  (
    &wild_head=1
  )
  if (STRING.SCAN("&clk", "*", 1)==(STRING.LENGTH("&clk")-1))
  (
    &wild_tail=1
  )

  if ((&wild_head==1)&&(&wild_tail==1))
  (
    if (STRING.SCAN("gcc_blsp1_uart1_sim_clk", STRING.MID("&clk", 1, &clk_input_length-2), 0)!=-1)
    ( 
      &match=1
    )
  )
  else if (&wild_head==1)
  (
    if (STRING.MID("gcc_blsp1_uart1_sim_clk", &clk_itr_length-&clk_input_length+1, &clk_input_length-1)==STRING.CUT("&clk", 1))
    ( 
      &match=1
    )
  )
  else if (&wild_tail==1)
  (
    if (STRING.MID("gcc_blsp1_uart1_sim_clk", 0, &clk_input_length-1)==STRING.CUT("&clk", -1))
    ( 
      &match=1
    )
  )	  
  else if ("gcc_blsp1_uart1_sim_clk"=="&clk")
  (
    &match=1
  )
  
  if (&match==1)
  (
    &clk_test=&CLK_TEST_GCC_BLSP1_UART1_SIM_CLK
    &clk_reg=&HWIO_GCC_BLSP1_UART1_SIM_CBCR_ADDR
    &clk_reg_name="GCC_BLSP1_UART1_SIM_CBCR"
    &clk_name="gcc_blsp1_uart1_sim_clk"
    &clk_reg_cbcr_type="sm_cbc"

    gosub Print_Clk_Info_Line
  )

  &match=0
  &wild_head=0
  &wild_tail=0
  &clk_input_length=STRING.LENGTH("&clk")
  &clk_itr_length=STRING.LENGTH("gcc_blsp1_uart2_sim_clk")

  if (STRING.SCAN("&clk", "*", 0)==0)
  (
    &wild_head=1
  )
  if (STRING.SCAN("&clk", "*", 1)==(STRING.LENGTH("&clk")-1))
  (
    &wild_tail=1
  )

  if ((&wild_head==1)&&(&wild_tail==1))
  (
    if (STRING.SCAN("gcc_blsp1_uart2_sim_clk", STRING.MID("&clk", 1, &clk_input_length-2), 0)!=-1)
    ( 
      &match=1
    )
  )
  else if (&wild_head==1)
  (
    if (STRING.MID("gcc_blsp1_uart2_sim_clk", &clk_itr_length-&clk_input_length+1, &clk_input_length-1)==STRING.CUT("&clk", 1))
    ( 
      &match=1
    )
  )
  else if (&wild_tail==1)
  (
    if (STRING.MID("gcc_blsp1_uart2_sim_clk", 0, &clk_input_length-1)==STRING.CUT("&clk", -1))
    ( 
      &match=1
    )
  )	  
  else if ("gcc_blsp1_uart2_sim_clk"=="&clk")
  (
    &match=1
  )
  
  if (&match==1)
  (
    &clk_test=&CLK_TEST_GCC_BLSP1_UART2_SIM_CLK
    &clk_reg=&HWIO_GCC_BLSP1_UART2_SIM_CBCR_ADDR
    &clk_reg_name="GCC_BLSP1_UART2_SIM_CBCR"
    &clk_name="gcc_blsp1_uart2_sim_clk"
    &clk_reg_cbcr_type="sm_cbc"

    gosub Print_Clk_Info_Line
  )

  &match=0
  &wild_head=0
  &wild_tail=0
  &clk_input_length=STRING.LENGTH("&clk")
  &clk_itr_length=STRING.LENGTH("gcc_blsp1_uart3_sim_clk")

  if (STRING.SCAN("&clk", "*", 0)==0)
  (
    &wild_head=1
  )
  if (STRING.SCAN("&clk", "*", 1)==(STRING.LENGTH("&clk")-1))
  (
    &wild_tail=1
  )

  if ((&wild_head==1)&&(&wild_tail==1))
  (
    if (STRING.SCAN("gcc_blsp1_uart3_sim_clk", STRING.MID("&clk", 1, &clk_input_length-2), 0)!=-1)
    ( 
      &match=1
    )
  )
  else if (&wild_head==1)
  (
    if (STRING.MID("gcc_blsp1_uart3_sim_clk", &clk_itr_length-&clk_input_length+1, &clk_input_length-1)==STRING.CUT("&clk", 1))
    ( 
      &match=1
    )
  )
  else if (&wild_tail==1)
  (
    if (STRING.MID("gcc_blsp1_uart3_sim_clk", 0, &clk_input_length-1)==STRING.CUT("&clk", -1))
    ( 
      &match=1
    )
  )	  
  else if ("gcc_blsp1_uart3_sim_clk"=="&clk")
  (
    &match=1
  )
  
  if (&match==1)
  (
    &clk_test=&CLK_TEST_GCC_BLSP1_UART3_SIM_CLK
    &clk_reg=&HWIO_GCC_BLSP1_UART3_SIM_CBCR_ADDR
    &clk_reg_name="GCC_BLSP1_UART3_SIM_CBCR"
    &clk_name="gcc_blsp1_uart3_sim_clk"
    &clk_reg_cbcr_type="sm_cbc"

    gosub Print_Clk_Info_Line
  )

  &match=0
  &wild_head=0
  &wild_tail=0
  &clk_input_length=STRING.LENGTH("&clk")
  &clk_itr_length=STRING.LENGTH("gcc_blsp1_uart4_sim_clk")

  if (STRING.SCAN("&clk", "*", 0)==0)
  (
    &wild_head=1
  )
  if (STRING.SCAN("&clk", "*", 1)==(STRING.LENGTH("&clk")-1))
  (
    &wild_tail=1
  )

  if ((&wild_head==1)&&(&wild_tail==1))
  (
    if (STRING.SCAN("gcc_blsp1_uart4_sim_clk", STRING.MID("&clk", 1, &clk_input_length-2), 0)!=-1)
    ( 
      &match=1
    )
  )
  else if (&wild_head==1)
  (
    if (STRING.MID("gcc_blsp1_uart4_sim_clk", &clk_itr_length-&clk_input_length+1, &clk_input_length-1)==STRING.CUT("&clk", 1))
    ( 
      &match=1
    )
  )
  else if (&wild_tail==1)
  (
    if (STRING.MID("gcc_blsp1_uart4_sim_clk", 0, &clk_input_length-1)==STRING.CUT("&clk", -1))
    ( 
      &match=1
    )
  )	  
  else if ("gcc_blsp1_uart4_sim_clk"=="&clk")
  (
    &match=1
  )
  
  if (&match==1)
  (
    &clk_test=&CLK_TEST_GCC_BLSP1_UART4_SIM_CLK
    &clk_reg=&HWIO_GCC_BLSP1_UART4_SIM_CBCR_ADDR
    &clk_reg_name="GCC_BLSP1_UART4_SIM_CBCR"
    &clk_name="gcc_blsp1_uart4_sim_clk"
    &clk_reg_cbcr_type="sm_cbc"

    gosub Print_Clk_Info_Line
  )

  &match=0
  &wild_head=0
  &wild_tail=0
  &clk_input_length=STRING.LENGTH("&clk")
  &clk_itr_length=STRING.LENGTH("gcc_blsp1_uart5_sim_clk")

  if (STRING.SCAN("&clk", "*", 0)==0)
  (
    &wild_head=1
  )
  if (STRING.SCAN("&clk", "*", 1)==(STRING.LENGTH("&clk")-1))
  (
    &wild_tail=1
  )

  if ((&wild_head==1)&&(&wild_tail==1))
  (
    if (STRING.SCAN("gcc_blsp1_uart5_sim_clk", STRING.MID("&clk", 1, &clk_input_length-2), 0)!=-1)
    ( 
      &match=1
    )
  )
  else if (&wild_head==1)
  (
    if (STRING.MID("gcc_blsp1_uart5_sim_clk", &clk_itr_length-&clk_input_length+1, &clk_input_length-1)==STRING.CUT("&clk", 1))
    ( 
      &match=1
    )
  )
  else if (&wild_tail==1)
  (
    if (STRING.MID("gcc_blsp1_uart5_sim_clk", 0, &clk_input_length-1)==STRING.CUT("&clk", -1))
    ( 
      &match=1
    )
  )	  
  else if ("gcc_blsp1_uart5_sim_clk"=="&clk")
  (
    &match=1
  )
  
  if (&match==1)
  (
    &clk_test=&CLK_TEST_GCC_BLSP1_UART5_SIM_CLK
    &clk_reg=&HWIO_GCC_BLSP1_UART5_SIM_CBCR_ADDR
    &clk_reg_name="GCC_BLSP1_UART5_SIM_CBCR"
    &clk_name="gcc_blsp1_uart5_sim_clk"
    &clk_reg_cbcr_type="sm_cbc"

    gosub Print_Clk_Info_Line
  )

  &match=0
  &wild_head=0
  &wild_tail=0
  &clk_input_length=STRING.LENGTH("&clk")
  &clk_itr_length=STRING.LENGTH("gcc_blsp1_uart6_sim_clk")

  if (STRING.SCAN("&clk", "*", 0)==0)
  (
    &wild_head=1
  )
  if (STRING.SCAN("&clk", "*", 1)==(STRING.LENGTH("&clk")-1))
  (
    &wild_tail=1
  )

  if ((&wild_head==1)&&(&wild_tail==1))
  (
    if (STRING.SCAN("gcc_blsp1_uart6_sim_clk", STRING.MID("&clk", 1, &clk_input_length-2), 0)!=-1)
    ( 
      &match=1
    )
  )
  else if (&wild_head==1)
  (
    if (STRING.MID("gcc_blsp1_uart6_sim_clk", &clk_itr_length-&clk_input_length+1, &clk_input_length-1)==STRING.CUT("&clk", 1))
    ( 
      &match=1
    )
  )
  else if (&wild_tail==1)
  (
    if (STRING.MID("gcc_blsp1_uart6_sim_clk", 0, &clk_input_length-1)==STRING.CUT("&clk", -1))
    ( 
      &match=1
    )
  )	  
  else if ("gcc_blsp1_uart6_sim_clk"=="&clk")
  (
    &match=1
  )
  
  if (&match==1)
  (
    &clk_test=&CLK_TEST_GCC_BLSP1_UART6_SIM_CLK
    &clk_reg=&HWIO_GCC_BLSP1_UART6_SIM_CBCR_ADDR
    &clk_reg_name="GCC_BLSP1_UART6_SIM_CBCR"
    &clk_name="gcc_blsp1_uart6_sim_clk"
    &clk_reg_cbcr_type="sm_cbc"

    gosub Print_Clk_Info_Line
  )

  &match=0
  &wild_head=0
  &wild_tail=0
  &clk_input_length=STRING.LENGTH("&clk")
  &clk_itr_length=STRING.LENGTH("gcc_blsp2_uart1_sim_clk")

  if (STRING.SCAN("&clk", "*", 0)==0)
  (
    &wild_head=1
  )
  if (STRING.SCAN("&clk", "*", 1)==(STRING.LENGTH("&clk")-1))
  (
    &wild_tail=1
  )

  if ((&wild_head==1)&&(&wild_tail==1))
  (
    if (STRING.SCAN("gcc_blsp2_uart1_sim_clk", STRING.MID("&clk", 1, &clk_input_length-2), 0)!=-1)
    ( 
      &match=1
    )
  )
  else if (&wild_head==1)
  (
    if (STRING.MID("gcc_blsp2_uart1_sim_clk", &clk_itr_length-&clk_input_length+1, &clk_input_length-1)==STRING.CUT("&clk", 1))
    ( 
      &match=1
    )
  )
  else if (&wild_tail==1)
  (
    if (STRING.MID("gcc_blsp2_uart1_sim_clk", 0, &clk_input_length-1)==STRING.CUT("&clk", -1))
    ( 
      &match=1
    )
  )	  
  else if ("gcc_blsp2_uart1_sim_clk"=="&clk")
  (
    &match=1
  )
  
  if (&match==1)
  (
    &clk_test=&CLK_TEST_GCC_BLSP2_UART1_SIM_CLK
    &clk_reg=&HWIO_GCC_BLSP2_UART1_SIM_CBCR_ADDR
    &clk_reg_name="GCC_BLSP2_UART1_SIM_CBCR"
    &clk_name="gcc_blsp2_uart1_sim_clk"
    &clk_reg_cbcr_type="sm_cbc"

    gosub Print_Clk_Info_Line
  )

  &match=0
  &wild_head=0
  &wild_tail=0
  &clk_input_length=STRING.LENGTH("&clk")
  &clk_itr_length=STRING.LENGTH("gcc_blsp2_uart2_sim_clk")

  if (STRING.SCAN("&clk", "*", 0)==0)
  (
    &wild_head=1
  )
  if (STRING.SCAN("&clk", "*", 1)==(STRING.LENGTH("&clk")-1))
  (
    &wild_tail=1
  )

  if ((&wild_head==1)&&(&wild_tail==1))
  (
    if (STRING.SCAN("gcc_blsp2_uart2_sim_clk", STRING.MID("&clk", 1, &clk_input_length-2), 0)!=-1)
    ( 
      &match=1
    )
  )
  else if (&wild_head==1)
  (
    if (STRING.MID("gcc_blsp2_uart2_sim_clk", &clk_itr_length-&clk_input_length+1, &clk_input_length-1)==STRING.CUT("&clk", 1))
    ( 
      &match=1
    )
  )
  else if (&wild_tail==1)
  (
    if (STRING.MID("gcc_blsp2_uart2_sim_clk", 0, &clk_input_length-1)==STRING.CUT("&clk", -1))
    ( 
      &match=1
    )
  )	  
  else if ("gcc_blsp2_uart2_sim_clk"=="&clk")
  (
    &match=1
  )
  
  if (&match==1)
  (
    &clk_test=&CLK_TEST_GCC_BLSP2_UART2_SIM_CLK
    &clk_reg=&HWIO_GCC_BLSP2_UART2_SIM_CBCR_ADDR
    &clk_reg_name="GCC_BLSP2_UART2_SIM_CBCR"
    &clk_name="gcc_blsp2_uart2_sim_clk"
    &clk_reg_cbcr_type="sm_cbc"

    gosub Print_Clk_Info_Line
  )

  &match=0
  &wild_head=0
  &wild_tail=0
  &clk_input_length=STRING.LENGTH("&clk")
  &clk_itr_length=STRING.LENGTH("gcc_blsp2_uart3_sim_clk")

  if (STRING.SCAN("&clk", "*", 0)==0)
  (
    &wild_head=1
  )
  if (STRING.SCAN("&clk", "*", 1)==(STRING.LENGTH("&clk")-1))
  (
    &wild_tail=1
  )

  if ((&wild_head==1)&&(&wild_tail==1))
  (
    if (STRING.SCAN("gcc_blsp2_uart3_sim_clk", STRING.MID("&clk", 1, &clk_input_length-2), 0)!=-1)
    ( 
      &match=1
    )
  )
  else if (&wild_head==1)
  (
    if (STRING.MID("gcc_blsp2_uart3_sim_clk", &clk_itr_length-&clk_input_length+1, &clk_input_length-1)==STRING.CUT("&clk", 1))
    ( 
      &match=1
    )
  )
  else if (&wild_tail==1)
  (
    if (STRING.MID("gcc_blsp2_uart3_sim_clk", 0, &clk_input_length-1)==STRING.CUT("&clk", -1))
    ( 
      &match=1
    )
  )	  
  else if ("gcc_blsp2_uart3_sim_clk"=="&clk")
  (
    &match=1
  )
  
  if (&match==1)
  (
    &clk_test=&CLK_TEST_GCC_BLSP2_UART3_SIM_CLK
    &clk_reg=&HWIO_GCC_BLSP2_UART3_SIM_CBCR_ADDR
    &clk_reg_name="GCC_BLSP2_UART3_SIM_CBCR"
    &clk_name="gcc_blsp2_uart3_sim_clk"
    &clk_reg_cbcr_type="sm_cbc"

    gosub Print_Clk_Info_Line
  )

  &match=0
  &wild_head=0
  &wild_tail=0
  &clk_input_length=STRING.LENGTH("&clk")
  &clk_itr_length=STRING.LENGTH("gcc_blsp2_uart4_sim_clk")

  if (STRING.SCAN("&clk", "*", 0)==0)
  (
    &wild_head=1
  )
  if (STRING.SCAN("&clk", "*", 1)==(STRING.LENGTH("&clk")-1))
  (
    &wild_tail=1
  )

  if ((&wild_head==1)&&(&wild_tail==1))
  (
    if (STRING.SCAN("gcc_blsp2_uart4_sim_clk", STRING.MID("&clk", 1, &clk_input_length-2), 0)!=-1)
    ( 
      &match=1
    )
  )
  else if (&wild_head==1)
  (
    if (STRING.MID("gcc_blsp2_uart4_sim_clk", &clk_itr_length-&clk_input_length+1, &clk_input_length-1)==STRING.CUT("&clk", 1))
    ( 
      &match=1
    )
  )
  else if (&wild_tail==1)
  (
    if (STRING.MID("gcc_blsp2_uart4_sim_clk", 0, &clk_input_length-1)==STRING.CUT("&clk", -1))
    ( 
      &match=1
    )
  )	  
  else if ("gcc_blsp2_uart4_sim_clk"=="&clk")
  (
    &match=1
  )
  
  if (&match==1)
  (
    &clk_test=&CLK_TEST_GCC_BLSP2_UART4_SIM_CLK
    &clk_reg=&HWIO_GCC_BLSP2_UART4_SIM_CBCR_ADDR
    &clk_reg_name="GCC_BLSP2_UART4_SIM_CBCR"
    &clk_name="gcc_blsp2_uart4_sim_clk"
    &clk_reg_cbcr_type="sm_cbc"

    gosub Print_Clk_Info_Line
  )

  &match=0
  &wild_head=0
  &wild_tail=0
  &clk_input_length=STRING.LENGTH("&clk")
  &clk_itr_length=STRING.LENGTH("gcc_blsp2_uart5_sim_clk")

  if (STRING.SCAN("&clk", "*", 0)==0)
  (
    &wild_head=1
  )
  if (STRING.SCAN("&clk", "*", 1)==(STRING.LENGTH("&clk")-1))
  (
    &wild_tail=1
  )

  if ((&wild_head==1)&&(&wild_tail==1))
  (
    if (STRING.SCAN("gcc_blsp2_uart5_sim_clk", STRING.MID("&clk", 1, &clk_input_length-2), 0)!=-1)
    ( 
      &match=1
    )
  )
  else if (&wild_head==1)
  (
    if (STRING.MID("gcc_blsp2_uart5_sim_clk", &clk_itr_length-&clk_input_length+1, &clk_input_length-1)==STRING.CUT("&clk", 1))
    ( 
      &match=1
    )
  )
  else if (&wild_tail==1)
  (
    if (STRING.MID("gcc_blsp2_uart5_sim_clk", 0, &clk_input_length-1)==STRING.CUT("&clk", -1))
    ( 
      &match=1
    )
  )	  
  else if ("gcc_blsp2_uart5_sim_clk"=="&clk")
  (
    &match=1
  )
  
  if (&match==1)
  (
    &clk_test=&CLK_TEST_GCC_BLSP2_UART5_SIM_CLK
    &clk_reg=&HWIO_GCC_BLSP2_UART5_SIM_CBCR_ADDR
    &clk_reg_name="GCC_BLSP2_UART5_SIM_CBCR"
    &clk_name="gcc_blsp2_uart5_sim_clk"
    &clk_reg_cbcr_type="sm_cbc"

    gosub Print_Clk_Info_Line
  )

  &match=0
  &wild_head=0
  &wild_tail=0
  &clk_input_length=STRING.LENGTH("&clk")
  &clk_itr_length=STRING.LENGTH("gcc_blsp2_uart6_sim_clk")

  if (STRING.SCAN("&clk", "*", 0)==0)
  (
    &wild_head=1
  )
  if (STRING.SCAN("&clk", "*", 1)==(STRING.LENGTH("&clk")-1))
  (
    &wild_tail=1
  )

  if ((&wild_head==1)&&(&wild_tail==1))
  (
    if (STRING.SCAN("gcc_blsp2_uart6_sim_clk", STRING.MID("&clk", 1, &clk_input_length-2), 0)!=-1)
    ( 
      &match=1
    )
  )
  else if (&wild_head==1)
  (
    if (STRING.MID("gcc_blsp2_uart6_sim_clk", &clk_itr_length-&clk_input_length+1, &clk_input_length-1)==STRING.CUT("&clk", 1))
    ( 
      &match=1
    )
  )
  else if (&wild_tail==1)
  (
    if (STRING.MID("gcc_blsp2_uart6_sim_clk", 0, &clk_input_length-1)==STRING.CUT("&clk", -1))
    ( 
      &match=1
    )
  )	  
  else if ("gcc_blsp2_uart6_sim_clk"=="&clk")
  (
    &match=1
  )
  
  if (&match==1)
  (
    &clk_test=&CLK_TEST_GCC_BLSP2_UART6_SIM_CLK
    &clk_reg=&HWIO_GCC_BLSP2_UART6_SIM_CBCR_ADDR
    &clk_reg_name="GCC_BLSP2_UART6_SIM_CBCR"
    &clk_name="gcc_blsp2_uart6_sim_clk"
    &clk_reg_cbcr_type="sm_cbc"

    gosub Print_Clk_Info_Line
  )

  &match=0
  &wild_head=0
  &wild_tail=0
  &clk_input_length=STRING.LENGTH("&clk")
  &clk_itr_length=STRING.LENGTH("gcc_ce1_clk")

  if (STRING.SCAN("&clk", "*", 0)==0)
  (
    &wild_head=1
  )
  if (STRING.SCAN("&clk", "*", 1)==(STRING.LENGTH("&clk")-1))
  (
    &wild_tail=1
  )

  if ((&wild_head==1)&&(&wild_tail==1))
  (
    if (STRING.SCAN("gcc_ce1_clk", STRING.MID("&clk", 1, &clk_input_length-2), 0)!=-1)
    ( 
      &match=1
    )
  )
  else if (&wild_head==1)
  (
    if (STRING.MID("gcc_ce1_clk", &clk_itr_length-&clk_input_length+1, &clk_input_length-1)==STRING.CUT("&clk", 1))
    ( 
      &match=1
    )
  )
  else if (&wild_tail==1)
  (
    if (STRING.MID("gcc_ce1_clk", 0, &clk_input_length-1)==STRING.CUT("&clk", -1))
    ( 
      &match=1
    )
  )	  
  else if ("gcc_ce1_clk"=="&clk")
  (
    &match=1
  )
  
  if (&match==1)
  (
    &clk_test=&CLK_TEST_GCC_CE1_CLK
    &clk_reg=&HWIO_GCC_CE1_CBCR_ADDR
    &clk_reg_name="GCC_CE1_CBCR"
    &clk_name="gcc_ce1_clk"
    &clk_reg_cbcr_type="sm_pscbc"

    gosub Print_Clk_Info_Line
  )

  &match=0
  &wild_head=0
  &wild_tail=0
  &clk_input_length=STRING.LENGTH("&clk")
  &clk_itr_length=STRING.LENGTH("gcc_ce2_clk")

  if (STRING.SCAN("&clk", "*", 0)==0)
  (
    &wild_head=1
  )
  if (STRING.SCAN("&clk", "*", 1)==(STRING.LENGTH("&clk")-1))
  (
    &wild_tail=1
  )

  if ((&wild_head==1)&&(&wild_tail==1))
  (
    if (STRING.SCAN("gcc_ce2_clk", STRING.MID("&clk", 1, &clk_input_length-2), 0)!=-1)
    ( 
      &match=1
    )
  )
  else if (&wild_head==1)
  (
    if (STRING.MID("gcc_ce2_clk", &clk_itr_length-&clk_input_length+1, &clk_input_length-1)==STRING.CUT("&clk", 1))
    ( 
      &match=1
    )
  )
  else if (&wild_tail==1)
  (
    if (STRING.MID("gcc_ce2_clk", 0, &clk_input_length-1)==STRING.CUT("&clk", -1))
    ( 
      &match=1
    )
  )	  
  else if ("gcc_ce2_clk"=="&clk")
  (
    &match=1
  )
  
  if (&match==1)
  (
    &clk_test=&CLK_TEST_GCC_CE2_CLK
    &clk_reg=&HWIO_GCC_CE2_CBCR_ADDR
    &clk_reg_name="GCC_CE2_CBCR"
    &clk_name="gcc_ce2_clk"
    &clk_reg_cbcr_type="sm_pscbc"

    gosub Print_Clk_Info_Line
  )

  &match=0
  &wild_head=0
  &wild_tail=0
  &clk_input_length=STRING.LENGTH("&clk")
  &clk_itr_length=STRING.LENGTH("gcc_ce3_clk")

  if (STRING.SCAN("&clk", "*", 0)==0)
  (
    &wild_head=1
  )
  if (STRING.SCAN("&clk", "*", 1)==(STRING.LENGTH("&clk")-1))
  (
    &wild_tail=1
  )

  if ((&wild_head==1)&&(&wild_tail==1))
  (
    if (STRING.SCAN("gcc_ce3_clk", STRING.MID("&clk", 1, &clk_input_length-2), 0)!=-1)
    ( 
      &match=1
    )
  )
  else if (&wild_head==1)
  (
    if (STRING.MID("gcc_ce3_clk", &clk_itr_length-&clk_input_length+1, &clk_input_length-1)==STRING.CUT("&clk", 1))
    ( 
      &match=1
    )
  )
  else if (&wild_tail==1)
  (
    if (STRING.MID("gcc_ce3_clk", 0, &clk_input_length-1)==STRING.CUT("&clk", -1))
    ( 
      &match=1
    )
  )	  
  else if ("gcc_ce3_clk"=="&clk")
  (
    &match=1
  )
  
  if (&match==1)
  (
    &clk_test=&CLK_TEST_GCC_CE3_CLK
    &clk_reg=&HWIO_GCC_CE3_CBCR_ADDR
    &clk_reg_name="GCC_CE3_CBCR"
    &clk_name="gcc_ce3_clk"
    &clk_reg_cbcr_type="sm_pscbc"

    gosub Print_Clk_Info_Line
  )

  &match=0
  &wild_head=0
  &wild_tail=0
  &clk_input_length=STRING.LENGTH("&clk")
  &clk_itr_length=STRING.LENGTH("gcc_ahb_clk")

  if (STRING.SCAN("&clk", "*", 0)==0)
  (
    &wild_head=1
  )
  if (STRING.SCAN("&clk", "*", 1)==(STRING.LENGTH("&clk")-1))
  (
    &wild_tail=1
  )

  if ((&wild_head==1)&&(&wild_tail==1))
  (
    if (STRING.SCAN("gcc_ahb_clk", STRING.MID("&clk", 1, &clk_input_length-2), 0)!=-1)
    ( 
      &match=1
    )
  )
  else if (&wild_head==1)
  (
    if (STRING.MID("gcc_ahb_clk", &clk_itr_length-&clk_input_length+1, &clk_input_length-1)==STRING.CUT("&clk", 1))
    ( 
      &match=1
    )
  )
  else if (&wild_tail==1)
  (
    if (STRING.MID("gcc_ahb_clk", 0, &clk_input_length-1)==STRING.CUT("&clk", -1))
    ( 
      &match=1
    )
  )	  
  else if ("gcc_ahb_clk"=="&clk")
  (
    &match=1
  )
  
  if (&match==1)
  (
    &clk_test=&CLK_TEST_GCC_AHB_CLK
    &clk_reg=&HWIO_GCC_GCC_AHB_CBCR_ADDR
    &clk_reg_name="GCC_GCC_AHB_CBCR"
    &clk_name="gcc_ahb_clk"
    &clk_reg_cbcr_type="sm_cbc"

    gosub Print_Clk_Info_Line
  )

  &match=0
  &wild_head=0
  &wild_tail=0
  &clk_input_length=STRING.LENGTH("&clk")
  &clk_itr_length=STRING.LENGTH("gcc_bimc_cfg_ahb_clk")

  if (STRING.SCAN("&clk", "*", 0)==0)
  (
    &wild_head=1
  )
  if (STRING.SCAN("&clk", "*", 1)==(STRING.LENGTH("&clk")-1))
  (
    &wild_tail=1
  )

  if ((&wild_head==1)&&(&wild_tail==1))
  (
    if (STRING.SCAN("gcc_bimc_cfg_ahb_clk", STRING.MID("&clk", 1, &clk_input_length-2), 0)!=-1)
    ( 
      &match=1
    )
  )
  else if (&wild_head==1)
  (
    if (STRING.MID("gcc_bimc_cfg_ahb_clk", &clk_itr_length-&clk_input_length+1, &clk_input_length-1)==STRING.CUT("&clk", 1))
    ( 
      &match=1
    )
  )
  else if (&wild_tail==1)
  (
    if (STRING.MID("gcc_bimc_cfg_ahb_clk", 0, &clk_input_length-1)==STRING.CUT("&clk", -1))
    ( 
      &match=1
    )
  )	  
  else if ("gcc_bimc_cfg_ahb_clk"=="&clk")
  (
    &match=1
  )
  
  if (&match==1)
  (
    &clk_test=&CLK_TEST_GCC_BIMC_CFG_AHB_CLK
    &clk_reg=&HWIO_GCC_BIMC_CFG_AHB_CBCR_ADDR
    &clk_reg_name="GCC_BIMC_CFG_AHB_CBCR"
    &clk_name="gcc_bimc_cfg_ahb_clk"
    &clk_reg_cbcr_type="sm_cbc"

    gosub Print_Clk_Info_Line
  )

  &match=0
  &wild_head=0
  &wild_tail=0
  &clk_input_length=STRING.LENGTH("&clk")
  &clk_itr_length=STRING.LENGTH("gcc_boot_rom_ahb_clk")

  if (STRING.SCAN("&clk", "*", 0)==0)
  (
    &wild_head=1
  )
  if (STRING.SCAN("&clk", "*", 1)==(STRING.LENGTH("&clk")-1))
  (
    &wild_tail=1
  )

  if ((&wild_head==1)&&(&wild_tail==1))
  (
    if (STRING.SCAN("gcc_boot_rom_ahb_clk", STRING.MID("&clk", 1, &clk_input_length-2), 0)!=-1)
    ( 
      &match=1
    )
  )
  else if (&wild_head==1)
  (
    if (STRING.MID("gcc_boot_rom_ahb_clk", &clk_itr_length-&clk_input_length+1, &clk_input_length-1)==STRING.CUT("&clk", 1))
    ( 
      &match=1
    )
  )
  else if (&wild_tail==1)
  (
    if (STRING.MID("gcc_boot_rom_ahb_clk", 0, &clk_input_length-1)==STRING.CUT("&clk", -1))
    ( 
      &match=1
    )
  )	  
  else if ("gcc_boot_rom_ahb_clk"=="&clk")
  (
    &match=1
  )
  
  if (&match==1)
  (
    &clk_test=&CLK_TEST_GCC_BOOT_ROM_AHB_CLK
    &clk_reg=&HWIO_GCC_BOOT_ROM_AHB_CBCR_ADDR
    &clk_reg_name="GCC_BOOT_ROM_AHB_CBCR"
    &clk_name="gcc_boot_rom_ahb_clk"
    &clk_reg_cbcr_type="sm_pscbc"

    gosub Print_Clk_Info_Line
  )

  &match=0
  &wild_head=0
  &wild_tail=0
  &clk_input_length=STRING.LENGTH("&clk")
  &clk_itr_length=STRING.LENGTH("gcc_ce1_ahb_clk")

  if (STRING.SCAN("&clk", "*", 0)==0)
  (
    &wild_head=1
  )
  if (STRING.SCAN("&clk", "*", 1)==(STRING.LENGTH("&clk")-1))
  (
    &wild_tail=1
  )

  if ((&wild_head==1)&&(&wild_tail==1))
  (
    if (STRING.SCAN("gcc_ce1_ahb_clk", STRING.MID("&clk", 1, &clk_input_length-2), 0)!=-1)
    ( 
      &match=1
    )
  )
  else if (&wild_head==1)
  (
    if (STRING.MID("gcc_ce1_ahb_clk", &clk_itr_length-&clk_input_length+1, &clk_input_length-1)==STRING.CUT("&clk", 1))
    ( 
      &match=1
    )
  )
  else if (&wild_tail==1)
  (
    if (STRING.MID("gcc_ce1_ahb_clk", 0, &clk_input_length-1)==STRING.CUT("&clk", -1))
    ( 
      &match=1
    )
  )	  
  else if ("gcc_ce1_ahb_clk"=="&clk")
  (
    &match=1
  )
  
  if (&match==1)
  (
    &clk_test=&CLK_TEST_GCC_CE1_AHB_CLK
    &clk_reg=&HWIO_GCC_CE1_AHB_CBCR_ADDR
    &clk_reg_name="GCC_CE1_AHB_CBCR"
    &clk_name="gcc_ce1_ahb_clk"
    &clk_reg_cbcr_type="sm_cbc"

    gosub Print_Clk_Info_Line
  )

  &match=0
  &wild_head=0
  &wild_tail=0
  &clk_input_length=STRING.LENGTH("&clk")
  &clk_itr_length=STRING.LENGTH("gcc_ce2_ahb_clk")

  if (STRING.SCAN("&clk", "*", 0)==0)
  (
    &wild_head=1
  )
  if (STRING.SCAN("&clk", "*", 1)==(STRING.LENGTH("&clk")-1))
  (
    &wild_tail=1
  )

  if ((&wild_head==1)&&(&wild_tail==1))
  (
    if (STRING.SCAN("gcc_ce2_ahb_clk", STRING.MID("&clk", 1, &clk_input_length-2), 0)!=-1)
    ( 
      &match=1
    )
  )
  else if (&wild_head==1)
  (
    if (STRING.MID("gcc_ce2_ahb_clk", &clk_itr_length-&clk_input_length+1, &clk_input_length-1)==STRING.CUT("&clk", 1))
    ( 
      &match=1
    )
  )
  else if (&wild_tail==1)
  (
    if (STRING.MID("gcc_ce2_ahb_clk", 0, &clk_input_length-1)==STRING.CUT("&clk", -1))
    ( 
      &match=1
    )
  )	  
  else if ("gcc_ce2_ahb_clk"=="&clk")
  (
    &match=1
  )
  
  if (&match==1)
  (
    &clk_test=&CLK_TEST_GCC_CE2_AHB_CLK
    &clk_reg=&HWIO_GCC_CE2_AHB_CBCR_ADDR
    &clk_reg_name="GCC_CE2_AHB_CBCR"
    &clk_name="gcc_ce2_ahb_clk"
    &clk_reg_cbcr_type="sm_cbc"

    gosub Print_Clk_Info_Line
  )

  &match=0
  &wild_head=0
  &wild_tail=0
  &clk_input_length=STRING.LENGTH("&clk")
  &clk_itr_length=STRING.LENGTH("gcc_ce3_ahb_clk")

  if (STRING.SCAN("&clk", "*", 0)==0)
  (
    &wild_head=1
  )
  if (STRING.SCAN("&clk", "*", 1)==(STRING.LENGTH("&clk")-1))
  (
    &wild_tail=1
  )

  if ((&wild_head==1)&&(&wild_tail==1))
  (
    if (STRING.SCAN("gcc_ce3_ahb_clk", STRING.MID("&clk", 1, &clk_input_length-2), 0)!=-1)
    ( 
      &match=1
    )
  )
  else if (&wild_head==1)
  (
    if (STRING.MID("gcc_ce3_ahb_clk", &clk_itr_length-&clk_input_length+1, &clk_input_length-1)==STRING.CUT("&clk", 1))
    ( 
      &match=1
    )
  )
  else if (&wild_tail==1)
  (
    if (STRING.MID("gcc_ce3_ahb_clk", 0, &clk_input_length-1)==STRING.CUT("&clk", -1))
    ( 
      &match=1
    )
  )	  
  else if ("gcc_ce3_ahb_clk"=="&clk")
  (
    &match=1
  )
  
  if (&match==1)
  (
    &clk_test=&CLK_TEST_GCC_CE3_AHB_CLK
    &clk_reg=&HWIO_GCC_CE3_AHB_CBCR_ADDR
    &clk_reg_name="GCC_CE3_AHB_CBCR"
    &clk_name="gcc_ce3_ahb_clk"
    &clk_reg_cbcr_type="sm_cbc"

    gosub Print_Clk_Info_Line
  )

  &match=0
  &wild_head=0
  &wild_tail=0
  &clk_input_length=STRING.LENGTH("&clk")
  &clk_itr_length=STRING.LENGTH("gcc_cfg_noc_ahb_clk")

  if (STRING.SCAN("&clk", "*", 0)==0)
  (
    &wild_head=1
  )
  if (STRING.SCAN("&clk", "*", 1)==(STRING.LENGTH("&clk")-1))
  (
    &wild_tail=1
  )

  if ((&wild_head==1)&&(&wild_tail==1))
  (
    if (STRING.SCAN("gcc_cfg_noc_ahb_clk", STRING.MID("&clk", 1, &clk_input_length-2), 0)!=-1)
    ( 
      &match=1
    )
  )
  else if (&wild_head==1)
  (
    if (STRING.MID("gcc_cfg_noc_ahb_clk", &clk_itr_length-&clk_input_length+1, &clk_input_length-1)==STRING.CUT("&clk", 1))
    ( 
      &match=1
    )
  )
  else if (&wild_tail==1)
  (
    if (STRING.MID("gcc_cfg_noc_ahb_clk", 0, &clk_input_length-1)==STRING.CUT("&clk", -1))
    ( 
      &match=1
    )
  )	  
  else if ("gcc_cfg_noc_ahb_clk"=="&clk")||("buses"=="&clk")
  (
    &match=1
  )
  
  if (&match==1)
  (
    &clk_test=&CLK_TEST_GCC_CFG_NOC_AHB_CLK
    &clk_reg=&HWIO_GCC_CFG_NOC_AHB_CBCR_ADDR
    &clk_reg_name="GCC_CFG_NOC_AHB_CBCR"
    &clk_name="gcc_cfg_noc_ahb_clk"
    &clk_reg_cbcr_type="sm_cbc"

    gosub Print_Clk_Info_Line
  )

  &match=0
  &wild_head=0
  &wild_tail=0
  &clk_input_length=STRING.LENGTH("&clk")
  &clk_itr_length=STRING.LENGTH("gcc_cnoc_bus_timeout0_ahb_clk")

  if (STRING.SCAN("&clk", "*", 0)==0)
  (
    &wild_head=1
  )
  if (STRING.SCAN("&clk", "*", 1)==(STRING.LENGTH("&clk")-1))
  (
    &wild_tail=1
  )

  if ((&wild_head==1)&&(&wild_tail==1))
  (
    if (STRING.SCAN("gcc_cnoc_bus_timeout0_ahb_clk", STRING.MID("&clk", 1, &clk_input_length-2), 0)!=-1)
    ( 
      &match=1
    )
  )
  else if (&wild_head==1)
  (
    if (STRING.MID("gcc_cnoc_bus_timeout0_ahb_clk", &clk_itr_length-&clk_input_length+1, &clk_input_length-1)==STRING.CUT("&clk", 1))
    ( 
      &match=1
    )
  )
  else if (&wild_tail==1)
  (
    if (STRING.MID("gcc_cnoc_bus_timeout0_ahb_clk", 0, &clk_input_length-1)==STRING.CUT("&clk", -1))
    ( 
      &match=1
    )
  )	  
  else if ("gcc_cnoc_bus_timeout0_ahb_clk"=="&clk")
  (
    &match=1
  )
  
  if (&match==1)
  (
    &clk_test=&CLK_TEST_GCC_CNOC_BUS_TIMEOUT0_AHB_CLK
    &clk_reg=&HWIO_GCC_CNOC_BUS_TIMEOUT0_AHB_CBCR_ADDR
    &clk_reg_name="GCC_CNOC_BUS_TIMEOUT0_AHB_CBCR"
    &clk_name="gcc_cnoc_bus_timeout0_ahb_clk"
    &clk_reg_cbcr_type="sm_cbc"

    gosub Print_Clk_Info_Line
  )

  &match=0
  &wild_head=0
  &wild_tail=0
  &clk_input_length=STRING.LENGTH("&clk")
  &clk_itr_length=STRING.LENGTH("gcc_cnoc_bus_timeout1_ahb_clk")

  if (STRING.SCAN("&clk", "*", 0)==0)
  (
    &wild_head=1
  )
  if (STRING.SCAN("&clk", "*", 1)==(STRING.LENGTH("&clk")-1))
  (
    &wild_tail=1
  )

  if ((&wild_head==1)&&(&wild_tail==1))
  (
    if (STRING.SCAN("gcc_cnoc_bus_timeout1_ahb_clk", STRING.MID("&clk", 1, &clk_input_length-2), 0)!=-1)
    ( 
      &match=1
    )
  )
  else if (&wild_head==1)
  (
    if (STRING.MID("gcc_cnoc_bus_timeout1_ahb_clk", &clk_itr_length-&clk_input_length+1, &clk_input_length-1)==STRING.CUT("&clk", 1))
    ( 
      &match=1
    )
  )
  else if (&wild_tail==1)
  (
    if (STRING.MID("gcc_cnoc_bus_timeout1_ahb_clk", 0, &clk_input_length-1)==STRING.CUT("&clk", -1))
    ( 
      &match=1
    )
  )	  
  else if ("gcc_cnoc_bus_timeout1_ahb_clk"=="&clk")
  (
    &match=1
  )
  
  if (&match==1)
  (
    &clk_test=&CLK_TEST_GCC_CNOC_BUS_TIMEOUT1_AHB_CLK
    &clk_reg=&HWIO_GCC_CNOC_BUS_TIMEOUT1_AHB_CBCR_ADDR
    &clk_reg_name="GCC_CNOC_BUS_TIMEOUT1_AHB_CBCR"
    &clk_name="gcc_cnoc_bus_timeout1_ahb_clk"
    &clk_reg_cbcr_type="sm_cbc"

    gosub Print_Clk_Info_Line
  )

  &match=0
  &wild_head=0
  &wild_tail=0
  &clk_input_length=STRING.LENGTH("&clk")
  &clk_itr_length=STRING.LENGTH("gcc_cnoc_bus_timeout2_ahb_clk")

  if (STRING.SCAN("&clk", "*", 0)==0)
  (
    &wild_head=1
  )
  if (STRING.SCAN("&clk", "*", 1)==(STRING.LENGTH("&clk")-1))
  (
    &wild_tail=1
  )

  if ((&wild_head==1)&&(&wild_tail==1))
  (
    if (STRING.SCAN("gcc_cnoc_bus_timeout2_ahb_clk", STRING.MID("&clk", 1, &clk_input_length-2), 0)!=-1)
    ( 
      &match=1
    )
  )
  else if (&wild_head==1)
  (
    if (STRING.MID("gcc_cnoc_bus_timeout2_ahb_clk", &clk_itr_length-&clk_input_length+1, &clk_input_length-1)==STRING.CUT("&clk", 1))
    ( 
      &match=1
    )
  )
  else if (&wild_tail==1)
  (
    if (STRING.MID("gcc_cnoc_bus_timeout2_ahb_clk", 0, &clk_input_length-1)==STRING.CUT("&clk", -1))
    ( 
      &match=1
    )
  )	  
  else if ("gcc_cnoc_bus_timeout2_ahb_clk"=="&clk")
  (
    &match=1
  )
  
  if (&match==1)
  (
    &clk_test=&CLK_TEST_GCC_CNOC_BUS_TIMEOUT2_AHB_CLK
    &clk_reg=&HWIO_GCC_CNOC_BUS_TIMEOUT2_AHB_CBCR_ADDR
    &clk_reg_name="GCC_CNOC_BUS_TIMEOUT2_AHB_CBCR"
    &clk_name="gcc_cnoc_bus_timeout2_ahb_clk"
    &clk_reg_cbcr_type="sm_cbc"

    gosub Print_Clk_Info_Line
  )

  &match=0
  &wild_head=0
  &wild_tail=0
  &clk_input_length=STRING.LENGTH("&clk")
  &clk_itr_length=STRING.LENGTH("gcc_cnoc_bus_timeout3_ahb_clk")

  if (STRING.SCAN("&clk", "*", 0)==0)
  (
    &wild_head=1
  )
  if (STRING.SCAN("&clk", "*", 1)==(STRING.LENGTH("&clk")-1))
  (
    &wild_tail=1
  )

  if ((&wild_head==1)&&(&wild_tail==1))
  (
    if (STRING.SCAN("gcc_cnoc_bus_timeout3_ahb_clk", STRING.MID("&clk", 1, &clk_input_length-2), 0)!=-1)
    ( 
      &match=1
    )
  )
  else if (&wild_head==1)
  (
    if (STRING.MID("gcc_cnoc_bus_timeout3_ahb_clk", &clk_itr_length-&clk_input_length+1, &clk_input_length-1)==STRING.CUT("&clk", 1))
    ( 
      &match=1
    )
  )
  else if (&wild_tail==1)
  (
    if (STRING.MID("gcc_cnoc_bus_timeout3_ahb_clk", 0, &clk_input_length-1)==STRING.CUT("&clk", -1))
    ( 
      &match=1
    )
  )	  
  else if ("gcc_cnoc_bus_timeout3_ahb_clk"=="&clk")
  (
    &match=1
  )
  
  if (&match==1)
  (
    &clk_test=&CLK_TEST_GCC_CNOC_BUS_TIMEOUT3_AHB_CLK
    &clk_reg=&HWIO_GCC_CNOC_BUS_TIMEOUT3_AHB_CBCR_ADDR
    &clk_reg_name="GCC_CNOC_BUS_TIMEOUT3_AHB_CBCR"
    &clk_name="gcc_cnoc_bus_timeout3_ahb_clk"
    &clk_reg_cbcr_type="sm_cbc"

    gosub Print_Clk_Info_Line
  )

  &match=0
  &wild_head=0
  &wild_tail=0
  &clk_input_length=STRING.LENGTH("&clk")
  &clk_itr_length=STRING.LENGTH("gcc_cnoc_bus_timeout4_ahb_clk")

  if (STRING.SCAN("&clk", "*", 0)==0)
  (
    &wild_head=1
  )
  if (STRING.SCAN("&clk", "*", 1)==(STRING.LENGTH("&clk")-1))
  (
    &wild_tail=1
  )

  if ((&wild_head==1)&&(&wild_tail==1))
  (
    if (STRING.SCAN("gcc_cnoc_bus_timeout4_ahb_clk", STRING.MID("&clk", 1, &clk_input_length-2), 0)!=-1)
    ( 
      &match=1
    )
  )
  else if (&wild_head==1)
  (
    if (STRING.MID("gcc_cnoc_bus_timeout4_ahb_clk", &clk_itr_length-&clk_input_length+1, &clk_input_length-1)==STRING.CUT("&clk", 1))
    ( 
      &match=1
    )
  )
  else if (&wild_tail==1)
  (
    if (STRING.MID("gcc_cnoc_bus_timeout4_ahb_clk", 0, &clk_input_length-1)==STRING.CUT("&clk", -1))
    ( 
      &match=1
    )
  )	  
  else if ("gcc_cnoc_bus_timeout4_ahb_clk"=="&clk")
  (
    &match=1
  )
  
  if (&match==1)
  (
    &clk_test=&CLK_TEST_GCC_CNOC_BUS_TIMEOUT4_AHB_CLK
    &clk_reg=&HWIO_GCC_CNOC_BUS_TIMEOUT4_AHB_CBCR_ADDR
    &clk_reg_name="GCC_CNOC_BUS_TIMEOUT4_AHB_CBCR"
    &clk_name="gcc_cnoc_bus_timeout4_ahb_clk"
    &clk_reg_cbcr_type="sm_cbc"

    gosub Print_Clk_Info_Line
  )

  &match=0
  &wild_head=0
  &wild_tail=0
  &clk_input_length=STRING.LENGTH("&clk")
  &clk_itr_length=STRING.LENGTH("gcc_cnoc_bus_timeout7_ahb_clk")

  if (STRING.SCAN("&clk", "*", 0)==0)
  (
    &wild_head=1
  )
  if (STRING.SCAN("&clk", "*", 1)==(STRING.LENGTH("&clk")-1))
  (
    &wild_tail=1
  )

  if ((&wild_head==1)&&(&wild_tail==1))
  (
    if (STRING.SCAN("gcc_cnoc_bus_timeout7_ahb_clk", STRING.MID("&clk", 1, &clk_input_length-2), 0)!=-1)
    ( 
      &match=1
    )
  )
  else if (&wild_head==1)
  (
    if (STRING.MID("gcc_cnoc_bus_timeout7_ahb_clk", &clk_itr_length-&clk_input_length+1, &clk_input_length-1)==STRING.CUT("&clk", 1))
    ( 
      &match=1
    )
  )
  else if (&wild_tail==1)
  (
    if (STRING.MID("gcc_cnoc_bus_timeout7_ahb_clk", 0, &clk_input_length-1)==STRING.CUT("&clk", -1))
    ( 
      &match=1
    )
  )	  
  else if ("gcc_cnoc_bus_timeout7_ahb_clk"=="&clk")
  (
    &match=1
  )
  
  if (&match==1)
  (
    &clk_test=&CLK_TEST_GCC_CNOC_BUS_TIMEOUT7_AHB_CLK
    &clk_reg=&HWIO_GCC_CNOC_BUS_TIMEOUT7_AHB_CBCR_ADDR
    &clk_reg_name="GCC_CNOC_BUS_TIMEOUT7_AHB_CBCR"
    &clk_name="gcc_cnoc_bus_timeout7_ahb_clk"
    &clk_reg_cbcr_type="sm_cbc"

    gosub Print_Clk_Info_Line
  )

  &match=0
  &wild_head=0
  &wild_tail=0
  &clk_input_length=STRING.LENGTH("&clk")
  &clk_itr_length=STRING.LENGTH("gcc_dehr_clk")

  if (STRING.SCAN("&clk", "*", 0)==0)
  (
    &wild_head=1
  )
  if (STRING.SCAN("&clk", "*", 1)==(STRING.LENGTH("&clk")-1))
  (
    &wild_tail=1
  )

  if ((&wild_head==1)&&(&wild_tail==1))
  (
    if (STRING.SCAN("gcc_dehr_clk", STRING.MID("&clk", 1, &clk_input_length-2), 0)!=-1)
    ( 
      &match=1
    )
  )
  else if (&wild_head==1)
  (
    if (STRING.MID("gcc_dehr_clk", &clk_itr_length-&clk_input_length+1, &clk_input_length-1)==STRING.CUT("&clk", 1))
    ( 
      &match=1
    )
  )
  else if (&wild_tail==1)
  (
    if (STRING.MID("gcc_dehr_clk", 0, &clk_input_length-1)==STRING.CUT("&clk", -1))
    ( 
      &match=1
    )
  )	  
  else if ("gcc_dehr_clk"=="&clk")
  (
    &match=1
  )
  
  if (&match==1)
  (
    &clk_test=&CLK_TEST_GCC_DEHR_CLK
    &clk_reg=&HWIO_GCC_DEHR_CBCR_ADDR
    &clk_reg_name="GCC_DEHR_CBCR"
    &clk_name="gcc_dehr_clk"
    &clk_reg_cbcr_type="sm_pscbc"

    gosub Print_Clk_Info_Line
  )

  &match=0
  &wild_head=0
  &wild_tail=0
  &clk_input_length=STRING.LENGTH("&clk")
  &clk_itr_length=STRING.LENGTH("gcc_imem_cfg_ahb_clk")

  if (STRING.SCAN("&clk", "*", 0)==0)
  (
    &wild_head=1
  )
  if (STRING.SCAN("&clk", "*", 1)==(STRING.LENGTH("&clk")-1))
  (
    &wild_tail=1
  )

  if ((&wild_head==1)&&(&wild_tail==1))
  (
    if (STRING.SCAN("gcc_imem_cfg_ahb_clk", STRING.MID("&clk", 1, &clk_input_length-2), 0)!=-1)
    ( 
      &match=1
    )
  )
  else if (&wild_head==1)
  (
    if (STRING.MID("gcc_imem_cfg_ahb_clk", &clk_itr_length-&clk_input_length+1, &clk_input_length-1)==STRING.CUT("&clk", 1))
    ( 
      &match=1
    )
  )
  else if (&wild_tail==1)
  (
    if (STRING.MID("gcc_imem_cfg_ahb_clk", 0, &clk_input_length-1)==STRING.CUT("&clk", -1))
    ( 
      &match=1
    )
  )	  
  else if ("gcc_imem_cfg_ahb_clk"=="&clk")
  (
    &match=1
  )
  
  if (&match==1)
  (
    &clk_test=&CLK_TEST_GCC_IMEM_CFG_AHB_CLK
    &clk_reg=&HWIO_GCC_IMEM_CFG_AHB_CBCR_ADDR
    &clk_reg_name="GCC_IMEM_CFG_AHB_CBCR"
    &clk_name="gcc_imem_cfg_ahb_clk"
    &clk_reg_cbcr_type="sm_cbc"

    gosub Print_Clk_Info_Line
  )

  &match=0
  &wild_head=0
  &wild_tail=0
  &clk_input_length=STRING.LENGTH("&clk")
  &clk_itr_length=STRING.LENGTH("gcc_ipa_ahb_clk")

  if (STRING.SCAN("&clk", "*", 0)==0)
  (
    &wild_head=1
  )
  if (STRING.SCAN("&clk", "*", 1)==(STRING.LENGTH("&clk")-1))
  (
    &wild_tail=1
  )

  if ((&wild_head==1)&&(&wild_tail==1))
  (
    if (STRING.SCAN("gcc_ipa_ahb_clk", STRING.MID("&clk", 1, &clk_input_length-2), 0)!=-1)
    ( 
      &match=1
    )
  )
  else if (&wild_head==1)
  (
    if (STRING.MID("gcc_ipa_ahb_clk", &clk_itr_length-&clk_input_length+1, &clk_input_length-1)==STRING.CUT("&clk", 1))
    ( 
      &match=1
    )
  )
  else if (&wild_tail==1)
  (
    if (STRING.MID("gcc_ipa_ahb_clk", 0, &clk_input_length-1)==STRING.CUT("&clk", -1))
    ( 
      &match=1
    )
  )	  
  else if ("gcc_ipa_ahb_clk"=="&clk")
  (
    &match=1
  )
  
  if (&match==1)
  (
    &clk_test=&CLK_TEST_GCC_IPA_AHB_CLK
    &clk_reg=&HWIO_GCC_IPA_AHB_CBCR_ADDR
    &clk_reg_name="GCC_IPA_AHB_CBCR"
    &clk_name="gcc_ipa_ahb_clk"
    &clk_reg_cbcr_type="sm_cbc"

    gosub Print_Clk_Info_Line
  )

  &match=0
  &wild_head=0
  &wild_tail=0
  &clk_input_length=STRING.LENGTH("&clk")
  &clk_itr_length=STRING.LENGTH("gcc_mmss_noc_cfg_ahb_clk")

  if (STRING.SCAN("&clk", "*", 0)==0)
  (
    &wild_head=1
  )
  if (STRING.SCAN("&clk", "*", 1)==(STRING.LENGTH("&clk")-1))
  (
    &wild_tail=1
  )

  if ((&wild_head==1)&&(&wild_tail==1))
  (
    if (STRING.SCAN("gcc_mmss_noc_cfg_ahb_clk", STRING.MID("&clk", 1, &clk_input_length-2), 0)!=-1)
    ( 
      &match=1
    )
  )
  else if (&wild_head==1)
  (
    if (STRING.MID("gcc_mmss_noc_cfg_ahb_clk", &clk_itr_length-&clk_input_length+1, &clk_input_length-1)==STRING.CUT("&clk", 1))
    ( 
      &match=1
    )
  )
  else if (&wild_tail==1)
  (
    if (STRING.MID("gcc_mmss_noc_cfg_ahb_clk", 0, &clk_input_length-1)==STRING.CUT("&clk", -1))
    ( 
      &match=1
    )
  )	  
  else if ("gcc_mmss_noc_cfg_ahb_clk"=="&clk")
  (
    &match=1
  )
  
  if (&match==1)
  (
    &clk_test=&CLK_TEST_GCC_MMSS_NOC_CFG_AHB_CLK
    &clk_reg=&HWIO_GCC_MMSS_NOC_CFG_AHB_CBCR_ADDR
    &clk_reg_name="GCC_MMSS_NOC_CFG_AHB_CBCR"
    &clk_name="gcc_mmss_noc_cfg_ahb_clk"
    &clk_reg_cbcr_type="sm_cbc"

    gosub Print_Clk_Info_Line
  )

  &match=0
  &wild_head=0
  &wild_tail=0
  &clk_input_length=STRING.LENGTH("&clk")
  &clk_itr_length=STRING.LENGTH("gcc_mpm_ahb_clk")

  if (STRING.SCAN("&clk", "*", 0)==0)
  (
    &wild_head=1
  )
  if (STRING.SCAN("&clk", "*", 1)==(STRING.LENGTH("&clk")-1))
  (
    &wild_tail=1
  )

  if ((&wild_head==1)&&(&wild_tail==1))
  (
    if (STRING.SCAN("gcc_mpm_ahb_clk", STRING.MID("&clk", 1, &clk_input_length-2), 0)!=-1)
    ( 
      &match=1
    )
  )
  else if (&wild_head==1)
  (
    if (STRING.MID("gcc_mpm_ahb_clk", &clk_itr_length-&clk_input_length+1, &clk_input_length-1)==STRING.CUT("&clk", 1))
    ( 
      &match=1
    )
  )
  else if (&wild_tail==1)
  (
    if (STRING.MID("gcc_mpm_ahb_clk", 0, &clk_input_length-1)==STRING.CUT("&clk", -1))
    ( 
      &match=1
    )
  )	  
  else if ("gcc_mpm_ahb_clk"=="&clk")
  (
    &match=1
  )
  
  if (&match==1)
  (
    &clk_test=&CLK_TEST_GCC_MPM_AHB_CLK
    &clk_reg=&HWIO_GCC_MPM_AHB_CBCR_ADDR
    &clk_reg_name="GCC_MPM_AHB_CBCR"
    &clk_name="gcc_mpm_ahb_clk"
    &clk_reg_cbcr_type="sm_cbc"

    gosub Print_Clk_Info_Line
  )

  &match=0
  &wild_head=0
  &wild_tail=0
  &clk_input_length=STRING.LENGTH("&clk")
  &clk_itr_length=STRING.LENGTH("gcc_msg_ram_ahb_clk")

  if (STRING.SCAN("&clk", "*", 0)==0)
  (
    &wild_head=1
  )
  if (STRING.SCAN("&clk", "*", 1)==(STRING.LENGTH("&clk")-1))
  (
    &wild_tail=1
  )

  if ((&wild_head==1)&&(&wild_tail==1))
  (
    if (STRING.SCAN("gcc_msg_ram_ahb_clk", STRING.MID("&clk", 1, &clk_input_length-2), 0)!=-1)
    ( 
      &match=1
    )
  )
  else if (&wild_head==1)
  (
    if (STRING.MID("gcc_msg_ram_ahb_clk", &clk_itr_length-&clk_input_length+1, &clk_input_length-1)==STRING.CUT("&clk", 1))
    ( 
      &match=1
    )
  )
  else if (&wild_tail==1)
  (
    if (STRING.MID("gcc_msg_ram_ahb_clk", 0, &clk_input_length-1)==STRING.CUT("&clk", -1))
    ( 
      &match=1
    )
  )	  
  else if ("gcc_msg_ram_ahb_clk"=="&clk")
  (
    &match=1
  )
  
  if (&match==1)
  (
    &clk_test=&CLK_TEST_GCC_MSG_RAM_AHB_CLK
    &clk_reg=&HWIO_GCC_MSG_RAM_AHB_CBCR_ADDR
    &clk_reg_name="GCC_MSG_RAM_AHB_CBCR"
    &clk_name="gcc_msg_ram_ahb_clk"
    &clk_reg_cbcr_type="sm_pscbc"

    gosub Print_Clk_Info_Line
  )

  &match=0
  &wild_head=0
  &wild_tail=0
  &clk_input_length=STRING.LENGTH("&clk")
  &clk_itr_length=STRING.LENGTH("gcc_mss_cfg_ahb_clk")

  if (STRING.SCAN("&clk", "*", 0)==0)
  (
    &wild_head=1
  )
  if (STRING.SCAN("&clk", "*", 1)==(STRING.LENGTH("&clk")-1))
  (
    &wild_tail=1
  )

  if ((&wild_head==1)&&(&wild_tail==1))
  (
    if (STRING.SCAN("gcc_mss_cfg_ahb_clk", STRING.MID("&clk", 1, &clk_input_length-2), 0)!=-1)
    ( 
      &match=1
    )
  )
  else if (&wild_head==1)
  (
    if (STRING.MID("gcc_mss_cfg_ahb_clk", &clk_itr_length-&clk_input_length+1, &clk_input_length-1)==STRING.CUT("&clk", 1))
    ( 
      &match=1
    )
  )
  else if (&wild_tail==1)
  (
    if (STRING.MID("gcc_mss_cfg_ahb_clk", 0, &clk_input_length-1)==STRING.CUT("&clk", -1))
    ( 
      &match=1
    )
  )	  
  else if ("gcc_mss_cfg_ahb_clk"=="&clk")
  (
    &match=1
  )
  
  if (&match==1)
  (
    &clk_test=&CLK_TEST_GCC_MSS_CFG_AHB_CLK
    &clk_reg=&HWIO_GCC_MSS_CFG_AHB_CBCR_ADDR
    &clk_reg_name="GCC_MSS_CFG_AHB_CBCR"
    &clk_name="gcc_mss_cfg_ahb_clk"
    &clk_reg_cbcr_type="sm_cbc"

    gosub Print_Clk_Info_Line
  )

  &match=0
  &wild_head=0
  &wild_tail=0
  &clk_input_length=STRING.LENGTH("&clk")
  &clk_itr_length=STRING.LENGTH("gcc_noc_conf_xpu_ahb_clk")

  if (STRING.SCAN("&clk", "*", 0)==0)
  (
    &wild_head=1
  )
  if (STRING.SCAN("&clk", "*", 1)==(STRING.LENGTH("&clk")-1))
  (
    &wild_tail=1
  )

  if ((&wild_head==1)&&(&wild_tail==1))
  (
    if (STRING.SCAN("gcc_noc_conf_xpu_ahb_clk", STRING.MID("&clk", 1, &clk_input_length-2), 0)!=-1)
    ( 
      &match=1
    )
  )
  else if (&wild_head==1)
  (
    if (STRING.MID("gcc_noc_conf_xpu_ahb_clk", &clk_itr_length-&clk_input_length+1, &clk_input_length-1)==STRING.CUT("&clk", 1))
    ( 
      &match=1
    )
  )
  else if (&wild_tail==1)
  (
    if (STRING.MID("gcc_noc_conf_xpu_ahb_clk", 0, &clk_input_length-1)==STRING.CUT("&clk", -1))
    ( 
      &match=1
    )
  )	  
  else if ("gcc_noc_conf_xpu_ahb_clk"=="&clk")
  (
    &match=1
  )
  
  if (&match==1)
  (
    &clk_test=&CLK_TEST_GCC_NOC_CONF_XPU_AHB_CLK
    &clk_reg=&HWIO_GCC_NOC_CONF_XPU_AHB_CBCR_ADDR
    &clk_reg_name="GCC_NOC_CONF_XPU_AHB_CBCR"
    &clk_name="gcc_noc_conf_xpu_ahb_clk"
    &clk_reg_cbcr_type="sm_cbc"

    gosub Print_Clk_Info_Line
  )

  &match=0
  &wild_head=0
  &wild_tail=0
  &clk_input_length=STRING.LENGTH("&clk")
  &clk_itr_length=STRING.LENGTH("gcc_pcie_0_cfg_ahb_clk")

  if (STRING.SCAN("&clk", "*", 0)==0)
  (
    &wild_head=1
  )
  if (STRING.SCAN("&clk", "*", 1)==(STRING.LENGTH("&clk")-1))
  (
    &wild_tail=1
  )

  if ((&wild_head==1)&&(&wild_tail==1))
  (
    if (STRING.SCAN("gcc_pcie_0_cfg_ahb_clk", STRING.MID("&clk", 1, &clk_input_length-2), 0)!=-1)
    ( 
      &match=1
    )
  )
  else if (&wild_head==1)
  (
    if (STRING.MID("gcc_pcie_0_cfg_ahb_clk", &clk_itr_length-&clk_input_length+1, &clk_input_length-1)==STRING.CUT("&clk", 1))
    ( 
      &match=1
    )
  )
  else if (&wild_tail==1)
  (
    if (STRING.MID("gcc_pcie_0_cfg_ahb_clk", 0, &clk_input_length-1)==STRING.CUT("&clk", -1))
    ( 
      &match=1
    )
  )	  
  else if ("gcc_pcie_0_cfg_ahb_clk"=="&clk")
  (
    &match=1
  )
  
  if (&match==1)
  (
    &clk_test=&CLK_TEST_GCC_PCIE_0_CFG_AHB_CLK
    &clk_reg=&HWIO_GCC_PCIE_0_CFG_AHB_CBCR_ADDR
    &clk_reg_name="GCC_PCIE_0_CFG_AHB_CBCR"
    &clk_name="gcc_pcie_0_cfg_ahb_clk"
    &clk_reg_cbcr_type="sm_cbc"

    gosub Print_Clk_Info_Line
  )

  &match=0
  &wild_head=0
  &wild_tail=0
  &clk_input_length=STRING.LENGTH("&clk")
  &clk_itr_length=STRING.LENGTH("gcc_pcie_1_cfg_ahb_clk")

  if (STRING.SCAN("&clk", "*", 0)==0)
  (
    &wild_head=1
  )
  if (STRING.SCAN("&clk", "*", 1)==(STRING.LENGTH("&clk")-1))
  (
    &wild_tail=1
  )

  if ((&wild_head==1)&&(&wild_tail==1))
  (
    if (STRING.SCAN("gcc_pcie_1_cfg_ahb_clk", STRING.MID("&clk", 1, &clk_input_length-2), 0)!=-1)
    ( 
      &match=1
    )
  )
  else if (&wild_head==1)
  (
    if (STRING.MID("gcc_pcie_1_cfg_ahb_clk", &clk_itr_length-&clk_input_length+1, &clk_input_length-1)==STRING.CUT("&clk", 1))
    ( 
      &match=1
    )
  )
  else if (&wild_tail==1)
  (
    if (STRING.MID("gcc_pcie_1_cfg_ahb_clk", 0, &clk_input_length-1)==STRING.CUT("&clk", -1))
    ( 
      &match=1
    )
  )	  
  else if ("gcc_pcie_1_cfg_ahb_clk"=="&clk")
  (
    &match=1
  )
  
  if (&match==1)
  (
    &clk_test=&CLK_TEST_GCC_PCIE_1_CFG_AHB_CLK
    &clk_reg=&HWIO_GCC_PCIE_1_CFG_AHB_CBCR_ADDR
    &clk_reg_name="GCC_PCIE_1_CFG_AHB_CBCR"
    &clk_name="gcc_pcie_1_cfg_ahb_clk"
    &clk_reg_cbcr_type="sm_cbc"

    gosub Print_Clk_Info_Line
  )

  &match=0
  &wild_head=0
  &wild_tail=0
  &clk_input_length=STRING.LENGTH("&clk")
  &clk_itr_length=STRING.LENGTH("gcc_periph_noc_cfg_ahb_clk")

  if (STRING.SCAN("&clk", "*", 0)==0)
  (
    &wild_head=1
  )
  if (STRING.SCAN("&clk", "*", 1)==(STRING.LENGTH("&clk")-1))
  (
    &wild_tail=1
  )

  if ((&wild_head==1)&&(&wild_tail==1))
  (
    if (STRING.SCAN("gcc_periph_noc_cfg_ahb_clk", STRING.MID("&clk", 1, &clk_input_length-2), 0)!=-1)
    ( 
      &match=1
    )
  )
  else if (&wild_head==1)
  (
    if (STRING.MID("gcc_periph_noc_cfg_ahb_clk", &clk_itr_length-&clk_input_length+1, &clk_input_length-1)==STRING.CUT("&clk", 1))
    ( 
      &match=1
    )
  )
  else if (&wild_tail==1)
  (
    if (STRING.MID("gcc_periph_noc_cfg_ahb_clk", 0, &clk_input_length-1)==STRING.CUT("&clk", -1))
    ( 
      &match=1
    )
  )	  
  else if ("gcc_periph_noc_cfg_ahb_clk"=="&clk")
  (
    &match=1
  )
  
  if (&match==1)
  (
    &clk_test=&CLK_TEST_GCC_PERIPH_NOC_CFG_AHB_CLK
    &clk_reg=&HWIO_GCC_PERIPH_NOC_CFG_AHB_CBCR_ADDR
    &clk_reg_name="GCC_PERIPH_NOC_CFG_AHB_CBCR"
    &clk_name="gcc_periph_noc_cfg_ahb_clk"
    &clk_reg_cbcr_type="sm_cbc"

    gosub Print_Clk_Info_Line
  )

  &match=0
  &wild_head=0
  &wild_tail=0
  &clk_input_length=STRING.LENGTH("&clk")
  &clk_itr_length=STRING.LENGTH("gcc_qdss_cfg_ahb_clk")

  if (STRING.SCAN("&clk", "*", 0)==0)
  (
    &wild_head=1
  )
  if (STRING.SCAN("&clk", "*", 1)==(STRING.LENGTH("&clk")-1))
  (
    &wild_tail=1
  )

  if ((&wild_head==1)&&(&wild_tail==1))
  (
    if (STRING.SCAN("gcc_qdss_cfg_ahb_clk", STRING.MID("&clk", 1, &clk_input_length-2), 0)!=-1)
    ( 
      &match=1
    )
  )
  else if (&wild_head==1)
  (
    if (STRING.MID("gcc_qdss_cfg_ahb_clk", &clk_itr_length-&clk_input_length+1, &clk_input_length-1)==STRING.CUT("&clk", 1))
    ( 
      &match=1
    )
  )
  else if (&wild_tail==1)
  (
    if (STRING.MID("gcc_qdss_cfg_ahb_clk", 0, &clk_input_length-1)==STRING.CUT("&clk", -1))
    ( 
      &match=1
    )
  )	  
  else if ("gcc_qdss_cfg_ahb_clk"=="&clk")
  (
    &match=1
  )
  
  if (&match==1)
  (
    &clk_test=&CLK_TEST_GCC_QDSS_CFG_AHB_CLK
    &clk_reg=&HWIO_GCC_QDSS_CFG_AHB_CBCR_ADDR
    &clk_reg_name="GCC_QDSS_CFG_AHB_CBCR"
    &clk_name="gcc_qdss_cfg_ahb_clk"
    &clk_reg_cbcr_type="sm_cbc"

    gosub Print_Clk_Info_Line
  )

  &match=0
  &wild_head=0
  &wild_tail=0
  &clk_input_length=STRING.LENGTH("&clk")
  &clk_itr_length=STRING.LENGTH("gcc_qdss_dap_ahb_clk")

  if (STRING.SCAN("&clk", "*", 0)==0)
  (
    &wild_head=1
  )
  if (STRING.SCAN("&clk", "*", 1)==(STRING.LENGTH("&clk")-1))
  (
    &wild_tail=1
  )

  if ((&wild_head==1)&&(&wild_tail==1))
  (
    if (STRING.SCAN("gcc_qdss_dap_ahb_clk", STRING.MID("&clk", 1, &clk_input_length-2), 0)!=-1)
    ( 
      &match=1
    )
  )
  else if (&wild_head==1)
  (
    if (STRING.MID("gcc_qdss_dap_ahb_clk", &clk_itr_length-&clk_input_length+1, &clk_input_length-1)==STRING.CUT("&clk", 1))
    ( 
      &match=1
    )
  )
  else if (&wild_tail==1)
  (
    if (STRING.MID("gcc_qdss_dap_ahb_clk", 0, &clk_input_length-1)==STRING.CUT("&clk", -1))
    ( 
      &match=1
    )
  )	  
  else if ("gcc_qdss_dap_ahb_clk"=="&clk")
  (
    &match=1
  )
  
  if (&match==1)
  (
    &clk_test=&CLK_TEST_GCC_QDSS_DAP_AHB_CLK
    &clk_reg=&HWIO_GCC_QDSS_DAP_AHB_CBCR_ADDR
    &clk_reg_name="GCC_QDSS_DAP_AHB_CBCR"
    &clk_name="gcc_qdss_dap_ahb_clk"
    &clk_reg_cbcr_type="sm_cbc"

    gosub Print_Clk_Info_Line
  )

  &match=0
  &wild_head=0
  &wild_tail=0
  &clk_input_length=STRING.LENGTH("&clk")
  &clk_itr_length=STRING.LENGTH("gcc_qdss_rbcpr_xpu_ahb_clk")

  if (STRING.SCAN("&clk", "*", 0)==0)
  (
    &wild_head=1
  )
  if (STRING.SCAN("&clk", "*", 1)==(STRING.LENGTH("&clk")-1))
  (
    &wild_tail=1
  )

  if ((&wild_head==1)&&(&wild_tail==1))
  (
    if (STRING.SCAN("gcc_qdss_rbcpr_xpu_ahb_clk", STRING.MID("&clk", 1, &clk_input_length-2), 0)!=-1)
    ( 
      &match=1
    )
  )
  else if (&wild_head==1)
  (
    if (STRING.MID("gcc_qdss_rbcpr_xpu_ahb_clk", &clk_itr_length-&clk_input_length+1, &clk_input_length-1)==STRING.CUT("&clk", 1))
    ( 
      &match=1
    )
  )
  else if (&wild_tail==1)
  (
    if (STRING.MID("gcc_qdss_rbcpr_xpu_ahb_clk", 0, &clk_input_length-1)==STRING.CUT("&clk", -1))
    ( 
      &match=1
    )
  )	  
  else if ("gcc_qdss_rbcpr_xpu_ahb_clk"=="&clk")
  (
    &match=1
  )
  
  if (&match==1)
  (
    &clk_test=&CLK_TEST_GCC_QDSS_RBCPR_XPU_AHB_CLK
    &clk_reg=&HWIO_GCC_QDSS_RBCPR_XPU_AHB_CBCR_ADDR
    &clk_reg_name="GCC_QDSS_RBCPR_XPU_AHB_CBCR"
    &clk_name="gcc_qdss_rbcpr_xpu_ahb_clk"
    &clk_reg_cbcr_type="sm_cbc"

    gosub Print_Clk_Info_Line
  )

  &match=0
  &wild_head=0
  &wild_tail=0
  &clk_input_length=STRING.LENGTH("&clk")
  &clk_itr_length=STRING.LENGTH("gcc_rbcpr_cx_ahb_clk")

  if (STRING.SCAN("&clk", "*", 0)==0)
  (
    &wild_head=1
  )
  if (STRING.SCAN("&clk", "*", 1)==(STRING.LENGTH("&clk")-1))
  (
    &wild_tail=1
  )

  if ((&wild_head==1)&&(&wild_tail==1))
  (
    if (STRING.SCAN("gcc_rbcpr_cx_ahb_clk", STRING.MID("&clk", 1, &clk_input_length-2), 0)!=-1)
    ( 
      &match=1
    )
  )
  else if (&wild_head==1)
  (
    if (STRING.MID("gcc_rbcpr_cx_ahb_clk", &clk_itr_length-&clk_input_length+1, &clk_input_length-1)==STRING.CUT("&clk", 1))
    ( 
      &match=1
    )
  )
  else if (&wild_tail==1)
  (
    if (STRING.MID("gcc_rbcpr_cx_ahb_clk", 0, &clk_input_length-1)==STRING.CUT("&clk", -1))
    ( 
      &match=1
    )
  )	  
  else if ("gcc_rbcpr_cx_ahb_clk"=="&clk")
  (
    &match=1
  )
  
  if (&match==1)
  (
    &clk_test=&CLK_TEST_GCC_RBCPR_CX_AHB_CLK
    &clk_reg=&HWIO_GCC_RBCPR_CX_AHB_CBCR_ADDR
    &clk_reg_name="GCC_RBCPR_CX_AHB_CBCR"
    &clk_name="gcc_rbcpr_cx_ahb_clk"
    &clk_reg_cbcr_type="sm_cbc"

    gosub Print_Clk_Info_Line
  )

  &match=0
  &wild_head=0
  &wild_tail=0
  &clk_input_length=STRING.LENGTH("&clk")
  &clk_itr_length=STRING.LENGTH("gcc_rbcpr_mx_ahb_clk")

  if (STRING.SCAN("&clk", "*", 0)==0)
  (
    &wild_head=1
  )
  if (STRING.SCAN("&clk", "*", 1)==(STRING.LENGTH("&clk")-1))
  (
    &wild_tail=1
  )

  if ((&wild_head==1)&&(&wild_tail==1))
  (
    if (STRING.SCAN("gcc_rbcpr_mx_ahb_clk", STRING.MID("&clk", 1, &clk_input_length-2), 0)!=-1)
    ( 
      &match=1
    )
  )
  else if (&wild_head==1)
  (
    if (STRING.MID("gcc_rbcpr_mx_ahb_clk", &clk_itr_length-&clk_input_length+1, &clk_input_length-1)==STRING.CUT("&clk", 1))
    ( 
      &match=1
    )
  )
  else if (&wild_tail==1)
  (
    if (STRING.MID("gcc_rbcpr_mx_ahb_clk", 0, &clk_input_length-1)==STRING.CUT("&clk", -1))
    ( 
      &match=1
    )
  )	  
  else if ("gcc_rbcpr_mx_ahb_clk"=="&clk")
  (
    &match=1
  )
  
  if (&match==1)
  (
    &clk_test=&CLK_TEST_GCC_RBCPR_MX_AHB_CLK
    &clk_reg=&HWIO_GCC_RBCPR_MX_AHB_CBCR_ADDR
    &clk_reg_name="GCC_RBCPR_MX_AHB_CBCR"
    &clk_name="gcc_rbcpr_mx_ahb_clk"
    &clk_reg_cbcr_type="sm_cbc"

    gosub Print_Clk_Info_Line
  )

  &match=0
  &wild_head=0
  &wild_tail=0
  &clk_input_length=STRING.LENGTH("&clk")
  &clk_itr_length=STRING.LENGTH("gcc_sec_ctrl_ahb_clk")

  if (STRING.SCAN("&clk", "*", 0)==0)
  (
    &wild_head=1
  )
  if (STRING.SCAN("&clk", "*", 1)==(STRING.LENGTH("&clk")-1))
  (
    &wild_tail=1
  )

  if ((&wild_head==1)&&(&wild_tail==1))
  (
    if (STRING.SCAN("gcc_sec_ctrl_ahb_clk", STRING.MID("&clk", 1, &clk_input_length-2), 0)!=-1)
    ( 
      &match=1
    )
  )
  else if (&wild_head==1)
  (
    if (STRING.MID("gcc_sec_ctrl_ahb_clk", &clk_itr_length-&clk_input_length+1, &clk_input_length-1)==STRING.CUT("&clk", 1))
    ( 
      &match=1
    )
  )
  else if (&wild_tail==1)
  (
    if (STRING.MID("gcc_sec_ctrl_ahb_clk", 0, &clk_input_length-1)==STRING.CUT("&clk", -1))
    ( 
      &match=1
    )
  )	  
  else if ("gcc_sec_ctrl_ahb_clk"=="&clk")
  (
    &match=1
  )
  
  if (&match==1)
  (
    &clk_test=&CLK_TEST_GCC_SEC_CTRL_AHB_CLK
    &clk_reg=&HWIO_GCC_SEC_CTRL_AHB_CBCR_ADDR
    &clk_reg_name="GCC_SEC_CTRL_AHB_CBCR"
    &clk_name="gcc_sec_ctrl_ahb_clk"
    &clk_reg_cbcr_type="sm_cbc"

    gosub Print_Clk_Info_Line
  )

  &match=0
  &wild_head=0
  &wild_tail=0
  &clk_input_length=STRING.LENGTH("&clk")
  &clk_itr_length=STRING.LENGTH("gcc_sec_ctrl_boot_rom_patch_clk")

  if (STRING.SCAN("&clk", "*", 0)==0)
  (
    &wild_head=1
  )
  if (STRING.SCAN("&clk", "*", 1)==(STRING.LENGTH("&clk")-1))
  (
    &wild_tail=1
  )

  if ((&wild_head==1)&&(&wild_tail==1))
  (
    if (STRING.SCAN("gcc_sec_ctrl_boot_rom_patch_clk", STRING.MID("&clk", 1, &clk_input_length-2), 0)!=-1)
    ( 
      &match=1
    )
  )
  else if (&wild_head==1)
  (
    if (STRING.MID("gcc_sec_ctrl_boot_rom_patch_clk", &clk_itr_length-&clk_input_length+1, &clk_input_length-1)==STRING.CUT("&clk", 1))
    ( 
      &match=1
    )
  )
  else if (&wild_tail==1)
  (
    if (STRING.MID("gcc_sec_ctrl_boot_rom_patch_clk", 0, &clk_input_length-1)==STRING.CUT("&clk", -1))
    ( 
      &match=1
    )
  )	  
  else if ("gcc_sec_ctrl_boot_rom_patch_clk"=="&clk")
  (
    &match=1
  )
  
  if (&match==1)
  (
    &clk_test=&CLK_TEST_GCC_SEC_CTRL_BOOT_ROM_PATCH_CLK
    &clk_reg=&HWIO_GCC_SEC_CTRL_BOOT_ROM_PATCH_CBCR_ADDR
    &clk_reg_name="GCC_SEC_CTRL_BOOT_ROM_PATCH_CBCR"
    &clk_name="gcc_sec_ctrl_boot_rom_patch_clk"
    &clk_reg_cbcr_type="sm_cbc"

    gosub Print_Clk_Info_Line
  )

  &match=0
  &wild_head=0
  &wild_tail=0
  &clk_input_length=STRING.LENGTH("&clk")
  &clk_itr_length=STRING.LENGTH("gcc_snoc_cnoc_ahb_clk")

  if (STRING.SCAN("&clk", "*", 0)==0)
  (
    &wild_head=1
  )
  if (STRING.SCAN("&clk", "*", 1)==(STRING.LENGTH("&clk")-1))
  (
    &wild_tail=1
  )

  if ((&wild_head==1)&&(&wild_tail==1))
  (
    if (STRING.SCAN("gcc_snoc_cnoc_ahb_clk", STRING.MID("&clk", 1, &clk_input_length-2), 0)!=-1)
    ( 
      &match=1
    )
  )
  else if (&wild_head==1)
  (
    if (STRING.MID("gcc_snoc_cnoc_ahb_clk", &clk_itr_length-&clk_input_length+1, &clk_input_length-1)==STRING.CUT("&clk", 1))
    ( 
      &match=1
    )
  )
  else if (&wild_tail==1)
  (
    if (STRING.MID("gcc_snoc_cnoc_ahb_clk", 0, &clk_input_length-1)==STRING.CUT("&clk", -1))
    ( 
      &match=1
    )
  )	  
  else if ("gcc_snoc_cnoc_ahb_clk"=="&clk")
  (
    &match=1
  )
  
  if (&match==1)
  (
    &clk_test=&CLK_TEST_GCC_SNOC_CNOC_AHB_CLK
    &clk_reg=&HWIO_GCC_SNOC_CNOC_AHB_CBCR_ADDR
    &clk_reg_name="GCC_SNOC_CNOC_AHB_CBCR"
    &clk_name="gcc_snoc_cnoc_ahb_clk"
    &clk_reg_cbcr_type="sm_cbc"

    gosub Print_Clk_Info_Line
  )

  &match=0
  &wild_head=0
  &wild_tail=0
  &clk_input_length=STRING.LENGTH("&clk")
  &clk_itr_length=STRING.LENGTH("gcc_spdm_cfg_ahb_clk")

  if (STRING.SCAN("&clk", "*", 0)==0)
  (
    &wild_head=1
  )
  if (STRING.SCAN("&clk", "*", 1)==(STRING.LENGTH("&clk")-1))
  (
    &wild_tail=1
  )

  if ((&wild_head==1)&&(&wild_tail==1))
  (
    if (STRING.SCAN("gcc_spdm_cfg_ahb_clk", STRING.MID("&clk", 1, &clk_input_length-2), 0)!=-1)
    ( 
      &match=1
    )
  )
  else if (&wild_head==1)
  (
    if (STRING.MID("gcc_spdm_cfg_ahb_clk", &clk_itr_length-&clk_input_length+1, &clk_input_length-1)==STRING.CUT("&clk", 1))
    ( 
      &match=1
    )
  )
  else if (&wild_tail==1)
  (
    if (STRING.MID("gcc_spdm_cfg_ahb_clk", 0, &clk_input_length-1)==STRING.CUT("&clk", -1))
    ( 
      &match=1
    )
  )	  
  else if ("gcc_spdm_cfg_ahb_clk"=="&clk")
  (
    &match=1
  )
  
  if (&match==1)
  (
    &clk_test=&CLK_TEST_GCC_SPDM_CFG_AHB_CLK
    &clk_reg=&HWIO_GCC_SPDM_CFG_AHB_CBCR_ADDR
    &clk_reg_name="GCC_SPDM_CFG_AHB_CBCR"
    &clk_name="gcc_spdm_cfg_ahb_clk"
    &clk_reg_cbcr_type="sm_cbc"

    gosub Print_Clk_Info_Line
  )

  &match=0
  &wild_head=0
  &wild_tail=0
  &clk_input_length=STRING.LENGTH("&clk")
  &clk_itr_length=STRING.LENGTH("gcc_spdm_mstr_ahb_clk")

  if (STRING.SCAN("&clk", "*", 0)==0)
  (
    &wild_head=1
  )
  if (STRING.SCAN("&clk", "*", 1)==(STRING.LENGTH("&clk")-1))
  (
    &wild_tail=1
  )

  if ((&wild_head==1)&&(&wild_tail==1))
  (
    if (STRING.SCAN("gcc_spdm_mstr_ahb_clk", STRING.MID("&clk", 1, &clk_input_length-2), 0)!=-1)
    ( 
      &match=1
    )
  )
  else if (&wild_head==1)
  (
    if (STRING.MID("gcc_spdm_mstr_ahb_clk", &clk_itr_length-&clk_input_length+1, &clk_input_length-1)==STRING.CUT("&clk", 1))
    ( 
      &match=1
    )
  )
  else if (&wild_tail==1)
  (
    if (STRING.MID("gcc_spdm_mstr_ahb_clk", 0, &clk_input_length-1)==STRING.CUT("&clk", -1))
    ( 
      &match=1
    )
  )	  
  else if ("gcc_spdm_mstr_ahb_clk"=="&clk")
  (
    &match=1
  )
  
  if (&match==1)
  (
    &clk_test=&CLK_TEST_GCC_SPDM_MSTR_AHB_CLK
    &clk_reg=&HWIO_GCC_SPDM_MSTR_AHB_CBCR_ADDR
    &clk_reg_name="GCC_SPDM_MSTR_AHB_CBCR"
    &clk_name="gcc_spdm_mstr_ahb_clk"
    &clk_reg_cbcr_type="sm_cbc"

    gosub Print_Clk_Info_Line
  )

  &match=0
  &wild_head=0
  &wild_tail=0
  &clk_input_length=STRING.LENGTH("&clk")
  &clk_itr_length=STRING.LENGTH("gcc_spmi_cnoc_ahb_clk")

  if (STRING.SCAN("&clk", "*", 0)==0)
  (
    &wild_head=1
  )
  if (STRING.SCAN("&clk", "*", 1)==(STRING.LENGTH("&clk")-1))
  (
    &wild_tail=1
  )

  if ((&wild_head==1)&&(&wild_tail==1))
  (
    if (STRING.SCAN("gcc_spmi_cnoc_ahb_clk", STRING.MID("&clk", 1, &clk_input_length-2), 0)!=-1)
    ( 
      &match=1
    )
  )
  else if (&wild_head==1)
  (
    if (STRING.MID("gcc_spmi_cnoc_ahb_clk", &clk_itr_length-&clk_input_length+1, &clk_input_length-1)==STRING.CUT("&clk", 1))
    ( 
      &match=1
    )
  )
  else if (&wild_tail==1)
  (
    if (STRING.MID("gcc_spmi_cnoc_ahb_clk", 0, &clk_input_length-1)==STRING.CUT("&clk", -1))
    ( 
      &match=1
    )
  )	  
  else if ("gcc_spmi_cnoc_ahb_clk"=="&clk")
  (
    &match=1
  )
  
  if (&match==1)
  (
    &clk_test=&CLK_TEST_GCC_SPMI_CNOC_AHB_CLK
    &clk_reg=&HWIO_GCC_SPMI_CNOC_AHB_CBCR_ADDR
    &clk_reg_name="GCC_SPMI_CNOC_AHB_CBCR"
    &clk_name="gcc_spmi_cnoc_ahb_clk"
    &clk_reg_cbcr_type="sm_cbc"

    gosub Print_Clk_Info_Line
  )

  &match=0
  &wild_head=0
  &wild_tail=0
  &clk_input_length=STRING.LENGTH("&clk")
  &clk_itr_length=STRING.LENGTH("gcc_tcsr_ahb_clk")

  if (STRING.SCAN("&clk", "*", 0)==0)
  (
    &wild_head=1
  )
  if (STRING.SCAN("&clk", "*", 1)==(STRING.LENGTH("&clk")-1))
  (
    &wild_tail=1
  )

  if ((&wild_head==1)&&(&wild_tail==1))
  (
    if (STRING.SCAN("gcc_tcsr_ahb_clk", STRING.MID("&clk", 1, &clk_input_length-2), 0)!=-1)
    ( 
      &match=1
    )
  )
  else if (&wild_head==1)
  (
    if (STRING.MID("gcc_tcsr_ahb_clk", &clk_itr_length-&clk_input_length+1, &clk_input_length-1)==STRING.CUT("&clk", 1))
    ( 
      &match=1
    )
  )
  else if (&wild_tail==1)
  (
    if (STRING.MID("gcc_tcsr_ahb_clk", 0, &clk_input_length-1)==STRING.CUT("&clk", -1))
    ( 
      &match=1
    )
  )	  
  else if ("gcc_tcsr_ahb_clk"=="&clk")
  (
    &match=1
  )
  
  if (&match==1)
  (
    &clk_test=&CLK_TEST_GCC_TCSR_AHB_CLK
    &clk_reg=&HWIO_GCC_TCSR_AHB_CBCR_ADDR
    &clk_reg_name="GCC_TCSR_AHB_CBCR"
    &clk_name="gcc_tcsr_ahb_clk"
    &clk_reg_cbcr_type="sm_cbc"

    gosub Print_Clk_Info_Line
  )

  &match=0
  &wild_head=0
  &wild_tail=0
  &clk_input_length=STRING.LENGTH("&clk")
  &clk_itr_length=STRING.LENGTH("gcc_tlmm_ahb_clk")

  if (STRING.SCAN("&clk", "*", 0)==0)
  (
    &wild_head=1
  )
  if (STRING.SCAN("&clk", "*", 1)==(STRING.LENGTH("&clk")-1))
  (
    &wild_tail=1
  )

  if ((&wild_head==1)&&(&wild_tail==1))
  (
    if (STRING.SCAN("gcc_tlmm_ahb_clk", STRING.MID("&clk", 1, &clk_input_length-2), 0)!=-1)
    ( 
      &match=1
    )
  )
  else if (&wild_head==1)
  (
    if (STRING.MID("gcc_tlmm_ahb_clk", &clk_itr_length-&clk_input_length+1, &clk_input_length-1)==STRING.CUT("&clk", 1))
    ( 
      &match=1
    )
  )
  else if (&wild_tail==1)
  (
    if (STRING.MID("gcc_tlmm_ahb_clk", 0, &clk_input_length-1)==STRING.CUT("&clk", -1))
    ( 
      &match=1
    )
  )	  
  else if ("gcc_tlmm_ahb_clk"=="&clk")
  (
    &match=1
  )
  
  if (&match==1)
  (
    &clk_test=&CLK_TEST_GCC_TLMM_AHB_CLK
    &clk_reg=&HWIO_GCC_TLMM_AHB_CBCR_ADDR
    &clk_reg_name="GCC_TLMM_AHB_CBCR"
    &clk_name="gcc_tlmm_ahb_clk"
    &clk_reg_cbcr_type="sm_cbc"

    gosub Print_Clk_Info_Line
  )

  &match=0
  &wild_head=0
  &wild_tail=0
  &clk_input_length=STRING.LENGTH("&clk")
  &clk_itr_length=STRING.LENGTH("gcc_tlmm_clk")

  if (STRING.SCAN("&clk", "*", 0)==0)
  (
    &wild_head=1
  )
  if (STRING.SCAN("&clk", "*", 1)==(STRING.LENGTH("&clk")-1))
  (
    &wild_tail=1
  )

  if ((&wild_head==1)&&(&wild_tail==1))
  (
    if (STRING.SCAN("gcc_tlmm_clk", STRING.MID("&clk", 1, &clk_input_length-2), 0)!=-1)
    ( 
      &match=1
    )
  )
  else if (&wild_head==1)
  (
    if (STRING.MID("gcc_tlmm_clk", &clk_itr_length-&clk_input_length+1, &clk_input_length-1)==STRING.CUT("&clk", 1))
    ( 
      &match=1
    )
  )
  else if (&wild_tail==1)
  (
    if (STRING.MID("gcc_tlmm_clk", 0, &clk_input_length-1)==STRING.CUT("&clk", -1))
    ( 
      &match=1
    )
  )	  
  else if ("gcc_tlmm_clk"=="&clk")
  (
    &match=1
  )
  
  if (&match==1)
  (
    &clk_test=&CLK_TEST_GCC_TLMM_CLK
    &clk_reg=&HWIO_GCC_TLMM_CBCR_ADDR
    &clk_reg_name="GCC_TLMM_CBCR"
    &clk_name="gcc_tlmm_clk"
    &clk_reg_cbcr_type="sm_cbc"

    gosub Print_Clk_Info_Line
  )

  &match=0
  &wild_head=0
  &wild_tail=0
  &clk_input_length=STRING.LENGTH("&clk")
  &clk_itr_length=STRING.LENGTH("gcc_ufs_ahb_clk")

  if (STRING.SCAN("&clk", "*", 0)==0)
  (
    &wild_head=1
  )
  if (STRING.SCAN("&clk", "*", 1)==(STRING.LENGTH("&clk")-1))
  (
    &wild_tail=1
  )

  if ((&wild_head==1)&&(&wild_tail==1))
  (
    if (STRING.SCAN("gcc_ufs_ahb_clk", STRING.MID("&clk", 1, &clk_input_length-2), 0)!=-1)
    ( 
      &match=1
    )
  )
  else if (&wild_head==1)
  (
    if (STRING.MID("gcc_ufs_ahb_clk", &clk_itr_length-&clk_input_length+1, &clk_input_length-1)==STRING.CUT("&clk", 1))
    ( 
      &match=1
    )
  )
  else if (&wild_tail==1)
  (
    if (STRING.MID("gcc_ufs_ahb_clk", 0, &clk_input_length-1)==STRING.CUT("&clk", -1))
    ( 
      &match=1
    )
  )	  
  else if ("gcc_ufs_ahb_clk"=="&clk")
  (
    &match=1
  )
  
  if (&match==1)
  (
    &clk_test=&CLK_TEST_GCC_UFS_AHB_CLK
    &clk_reg=&HWIO_GCC_UFS_AHB_CBCR_ADDR
    &clk_reg_name="GCC_UFS_AHB_CBCR"
    &clk_name="gcc_ufs_ahb_clk"
    &clk_reg_cbcr_type="sm_cbc"

    gosub Print_Clk_Info_Line
  )

  &match=0
  &wild_head=0
  &wild_tail=0
  &clk_input_length=STRING.LENGTH("&clk")
  &clk_itr_length=STRING.LENGTH("gcc_dcd_xo_clk")

  if (STRING.SCAN("&clk", "*", 0)==0)
  (
    &wild_head=1
  )
  if (STRING.SCAN("&clk", "*", 1)==(STRING.LENGTH("&clk")-1))
  (
    &wild_tail=1
  )

  if ((&wild_head==1)&&(&wild_tail==1))
  (
    if (STRING.SCAN("gcc_dcd_xo_clk", STRING.MID("&clk", 1, &clk_input_length-2), 0)!=-1)
    ( 
      &match=1
    )
  )
  else if (&wild_head==1)
  (
    if (STRING.MID("gcc_dcd_xo_clk", &clk_itr_length-&clk_input_length+1, &clk_input_length-1)==STRING.CUT("&clk", 1))
    ( 
      &match=1
    )
  )
  else if (&wild_tail==1)
  (
    if (STRING.MID("gcc_dcd_xo_clk", 0, &clk_input_length-1)==STRING.CUT("&clk", -1))
    ( 
      &match=1
    )
  )	  
  else if ("gcc_dcd_xo_clk"=="&clk")
  (
    &match=1
  )
  
  if (&match==1)
  (
    &clk_test=&CLK_TEST_GCC_DCD_XO_CLK
    &clk_reg=&HWIO_GCC_DCD_XO_CBCR_ADDR
    &clk_reg_name="GCC_DCD_XO_CBCR"
    &clk_name="gcc_dcd_xo_clk"
    &clk_reg_cbcr_type="sm_cbc"

    gosub Print_Clk_Info_Line
  )

  &match=0
  &wild_head=0
  &wild_tail=0
  &clk_input_length=STRING.LENGTH("&clk")
  &clk_itr_length=STRING.LENGTH("gcc_bam_dma_inactivity_timers_clk")

  if (STRING.SCAN("&clk", "*", 0)==0)
  (
    &wild_head=1
  )
  if (STRING.SCAN("&clk", "*", 1)==(STRING.LENGTH("&clk")-1))
  (
    &wild_tail=1
  )

  if ((&wild_head==1)&&(&wild_tail==1))
  (
    if (STRING.SCAN("gcc_bam_dma_inactivity_timers_clk", STRING.MID("&clk", 1, &clk_input_length-2), 0)!=-1)
    ( 
      &match=1
    )
  )
  else if (&wild_head==1)
  (
    if (STRING.MID("gcc_bam_dma_inactivity_timers_clk", &clk_itr_length-&clk_input_length+1, &clk_input_length-1)==STRING.CUT("&clk", 1))
    ( 
      &match=1
    )
  )
  else if (&wild_tail==1)
  (
    if (STRING.MID("gcc_bam_dma_inactivity_timers_clk", 0, &clk_input_length-1)==STRING.CUT("&clk", -1))
    ( 
      &match=1
    )
  )	  
  else if ("gcc_bam_dma_inactivity_timers_clk"=="&clk")
  (
    &match=1
  )
  
  if (&match==1)
  (
    &clk_test=&CLK_TEST_GCC_BAM_DMA_INACTIVITY_TIMERS_CLK
    &clk_reg=&HWIO_GCC_BAM_DMA_INACTIVITY_TIMERS_CBCR_ADDR
    &clk_reg_name="GCC_BAM_DMA_INACTIVITY_TIMERS_CBCR"
    &clk_name="gcc_bam_dma_inactivity_timers_clk"
    &clk_reg_cbcr_type="sm_cbc"

    gosub Print_Clk_Info_Line
  )

  &match=0
  &wild_head=0
  &wild_tail=0
  &clk_input_length=STRING.LENGTH("&clk")
  &clk_itr_length=STRING.LENGTH("gcc_bimc_sleep_clk")

  if (STRING.SCAN("&clk", "*", 0)==0)
  (
    &wild_head=1
  )
  if (STRING.SCAN("&clk", "*", 1)==(STRING.LENGTH("&clk")-1))
  (
    &wild_tail=1
  )

  if ((&wild_head==1)&&(&wild_tail==1))
  (
    if (STRING.SCAN("gcc_bimc_sleep_clk", STRING.MID("&clk", 1, &clk_input_length-2), 0)!=-1)
    ( 
      &match=1
    )
  )
  else if (&wild_head==1)
  (
    if (STRING.MID("gcc_bimc_sleep_clk", &clk_itr_length-&clk_input_length+1, &clk_input_length-1)==STRING.CUT("&clk", 1))
    ( 
      &match=1
    )
  )
  else if (&wild_tail==1)
  (
    if (STRING.MID("gcc_bimc_sleep_clk", 0, &clk_input_length-1)==STRING.CUT("&clk", -1))
    ( 
      &match=1
    )
  )	  
  else if ("gcc_bimc_sleep_clk"=="&clk")
  (
    &match=1
  )
  
  if (&match==1)
  (
    &clk_test=&CLK_TEST_GCC_BIMC_SLEEP_CLK
    &clk_reg=&HWIO_GCC_BIMC_SLEEP_CBCR_ADDR
    &clk_reg_name="GCC_BIMC_SLEEP_CBCR"
    &clk_name="gcc_bimc_sleep_clk"
    &clk_reg_cbcr_type="sm_cbc"

    gosub Print_Clk_Info_Line
  )

  &match=0
  &wild_head=0
  &wild_tail=0
  &clk_input_length=STRING.LENGTH("&clk")
  &clk_itr_length=STRING.LENGTH("gcc_blsp1_sleep_clk")

  if (STRING.SCAN("&clk", "*", 0)==0)
  (
    &wild_head=1
  )
  if (STRING.SCAN("&clk", "*", 1)==(STRING.LENGTH("&clk")-1))
  (
    &wild_tail=1
  )

  if ((&wild_head==1)&&(&wild_tail==1))
  (
    if (STRING.SCAN("gcc_blsp1_sleep_clk", STRING.MID("&clk", 1, &clk_input_length-2), 0)!=-1)
    ( 
      &match=1
    )
  )
  else if (&wild_head==1)
  (
    if (STRING.MID("gcc_blsp1_sleep_clk", &clk_itr_length-&clk_input_length+1, &clk_input_length-1)==STRING.CUT("&clk", 1))
    ( 
      &match=1
    )
  )
  else if (&wild_tail==1)
  (
    if (STRING.MID("gcc_blsp1_sleep_clk", 0, &clk_input_length-1)==STRING.CUT("&clk", -1))
    ( 
      &match=1
    )
  )	  
  else if ("gcc_blsp1_sleep_clk"=="&clk")
  (
    &match=1
  )
  
  if (&match==1)
  (
    &clk_test=&CLK_TEST_GCC_BLSP1_SLEEP_CLK
    &clk_reg=&HWIO_GCC_BLSP1_SLEEP_CBCR_ADDR
    &clk_reg_name="GCC_BLSP1_SLEEP_CBCR"
    &clk_name="gcc_blsp1_sleep_clk"
    &clk_reg_cbcr_type="sm_cbc"

    gosub Print_Clk_Info_Line
  )

  &match=0
  &wild_head=0
  &wild_tail=0
  &clk_input_length=STRING.LENGTH("&clk")
  &clk_itr_length=STRING.LENGTH("gcc_blsp2_sleep_clk")

  if (STRING.SCAN("&clk", "*", 0)==0)
  (
    &wild_head=1
  )
  if (STRING.SCAN("&clk", "*", 1)==(STRING.LENGTH("&clk")-1))
  (
    &wild_tail=1
  )

  if ((&wild_head==1)&&(&wild_tail==1))
  (
    if (STRING.SCAN("gcc_blsp2_sleep_clk", STRING.MID("&clk", 1, &clk_input_length-2), 0)!=-1)
    ( 
      &match=1
    )
  )
  else if (&wild_head==1)
  (
    if (STRING.MID("gcc_blsp2_sleep_clk", &clk_itr_length-&clk_input_length+1, &clk_input_length-1)==STRING.CUT("&clk", 1))
    ( 
      &match=1
    )
  )
  else if (&wild_tail==1)
  (
    if (STRING.MID("gcc_blsp2_sleep_clk", 0, &clk_input_length-1)==STRING.CUT("&clk", -1))
    ( 
      &match=1
    )
  )	  
  else if ("gcc_blsp2_sleep_clk"=="&clk")
  (
    &match=1
  )
  
  if (&match==1)
  (
    &clk_test=&CLK_TEST_GCC_BLSP2_SLEEP_CLK
    &clk_reg=&HWIO_GCC_BLSP2_SLEEP_CBCR_ADDR
    &clk_reg_name="GCC_BLSP2_SLEEP_CBCR"
    &clk_name="gcc_blsp2_sleep_clk"
    &clk_reg_cbcr_type="sm_cbc"

    gosub Print_Clk_Info_Line
  )

  &match=0
  &wild_head=0
  &wild_tail=0
  &clk_input_length=STRING.LENGTH("&clk")
  &clk_itr_length=STRING.LENGTH("gcc_ddr_dim_sleep_clk")

  if (STRING.SCAN("&clk", "*", 0)==0)
  (
    &wild_head=1
  )
  if (STRING.SCAN("&clk", "*", 1)==(STRING.LENGTH("&clk")-1))
  (
    &wild_tail=1
  )

  if ((&wild_head==1)&&(&wild_tail==1))
  (
    if (STRING.SCAN("gcc_ddr_dim_sleep_clk", STRING.MID("&clk", 1, &clk_input_length-2), 0)!=-1)
    ( 
      &match=1
    )
  )
  else if (&wild_head==1)
  (
    if (STRING.MID("gcc_ddr_dim_sleep_clk", &clk_itr_length-&clk_input_length+1, &clk_input_length-1)==STRING.CUT("&clk", 1))
    ( 
      &match=1
    )
  )
  else if (&wild_tail==1)
  (
    if (STRING.MID("gcc_ddr_dim_sleep_clk", 0, &clk_input_length-1)==STRING.CUT("&clk", -1))
    ( 
      &match=1
    )
  )	  
  else if ("gcc_ddr_dim_sleep_clk"=="&clk")
  (
    &match=1
  )
  
  if (&match==1)
  (
    &clk_test=&CLK_TEST_GCC_DDR_DIM_SLEEP_CLK
    &clk_reg=&HWIO_GCC_DDR_DIM_SLEEP_CBCR_ADDR
    &clk_reg_name="GCC_DDR_DIM_SLEEP_CBCR"
    &clk_name="gcc_ddr_dim_sleep_clk"
    &clk_reg_cbcr_type="sm_cbc"

    gosub Print_Clk_Info_Line
  )

  &match=0
  &wild_head=0
  &wild_tail=0
  &clk_input_length=STRING.LENGTH("&clk")
  &clk_itr_length=STRING.LENGTH("gcc_im_sleep_clk")

  if (STRING.SCAN("&clk", "*", 0)==0)
  (
    &wild_head=1
  )
  if (STRING.SCAN("&clk", "*", 1)==(STRING.LENGTH("&clk")-1))
  (
    &wild_tail=1
  )

  if ((&wild_head==1)&&(&wild_tail==1))
  (
    if (STRING.SCAN("gcc_im_sleep_clk", STRING.MID("&clk", 1, &clk_input_length-2), 0)!=-1)
    ( 
      &match=1
    )
  )
  else if (&wild_head==1)
  (
    if (STRING.MID("gcc_im_sleep_clk", &clk_itr_length-&clk_input_length+1, &clk_input_length-1)==STRING.CUT("&clk", 1))
    ( 
      &match=1
    )
  )
  else if (&wild_tail==1)
  (
    if (STRING.MID("gcc_im_sleep_clk", 0, &clk_input_length-1)==STRING.CUT("&clk", -1))
    ( 
      &match=1
    )
  )	  
  else if ("gcc_im_sleep_clk"=="&clk")
  (
    &match=1
  )
  
  if (&match==1)
  (
    &clk_test=&CLK_TEST_GCC_IM_SLEEP_CLK
    &clk_reg=&HWIO_GCC_GCC_IM_SLEEP_CBCR_ADDR
    &clk_reg_name="GCC_GCC_IM_SLEEP_CBCR"
    &clk_name="gcc_im_sleep_clk"
    &clk_reg_cbcr_type="sm_cbc"

    gosub Print_Clk_Info_Line
  )

  &match=0
  &wild_head=0
  &wild_tail=0
  &clk_input_length=STRING.LENGTH("&clk")
  &clk_itr_length=STRING.LENGTH("gcc_ipa_sleep_clk")

  if (STRING.SCAN("&clk", "*", 0)==0)
  (
    &wild_head=1
  )
  if (STRING.SCAN("&clk", "*", 1)==(STRING.LENGTH("&clk")-1))
  (
    &wild_tail=1
  )

  if ((&wild_head==1)&&(&wild_tail==1))
  (
    if (STRING.SCAN("gcc_ipa_sleep_clk", STRING.MID("&clk", 1, &clk_input_length-2), 0)!=-1)
    ( 
      &match=1
    )
  )
  else if (&wild_head==1)
  (
    if (STRING.MID("gcc_ipa_sleep_clk", &clk_itr_length-&clk_input_length+1, &clk_input_length-1)==STRING.CUT("&clk", 1))
    ( 
      &match=1
    )
  )
  else if (&wild_tail==1)
  (
    if (STRING.MID("gcc_ipa_sleep_clk", 0, &clk_input_length-1)==STRING.CUT("&clk", -1))
    ( 
      &match=1
    )
  )	  
  else if ("gcc_ipa_sleep_clk"=="&clk")
  (
    &match=1
  )
  
  if (&match==1)
  (
    &clk_test=&CLK_TEST_GCC_IPA_SLEEP_CLK
    &clk_reg=&HWIO_GCC_IPA_SLEEP_CBCR_ADDR
    &clk_reg_name="GCC_IPA_SLEEP_CBCR"
    &clk_name="gcc_ipa_sleep_clk"
    &clk_reg_cbcr_type="sm_cbc"

    gosub Print_Clk_Info_Line
  )

  &match=0
  &wild_head=0
  &wild_tail=0
  &clk_input_length=STRING.LENGTH("&clk")
  &clk_itr_length=STRING.LENGTH("gcc_rpm_sleep_clk")

  if (STRING.SCAN("&clk", "*", 0)==0)
  (
    &wild_head=1
  )
  if (STRING.SCAN("&clk", "*", 1)==(STRING.LENGTH("&clk")-1))
  (
    &wild_tail=1
  )

  if ((&wild_head==1)&&(&wild_tail==1))
  (
    if (STRING.SCAN("gcc_rpm_sleep_clk", STRING.MID("&clk", 1, &clk_input_length-2), 0)!=-1)
    ( 
      &match=1
    )
  )
  else if (&wild_head==1)
  (
    if (STRING.MID("gcc_rpm_sleep_clk", &clk_itr_length-&clk_input_length+1, &clk_input_length-1)==STRING.CUT("&clk", 1))
    ( 
      &match=1
    )
  )
  else if (&wild_tail==1)
  (
    if (STRING.MID("gcc_rpm_sleep_clk", 0, &clk_input_length-1)==STRING.CUT("&clk", -1))
    ( 
      &match=1
    )
  )	  
  else if ("gcc_rpm_sleep_clk"=="&clk")
  (
    &match=1
  )
  
  if (&match==1)
  (
    &clk_test=&CLK_TEST_GCC_RPM_SLEEP_CLK
    &clk_reg=&HWIO_GCC_RPM_SLEEP_CBCR_ADDR
    &clk_reg_name="GCC_RPM_SLEEP_CBCR"
    &clk_name="gcc_rpm_sleep_clk"
    &clk_reg_cbcr_type="sm_cbc"

    gosub Print_Clk_Info_Line
  )

  &match=0
  &wild_head=0
  &wild_tail=0
  &clk_input_length=STRING.LENGTH("&clk")
  &clk_itr_length=STRING.LENGTH("gcc_tsif_inactivity_timers_clk")

  if (STRING.SCAN("&clk", "*", 0)==0)
  (
    &wild_head=1
  )
  if (STRING.SCAN("&clk", "*", 1)==(STRING.LENGTH("&clk")-1))
  (
    &wild_tail=1
  )

  if ((&wild_head==1)&&(&wild_tail==1))
  (
    if (STRING.SCAN("gcc_tsif_inactivity_timers_clk", STRING.MID("&clk", 1, &clk_input_length-2), 0)!=-1)
    ( 
      &match=1
    )
  )
  else if (&wild_head==1)
  (
    if (STRING.MID("gcc_tsif_inactivity_timers_clk", &clk_itr_length-&clk_input_length+1, &clk_input_length-1)==STRING.CUT("&clk", 1))
    ( 
      &match=1
    )
  )
  else if (&wild_tail==1)
  (
    if (STRING.MID("gcc_tsif_inactivity_timers_clk", 0, &clk_input_length-1)==STRING.CUT("&clk", -1))
    ( 
      &match=1
    )
  )	  
  else if ("gcc_tsif_inactivity_timers_clk"=="&clk")
  (
    &match=1
  )
  
  if (&match==1)
  (
    &clk_test=&CLK_TEST_GCC_TSIF_INACTIVITY_TIMERS_CLK
    &clk_reg=&HWIO_GCC_TSIF_INACTIVITY_TIMERS_CBCR_ADDR
    &clk_reg_name="GCC_TSIF_INACTIVITY_TIMERS_CBCR"
    &clk_name="gcc_tsif_inactivity_timers_clk"
    &clk_reg_cbcr_type="sm_cbc"

    gosub Print_Clk_Info_Line
  )

  &match=0
  &wild_head=0
  &wild_tail=0
  &clk_input_length=STRING.LENGTH("&clk")
  &clk_itr_length=STRING.LENGTH("gcc_usb2_hs_phy_sleep_clk")

  if (STRING.SCAN("&clk", "*", 0)==0)
  (
    &wild_head=1
  )
  if (STRING.SCAN("&clk", "*", 1)==(STRING.LENGTH("&clk")-1))
  (
    &wild_tail=1
  )

  if ((&wild_head==1)&&(&wild_tail==1))
  (
    if (STRING.SCAN("gcc_usb2_hs_phy_sleep_clk", STRING.MID("&clk", 1, &clk_input_length-2), 0)!=-1)
    ( 
      &match=1
    )
  )
  else if (&wild_head==1)
  (
    if (STRING.MID("gcc_usb2_hs_phy_sleep_clk", &clk_itr_length-&clk_input_length+1, &clk_input_length-1)==STRING.CUT("&clk", 1))
    ( 
      &match=1
    )
  )
  else if (&wild_tail==1)
  (
    if (STRING.MID("gcc_usb2_hs_phy_sleep_clk", 0, &clk_input_length-1)==STRING.CUT("&clk", -1))
    ( 
      &match=1
    )
  )	  
  else if ("gcc_usb2_hs_phy_sleep_clk"=="&clk")
  (
    &match=1
  )
  
  if (&match==1)
  (
    &clk_test=&CLK_TEST_GCC_USB2_HS_PHY_SLEEP_CLK
    &clk_reg=&HWIO_GCC_USB2_HS_PHY_SLEEP_CBCR_ADDR
    &clk_reg_name="GCC_USB2_HS_PHY_SLEEP_CBCR"
    &clk_name="gcc_usb2_hs_phy_sleep_clk"
    &clk_reg_cbcr_type="sm_cbc"

    gosub Print_Clk_Info_Line
  )

  &match=0
  &wild_head=0
  &wild_tail=0
  &clk_input_length=STRING.LENGTH("&clk")
  &clk_itr_length=STRING.LENGTH("gcc_usb30_sleep_clk")

  if (STRING.SCAN("&clk", "*", 0)==0)
  (
    &wild_head=1
  )
  if (STRING.SCAN("&clk", "*", 1)==(STRING.LENGTH("&clk")-1))
  (
    &wild_tail=1
  )

  if ((&wild_head==1)&&(&wild_tail==1))
  (
    if (STRING.SCAN("gcc_usb30_sleep_clk", STRING.MID("&clk", 1, &clk_input_length-2), 0)!=-1)
    ( 
      &match=1
    )
  )
  else if (&wild_head==1)
  (
    if (STRING.MID("gcc_usb30_sleep_clk", &clk_itr_length-&clk_input_length+1, &clk_input_length-1)==STRING.CUT("&clk", 1))
    ( 
      &match=1
    )
  )
  else if (&wild_tail==1)
  (
    if (STRING.MID("gcc_usb30_sleep_clk", 0, &clk_input_length-1)==STRING.CUT("&clk", -1))
    ( 
      &match=1
    )
  )	  
  else if ("gcc_usb30_sleep_clk"=="&clk")
  (
    &match=1
  )
  
  if (&match==1)
  (
    &clk_test=&CLK_TEST_GCC_USB30_SLEEP_CLK
    &clk_reg=&HWIO_GCC_USB30_SLEEP_CBCR_ADDR
    &clk_reg_name="GCC_USB30_SLEEP_CBCR"
    &clk_name="gcc_usb30_sleep_clk"
    &clk_reg_cbcr_type="sm_cbc"

    gosub Print_Clk_Info_Line
  )

  &match=0
  &wild_head=0
  &wild_tail=0
  &clk_input_length=STRING.LENGTH("&clk")
  &clk_itr_length=STRING.LENGTH("gcc_usb_hs_inactivity_timers_clk")

  if (STRING.SCAN("&clk", "*", 0)==0)
  (
    &wild_head=1
  )
  if (STRING.SCAN("&clk", "*", 1)==(STRING.LENGTH("&clk")-1))
  (
    &wild_tail=1
  )

  if ((&wild_head==1)&&(&wild_tail==1))
  (
    if (STRING.SCAN("gcc_usb_hs_inactivity_timers_clk", STRING.MID("&clk", 1, &clk_input_length-2), 0)!=-1)
    ( 
      &match=1
    )
  )
  else if (&wild_head==1)
  (
    if (STRING.MID("gcc_usb_hs_inactivity_timers_clk", &clk_itr_length-&clk_input_length+1, &clk_input_length-1)==STRING.CUT("&clk", 1))
    ( 
      &match=1
    )
  )
  else if (&wild_tail==1)
  (
    if (STRING.MID("gcc_usb_hs_inactivity_timers_clk", 0, &clk_input_length-1)==STRING.CUT("&clk", -1))
    ( 
      &match=1
    )
  )	  
  else if ("gcc_usb_hs_inactivity_timers_clk"=="&clk")
  (
    &match=1
  )
  
  if (&match==1)
  (
    &clk_test=&CLK_TEST_GCC_USB_HS_INACTIVITY_TIMERS_CLK
    &clk_reg=&HWIO_GCC_USB_HS_INACTIVITY_TIMERS_CBCR_ADDR
    &clk_reg_name="GCC_USB_HS_INACTIVITY_TIMERS_CBCR"
    &clk_name="gcc_usb_hs_inactivity_timers_clk"
    &clk_reg_cbcr_type="sm_cbc"

    gosub Print_Clk_Info_Line
  )

  &match=0
  &wild_head=0
  &wild_tail=0
  &clk_input_length=STRING.LENGTH("&clk")
  &clk_itr_length=STRING.LENGTH("gcc_xo_clk")

  if (STRING.SCAN("&clk", "*", 0)==0)
  (
    &wild_head=1
  )
  if (STRING.SCAN("&clk", "*", 1)==(STRING.LENGTH("&clk")-1))
  (
    &wild_tail=1
  )

  if ((&wild_head==1)&&(&wild_tail==1))
  (
    if (STRING.SCAN("gcc_xo_clk", STRING.MID("&clk", 1, &clk_input_length-2), 0)!=-1)
    ( 
      &match=1
    )
  )
  else if (&wild_head==1)
  (
    if (STRING.MID("gcc_xo_clk", &clk_itr_length-&clk_input_length+1, &clk_input_length-1)==STRING.CUT("&clk", 1))
    ( 
      &match=1
    )
  )
  else if (&wild_tail==1)
  (
    if (STRING.MID("gcc_xo_clk", 0, &clk_input_length-1)==STRING.CUT("&clk", -1))
    ( 
      &match=1
    )
  )	  
  else if ("gcc_xo_clk"=="&clk")
  (
    &match=1
  )
  
  if (&match==1)
  (
    &clk_test=&CLK_TEST_GCC_XO_CLK
    &clk_reg=&HWIO_GCC_GCC_XO_CBCR_ADDR
    &clk_reg_name="GCC_GCC_XO_CBCR"
    &clk_name="gcc_xo_clk"
    &clk_reg_cbcr_type="sm_cbc"

    gosub Print_Clk_Info_Line
  )

  &match=0
  &wild_head=0
  &wild_tail=0
  &clk_input_length=STRING.LENGTH("&clk")
  &clk_itr_length=STRING.LENGTH("gcc_xo_div4_clk")

  if (STRING.SCAN("&clk", "*", 0)==0)
  (
    &wild_head=1
  )
  if (STRING.SCAN("&clk", "*", 1)==(STRING.LENGTH("&clk")-1))
  (
    &wild_tail=1
  )

  if ((&wild_head==1)&&(&wild_tail==1))
  (
    if (STRING.SCAN("gcc_xo_div4_clk", STRING.MID("&clk", 1, &clk_input_length-2), 0)!=-1)
    ( 
      &match=1
    )
  )
  else if (&wild_head==1)
  (
    if (STRING.MID("gcc_xo_div4_clk", &clk_itr_length-&clk_input_length+1, &clk_input_length-1)==STRING.CUT("&clk", 1))
    ( 
      &match=1
    )
  )
  else if (&wild_tail==1)
  (
    if (STRING.MID("gcc_xo_div4_clk", 0, &clk_input_length-1)==STRING.CUT("&clk", -1))
    ( 
      &match=1
    )
  )	  
  else if ("gcc_xo_div4_clk"=="&clk")
  (
    &match=1
  )
  
  if (&match==1)
  (
    &clk_test=&CLK_TEST_GCC_XO_DIV4_CLK
    &clk_reg=&HWIO_GCC_GCC_XO_DIV4_CBCR_ADDR
    &clk_reg_name="GCC_GCC_XO_DIV4_CBCR"
    &clk_name="gcc_xo_div4_clk"
    &clk_reg_cbcr_type="sm_cbc"

    gosub Print_Clk_Info_Line
  )

  &match=0
  &wild_head=0
  &wild_tail=0
  &clk_input_length=STRING.LENGTH("&clk")
  &clk_itr_length=STRING.LENGTH("gcc_gp1_clk")

  if (STRING.SCAN("&clk", "*", 0)==0)
  (
    &wild_head=1
  )
  if (STRING.SCAN("&clk", "*", 1)==(STRING.LENGTH("&clk")-1))
  (
    &wild_tail=1
  )

  if ((&wild_head==1)&&(&wild_tail==1))
  (
    if (STRING.SCAN("gcc_gp1_clk", STRING.MID("&clk", 1, &clk_input_length-2), 0)!=-1)
    ( 
      &match=1
    )
  )
  else if (&wild_head==1)
  (
    if (STRING.MID("gcc_gp1_clk", &clk_itr_length-&clk_input_length+1, &clk_input_length-1)==STRING.CUT("&clk", 1))
    ( 
      &match=1
    )
  )
  else if (&wild_tail==1)
  (
    if (STRING.MID("gcc_gp1_clk", 0, &clk_input_length-1)==STRING.CUT("&clk", -1))
    ( 
      &match=1
    )
  )	  
  else if ("gcc_gp1_clk"=="&clk")
  (
    &match=1
  )
  
  if (&match==1)
  (
    &clk_test=0
    &clk_reg=&HWIO_GCC_GP1_CBCR_ADDR
    &clk_reg_name="GCC_GP1_CBCR"
    &clk_name="gcc_gp1_clk"
    &clk_reg_cbcr_type="sm_cbc"

    gosub Print_Clk_Info_Line
  )

  &match=0
  &wild_head=0
  &wild_tail=0
  &clk_input_length=STRING.LENGTH("&clk")
  &clk_itr_length=STRING.LENGTH("gcc_gp2_clk")

  if (STRING.SCAN("&clk", "*", 0)==0)
  (
    &wild_head=1
  )
  if (STRING.SCAN("&clk", "*", 1)==(STRING.LENGTH("&clk")-1))
  (
    &wild_tail=1
  )

  if ((&wild_head==1)&&(&wild_tail==1))
  (
    if (STRING.SCAN("gcc_gp2_clk", STRING.MID("&clk", 1, &clk_input_length-2), 0)!=-1)
    ( 
      &match=1
    )
  )
  else if (&wild_head==1)
  (
    if (STRING.MID("gcc_gp2_clk", &clk_itr_length-&clk_input_length+1, &clk_input_length-1)==STRING.CUT("&clk", 1))
    ( 
      &match=1
    )
  )
  else if (&wild_tail==1)
  (
    if (STRING.MID("gcc_gp2_clk", 0, &clk_input_length-1)==STRING.CUT("&clk", -1))
    ( 
      &match=1
    )
  )	  
  else if ("gcc_gp2_clk"=="&clk")
  (
    &match=1
  )
  
  if (&match==1)
  (
    &clk_test=0
    &clk_reg=&HWIO_GCC_GP2_CBCR_ADDR
    &clk_reg_name="GCC_GP2_CBCR"
    &clk_name="gcc_gp2_clk"
    &clk_reg_cbcr_type="sm_cbc"

    gosub Print_Clk_Info_Line
  )

  &match=0
  &wild_head=0
  &wild_tail=0
  &clk_input_length=STRING.LENGTH("&clk")
  &clk_itr_length=STRING.LENGTH("gcc_gp3_clk")

  if (STRING.SCAN("&clk", "*", 0)==0)
  (
    &wild_head=1
  )
  if (STRING.SCAN("&clk", "*", 1)==(STRING.LENGTH("&clk")-1))
  (
    &wild_tail=1
  )

  if ((&wild_head==1)&&(&wild_tail==1))
  (
    if (STRING.SCAN("gcc_gp3_clk", STRING.MID("&clk", 1, &clk_input_length-2), 0)!=-1)
    ( 
      &match=1
    )
  )
  else if (&wild_head==1)
  (
    if (STRING.MID("gcc_gp3_clk", &clk_itr_length-&clk_input_length+1, &clk_input_length-1)==STRING.CUT("&clk", 1))
    ( 
      &match=1
    )
  )
  else if (&wild_tail==1)
  (
    if (STRING.MID("gcc_gp3_clk", 0, &clk_input_length-1)==STRING.CUT("&clk", -1))
    ( 
      &match=1
    )
  )	  
  else if ("gcc_gp3_clk"=="&clk")
  (
    &match=1
  )
  
  if (&match==1)
  (
    &clk_test=0
    &clk_reg=&HWIO_GCC_GP3_CBCR_ADDR
    &clk_reg_name="GCC_GP3_CBCR"
    &clk_name="gcc_gp3_clk"
    &clk_reg_cbcr_type="sm_cbc"

    gosub Print_Clk_Info_Line
  )

  &match=0
  &wild_head=0
  &wild_tail=0
  &clk_input_length=STRING.LENGTH("&clk")
  &clk_itr_length=STRING.LENGTH("gcc_ipa_clk")

  if (STRING.SCAN("&clk", "*", 0)==0)
  (
    &wild_head=1
  )
  if (STRING.SCAN("&clk", "*", 1)==(STRING.LENGTH("&clk")-1))
  (
    &wild_tail=1
  )

  if ((&wild_head==1)&&(&wild_tail==1))
  (
    if (STRING.SCAN("gcc_ipa_clk", STRING.MID("&clk", 1, &clk_input_length-2), 0)!=-1)
    ( 
      &match=1
    )
  )
  else if (&wild_head==1)
  (
    if (STRING.MID("gcc_ipa_clk", &clk_itr_length-&clk_input_length+1, &clk_input_length-1)==STRING.CUT("&clk", 1))
    ( 
      &match=1
    )
  )
  else if (&wild_tail==1)
  (
    if (STRING.MID("gcc_ipa_clk", 0, &clk_input_length-1)==STRING.CUT("&clk", -1))
    ( 
      &match=1
    )
  )	  
  else if ("gcc_ipa_clk"=="&clk")
  (
    &match=1
  )
  
  if (&match==1)
  (
    &clk_test=&CLK_TEST_GCC_IPA_CLK
    &clk_reg=&HWIO_GCC_IPA_CBCR_ADDR
    &clk_reg_name="GCC_IPA_CBCR"
    &clk_name="gcc_ipa_clk"
    &clk_reg_cbcr_type="sm_pscbc"

    gosub Print_Clk_Info_Line
  )

  &match=0
  &wild_head=0
  &wild_tail=0
  &clk_input_length=STRING.LENGTH("&clk")
  &clk_itr_length=STRING.LENGTH("gcc_sys_noc_ipa_axi_clk")

  if (STRING.SCAN("&clk", "*", 0)==0)
  (
    &wild_head=1
  )
  if (STRING.SCAN("&clk", "*", 1)==(STRING.LENGTH("&clk")-1))
  (
    &wild_tail=1
  )

  if ((&wild_head==1)&&(&wild_tail==1))
  (
    if (STRING.SCAN("gcc_sys_noc_ipa_axi_clk", STRING.MID("&clk", 1, &clk_input_length-2), 0)!=-1)
    ( 
      &match=1
    )
  )
  else if (&wild_head==1)
  (
    if (STRING.MID("gcc_sys_noc_ipa_axi_clk", &clk_itr_length-&clk_input_length+1, &clk_input_length-1)==STRING.CUT("&clk", 1))
    ( 
      &match=1
    )
  )
  else if (&wild_tail==1)
  (
    if (STRING.MID("gcc_sys_noc_ipa_axi_clk", 0, &clk_input_length-1)==STRING.CUT("&clk", -1))
    ( 
      &match=1
    )
  )	  
  else if ("gcc_sys_noc_ipa_axi_clk"=="&clk")
  (
    &match=1
  )
  
  if (&match==1)
  (
    &clk_test=&CLK_TEST_GCC_SYS_NOC_IPA_AXI_CLK
    &clk_reg=&HWIO_GCC_SYS_NOC_IPA_AXI_CBCR_ADDR
    &clk_reg_name="GCC_SYS_NOC_IPA_AXI_CBCR"
    &clk_name="gcc_sys_noc_ipa_axi_clk"
    &clk_reg_cbcr_type="sm_cbc"

    gosub Print_Clk_Info_Line
  )

  &match=0
  &wild_head=0
  &wild_tail=0
  &clk_input_length=STRING.LENGTH("&clk")
  &clk_itr_length=STRING.LENGTH("gcc_kpss_ahb_clk")

  if (STRING.SCAN("&clk", "*", 0)==0)
  (
    &wild_head=1
  )
  if (STRING.SCAN("&clk", "*", 1)==(STRING.LENGTH("&clk")-1))
  (
    &wild_tail=1
  )

  if ((&wild_head==1)&&(&wild_tail==1))
  (
    if (STRING.SCAN("gcc_kpss_ahb_clk", STRING.MID("&clk", 1, &clk_input_length-2), 0)!=-1)
    ( 
      &match=1
    )
  )
  else if (&wild_head==1)
  (
    if (STRING.MID("gcc_kpss_ahb_clk", &clk_itr_length-&clk_input_length+1, &clk_input_length-1)==STRING.CUT("&clk", 1))
    ( 
      &match=1
    )
  )
  else if (&wild_tail==1)
  (
    if (STRING.MID("gcc_kpss_ahb_clk", 0, &clk_input_length-1)==STRING.CUT("&clk", -1))
    ( 
      &match=1
    )
  )	  
  else if ("gcc_kpss_ahb_clk"=="&clk")
  (
    &match=1
  )
  
  if (&match==1)
  (
    &clk_test=&CLK_TEST_GCC_KPSS_AHB_CLK
    &clk_reg=&HWIO_GCC_KPSS_AHB_CBCR_ADDR
    &clk_reg_name="GCC_KPSS_AHB_CBCR"
    &clk_name="gcc_kpss_ahb_clk"
    &clk_reg_cbcr_type="sm_cbc"

    gosub Print_Clk_Info_Line
  )

  &match=0
  &wild_head=0
  &wild_tail=0
  &clk_input_length=STRING.LENGTH("&clk")
  &clk_itr_length=STRING.LENGTH("gcc_snoc_bus_timeout0_ahb_clk")

  if (STRING.SCAN("&clk", "*", 0)==0)
  (
    &wild_head=1
  )
  if (STRING.SCAN("&clk", "*", 1)==(STRING.LENGTH("&clk")-1))
  (
    &wild_tail=1
  )

  if ((&wild_head==1)&&(&wild_tail==1))
  (
    if (STRING.SCAN("gcc_snoc_bus_timeout0_ahb_clk", STRING.MID("&clk", 1, &clk_input_length-2), 0)!=-1)
    ( 
      &match=1
    )
  )
  else if (&wild_head==1)
  (
    if (STRING.MID("gcc_snoc_bus_timeout0_ahb_clk", &clk_itr_length-&clk_input_length+1, &clk_input_length-1)==STRING.CUT("&clk", 1))
    ( 
      &match=1
    )
  )
  else if (&wild_tail==1)
  (
    if (STRING.MID("gcc_snoc_bus_timeout0_ahb_clk", 0, &clk_input_length-1)==STRING.CUT("&clk", -1))
    ( 
      &match=1
    )
  )	  
  else if ("gcc_snoc_bus_timeout0_ahb_clk"=="&clk")
  (
    &match=1
  )
  
  if (&match==1)
  (
    &clk_test=&CLK_TEST_GCC_SNOC_BUS_TIMEOUT0_AHB_CLK
    &clk_reg=&HWIO_GCC_SNOC_BUS_TIMEOUT0_AHB_CBCR_ADDR
    &clk_reg_name="GCC_SNOC_BUS_TIMEOUT0_AHB_CBCR"
    &clk_name="gcc_snoc_bus_timeout0_ahb_clk"
    &clk_reg_cbcr_type="sm_cbc"

    gosub Print_Clk_Info_Line
  )

  &match=0
  &wild_head=0
  &wild_tail=0
  &clk_input_length=STRING.LENGTH("&clk")
  &clk_itr_length=STRING.LENGTH("gcc_sys_noc_kpss_ahb_clk")

  if (STRING.SCAN("&clk", "*", 0)==0)
  (
    &wild_head=1
  )
  if (STRING.SCAN("&clk", "*", 1)==(STRING.LENGTH("&clk")-1))
  (
    &wild_tail=1
  )

  if ((&wild_head==1)&&(&wild_tail==1))
  (
    if (STRING.SCAN("gcc_sys_noc_kpss_ahb_clk", STRING.MID("&clk", 1, &clk_input_length-2), 0)!=-1)
    ( 
      &match=1
    )
  )
  else if (&wild_head==1)
  (
    if (STRING.MID("gcc_sys_noc_kpss_ahb_clk", &clk_itr_length-&clk_input_length+1, &clk_input_length-1)==STRING.CUT("&clk", 1))
    ( 
      &match=1
    )
  )
  else if (&wild_tail==1)
  (
    if (STRING.MID("gcc_sys_noc_kpss_ahb_clk", 0, &clk_input_length-1)==STRING.CUT("&clk", -1))
    ( 
      &match=1
    )
  )	  
  else if ("gcc_sys_noc_kpss_ahb_clk"=="&clk")
  (
    &match=1
  )
  
  if (&match==1)
  (
    &clk_test=&CLK_TEST_GCC_SYS_NOC_KPSS_AHB_CLK
    &clk_reg=&HWIO_GCC_SYS_NOC_KPSS_AHB_CBCR_ADDR
    &clk_reg_name="GCC_SYS_NOC_KPSS_AHB_CBCR"
    &clk_name="gcc_sys_noc_kpss_ahb_clk"
    &clk_reg_cbcr_type="sm_cbc"

    gosub Print_Clk_Info_Line
  )

  &match=0
  &wild_head=0
  &wild_tail=0
  &clk_input_length=STRING.LENGTH("&clk")
  &clk_itr_length=STRING.LENGTH("gcc_bimc_gfx_clk")

  if (STRING.SCAN("&clk", "*", 0)==0)
  (
    &wild_head=1
  )
  if (STRING.SCAN("&clk", "*", 1)==(STRING.LENGTH("&clk")-1))
  (
    &wild_tail=1
  )

  if ((&wild_head==1)&&(&wild_tail==1))
  (
    if (STRING.SCAN("gcc_bimc_gfx_clk", STRING.MID("&clk", 1, &clk_input_length-2), 0)!=-1)
    ( 
      &match=1
    )
  )
  else if (&wild_head==1)
  (
    if (STRING.MID("gcc_bimc_gfx_clk", &clk_itr_length-&clk_input_length+1, &clk_input_length-1)==STRING.CUT("&clk", 1))
    ( 
      &match=1
    )
  )
  else if (&wild_tail==1)
  (
    if (STRING.MID("gcc_bimc_gfx_clk", 0, &clk_input_length-1)==STRING.CUT("&clk", -1))
    ( 
      &match=1
    )
  )	  
  else if ("gcc_bimc_gfx_clk"=="&clk")
  (
    &match=1
  )
  
  if (&match==1)
  (
    &clk_test=&CLK_TEST_GCC_BIMC_GFX_CLK
    &clk_reg=&HWIO_GCC_BIMC_GFX_CBCR_ADDR
    &clk_reg_name="GCC_BIMC_GFX_CBCR"
    &clk_name="gcc_bimc_gfx_clk"
    &clk_reg_cbcr_type="sm_cbc"

    gosub Print_Clk_Info_Line
  )

  &match=0
  &wild_head=0
  &wild_tail=0
  &clk_input_length=STRING.LENGTH("&clk")
  &clk_itr_length=STRING.LENGTH("gcc_mmss_bimc_gfx_clk")

  if (STRING.SCAN("&clk", "*", 0)==0)
  (
    &wild_head=1
  )
  if (STRING.SCAN("&clk", "*", 1)==(STRING.LENGTH("&clk")-1))
  (
    &wild_tail=1
  )

  if ((&wild_head==1)&&(&wild_tail==1))
  (
    if (STRING.SCAN("gcc_mmss_bimc_gfx_clk", STRING.MID("&clk", 1, &clk_input_length-2), 0)!=-1)
    ( 
      &match=1
    )
  )
  else if (&wild_head==1)
  (
    if (STRING.MID("gcc_mmss_bimc_gfx_clk", &clk_itr_length-&clk_input_length+1, &clk_input_length-1)==STRING.CUT("&clk", 1))
    ( 
      &match=1
    )
  )
  else if (&wild_tail==1)
  (
    if (STRING.MID("gcc_mmss_bimc_gfx_clk", 0, &clk_input_length-1)==STRING.CUT("&clk", -1))
    ( 
      &match=1
    )
  )	  
  else if ("gcc_mmss_bimc_gfx_clk"=="&clk")
  (
    &match=1
  )
  
  if (&match==1)
  (
    &clk_test=&CLK_TEST_GCC_MMSS_BIMC_GFX_CLK
    &clk_reg=&HWIO_GCC_MMSS_BIMC_GFX_CBCR_ADDR
    &clk_reg_name="GCC_MMSS_BIMC_GFX_CBCR"
    &clk_name="gcc_mmss_bimc_gfx_clk"
    &clk_reg_cbcr_type="sm_pscbc"

    gosub Print_Clk_Info_Line
  )

  &match=0
  &wild_head=0
  &wild_tail=0
  &clk_input_length=STRING.LENGTH("&clk")
  &clk_itr_length=STRING.LENGTH("gcc_mss_q6_bimc_axi_clk")

  if (STRING.SCAN("&clk", "*", 0)==0)
  (
    &wild_head=1
  )
  if (STRING.SCAN("&clk", "*", 1)==(STRING.LENGTH("&clk")-1))
  (
    &wild_tail=1
  )

  if ((&wild_head==1)&&(&wild_tail==1))
  (
    if (STRING.SCAN("gcc_mss_q6_bimc_axi_clk", STRING.MID("&clk", 1, &clk_input_length-2), 0)!=-1)
    ( 
      &match=1
    )
  )
  else if (&wild_head==1)
  (
    if (STRING.MID("gcc_mss_q6_bimc_axi_clk", &clk_itr_length-&clk_input_length+1, &clk_input_length-1)==STRING.CUT("&clk", 1))
    ( 
      &match=1
    )
  )
  else if (&wild_tail==1)
  (
    if (STRING.MID("gcc_mss_q6_bimc_axi_clk", 0, &clk_input_length-1)==STRING.CUT("&clk", -1))
    ( 
      &match=1
    )
  )	  
  else if ("gcc_mss_q6_bimc_axi_clk"=="&clk")
  (
    &match=1
  )
  
  if (&match==1)
  (
    &clk_test=&CLK_TEST_GCC_MSS_Q6_BIMC_AXI_CLK
    &clk_reg=&HWIO_GCC_MSS_Q6_BIMC_AXI_CBCR_ADDR
    &clk_reg_name="GCC_MSS_Q6_BIMC_AXI_CBCR"
    &clk_name="gcc_mss_q6_bimc_axi_clk"
    &clk_reg_cbcr_type="sm_cbc"

    gosub Print_Clk_Info_Line
  )

  &match=0
  &wild_head=0
  &wild_tail=0
  &clk_input_length=STRING.LENGTH("&clk")
  &clk_itr_length=STRING.LENGTH("gcc_obt_odt_clk")

  if (STRING.SCAN("&clk", "*", 0)==0)
  (
    &wild_head=1
  )
  if (STRING.SCAN("&clk", "*", 1)==(STRING.LENGTH("&clk")-1))
  (
    &wild_tail=1
  )

  if ((&wild_head==1)&&(&wild_tail==1))
  (
    if (STRING.SCAN("gcc_obt_odt_clk", STRING.MID("&clk", 1, &clk_input_length-2), 0)!=-1)
    ( 
      &match=1
    )
  )
  else if (&wild_head==1)
  (
    if (STRING.MID("gcc_obt_odt_clk", &clk_itr_length-&clk_input_length+1, &clk_input_length-1)==STRING.CUT("&clk", 1))
    ( 
      &match=1
    )
  )
  else if (&wild_tail==1)
  (
    if (STRING.MID("gcc_obt_odt_clk", 0, &clk_input_length-1)==STRING.CUT("&clk", -1))
    ( 
      &match=1
    )
  )	  
  else if ("gcc_obt_odt_clk"=="&clk")
  (
    &match=1
  )
  
  if (&match==1)
  (
    &clk_test=&CLK_TEST_GCC_OBT_ODT_CLK
    &clk_reg=&HWIO_GCC_OBT_ODT_CBCR_ADDR
    &clk_reg_name="GCC_OBT_ODT_CBCR"
    &clk_name="gcc_obt_odt_clk"
    &clk_reg_cbcr_type="sm_cbc"

    gosub Print_Clk_Info_Line
  )

  &match=0
  &wild_head=0
  &wild_tail=0
  &clk_input_length=STRING.LENGTH("&clk")
  &clk_itr_length=STRING.LENGTH("gcc_pcie_0_aux_clk")

  if (STRING.SCAN("&clk", "*", 0)==0)
  (
    &wild_head=1
  )
  if (STRING.SCAN("&clk", "*", 1)==(STRING.LENGTH("&clk")-1))
  (
    &wild_tail=1
  )

  if ((&wild_head==1)&&(&wild_tail==1))
  (
    if (STRING.SCAN("gcc_pcie_0_aux_clk", STRING.MID("&clk", 1, &clk_input_length-2), 0)!=-1)
    ( 
      &match=1
    )
  )
  else if (&wild_head==1)
  (
    if (STRING.MID("gcc_pcie_0_aux_clk", &clk_itr_length-&clk_input_length+1, &clk_input_length-1)==STRING.CUT("&clk", 1))
    ( 
      &match=1
    )
  )
  else if (&wild_tail==1)
  (
    if (STRING.MID("gcc_pcie_0_aux_clk", 0, &clk_input_length-1)==STRING.CUT("&clk", -1))
    ( 
      &match=1
    )
  )	  
  else if ("gcc_pcie_0_aux_clk"=="&clk")
  (
    &match=1
  )
  
  if (&match==1)
  (
    &clk_test=&CLK_TEST_GCC_PCIE_0_AUX_CLK
    &clk_reg=&HWIO_GCC_PCIE_0_AUX_CBCR_ADDR
    &clk_reg_name="GCC_PCIE_0_AUX_CBCR"
    &clk_name="gcc_pcie_0_aux_clk"
    &clk_reg_cbcr_type="sm_cbc"

    gosub Print_Clk_Info_Line
  )

  &match=0
  &wild_head=0
  &wild_tail=0
  &clk_input_length=STRING.LENGTH("&clk")
  &clk_itr_length=STRING.LENGTH("gcc_pcie_0_pipe_clk")

  if (STRING.SCAN("&clk", "*", 0)==0)
  (
    &wild_head=1
  )
  if (STRING.SCAN("&clk", "*", 1)==(STRING.LENGTH("&clk")-1))
  (
    &wild_tail=1
  )

  if ((&wild_head==1)&&(&wild_tail==1))
  (
    if (STRING.SCAN("gcc_pcie_0_pipe_clk", STRING.MID("&clk", 1, &clk_input_length-2), 0)!=-1)
    ( 
      &match=1
    )
  )
  else if (&wild_head==1)
  (
    if (STRING.MID("gcc_pcie_0_pipe_clk", &clk_itr_length-&clk_input_length+1, &clk_input_length-1)==STRING.CUT("&clk", 1))
    ( 
      &match=1
    )
  )
  else if (&wild_tail==1)
  (
    if (STRING.MID("gcc_pcie_0_pipe_clk", 0, &clk_input_length-1)==STRING.CUT("&clk", -1))
    ( 
      &match=1
    )
  )	  
  else if ("gcc_pcie_0_pipe_clk"=="&clk")
  (
    &match=1
  )
  
  if (&match==1)
  (
    &clk_test=&CLK_TEST_GCC_PCIE_0_PIPE_CLK
    &clk_reg=&HWIO_GCC_PCIE_0_PIPE_CBCR_ADDR
    &clk_reg_name="GCC_PCIE_0_PIPE_CBCR"
    &clk_name="gcc_pcie_0_pipe_clk"
    &clk_reg_cbcr_type="sm_pscbc"

    gosub Print_Clk_Info_Line
  )

  &match=0
  &wild_head=0
  &wild_tail=0
  &clk_input_length=STRING.LENGTH("&clk")
  &clk_itr_length=STRING.LENGTH("gcc_pcie_1_aux_clk")

  if (STRING.SCAN("&clk", "*", 0)==0)
  (
    &wild_head=1
  )
  if (STRING.SCAN("&clk", "*", 1)==(STRING.LENGTH("&clk")-1))
  (
    &wild_tail=1
  )

  if ((&wild_head==1)&&(&wild_tail==1))
  (
    if (STRING.SCAN("gcc_pcie_1_aux_clk", STRING.MID("&clk", 1, &clk_input_length-2), 0)!=-1)
    ( 
      &match=1
    )
  )
  else if (&wild_head==1)
  (
    if (STRING.MID("gcc_pcie_1_aux_clk", &clk_itr_length-&clk_input_length+1, &clk_input_length-1)==STRING.CUT("&clk", 1))
    ( 
      &match=1
    )
  )
  else if (&wild_tail==1)
  (
    if (STRING.MID("gcc_pcie_1_aux_clk", 0, &clk_input_length-1)==STRING.CUT("&clk", -1))
    ( 
      &match=1
    )
  )	  
  else if ("gcc_pcie_1_aux_clk"=="&clk")
  (
    &match=1
  )
  
  if (&match==1)
  (
    &clk_test=&CLK_TEST_GCC_PCIE_1_AUX_CLK
    &clk_reg=&HWIO_GCC_PCIE_1_AUX_CBCR_ADDR
    &clk_reg_name="GCC_PCIE_1_AUX_CBCR"
    &clk_name="gcc_pcie_1_aux_clk"
    &clk_reg_cbcr_type="sm_cbc"

    gosub Print_Clk_Info_Line
  )

  &match=0
  &wild_head=0
  &wild_tail=0
  &clk_input_length=STRING.LENGTH("&clk")
  &clk_itr_length=STRING.LENGTH("gcc_pcie_1_pipe_clk")

  if (STRING.SCAN("&clk", "*", 0)==0)
  (
    &wild_head=1
  )
  if (STRING.SCAN("&clk", "*", 1)==(STRING.LENGTH("&clk")-1))
  (
    &wild_tail=1
  )

  if ((&wild_head==1)&&(&wild_tail==1))
  (
    if (STRING.SCAN("gcc_pcie_1_pipe_clk", STRING.MID("&clk", 1, &clk_input_length-2), 0)!=-1)
    ( 
      &match=1
    )
  )
  else if (&wild_head==1)
  (
    if (STRING.MID("gcc_pcie_1_pipe_clk", &clk_itr_length-&clk_input_length+1, &clk_input_length-1)==STRING.CUT("&clk", 1))
    ( 
      &match=1
    )
  )
  else if (&wild_tail==1)
  (
    if (STRING.MID("gcc_pcie_1_pipe_clk", 0, &clk_input_length-1)==STRING.CUT("&clk", -1))
    ( 
      &match=1
    )
  )	  
  else if ("gcc_pcie_1_pipe_clk"=="&clk")
  (
    &match=1
  )
  
  if (&match==1)
  (
    &clk_test=&CLK_TEST_GCC_PCIE_1_PIPE_CLK
    &clk_reg=&HWIO_GCC_PCIE_1_PIPE_CBCR_ADDR
    &clk_reg_name="GCC_PCIE_1_PIPE_CBCR"
    &clk_name="gcc_pcie_1_pipe_clk"
    &clk_reg_cbcr_type="sm_pscbc"

    gosub Print_Clk_Info_Line
  )

  &match=0
  &wild_head=0
  &wild_tail=0
  &clk_input_length=STRING.LENGTH("&clk")
  &clk_itr_length=STRING.LENGTH("gcc_pdm_xo4_clk")

  if (STRING.SCAN("&clk", "*", 0)==0)
  (
    &wild_head=1
  )
  if (STRING.SCAN("&clk", "*", 1)==(STRING.LENGTH("&clk")-1))
  (
    &wild_tail=1
  )

  if ((&wild_head==1)&&(&wild_tail==1))
  (
    if (STRING.SCAN("gcc_pdm_xo4_clk", STRING.MID("&clk", 1, &clk_input_length-2), 0)!=-1)
    ( 
      &match=1
    )
  )
  else if (&wild_head==1)
  (
    if (STRING.MID("gcc_pdm_xo4_clk", &clk_itr_length-&clk_input_length+1, &clk_input_length-1)==STRING.CUT("&clk", 1))
    ( 
      &match=1
    )
  )
  else if (&wild_tail==1)
  (
    if (STRING.MID("gcc_pdm_xo4_clk", 0, &clk_input_length-1)==STRING.CUT("&clk", -1))
    ( 
      &match=1
    )
  )	  
  else if ("gcc_pdm_xo4_clk"=="&clk")
  (
    &match=1
  )
  
  if (&match==1)
  (
    &clk_test=&CLK_TEST_GCC_PDM_XO4_CLK
    &clk_reg=&HWIO_GCC_PDM_XO4_CBCR_ADDR
    &clk_reg_name="GCC_PDM_XO4_CBCR"
    &clk_name="gcc_pdm_xo4_clk"
    &clk_reg_cbcr_type="sm_cbc"

    gosub Print_Clk_Info_Line
  )

  &match=0
  &wild_head=0
  &wild_tail=0
  &clk_input_length=STRING.LENGTH("&clk")
  &clk_itr_length=STRING.LENGTH("gcc_pdm2_clk")

  if (STRING.SCAN("&clk", "*", 0)==0)
  (
    &wild_head=1
  )
  if (STRING.SCAN("&clk", "*", 1)==(STRING.LENGTH("&clk")-1))
  (
    &wild_tail=1
  )

  if ((&wild_head==1)&&(&wild_tail==1))
  (
    if (STRING.SCAN("gcc_pdm2_clk", STRING.MID("&clk", 1, &clk_input_length-2), 0)!=-1)
    ( 
      &match=1
    )
  )
  else if (&wild_head==1)
  (
    if (STRING.MID("gcc_pdm2_clk", &clk_itr_length-&clk_input_length+1, &clk_input_length-1)==STRING.CUT("&clk", 1))
    ( 
      &match=1
    )
  )
  else if (&wild_tail==1)
  (
    if (STRING.MID("gcc_pdm2_clk", 0, &clk_input_length-1)==STRING.CUT("&clk", -1))
    ( 
      &match=1
    )
  )	  
  else if ("gcc_pdm2_clk"=="&clk")
  (
    &match=1
  )
  
  if (&match==1)
  (
    &clk_test=&CLK_TEST_GCC_PDM2_CLK
    &clk_reg=&HWIO_GCC_PDM2_CBCR_ADDR
    &clk_reg_name="GCC_PDM2_CBCR"
    &clk_name="gcc_pdm2_clk"
    &clk_reg_cbcr_type="sm_cbc"

    gosub Print_Clk_Info_Line
  )

  &match=0
  &wild_head=0
  &wild_tail=0
  &clk_input_length=STRING.LENGTH("&clk")
  &clk_itr_length=STRING.LENGTH("gcc_bam_dma_ahb_clk")

  if (STRING.SCAN("&clk", "*", 0)==0)
  (
    &wild_head=1
  )
  if (STRING.SCAN("&clk", "*", 1)==(STRING.LENGTH("&clk")-1))
  (
    &wild_tail=1
  )

  if ((&wild_head==1)&&(&wild_tail==1))
  (
    if (STRING.SCAN("gcc_bam_dma_ahb_clk", STRING.MID("&clk", 1, &clk_input_length-2), 0)!=-1)
    ( 
      &match=1
    )
  )
  else if (&wild_head==1)
  (
    if (STRING.MID("gcc_bam_dma_ahb_clk", &clk_itr_length-&clk_input_length+1, &clk_input_length-1)==STRING.CUT("&clk", 1))
    ( 
      &match=1
    )
  )
  else if (&wild_tail==1)
  (
    if (STRING.MID("gcc_bam_dma_ahb_clk", 0, &clk_input_length-1)==STRING.CUT("&clk", -1))
    ( 
      &match=1
    )
  )	  
  else if ("gcc_bam_dma_ahb_clk"=="&clk")
  (
    &match=1
  )
  
  if (&match==1)
  (
    &clk_test=&CLK_TEST_GCC_BAM_DMA_AHB_CLK
    &clk_reg=&HWIO_GCC_BAM_DMA_AHB_CBCR_ADDR
    &clk_reg_name="GCC_BAM_DMA_AHB_CBCR"
    &clk_name="gcc_bam_dma_ahb_clk"
    &clk_reg_cbcr_type="sm_pscbc"

    gosub Print_Clk_Info_Line
  )

  &match=0
  &wild_head=0
  &wild_tail=0
  &clk_input_length=STRING.LENGTH("&clk")
  &clk_itr_length=STRING.LENGTH("gcc_blsp1_ahb_clk")

  if (STRING.SCAN("&clk", "*", 0)==0)
  (
    &wild_head=1
  )
  if (STRING.SCAN("&clk", "*", 1)==(STRING.LENGTH("&clk")-1))
  (
    &wild_tail=1
  )

  if ((&wild_head==1)&&(&wild_tail==1))
  (
    if (STRING.SCAN("gcc_blsp1_ahb_clk", STRING.MID("&clk", 1, &clk_input_length-2), 0)!=-1)
    ( 
      &match=1
    )
  )
  else if (&wild_head==1)
  (
    if (STRING.MID("gcc_blsp1_ahb_clk", &clk_itr_length-&clk_input_length+1, &clk_input_length-1)==STRING.CUT("&clk", 1))
    ( 
      &match=1
    )
  )
  else if (&wild_tail==1)
  (
    if (STRING.MID("gcc_blsp1_ahb_clk", 0, &clk_input_length-1)==STRING.CUT("&clk", -1))
    ( 
      &match=1
    )
  )	  
  else if ("gcc_blsp1_ahb_clk"=="&clk")
  (
    &match=1
  )
  
  if (&match==1)
  (
    &clk_test=&CLK_TEST_GCC_BLSP1_AHB_CLK
    &clk_reg=&HWIO_GCC_BLSP1_AHB_CBCR_ADDR
    &clk_reg_name="GCC_BLSP1_AHB_CBCR"
    &clk_name="gcc_blsp1_ahb_clk"
    &clk_reg_cbcr_type="sm_pscbc"

    gosub Print_Clk_Info_Line
  )

  &match=0
  &wild_head=0
  &wild_tail=0
  &clk_input_length=STRING.LENGTH("&clk")
  &clk_itr_length=STRING.LENGTH("gcc_blsp2_ahb_clk")

  if (STRING.SCAN("&clk", "*", 0)==0)
  (
    &wild_head=1
  )
  if (STRING.SCAN("&clk", "*", 1)==(STRING.LENGTH("&clk")-1))
  (
    &wild_tail=1
  )

  if ((&wild_head==1)&&(&wild_tail==1))
  (
    if (STRING.SCAN("gcc_blsp2_ahb_clk", STRING.MID("&clk", 1, &clk_input_length-2), 0)!=-1)
    ( 
      &match=1
    )
  )
  else if (&wild_head==1)
  (
    if (STRING.MID("gcc_blsp2_ahb_clk", &clk_itr_length-&clk_input_length+1, &clk_input_length-1)==STRING.CUT("&clk", 1))
    ( 
      &match=1
    )
  )
  else if (&wild_tail==1)
  (
    if (STRING.MID("gcc_blsp2_ahb_clk", 0, &clk_input_length-1)==STRING.CUT("&clk", -1))
    ( 
      &match=1
    )
  )	  
  else if ("gcc_blsp2_ahb_clk"=="&clk")
  (
    &match=1
  )
  
  if (&match==1)
  (
    &clk_test=&CLK_TEST_GCC_BLSP2_AHB_CLK
    &clk_reg=&HWIO_GCC_BLSP2_AHB_CBCR_ADDR
    &clk_reg_name="GCC_BLSP2_AHB_CBCR"
    &clk_name="gcc_blsp2_ahb_clk"
    &clk_reg_cbcr_type="sm_pscbc"

    gosub Print_Clk_Info_Line
  )

  &match=0
  &wild_head=0
  &wild_tail=0
  &clk_input_length=STRING.LENGTH("&clk")
  &clk_itr_length=STRING.LENGTH("gcc_pdm_ahb_clk")

  if (STRING.SCAN("&clk", "*", 0)==0)
  (
    &wild_head=1
  )
  if (STRING.SCAN("&clk", "*", 1)==(STRING.LENGTH("&clk")-1))
  (
    &wild_tail=1
  )

  if ((&wild_head==1)&&(&wild_tail==1))
  (
    if (STRING.SCAN("gcc_pdm_ahb_clk", STRING.MID("&clk", 1, &clk_input_length-2), 0)!=-1)
    ( 
      &match=1
    )
  )
  else if (&wild_head==1)
  (
    if (STRING.MID("gcc_pdm_ahb_clk", &clk_itr_length-&clk_input_length+1, &clk_input_length-1)==STRING.CUT("&clk", 1))
    ( 
      &match=1
    )
  )
  else if (&wild_tail==1)
  (
    if (STRING.MID("gcc_pdm_ahb_clk", 0, &clk_input_length-1)==STRING.CUT("&clk", -1))
    ( 
      &match=1
    )
  )	  
  else if ("gcc_pdm_ahb_clk"=="&clk")
  (
    &match=1
  )
  
  if (&match==1)
  (
    &clk_test=&CLK_TEST_GCC_PDM_AHB_CLK
    &clk_reg=&HWIO_GCC_PDM_AHB_CBCR_ADDR
    &clk_reg_name="GCC_PDM_AHB_CBCR"
    &clk_name="gcc_pdm_ahb_clk"
    &clk_reg_cbcr_type="sm_cbc"

    gosub Print_Clk_Info_Line
  )

  &match=0
  &wild_head=0
  &wild_tail=0
  &clk_input_length=STRING.LENGTH("&clk")
  &clk_itr_length=STRING.LENGTH("gcc_periph_noc_ahb_clk")

  if (STRING.SCAN("&clk", "*", 0)==0)
  (
    &wild_head=1
  )
  if (STRING.SCAN("&clk", "*", 1)==(STRING.LENGTH("&clk")-1))
  (
    &wild_tail=1
  )

  if ((&wild_head==1)&&(&wild_tail==1))
  (
    if (STRING.SCAN("gcc_periph_noc_ahb_clk", STRING.MID("&clk", 1, &clk_input_length-2), 0)!=-1)
    ( 
      &match=1
    )
  )
  else if (&wild_head==1)
  (
    if (STRING.MID("gcc_periph_noc_ahb_clk", &clk_itr_length-&clk_input_length+1, &clk_input_length-1)==STRING.CUT("&clk", 1))
    ( 
      &match=1
    )
  )
  else if (&wild_tail==1)
  (
    if (STRING.MID("gcc_periph_noc_ahb_clk", 0, &clk_input_length-1)==STRING.CUT("&clk", -1))
    ( 
      &match=1
    )
  )	  
  else if ("gcc_periph_noc_ahb_clk"=="&clk")||("buses"=="&clk")
  (
    &match=1
  )
  
  if (&match==1)
  (
    &clk_test=&CLK_TEST_GCC_PERIPH_NOC_AHB_CLK
    &clk_reg=&HWIO_GCC_PERIPH_NOC_AHB_CBCR_ADDR
    &clk_reg_name="GCC_PERIPH_NOC_AHB_CBCR"
    &clk_name="gcc_periph_noc_ahb_clk"
    &clk_reg_cbcr_type="sm_cbc"

    gosub Print_Clk_Info_Line
  )

  &match=0
  &wild_head=0
  &wild_tail=0
  &clk_input_length=STRING.LENGTH("&clk")
  &clk_itr_length=STRING.LENGTH("gcc_periph_noc_mpu_cfg_ahb_clk")

  if (STRING.SCAN("&clk", "*", 0)==0)
  (
    &wild_head=1
  )
  if (STRING.SCAN("&clk", "*", 1)==(STRING.LENGTH("&clk")-1))
  (
    &wild_tail=1
  )

  if ((&wild_head==1)&&(&wild_tail==1))
  (
    if (STRING.SCAN("gcc_periph_noc_mpu_cfg_ahb_clk", STRING.MID("&clk", 1, &clk_input_length-2), 0)!=-1)
    ( 
      &match=1
    )
  )
  else if (&wild_head==1)
  (
    if (STRING.MID("gcc_periph_noc_mpu_cfg_ahb_clk", &clk_itr_length-&clk_input_length+1, &clk_input_length-1)==STRING.CUT("&clk", 1))
    ( 
      &match=1
    )
  )
  else if (&wild_tail==1)
  (
    if (STRING.MID("gcc_periph_noc_mpu_cfg_ahb_clk", 0, &clk_input_length-1)==STRING.CUT("&clk", -1))
    ( 
      &match=1
    )
  )	  
  else if ("gcc_periph_noc_mpu_cfg_ahb_clk"=="&clk")
  (
    &match=1
  )
  
  if (&match==1)
  (
    &clk_test=&CLK_TEST_GCC_PERIPH_NOC_MPU_CFG_AHB_CLK
    &clk_reg=&HWIO_GCC_PERIPH_NOC_MPU_CFG_AHB_CBCR_ADDR
    &clk_reg_name="GCC_PERIPH_NOC_MPU_CFG_AHB_CBCR"
    &clk_name="gcc_periph_noc_mpu_cfg_ahb_clk"
    &clk_reg_cbcr_type="sm_cbc"

    gosub Print_Clk_Info_Line
  )

  &match=0
  &wild_head=0
  &wild_tail=0
  &clk_input_length=STRING.LENGTH("&clk")
  &clk_itr_length=STRING.LENGTH("gcc_periph_xpu_ahb_clk")

  if (STRING.SCAN("&clk", "*", 0)==0)
  (
    &wild_head=1
  )
  if (STRING.SCAN("&clk", "*", 1)==(STRING.LENGTH("&clk")-1))
  (
    &wild_tail=1
  )

  if ((&wild_head==1)&&(&wild_tail==1))
  (
    if (STRING.SCAN("gcc_periph_xpu_ahb_clk", STRING.MID("&clk", 1, &clk_input_length-2), 0)!=-1)
    ( 
      &match=1
    )
  )
  else if (&wild_head==1)
  (
    if (STRING.MID("gcc_periph_xpu_ahb_clk", &clk_itr_length-&clk_input_length+1, &clk_input_length-1)==STRING.CUT("&clk", 1))
    ( 
      &match=1
    )
  )
  else if (&wild_tail==1)
  (
    if (STRING.MID("gcc_periph_xpu_ahb_clk", 0, &clk_input_length-1)==STRING.CUT("&clk", -1))
    ( 
      &match=1
    )
  )	  
  else if ("gcc_periph_xpu_ahb_clk"=="&clk")
  (
    &match=1
  )
  
  if (&match==1)
  (
    &clk_test=&CLK_TEST_GCC_PERIPH_XPU_AHB_CLK
    &clk_reg=&HWIO_GCC_PERIPH_XPU_AHB_CBCR_ADDR
    &clk_reg_name="GCC_PERIPH_XPU_AHB_CBCR"
    &clk_name="gcc_periph_xpu_ahb_clk"
    &clk_reg_cbcr_type="sm_cbc"

    gosub Print_Clk_Info_Line
  )

  &match=0
  &wild_head=0
  &wild_tail=0
  &clk_input_length=STRING.LENGTH("&clk")
  &clk_itr_length=STRING.LENGTH("gcc_pnoc_bus_timeout0_ahb_clk")

  if (STRING.SCAN("&clk", "*", 0)==0)
  (
    &wild_head=1
  )
  if (STRING.SCAN("&clk", "*", 1)==(STRING.LENGTH("&clk")-1))
  (
    &wild_tail=1
  )

  if ((&wild_head==1)&&(&wild_tail==1))
  (
    if (STRING.SCAN("gcc_pnoc_bus_timeout0_ahb_clk", STRING.MID("&clk", 1, &clk_input_length-2), 0)!=-1)
    ( 
      &match=1
    )
  )
  else if (&wild_head==1)
  (
    if (STRING.MID("gcc_pnoc_bus_timeout0_ahb_clk", &clk_itr_length-&clk_input_length+1, &clk_input_length-1)==STRING.CUT("&clk", 1))
    ( 
      &match=1
    )
  )
  else if (&wild_tail==1)
  (
    if (STRING.MID("gcc_pnoc_bus_timeout0_ahb_clk", 0, &clk_input_length-1)==STRING.CUT("&clk", -1))
    ( 
      &match=1
    )
  )	  
  else if ("gcc_pnoc_bus_timeout0_ahb_clk"=="&clk")
  (
    &match=1
  )
  
  if (&match==1)
  (
    &clk_test=&CLK_TEST_GCC_PNOC_BUS_TIMEOUT0_AHB_CLK
    &clk_reg=&HWIO_GCC_PNOC_BUS_TIMEOUT0_AHB_CBCR_ADDR
    &clk_reg_name="GCC_PNOC_BUS_TIMEOUT0_AHB_CBCR"
    &clk_name="gcc_pnoc_bus_timeout0_ahb_clk"
    &clk_reg_cbcr_type="sm_cbc"

    gosub Print_Clk_Info_Line
  )

  &match=0
  &wild_head=0
  &wild_tail=0
  &clk_input_length=STRING.LENGTH("&clk")
  &clk_itr_length=STRING.LENGTH("gcc_pnoc_bus_timeout1_ahb_clk")

  if (STRING.SCAN("&clk", "*", 0)==0)
  (
    &wild_head=1
  )
  if (STRING.SCAN("&clk", "*", 1)==(STRING.LENGTH("&clk")-1))
  (
    &wild_tail=1
  )

  if ((&wild_head==1)&&(&wild_tail==1))
  (
    if (STRING.SCAN("gcc_pnoc_bus_timeout1_ahb_clk", STRING.MID("&clk", 1, &clk_input_length-2), 0)!=-1)
    ( 
      &match=1
    )
  )
  else if (&wild_head==1)
  (
    if (STRING.MID("gcc_pnoc_bus_timeout1_ahb_clk", &clk_itr_length-&clk_input_length+1, &clk_input_length-1)==STRING.CUT("&clk", 1))
    ( 
      &match=1
    )
  )
  else if (&wild_tail==1)
  (
    if (STRING.MID("gcc_pnoc_bus_timeout1_ahb_clk", 0, &clk_input_length-1)==STRING.CUT("&clk", -1))
    ( 
      &match=1
    )
  )	  
  else if ("gcc_pnoc_bus_timeout1_ahb_clk"=="&clk")
  (
    &match=1
  )
  
  if (&match==1)
  (
    &clk_test=&CLK_TEST_GCC_PNOC_BUS_TIMEOUT1_AHB_CLK
    &clk_reg=&HWIO_GCC_PNOC_BUS_TIMEOUT1_AHB_CBCR_ADDR
    &clk_reg_name="GCC_PNOC_BUS_TIMEOUT1_AHB_CBCR"
    &clk_name="gcc_pnoc_bus_timeout1_ahb_clk"
    &clk_reg_cbcr_type="sm_cbc"

    gosub Print_Clk_Info_Line
  )

  &match=0
  &wild_head=0
  &wild_tail=0
  &clk_input_length=STRING.LENGTH("&clk")
  &clk_itr_length=STRING.LENGTH("gcc_pnoc_bus_timeout2_ahb_clk")

  if (STRING.SCAN("&clk", "*", 0)==0)
  (
    &wild_head=1
  )
  if (STRING.SCAN("&clk", "*", 1)==(STRING.LENGTH("&clk")-1))
  (
    &wild_tail=1
  )

  if ((&wild_head==1)&&(&wild_tail==1))
  (
    if (STRING.SCAN("gcc_pnoc_bus_timeout2_ahb_clk", STRING.MID("&clk", 1, &clk_input_length-2), 0)!=-1)
    ( 
      &match=1
    )
  )
  else if (&wild_head==1)
  (
    if (STRING.MID("gcc_pnoc_bus_timeout2_ahb_clk", &clk_itr_length-&clk_input_length+1, &clk_input_length-1)==STRING.CUT("&clk", 1))
    ( 
      &match=1
    )
  )
  else if (&wild_tail==1)
  (
    if (STRING.MID("gcc_pnoc_bus_timeout2_ahb_clk", 0, &clk_input_length-1)==STRING.CUT("&clk", -1))
    ( 
      &match=1
    )
  )	  
  else if ("gcc_pnoc_bus_timeout2_ahb_clk"=="&clk")
  (
    &match=1
  )
  
  if (&match==1)
  (
    &clk_test=&CLK_TEST_GCC_PNOC_BUS_TIMEOUT2_AHB_CLK
    &clk_reg=&HWIO_GCC_PNOC_BUS_TIMEOUT2_AHB_CBCR_ADDR
    &clk_reg_name="GCC_PNOC_BUS_TIMEOUT2_AHB_CBCR"
    &clk_name="gcc_pnoc_bus_timeout2_ahb_clk"
    &clk_reg_cbcr_type="sm_cbc"

    gosub Print_Clk_Info_Line
  )

  &match=0
  &wild_head=0
  &wild_tail=0
  &clk_input_length=STRING.LENGTH("&clk")
  &clk_itr_length=STRING.LENGTH("gcc_pnoc_bus_timeout3_ahb_clk")

  if (STRING.SCAN("&clk", "*", 0)==0)
  (
    &wild_head=1
  )
  if (STRING.SCAN("&clk", "*", 1)==(STRING.LENGTH("&clk")-1))
  (
    &wild_tail=1
  )

  if ((&wild_head==1)&&(&wild_tail==1))
  (
    if (STRING.SCAN("gcc_pnoc_bus_timeout3_ahb_clk", STRING.MID("&clk", 1, &clk_input_length-2), 0)!=-1)
    ( 
      &match=1
    )
  )
  else if (&wild_head==1)
  (
    if (STRING.MID("gcc_pnoc_bus_timeout3_ahb_clk", &clk_itr_length-&clk_input_length+1, &clk_input_length-1)==STRING.CUT("&clk", 1))
    ( 
      &match=1
    )
  )
  else if (&wild_tail==1)
  (
    if (STRING.MID("gcc_pnoc_bus_timeout3_ahb_clk", 0, &clk_input_length-1)==STRING.CUT("&clk", -1))
    ( 
      &match=1
    )
  )	  
  else if ("gcc_pnoc_bus_timeout3_ahb_clk"=="&clk")
  (
    &match=1
  )
  
  if (&match==1)
  (
    &clk_test=&CLK_TEST_GCC_PNOC_BUS_TIMEOUT3_AHB_CLK
    &clk_reg=&HWIO_GCC_PNOC_BUS_TIMEOUT3_AHB_CBCR_ADDR
    &clk_reg_name="GCC_PNOC_BUS_TIMEOUT3_AHB_CBCR"
    &clk_name="gcc_pnoc_bus_timeout3_ahb_clk"
    &clk_reg_cbcr_type="sm_cbc"

    gosub Print_Clk_Info_Line
  )

  &match=0
  &wild_head=0
  &wild_tail=0
  &clk_input_length=STRING.LENGTH("&clk")
  &clk_itr_length=STRING.LENGTH("gcc_pnoc_bus_timeout4_ahb_clk")

  if (STRING.SCAN("&clk", "*", 0)==0)
  (
    &wild_head=1
  )
  if (STRING.SCAN("&clk", "*", 1)==(STRING.LENGTH("&clk")-1))
  (
    &wild_tail=1
  )

  if ((&wild_head==1)&&(&wild_tail==1))
  (
    if (STRING.SCAN("gcc_pnoc_bus_timeout4_ahb_clk", STRING.MID("&clk", 1, &clk_input_length-2), 0)!=-1)
    ( 
      &match=1
    )
  )
  else if (&wild_head==1)
  (
    if (STRING.MID("gcc_pnoc_bus_timeout4_ahb_clk", &clk_itr_length-&clk_input_length+1, &clk_input_length-1)==STRING.CUT("&clk", 1))
    ( 
      &match=1
    )
  )
  else if (&wild_tail==1)
  (
    if (STRING.MID("gcc_pnoc_bus_timeout4_ahb_clk", 0, &clk_input_length-1)==STRING.CUT("&clk", -1))
    ( 
      &match=1
    )
  )	  
  else if ("gcc_pnoc_bus_timeout4_ahb_clk"=="&clk")
  (
    &match=1
  )
  
  if (&match==1)
  (
    &clk_test=&CLK_TEST_GCC_PNOC_BUS_TIMEOUT4_AHB_CLK
    &clk_reg=&HWIO_GCC_PNOC_BUS_TIMEOUT4_AHB_CBCR_ADDR
    &clk_reg_name="GCC_PNOC_BUS_TIMEOUT4_AHB_CBCR"
    &clk_name="gcc_pnoc_bus_timeout4_ahb_clk"
    &clk_reg_cbcr_type="sm_cbc"

    gosub Print_Clk_Info_Line
  )

  &match=0
  &wild_head=0
  &wild_tail=0
  &clk_input_length=STRING.LENGTH("&clk")
  &clk_itr_length=STRING.LENGTH("gcc_prng_ahb_clk")

  if (STRING.SCAN("&clk", "*", 0)==0)
  (
    &wild_head=1
  )
  if (STRING.SCAN("&clk", "*", 1)==(STRING.LENGTH("&clk")-1))
  (
    &wild_tail=1
  )

  if ((&wild_head==1)&&(&wild_tail==1))
  (
    if (STRING.SCAN("gcc_prng_ahb_clk", STRING.MID("&clk", 1, &clk_input_length-2), 0)!=-1)
    ( 
      &match=1
    )
  )
  else if (&wild_head==1)
  (
    if (STRING.MID("gcc_prng_ahb_clk", &clk_itr_length-&clk_input_length+1, &clk_input_length-1)==STRING.CUT("&clk", 1))
    ( 
      &match=1
    )
  )
  else if (&wild_tail==1)
  (
    if (STRING.MID("gcc_prng_ahb_clk", 0, &clk_input_length-1)==STRING.CUT("&clk", -1))
    ( 
      &match=1
    )
  )	  
  else if ("gcc_prng_ahb_clk"=="&clk")
  (
    &match=1
  )
  
  if (&match==1)
  (
    &clk_test=&CLK_TEST_GCC_PRNG_AHB_CLK
    &clk_reg=&HWIO_GCC_PRNG_AHB_CBCR_ADDR
    &clk_reg_name="GCC_PRNG_AHB_CBCR"
    &clk_name="gcc_prng_ahb_clk"
    &clk_reg_cbcr_type="sm_cbc"

    gosub Print_Clk_Info_Line
  )

  &match=0
  &wild_head=0
  &wild_tail=0
  &clk_input_length=STRING.LENGTH("&clk")
  &clk_itr_length=STRING.LENGTH("gcc_sdcc1_ahb_clk")

  if (STRING.SCAN("&clk", "*", 0)==0)
  (
    &wild_head=1
  )
  if (STRING.SCAN("&clk", "*", 1)==(STRING.LENGTH("&clk")-1))
  (
    &wild_tail=1
  )

  if ((&wild_head==1)&&(&wild_tail==1))
  (
    if (STRING.SCAN("gcc_sdcc1_ahb_clk", STRING.MID("&clk", 1, &clk_input_length-2), 0)!=-1)
    ( 
      &match=1
    )
  )
  else if (&wild_head==1)
  (
    if (STRING.MID("gcc_sdcc1_ahb_clk", &clk_itr_length-&clk_input_length+1, &clk_input_length-1)==STRING.CUT("&clk", 1))
    ( 
      &match=1
    )
  )
  else if (&wild_tail==1)
  (
    if (STRING.MID("gcc_sdcc1_ahb_clk", 0, &clk_input_length-1)==STRING.CUT("&clk", -1))
    ( 
      &match=1
    )
  )	  
  else if ("gcc_sdcc1_ahb_clk"=="&clk")
  (
    &match=1
  )
  
  if (&match==1)
  (
    &clk_test=&CLK_TEST_GCC_SDCC1_AHB_CLK
    &clk_reg=&HWIO_GCC_SDCC1_AHB_CBCR_ADDR
    &clk_reg_name="GCC_SDCC1_AHB_CBCR"
    &clk_name="gcc_sdcc1_ahb_clk"
    &clk_reg_cbcr_type="sm_pscbc"

    gosub Print_Clk_Info_Line
  )

  &match=0
  &wild_head=0
  &wild_tail=0
  &clk_input_length=STRING.LENGTH("&clk")
  &clk_itr_length=STRING.LENGTH("gcc_sdcc2_ahb_clk")

  if (STRING.SCAN("&clk", "*", 0)==0)
  (
    &wild_head=1
  )
  if (STRING.SCAN("&clk", "*", 1)==(STRING.LENGTH("&clk")-1))
  (
    &wild_tail=1
  )

  if ((&wild_head==1)&&(&wild_tail==1))
  (
    if (STRING.SCAN("gcc_sdcc2_ahb_clk", STRING.MID("&clk", 1, &clk_input_length-2), 0)!=-1)
    ( 
      &match=1
    )
  )
  else if (&wild_head==1)
  (
    if (STRING.MID("gcc_sdcc2_ahb_clk", &clk_itr_length-&clk_input_length+1, &clk_input_length-1)==STRING.CUT("&clk", 1))
    ( 
      &match=1
    )
  )
  else if (&wild_tail==1)
  (
    if (STRING.MID("gcc_sdcc2_ahb_clk", 0, &clk_input_length-1)==STRING.CUT("&clk", -1))
    ( 
      &match=1
    )
  )	  
  else if ("gcc_sdcc2_ahb_clk"=="&clk")
  (
    &match=1
  )
  
  if (&match==1)
  (
    &clk_test=&CLK_TEST_GCC_SDCC2_AHB_CLK
    &clk_reg=&HWIO_GCC_SDCC2_AHB_CBCR_ADDR
    &clk_reg_name="GCC_SDCC2_AHB_CBCR"
    &clk_name="gcc_sdcc2_ahb_clk"
    &clk_reg_cbcr_type="sm_pscbc"

    gosub Print_Clk_Info_Line
  )

  &match=0
  &wild_head=0
  &wild_tail=0
  &clk_input_length=STRING.LENGTH("&clk")
  &clk_itr_length=STRING.LENGTH("gcc_sdcc3_ahb_clk")

  if (STRING.SCAN("&clk", "*", 0)==0)
  (
    &wild_head=1
  )
  if (STRING.SCAN("&clk", "*", 1)==(STRING.LENGTH("&clk")-1))
  (
    &wild_tail=1
  )

  if ((&wild_head==1)&&(&wild_tail==1))
  (
    if (STRING.SCAN("gcc_sdcc3_ahb_clk", STRING.MID("&clk", 1, &clk_input_length-2), 0)!=-1)
    ( 
      &match=1
    )
  )
  else if (&wild_head==1)
  (
    if (STRING.MID("gcc_sdcc3_ahb_clk", &clk_itr_length-&clk_input_length+1, &clk_input_length-1)==STRING.CUT("&clk", 1))
    ( 
      &match=1
    )
  )
  else if (&wild_tail==1)
  (
    if (STRING.MID("gcc_sdcc3_ahb_clk", 0, &clk_input_length-1)==STRING.CUT("&clk", -1))
    ( 
      &match=1
    )
  )	  
  else if ("gcc_sdcc3_ahb_clk"=="&clk")
  (
    &match=1
  )
  
  if (&match==1)
  (
    &clk_test=&CLK_TEST_GCC_SDCC3_AHB_CLK
    &clk_reg=&HWIO_GCC_SDCC3_AHB_CBCR_ADDR
    &clk_reg_name="GCC_SDCC3_AHB_CBCR"
    &clk_name="gcc_sdcc3_ahb_clk"
    &clk_reg_cbcr_type="sm_pscbc"

    gosub Print_Clk_Info_Line
  )

  &match=0
  &wild_head=0
  &wild_tail=0
  &clk_input_length=STRING.LENGTH("&clk")
  &clk_itr_length=STRING.LENGTH("gcc_sdcc4_ahb_clk")

  if (STRING.SCAN("&clk", "*", 0)==0)
  (
    &wild_head=1
  )
  if (STRING.SCAN("&clk", "*", 1)==(STRING.LENGTH("&clk")-1))
  (
    &wild_tail=1
  )

  if ((&wild_head==1)&&(&wild_tail==1))
  (
    if (STRING.SCAN("gcc_sdcc4_ahb_clk", STRING.MID("&clk", 1, &clk_input_length-2), 0)!=-1)
    ( 
      &match=1
    )
  )
  else if (&wild_head==1)
  (
    if (STRING.MID("gcc_sdcc4_ahb_clk", &clk_itr_length-&clk_input_length+1, &clk_input_length-1)==STRING.CUT("&clk", 1))
    ( 
      &match=1
    )
  )
  else if (&wild_tail==1)
  (
    if (STRING.MID("gcc_sdcc4_ahb_clk", 0, &clk_input_length-1)==STRING.CUT("&clk", -1))
    ( 
      &match=1
    )
  )	  
  else if ("gcc_sdcc4_ahb_clk"=="&clk")
  (
    &match=1
  )
  
  if (&match==1)
  (
    &clk_test=&CLK_TEST_GCC_SDCC4_AHB_CLK
    &clk_reg=&HWIO_GCC_SDCC4_AHB_CBCR_ADDR
    &clk_reg_name="GCC_SDCC4_AHB_CBCR"
    &clk_name="gcc_sdcc4_ahb_clk"
    &clk_reg_cbcr_type="sm_pscbc"

    gosub Print_Clk_Info_Line
  )

  &match=0
  &wild_head=0
  &wild_tail=0
  &clk_input_length=STRING.LENGTH("&clk")
  &clk_itr_length=STRING.LENGTH("gcc_snoc_pnoc_ahb_clk")

  if (STRING.SCAN("&clk", "*", 0)==0)
  (
    &wild_head=1
  )
  if (STRING.SCAN("&clk", "*", 1)==(STRING.LENGTH("&clk")-1))
  (
    &wild_tail=1
  )

  if ((&wild_head==1)&&(&wild_tail==1))
  (
    if (STRING.SCAN("gcc_snoc_pnoc_ahb_clk", STRING.MID("&clk", 1, &clk_input_length-2), 0)!=-1)
    ( 
      &match=1
    )
  )
  else if (&wild_head==1)
  (
    if (STRING.MID("gcc_snoc_pnoc_ahb_clk", &clk_itr_length-&clk_input_length+1, &clk_input_length-1)==STRING.CUT("&clk", 1))
    ( 
      &match=1
    )
  )
  else if (&wild_tail==1)
  (
    if (STRING.MID("gcc_snoc_pnoc_ahb_clk", 0, &clk_input_length-1)==STRING.CUT("&clk", -1))
    ( 
      &match=1
    )
  )	  
  else if ("gcc_snoc_pnoc_ahb_clk"=="&clk")
  (
    &match=1
  )
  
  if (&match==1)
  (
    &clk_test=&CLK_TEST_GCC_SNOC_PNOC_AHB_CLK
    &clk_reg=&HWIO_GCC_SNOC_PNOC_AHB_CBCR_ADDR
    &clk_reg_name="GCC_SNOC_PNOC_AHB_CBCR"
    &clk_name="gcc_snoc_pnoc_ahb_clk"
    &clk_reg_cbcr_type="sm_cbc"

    gosub Print_Clk_Info_Line
  )

  &match=0
  &wild_head=0
  &wild_tail=0
  &clk_input_length=STRING.LENGTH("&clk")
  &clk_itr_length=STRING.LENGTH("gcc_tsif_ahb_clk")

  if (STRING.SCAN("&clk", "*", 0)==0)
  (
    &wild_head=1
  )
  if (STRING.SCAN("&clk", "*", 1)==(STRING.LENGTH("&clk")-1))
  (
    &wild_tail=1
  )

  if ((&wild_head==1)&&(&wild_tail==1))
  (
    if (STRING.SCAN("gcc_tsif_ahb_clk", STRING.MID("&clk", 1, &clk_input_length-2), 0)!=-1)
    ( 
      &match=1
    )
  )
  else if (&wild_head==1)
  (
    if (STRING.MID("gcc_tsif_ahb_clk", &clk_itr_length-&clk_input_length+1, &clk_input_length-1)==STRING.CUT("&clk", 1))
    ( 
      &match=1
    )
  )
  else if (&wild_tail==1)
  (
    if (STRING.MID("gcc_tsif_ahb_clk", 0, &clk_input_length-1)==STRING.CUT("&clk", -1))
    ( 
      &match=1
    )
  )	  
  else if ("gcc_tsif_ahb_clk"=="&clk")
  (
    &match=1
  )
  
  if (&match==1)
  (
    &clk_test=&CLK_TEST_GCC_TSIF_AHB_CLK
    &clk_reg=&HWIO_GCC_TSIF_AHB_CBCR_ADDR
    &clk_reg_name="GCC_TSIF_AHB_CBCR"
    &clk_name="gcc_tsif_ahb_clk"
    &clk_reg_cbcr_type="sm_pscbc"

    gosub Print_Clk_Info_Line
  )

  &match=0
  &wild_head=0
  &wild_tail=0
  &clk_input_length=STRING.LENGTH("&clk")
  &clk_itr_length=STRING.LENGTH("gcc_usb_hs_ahb_clk")

  if (STRING.SCAN("&clk", "*", 0)==0)
  (
    &wild_head=1
  )
  if (STRING.SCAN("&clk", "*", 1)==(STRING.LENGTH("&clk")-1))
  (
    &wild_tail=1
  )

  if ((&wild_head==1)&&(&wild_tail==1))
  (
    if (STRING.SCAN("gcc_usb_hs_ahb_clk", STRING.MID("&clk", 1, &clk_input_length-2), 0)!=-1)
    ( 
      &match=1
    )
  )
  else if (&wild_head==1)
  (
    if (STRING.MID("gcc_usb_hs_ahb_clk", &clk_itr_length-&clk_input_length+1, &clk_input_length-1)==STRING.CUT("&clk", 1))
    ( 
      &match=1
    )
  )
  else if (&wild_tail==1)
  (
    if (STRING.MID("gcc_usb_hs_ahb_clk", 0, &clk_input_length-1)==STRING.CUT("&clk", -1))
    ( 
      &match=1
    )
  )	  
  else if ("gcc_usb_hs_ahb_clk"=="&clk")
  (
    &match=1
  )
  
  if (&match==1)
  (
    &clk_test=&CLK_TEST_GCC_USB_HS_AHB_CLK
    &clk_reg=&HWIO_GCC_USB_HS_AHB_CBCR_ADDR
    &clk_reg_name="GCC_USB_HS_AHB_CBCR"
    &clk_name="gcc_usb_hs_ahb_clk"
    &clk_reg_cbcr_type="sm_pscbc"

    gosub Print_Clk_Info_Line
  )

  &match=0
  &wild_head=0
  &wild_tail=0
  &clk_input_length=STRING.LENGTH("&clk")
  &clk_itr_length=STRING.LENGTH("gcc_usb_phy_cfg_ahb2phy_clk")

  if (STRING.SCAN("&clk", "*", 0)==0)
  (
    &wild_head=1
  )
  if (STRING.SCAN("&clk", "*", 1)==(STRING.LENGTH("&clk")-1))
  (
    &wild_tail=1
  )

  if ((&wild_head==1)&&(&wild_tail==1))
  (
    if (STRING.SCAN("gcc_usb_phy_cfg_ahb2phy_clk", STRING.MID("&clk", 1, &clk_input_length-2), 0)!=-1)
    ( 
      &match=1
    )
  )
  else if (&wild_head==1)
  (
    if (STRING.MID("gcc_usb_phy_cfg_ahb2phy_clk", &clk_itr_length-&clk_input_length+1, &clk_input_length-1)==STRING.CUT("&clk", 1))
    ( 
      &match=1
    )
  )
  else if (&wild_tail==1)
  (
    if (STRING.MID("gcc_usb_phy_cfg_ahb2phy_clk", 0, &clk_input_length-1)==STRING.CUT("&clk", -1))
    ( 
      &match=1
    )
  )	  
  else if ("gcc_usb_phy_cfg_ahb2phy_clk"=="&clk")
  (
    &match=1
  )
  
  if (&match==1)
  (
    &clk_test=&CLK_TEST_GCC_USB_PHY_CFG_AHB2PHY_CLK
    &clk_reg=&HWIO_GCC_USB_PHY_CFG_AHB2PHY_CBCR_ADDR
    &clk_reg_name="GCC_USB_PHY_CFG_AHB2PHY_CBCR"
    &clk_name="gcc_usb_phy_cfg_ahb2phy_clk"
    &clk_reg_cbcr_type="sm_cbc"

    gosub Print_Clk_Info_Line
  )

  &match=0
  &wild_head=0
  &wild_tail=0
  &clk_input_length=STRING.LENGTH("&clk")
  &clk_itr_length=STRING.LENGTH("gcc_mmss_noc_at_clk")

  if (STRING.SCAN("&clk", "*", 0)==0)
  (
    &wild_head=1
  )
  if (STRING.SCAN("&clk", "*", 1)==(STRING.LENGTH("&clk")-1))
  (
    &wild_tail=1
  )

  if ((&wild_head==1)&&(&wild_tail==1))
  (
    if (STRING.SCAN("gcc_mmss_noc_at_clk", STRING.MID("&clk", 1, &clk_input_length-2), 0)!=-1)
    ( 
      &match=1
    )
  )
  else if (&wild_head==1)
  (
    if (STRING.MID("gcc_mmss_noc_at_clk", &clk_itr_length-&clk_input_length+1, &clk_input_length-1)==STRING.CUT("&clk", 1))
    ( 
      &match=1
    )
  )
  else if (&wild_tail==1)
  (
    if (STRING.MID("gcc_mmss_noc_at_clk", 0, &clk_input_length-1)==STRING.CUT("&clk", -1))
    ( 
      &match=1
    )
  )	  
  else if ("gcc_mmss_noc_at_clk"=="&clk")
  (
    &match=1
  )
  
  if (&match==1)
  (
    &clk_test=&CLK_TEST_GCC_MMSS_NOC_AT_CLK
    &clk_reg=&HWIO_GCC_MMSS_NOC_AT_CBCR_ADDR
    &clk_reg_name="GCC_MMSS_NOC_AT_CBCR"
    &clk_name="gcc_mmss_noc_at_clk"
    &clk_reg_cbcr_type="sm_cbc"

    gosub Print_Clk_Info_Line
  )

  &match=0
  &wild_head=0
  &wild_tail=0
  &clk_input_length=STRING.LENGTH("&clk")
  &clk_itr_length=STRING.LENGTH("gcc_periph_noc_at_clk")

  if (STRING.SCAN("&clk", "*", 0)==0)
  (
    &wild_head=1
  )
  if (STRING.SCAN("&clk", "*", 1)==(STRING.LENGTH("&clk")-1))
  (
    &wild_tail=1
  )

  if ((&wild_head==1)&&(&wild_tail==1))
  (
    if (STRING.SCAN("gcc_periph_noc_at_clk", STRING.MID("&clk", 1, &clk_input_length-2), 0)!=-1)
    ( 
      &match=1
    )
  )
  else if (&wild_head==1)
  (
    if (STRING.MID("gcc_periph_noc_at_clk", &clk_itr_length-&clk_input_length+1, &clk_input_length-1)==STRING.CUT("&clk", 1))
    ( 
      &match=1
    )
  )
  else if (&wild_tail==1)
  (
    if (STRING.MID("gcc_periph_noc_at_clk", 0, &clk_input_length-1)==STRING.CUT("&clk", -1))
    ( 
      &match=1
    )
  )	  
  else if ("gcc_periph_noc_at_clk"=="&clk")
  (
    &match=1
  )
  
  if (&match==1)
  (
    &clk_test=&CLK_TEST_GCC_PERIPH_NOC_AT_CLK
    &clk_reg=&HWIO_GCC_PERIPH_NOC_AT_CBCR_ADDR
    &clk_reg_name="GCC_PERIPH_NOC_AT_CBCR"
    &clk_name="gcc_periph_noc_at_clk"
    &clk_reg_cbcr_type="sm_cbc"

    gosub Print_Clk_Info_Line
  )

  &match=0
  &wild_head=0
  &wild_tail=0
  &clk_input_length=STRING.LENGTH("&clk")
  &clk_itr_length=STRING.LENGTH("gcc_qdss_at_clk")

  if (STRING.SCAN("&clk", "*", 0)==0)
  (
    &wild_head=1
  )
  if (STRING.SCAN("&clk", "*", 1)==(STRING.LENGTH("&clk")-1))
  (
    &wild_tail=1
  )

  if ((&wild_head==1)&&(&wild_tail==1))
  (
    if (STRING.SCAN("gcc_qdss_at_clk", STRING.MID("&clk", 1, &clk_input_length-2), 0)!=-1)
    ( 
      &match=1
    )
  )
  else if (&wild_head==1)
  (
    if (STRING.MID("gcc_qdss_at_clk", &clk_itr_length-&clk_input_length+1, &clk_input_length-1)==STRING.CUT("&clk", 1))
    ( 
      &match=1
    )
  )
  else if (&wild_tail==1)
  (
    if (STRING.MID("gcc_qdss_at_clk", 0, &clk_input_length-1)==STRING.CUT("&clk", -1))
    ( 
      &match=1
    )
  )	  
  else if ("gcc_qdss_at_clk"=="&clk")
  (
    &match=1
  )
  
  if (&match==1)
  (
    &clk_test=&CLK_TEST_GCC_QDSS_AT_CLK
    &clk_reg=&HWIO_GCC_QDSS_AT_CBCR_ADDR
    &clk_reg_name="GCC_QDSS_AT_CBCR"
    &clk_name="gcc_qdss_at_clk"
    &clk_reg_cbcr_type="sm_pscbc"

    gosub Print_Clk_Info_Line
  )

  &match=0
  &wild_head=0
  &wild_tail=0
  &clk_input_length=STRING.LENGTH("&clk")
  &clk_itr_length=STRING.LENGTH("gcc_sys_noc_at_clk")

  if (STRING.SCAN("&clk", "*", 0)==0)
  (
    &wild_head=1
  )
  if (STRING.SCAN("&clk", "*", 1)==(STRING.LENGTH("&clk")-1))
  (
    &wild_tail=1
  )

  if ((&wild_head==1)&&(&wild_tail==1))
  (
    if (STRING.SCAN("gcc_sys_noc_at_clk", STRING.MID("&clk", 1, &clk_input_length-2), 0)!=-1)
    ( 
      &match=1
    )
  )
  else if (&wild_head==1)
  (
    if (STRING.MID("gcc_sys_noc_at_clk", &clk_itr_length-&clk_input_length+1, &clk_input_length-1)==STRING.CUT("&clk", 1))
    ( 
      &match=1
    )
  )
  else if (&wild_tail==1)
  (
    if (STRING.MID("gcc_sys_noc_at_clk", 0, &clk_input_length-1)==STRING.CUT("&clk", -1))
    ( 
      &match=1
    )
  )	  
  else if ("gcc_sys_noc_at_clk"=="&clk")
  (
    &match=1
  )
  
  if (&match==1)
  (
    &clk_test=&CLK_TEST_GCC_SYS_NOC_AT_CLK
    &clk_reg=&HWIO_GCC_SYS_NOC_AT_CBCR_ADDR
    &clk_reg_name="GCC_SYS_NOC_AT_CBCR"
    &clk_name="gcc_sys_noc_at_clk"
    &clk_reg_cbcr_type="sm_cbc"

    gosub Print_Clk_Info_Line
  )

  &match=0
  &wild_head=0
  &wild_tail=0
  &clk_input_length=STRING.LENGTH("&clk")
  &clk_itr_length=STRING.LENGTH("gcc_qdss_dap_clk")

  if (STRING.SCAN("&clk", "*", 0)==0)
  (
    &wild_head=1
  )
  if (STRING.SCAN("&clk", "*", 1)==(STRING.LENGTH("&clk")-1))
  (
    &wild_tail=1
  )

  if ((&wild_head==1)&&(&wild_tail==1))
  (
    if (STRING.SCAN("gcc_qdss_dap_clk", STRING.MID("&clk", 1, &clk_input_length-2), 0)!=-1)
    ( 
      &match=1
    )
  )
  else if (&wild_head==1)
  (
    if (STRING.MID("gcc_qdss_dap_clk", &clk_itr_length-&clk_input_length+1, &clk_input_length-1)==STRING.CUT("&clk", 1))
    ( 
      &match=1
    )
  )
  else if (&wild_tail==1)
  (
    if (STRING.MID("gcc_qdss_dap_clk", 0, &clk_input_length-1)==STRING.CUT("&clk", -1))
    ( 
      &match=1
    )
  )	  
  else if ("gcc_qdss_dap_clk"=="&clk")
  (
    &match=1
  )
  
  if (&match==1)
  (
    &clk_test=&CLK_TEST_GCC_QDSS_DAP_CLK
    &clk_reg=&HWIO_GCC_QDSS_DAP_CBCR_ADDR
    &clk_reg_name="GCC_QDSS_DAP_CBCR"
    &clk_name="gcc_qdss_dap_clk"
    &clk_reg_cbcr_type="sm_cbc"

    gosub Print_Clk_Info_Line
  )

  &match=0
  &wild_head=0
  &wild_tail=0
  &clk_input_length=STRING.LENGTH("&clk")
  &clk_itr_length=STRING.LENGTH("gcc_qdss_stm_clk")

  if (STRING.SCAN("&clk", "*", 0)==0)
  (
    &wild_head=1
  )
  if (STRING.SCAN("&clk", "*", 1)==(STRING.LENGTH("&clk")-1))
  (
    &wild_tail=1
  )

  if ((&wild_head==1)&&(&wild_tail==1))
  (
    if (STRING.SCAN("gcc_qdss_stm_clk", STRING.MID("&clk", 1, &clk_input_length-2), 0)!=-1)
    ( 
      &match=1
    )
  )
  else if (&wild_head==1)
  (
    if (STRING.MID("gcc_qdss_stm_clk", &clk_itr_length-&clk_input_length+1, &clk_input_length-1)==STRING.CUT("&clk", 1))
    ( 
      &match=1
    )
  )
  else if (&wild_tail==1)
  (
    if (STRING.MID("gcc_qdss_stm_clk", 0, &clk_input_length-1)==STRING.CUT("&clk", -1))
    ( 
      &match=1
    )
  )	  
  else if ("gcc_qdss_stm_clk"=="&clk")
  (
    &match=1
  )
  
  if (&match==1)
  (
    &clk_test=&CLK_TEST_GCC_QDSS_STM_CLK
    &clk_reg=&HWIO_GCC_QDSS_STM_CBCR_ADDR
    &clk_reg_name="GCC_QDSS_STM_CBCR"
    &clk_name="gcc_qdss_stm_clk"
    &clk_reg_cbcr_type="sm_cbc"

    gosub Print_Clk_Info_Line
  )

  &match=0
  &wild_head=0
  &wild_tail=0
  &clk_input_length=STRING.LENGTH("&clk")
  &clk_itr_length=STRING.LENGTH("gcc_sys_noc_qdss_stm_axi_clk")

  if (STRING.SCAN("&clk", "*", 0)==0)
  (
    &wild_head=1
  )
  if (STRING.SCAN("&clk", "*", 1)==(STRING.LENGTH("&clk")-1))
  (
    &wild_tail=1
  )

  if ((&wild_head==1)&&(&wild_tail==1))
  (
    if (STRING.SCAN("gcc_sys_noc_qdss_stm_axi_clk", STRING.MID("&clk", 1, &clk_input_length-2), 0)!=-1)
    ( 
      &match=1
    )
  )
  else if (&wild_head==1)
  (
    if (STRING.MID("gcc_sys_noc_qdss_stm_axi_clk", &clk_itr_length-&clk_input_length+1, &clk_input_length-1)==STRING.CUT("&clk", 1))
    ( 
      &match=1
    )
  )
  else if (&wild_tail==1)
  (
    if (STRING.MID("gcc_sys_noc_qdss_stm_axi_clk", 0, &clk_input_length-1)==STRING.CUT("&clk", -1))
    ( 
      &match=1
    )
  )	  
  else if ("gcc_sys_noc_qdss_stm_axi_clk"=="&clk")
  (
    &match=1
  )
  
  if (&match==1)
  (
    &clk_test=&CLK_TEST_GCC_SYS_NOC_QDSS_STM_AXI_CLK
    &clk_reg=&HWIO_GCC_SYS_NOC_QDSS_STM_AXI_CBCR_ADDR
    &clk_reg_name="GCC_SYS_NOC_QDSS_STM_AXI_CBCR"
    &clk_name="gcc_sys_noc_qdss_stm_axi_clk"
    &clk_reg_cbcr_type="sm_cbc"

    gosub Print_Clk_Info_Line
  )

  &match=0
  &wild_head=0
  &wild_tail=0
  &clk_input_length=STRING.LENGTH("&clk")
  &clk_itr_length=STRING.LENGTH("gcc_qdss_traceclkin_clk")

  if (STRING.SCAN("&clk", "*", 0)==0)
  (
    &wild_head=1
  )
  if (STRING.SCAN("&clk", "*", 1)==(STRING.LENGTH("&clk")-1))
  (
    &wild_tail=1
  )

  if ((&wild_head==1)&&(&wild_tail==1))
  (
    if (STRING.SCAN("gcc_qdss_traceclkin_clk", STRING.MID("&clk", 1, &clk_input_length-2), 0)!=-1)
    ( 
      &match=1
    )
  )
  else if (&wild_head==1)
  (
    if (STRING.MID("gcc_qdss_traceclkin_clk", &clk_itr_length-&clk_input_length+1, &clk_input_length-1)==STRING.CUT("&clk", 1))
    ( 
      &match=1
    )
  )
  else if (&wild_tail==1)
  (
    if (STRING.MID("gcc_qdss_traceclkin_clk", 0, &clk_input_length-1)==STRING.CUT("&clk", -1))
    ( 
      &match=1
    )
  )	  
  else if ("gcc_qdss_traceclkin_clk"=="&clk")
  (
    &match=1
  )
  
  if (&match==1)
  (
    &clk_test=&CLK_TEST_GCC_QDSS_TRACECLKIN_CLK
    &clk_reg=&HWIO_GCC_QDSS_TRACECLKIN_CBCR_ADDR
    &clk_reg_name="GCC_QDSS_TRACECLKIN_CBCR"
    &clk_name="gcc_qdss_traceclkin_clk"
    &clk_reg_cbcr_type="sm_cbc"

    gosub Print_Clk_Info_Line
  )

  &match=0
  &wild_head=0
  &wild_tail=0
  &clk_input_length=STRING.LENGTH("&clk")
  &clk_itr_length=STRING.LENGTH("gcc_qdss_tsctr_div2_clk")

  if (STRING.SCAN("&clk", "*", 0)==0)
  (
    &wild_head=1
  )
  if (STRING.SCAN("&clk", "*", 1)==(STRING.LENGTH("&clk")-1))
  (
    &wild_tail=1
  )

  if ((&wild_head==1)&&(&wild_tail==1))
  (
    if (STRING.SCAN("gcc_qdss_tsctr_div2_clk", STRING.MID("&clk", 1, &clk_input_length-2), 0)!=-1)
    ( 
      &match=1
    )
  )
  else if (&wild_head==1)
  (
    if (STRING.MID("gcc_qdss_tsctr_div2_clk", &clk_itr_length-&clk_input_length+1, &clk_input_length-1)==STRING.CUT("&clk", 1))
    ( 
      &match=1
    )
  )
  else if (&wild_tail==1)
  (
    if (STRING.MID("gcc_qdss_tsctr_div2_clk", 0, &clk_input_length-1)==STRING.CUT("&clk", -1))
    ( 
      &match=1
    )
  )	  
  else if ("gcc_qdss_tsctr_div2_clk"=="&clk")
  (
    &match=1
  )
  
  if (&match==1)
  (
    &clk_test=&CLK_TEST_GCC_QDSS_TSCTR_DIV2_CLK
    &clk_reg=&HWIO_GCC_QDSS_TSCTR_DIV2_CBCR_ADDR
    &clk_reg_name="GCC_QDSS_TSCTR_DIV2_CBCR"
    &clk_name="gcc_qdss_tsctr_div2_clk"
    &clk_reg_cbcr_type="sm_cbc"

    gosub Print_Clk_Info_Line
  )

  &match=0
  &wild_head=0
  &wild_tail=0
  &clk_input_length=STRING.LENGTH("&clk")
  &clk_itr_length=STRING.LENGTH("gcc_qdss_tsctr_div4_clk")

  if (STRING.SCAN("&clk", "*", 0)==0)
  (
    &wild_head=1
  )
  if (STRING.SCAN("&clk", "*", 1)==(STRING.LENGTH("&clk")-1))
  (
    &wild_tail=1
  )

  if ((&wild_head==1)&&(&wild_tail==1))
  (
    if (STRING.SCAN("gcc_qdss_tsctr_div4_clk", STRING.MID("&clk", 1, &clk_input_length-2), 0)!=-1)
    ( 
      &match=1
    )
  )
  else if (&wild_head==1)
  (
    if (STRING.MID("gcc_qdss_tsctr_div4_clk", &clk_itr_length-&clk_input_length+1, &clk_input_length-1)==STRING.CUT("&clk", 1))
    ( 
      &match=1
    )
  )
  else if (&wild_tail==1)
  (
    if (STRING.MID("gcc_qdss_tsctr_div4_clk", 0, &clk_input_length-1)==STRING.CUT("&clk", -1))
    ( 
      &match=1
    )
  )	  
  else if ("gcc_qdss_tsctr_div4_clk"=="&clk")
  (
    &match=1
  )
  
  if (&match==1)
  (
    &clk_test=&CLK_TEST_GCC_QDSS_TSCTR_DIV4_CLK
    &clk_reg=&HWIO_GCC_QDSS_TSCTR_DIV4_CBCR_ADDR
    &clk_reg_name="GCC_QDSS_TSCTR_DIV4_CBCR"
    &clk_name="gcc_qdss_tsctr_div4_clk"
    &clk_reg_cbcr_type="sm_cbc"

    gosub Print_Clk_Info_Line
  )

  &match=0
  &wild_head=0
  &wild_tail=0
  &clk_input_length=STRING.LENGTH("&clk")
  &clk_itr_length=STRING.LENGTH("gcc_qdss_tsctr_div16_clk")

  if (STRING.SCAN("&clk", "*", 0)==0)
  (
    &wild_head=1
  )
  if (STRING.SCAN("&clk", "*", 1)==(STRING.LENGTH("&clk")-1))
  (
    &wild_tail=1
  )

  if ((&wild_head==1)&&(&wild_tail==1))
  (
    if (STRING.SCAN("gcc_qdss_tsctr_div16_clk", STRING.MID("&clk", 1, &clk_input_length-2), 0)!=-1)
    ( 
      &match=1
    )
  )
  else if (&wild_head==1)
  (
    if (STRING.MID("gcc_qdss_tsctr_div16_clk", &clk_itr_length-&clk_input_length+1, &clk_input_length-1)==STRING.CUT("&clk", 1))
    ( 
      &match=1
    )
  )
  else if (&wild_tail==1)
  (
    if (STRING.MID("gcc_qdss_tsctr_div16_clk", 0, &clk_input_length-1)==STRING.CUT("&clk", -1))
    ( 
      &match=1
    )
  )	  
  else if ("gcc_qdss_tsctr_div16_clk"=="&clk")
  (
    &match=1
  )
  
  if (&match==1)
  (
    &clk_test=&CLK_TEST_GCC_QDSS_TSCTR_DIV16_CLK
    &clk_reg=&HWIO_GCC_QDSS_TSCTR_DIV16_CBCR_ADDR
    &clk_reg_name="GCC_QDSS_TSCTR_DIV16_CBCR"
    &clk_name="gcc_qdss_tsctr_div16_clk"
    &clk_reg_cbcr_type="sm_cbc"

    gosub Print_Clk_Info_Line
  )

  &match=0
  &wild_head=0
  &wild_tail=0
  &clk_input_length=STRING.LENGTH("&clk")
  &clk_itr_length=STRING.LENGTH("gcc_qdss_tsctr_div3_clk")

  if (STRING.SCAN("&clk", "*", 0)==0)
  (
    &wild_head=1
  )
  if (STRING.SCAN("&clk", "*", 1)==(STRING.LENGTH("&clk")-1))
  (
    &wild_tail=1
  )

  if ((&wild_head==1)&&(&wild_tail==1))
  (
    if (STRING.SCAN("gcc_qdss_tsctr_div3_clk", STRING.MID("&clk", 1, &clk_input_length-2), 0)!=-1)
    ( 
      &match=1
    )
  )
  else if (&wild_head==1)
  (
    if (STRING.MID("gcc_qdss_tsctr_div3_clk", &clk_itr_length-&clk_input_length+1, &clk_input_length-1)==STRING.CUT("&clk", 1))
    ( 
      &match=1
    )
  )
  else if (&wild_tail==1)
  (
    if (STRING.MID("gcc_qdss_tsctr_div3_clk", 0, &clk_input_length-1)==STRING.CUT("&clk", -1))
    ( 
      &match=1
    )
  )	  
  else if ("gcc_qdss_tsctr_div3_clk"=="&clk")
  (
    &match=1
  )
  
  if (&match==1)
  (
    &clk_test=&CLK_TEST_GCC_QDSS_TSCTR_DIV3_CLK
    &clk_reg=&HWIO_GCC_QDSS_TSCTR_DIV3_CBCR_ADDR
    &clk_reg_name="GCC_QDSS_TSCTR_DIV3_CBCR"
    &clk_name="gcc_qdss_tsctr_div3_clk"
    &clk_reg_cbcr_type="sm_cbc"

    gosub Print_Clk_Info_Line
  )

  &match=0
  &wild_head=0
  &wild_tail=0
  &clk_input_length=STRING.LENGTH("&clk")
  &clk_itr_length=STRING.LENGTH("gcc_qdss_tsctr_div8_clk")

  if (STRING.SCAN("&clk", "*", 0)==0)
  (
    &wild_head=1
  )
  if (STRING.SCAN("&clk", "*", 1)==(STRING.LENGTH("&clk")-1))
  (
    &wild_tail=1
  )

  if ((&wild_head==1)&&(&wild_tail==1))
  (
    if (STRING.SCAN("gcc_qdss_tsctr_div8_clk", STRING.MID("&clk", 1, &clk_input_length-2), 0)!=-1)
    ( 
      &match=1
    )
  )
  else if (&wild_head==1)
  (
    if (STRING.MID("gcc_qdss_tsctr_div8_clk", &clk_itr_length-&clk_input_length+1, &clk_input_length-1)==STRING.CUT("&clk", 1))
    ( 
      &match=1
    )
  )
  else if (&wild_tail==1)
  (
    if (STRING.MID("gcc_qdss_tsctr_div8_clk", 0, &clk_input_length-1)==STRING.CUT("&clk", -1))
    ( 
      &match=1
    )
  )	  
  else if ("gcc_qdss_tsctr_div8_clk"=="&clk")
  (
    &match=1
  )
  
  if (&match==1)
  (
    &clk_test=&CLK_TEST_GCC_QDSS_TSCTR_DIV8_CLK
    &clk_reg=&HWIO_GCC_QDSS_TSCTR_DIV8_CBCR_ADDR
    &clk_reg_name="GCC_QDSS_TSCTR_DIV8_CBCR"
    &clk_name="gcc_qdss_tsctr_div8_clk"
    &clk_reg_cbcr_type="sm_cbc"

    gosub Print_Clk_Info_Line
  )

  &match=0
  &wild_head=0
  &wild_tail=0
  &clk_input_length=STRING.LENGTH("&clk")
  &clk_itr_length=STRING.LENGTH("gcc_rbcpr_cx_clk")

  if (STRING.SCAN("&clk", "*", 0)==0)
  (
    &wild_head=1
  )
  if (STRING.SCAN("&clk", "*", 1)==(STRING.LENGTH("&clk")-1))
  (
    &wild_tail=1
  )

  if ((&wild_head==1)&&(&wild_tail==1))
  (
    if (STRING.SCAN("gcc_rbcpr_cx_clk", STRING.MID("&clk", 1, &clk_input_length-2), 0)!=-1)
    ( 
      &match=1
    )
  )
  else if (&wild_head==1)
  (
    if (STRING.MID("gcc_rbcpr_cx_clk", &clk_itr_length-&clk_input_length+1, &clk_input_length-1)==STRING.CUT("&clk", 1))
    ( 
      &match=1
    )
  )
  else if (&wild_tail==1)
  (
    if (STRING.MID("gcc_rbcpr_cx_clk", 0, &clk_input_length-1)==STRING.CUT("&clk", -1))
    ( 
      &match=1
    )
  )	  
  else if ("gcc_rbcpr_cx_clk"=="&clk")
  (
    &match=1
  )
  
  if (&match==1)
  (
    &clk_test=&CLK_TEST_GCC_RBCPR_CX_CLK
    &clk_reg=&HWIO_GCC_RBCPR_CX_CBCR_ADDR
    &clk_reg_name="GCC_RBCPR_CX_CBCR"
    &clk_name="gcc_rbcpr_cx_clk"
    &clk_reg_cbcr_type="sm_cbc"

    gosub Print_Clk_Info_Line
  )

  &match=0
  &wild_head=0
  &wild_tail=0
  &clk_input_length=STRING.LENGTH("&clk")
  &clk_itr_length=STRING.LENGTH("gcc_rbcpr_mx_clk")

  if (STRING.SCAN("&clk", "*", 0)==0)
  (
    &wild_head=1
  )
  if (STRING.SCAN("&clk", "*", 1)==(STRING.LENGTH("&clk")-1))
  (
    &wild_tail=1
  )

  if ((&wild_head==1)&&(&wild_tail==1))
  (
    if (STRING.SCAN("gcc_rbcpr_mx_clk", STRING.MID("&clk", 1, &clk_input_length-2), 0)!=-1)
    ( 
      &match=1
    )
  )
  else if (&wild_head==1)
  (
    if (STRING.MID("gcc_rbcpr_mx_clk", &clk_itr_length-&clk_input_length+1, &clk_input_length-1)==STRING.CUT("&clk", 1))
    ( 
      &match=1
    )
  )
  else if (&wild_tail==1)
  (
    if (STRING.MID("gcc_rbcpr_mx_clk", 0, &clk_input_length-1)==STRING.CUT("&clk", -1))
    ( 
      &match=1
    )
  )	  
  else if ("gcc_rbcpr_mx_clk"=="&clk")
  (
    &match=1
  )
  
  if (&match==1)
  (
    &clk_test=&CLK_TEST_GCC_RBCPR_MX_CLK
    &clk_reg=&HWIO_GCC_RBCPR_MX_CBCR_ADDR
    &clk_reg_name="GCC_RBCPR_MX_CBCR"
    &clk_name="gcc_rbcpr_mx_clk"
    &clk_reg_cbcr_type="sm_cbc"

    gosub Print_Clk_Info_Line
  )

  &match=0
  &wild_head=0
  &wild_tail=0
  &clk_input_length=STRING.LENGTH("&clk")
  &clk_itr_length=STRING.LENGTH("gcc_cfg_noc_rpm_ahb_clk")

  if (STRING.SCAN("&clk", "*", 0)==0)
  (
    &wild_head=1
  )
  if (STRING.SCAN("&clk", "*", 1)==(STRING.LENGTH("&clk")-1))
  (
    &wild_tail=1
  )

  if ((&wild_head==1)&&(&wild_tail==1))
  (
    if (STRING.SCAN("gcc_cfg_noc_rpm_ahb_clk", STRING.MID("&clk", 1, &clk_input_length-2), 0)!=-1)
    ( 
      &match=1
    )
  )
  else if (&wild_head==1)
  (
    if (STRING.MID("gcc_cfg_noc_rpm_ahb_clk", &clk_itr_length-&clk_input_length+1, &clk_input_length-1)==STRING.CUT("&clk", 1))
    ( 
      &match=1
    )
  )
  else if (&wild_tail==1)
  (
    if (STRING.MID("gcc_cfg_noc_rpm_ahb_clk", 0, &clk_input_length-1)==STRING.CUT("&clk", -1))
    ( 
      &match=1
    )
  )	  
  else if ("gcc_cfg_noc_rpm_ahb_clk"=="&clk")
  (
    &match=1
  )
  
  if (&match==1)
  (
    &clk_test=&CLK_TEST_GCC_CFG_NOC_RPM_AHB_CLK
    &clk_reg=&HWIO_GCC_CFG_NOC_RPM_AHB_CBCR_ADDR
    &clk_reg_name="GCC_CFG_NOC_RPM_AHB_CBCR"
    &clk_name="gcc_cfg_noc_rpm_ahb_clk"
    &clk_reg_cbcr_type="sm_cbc"

    gosub Print_Clk_Info_Line
  )

  &match=0
  &wild_head=0
  &wild_tail=0
  &clk_input_length=STRING.LENGTH("&clk")
  &clk_itr_length=STRING.LENGTH("gcc_cnoc_bus_timeout6_ahb_clk")

  if (STRING.SCAN("&clk", "*", 0)==0)
  (
    &wild_head=1
  )
  if (STRING.SCAN("&clk", "*", 1)==(STRING.LENGTH("&clk")-1))
  (
    &wild_tail=1
  )

  if ((&wild_head==1)&&(&wild_tail==1))
  (
    if (STRING.SCAN("gcc_cnoc_bus_timeout6_ahb_clk", STRING.MID("&clk", 1, &clk_input_length-2), 0)!=-1)
    ( 
      &match=1
    )
  )
  else if (&wild_head==1)
  (
    if (STRING.MID("gcc_cnoc_bus_timeout6_ahb_clk", &clk_itr_length-&clk_input_length+1, &clk_input_length-1)==STRING.CUT("&clk", 1))
    ( 
      &match=1
    )
  )
  else if (&wild_tail==1)
  (
    if (STRING.MID("gcc_cnoc_bus_timeout6_ahb_clk", 0, &clk_input_length-1)==STRING.CUT("&clk", -1))
    ( 
      &match=1
    )
  )	  
  else if ("gcc_cnoc_bus_timeout6_ahb_clk"=="&clk")
  (
    &match=1
  )
  
  if (&match==1)
  (
    &clk_test=&CLK_TEST_GCC_CNOC_BUS_TIMEOUT6_AHB_CLK
    &clk_reg=&HWIO_GCC_CNOC_BUS_TIMEOUT6_AHB_CBCR_ADDR
    &clk_reg_name="GCC_CNOC_BUS_TIMEOUT6_AHB_CBCR"
    &clk_name="gcc_cnoc_bus_timeout6_ahb_clk"
    &clk_reg_cbcr_type="sm_cbc"

    gosub Print_Clk_Info_Line
  )

  &match=0
  &wild_head=0
  &wild_tail=0
  &clk_input_length=STRING.LENGTH("&clk")
  &clk_itr_length=STRING.LENGTH("gcc_rpm_bus_ahb_clk")

  if (STRING.SCAN("&clk", "*", 0)==0)
  (
    &wild_head=1
  )
  if (STRING.SCAN("&clk", "*", 1)==(STRING.LENGTH("&clk")-1))
  (
    &wild_tail=1
  )

  if ((&wild_head==1)&&(&wild_tail==1))
  (
    if (STRING.SCAN("gcc_rpm_bus_ahb_clk", STRING.MID("&clk", 1, &clk_input_length-2), 0)!=-1)
    ( 
      &match=1
    )
  )
  else if (&wild_head==1)
  (
    if (STRING.MID("gcc_rpm_bus_ahb_clk", &clk_itr_length-&clk_input_length+1, &clk_input_length-1)==STRING.CUT("&clk", 1))
    ( 
      &match=1
    )
  )
  else if (&wild_tail==1)
  (
    if (STRING.MID("gcc_rpm_bus_ahb_clk", 0, &clk_input_length-1)==STRING.CUT("&clk", -1))
    ( 
      &match=1
    )
  )	  
  else if ("gcc_rpm_bus_ahb_clk"=="&clk")
  (
    &match=1
  )
  
  if (&match==1)
  (
    &clk_test=&CLK_TEST_GCC_RPM_BUS_AHB_CLK
    &clk_reg=&HWIO_GCC_RPM_BUS_AHB_CBCR_ADDR
    &clk_reg_name="GCC_RPM_BUS_AHB_CBCR"
    &clk_name="gcc_rpm_bus_ahb_clk"
    &clk_reg_cbcr_type="sm_pscbc"

    gosub Print_Clk_Info_Line
  )

  &match=0
  &wild_head=0
  &wild_tail=0
  &clk_input_length=STRING.LENGTH("&clk")
  &clk_itr_length=STRING.LENGTH("gcc_rpm_proc_fclk")

  if (STRING.SCAN("&clk", "*", 0)==0)
  (
    &wild_head=1
  )
  if (STRING.SCAN("&clk", "*", 1)==(STRING.LENGTH("&clk")-1))
  (
    &wild_tail=1
  )

  if ((&wild_head==1)&&(&wild_tail==1))
  (
    if (STRING.SCAN("gcc_rpm_proc_fclk", STRING.MID("&clk", 1, &clk_input_length-2), 0)!=-1)
    ( 
      &match=1
    )
  )
  else if (&wild_head==1)
  (
    if (STRING.MID("gcc_rpm_proc_fclk", &clk_itr_length-&clk_input_length+1, &clk_input_length-1)==STRING.CUT("&clk", 1))
    ( 
      &match=1
    )
  )
  else if (&wild_tail==1)
  (
    if (STRING.MID("gcc_rpm_proc_fclk", 0, &clk_input_length-1)==STRING.CUT("&clk", -1))
    ( 
      &match=1
    )
  )	  
  else if ("gcc_rpm_proc_fclk"=="&clk")||("cpus"=="&clk")
  (
    &match=1
  )
  
  if (&match==1)
  (
    &clk_test=&CLK_TEST_GCC_RPM_PROC_FCLK
    &clk_reg=0
    &clk_reg_name="No CBCR"
    &clk_name="gcc_rpm_proc_fclk"
    &clk_reg_cbcr_type=""

    gosub Print_Clk_Info_Line
  )

  &match=0
  &wild_head=0
  &wild_tail=0
  &clk_input_length=STRING.LENGTH("&clk")
  &clk_itr_length=STRING.LENGTH("gcc_rpm_proc_hclk")

  if (STRING.SCAN("&clk", "*", 0)==0)
  (
    &wild_head=1
  )
  if (STRING.SCAN("&clk", "*", 1)==(STRING.LENGTH("&clk")-1))
  (
    &wild_tail=1
  )

  if ((&wild_head==1)&&(&wild_tail==1))
  (
    if (STRING.SCAN("gcc_rpm_proc_hclk", STRING.MID("&clk", 1, &clk_input_length-2), 0)!=-1)
    ( 
      &match=1
    )
  )
  else if (&wild_head==1)
  (
    if (STRING.MID("gcc_rpm_proc_hclk", &clk_itr_length-&clk_input_length+1, &clk_input_length-1)==STRING.CUT("&clk", 1))
    ( 
      &match=1
    )
  )
  else if (&wild_tail==1)
  (
    if (STRING.MID("gcc_rpm_proc_hclk", 0, &clk_input_length-1)==STRING.CUT("&clk", -1))
    ( 
      &match=1
    )
  )	  
  else if ("gcc_rpm_proc_hclk"=="&clk")
  (
    &match=1
  )
  
  if (&match==1)
  (
    &clk_test=&CLK_TEST_GCC_RPM_PROC_HCLK
    &clk_reg=&HWIO_GCC_RPM_PROC_HCLK_CBCR_ADDR
    &clk_reg_name="GCC_RPM_PROC_HCLK_CBCR"
    &clk_name="gcc_rpm_proc_hclk"
    &clk_reg_cbcr_type="sm_cbc"

    gosub Print_Clk_Info_Line
  )

  &match=0
  &wild_head=0
  &wild_tail=0
  &clk_input_length=STRING.LENGTH("&clk")
  &clk_itr_length=STRING.LENGTH("gcc_rpm_timer_clk")

  if (STRING.SCAN("&clk", "*", 0)==0)
  (
    &wild_head=1
  )
  if (STRING.SCAN("&clk", "*", 1)==(STRING.LENGTH("&clk")-1))
  (
    &wild_tail=1
  )

  if ((&wild_head==1)&&(&wild_tail==1))
  (
    if (STRING.SCAN("gcc_rpm_timer_clk", STRING.MID("&clk", 1, &clk_input_length-2), 0)!=-1)
    ( 
      &match=1
    )
  )
  else if (&wild_head==1)
  (
    if (STRING.MID("gcc_rpm_timer_clk", &clk_itr_length-&clk_input_length+1, &clk_input_length-1)==STRING.CUT("&clk", 1))
    ( 
      &match=1
    )
  )
  else if (&wild_tail==1)
  (
    if (STRING.MID("gcc_rpm_timer_clk", 0, &clk_input_length-1)==STRING.CUT("&clk", -1))
    ( 
      &match=1
    )
  )	  
  else if ("gcc_rpm_timer_clk"=="&clk")
  (
    &match=1
  )
  
  if (&match==1)
  (
    &clk_test=&CLK_TEST_GCC_RPM_TIMER_CLK
    &clk_reg=&HWIO_GCC_RPM_TIMER_CBCR_ADDR
    &clk_reg_name="GCC_RPM_TIMER_CBCR"
    &clk_name="gcc_rpm_timer_clk"
    &clk_reg_cbcr_type="sm_cbc"

    gosub Print_Clk_Info_Line
  )

  &match=0
  &wild_head=0
  &wild_tail=0
  &clk_input_length=STRING.LENGTH("&clk")
  &clk_itr_length=STRING.LENGTH("gcc_sdcc1_apps_clk")

  if (STRING.SCAN("&clk", "*", 0)==0)
  (
    &wild_head=1
  )
  if (STRING.SCAN("&clk", "*", 1)==(STRING.LENGTH("&clk")-1))
  (
    &wild_tail=1
  )

  if ((&wild_head==1)&&(&wild_tail==1))
  (
    if (STRING.SCAN("gcc_sdcc1_apps_clk", STRING.MID("&clk", 1, &clk_input_length-2), 0)!=-1)
    ( 
      &match=1
    )
  )
  else if (&wild_head==1)
  (
    if (STRING.MID("gcc_sdcc1_apps_clk", &clk_itr_length-&clk_input_length+1, &clk_input_length-1)==STRING.CUT("&clk", 1))
    ( 
      &match=1
    )
  )
  else if (&wild_tail==1)
  (
    if (STRING.MID("gcc_sdcc1_apps_clk", 0, &clk_input_length-1)==STRING.CUT("&clk", -1))
    ( 
      &match=1
    )
  )	  
  else if ("gcc_sdcc1_apps_clk"=="&clk")
  (
    &match=1
  )
  
  if (&match==1)
  (
    &clk_test=&CLK_TEST_GCC_SDCC1_APPS_CLK
    &clk_reg=&HWIO_GCC_SDCC1_APPS_CBCR_ADDR
    &clk_reg_name="GCC_SDCC1_APPS_CBCR"
    &clk_name="gcc_sdcc1_apps_clk"
    &clk_reg_cbcr_type="sm_pscbc"

    gosub Print_Clk_Info_Line
  )

  &match=0
  &wild_head=0
  &wild_tail=0
  &clk_input_length=STRING.LENGTH("&clk")
  &clk_itr_length=STRING.LENGTH("gcc_sdcc2_apps_clk")

  if (STRING.SCAN("&clk", "*", 0)==0)
  (
    &wild_head=1
  )
  if (STRING.SCAN("&clk", "*", 1)==(STRING.LENGTH("&clk")-1))
  (
    &wild_tail=1
  )

  if ((&wild_head==1)&&(&wild_tail==1))
  (
    if (STRING.SCAN("gcc_sdcc2_apps_clk", STRING.MID("&clk", 1, &clk_input_length-2), 0)!=-1)
    ( 
      &match=1
    )
  )
  else if (&wild_head==1)
  (
    if (STRING.MID("gcc_sdcc2_apps_clk", &clk_itr_length-&clk_input_length+1, &clk_input_length-1)==STRING.CUT("&clk", 1))
    ( 
      &match=1
    )
  )
  else if (&wild_tail==1)
  (
    if (STRING.MID("gcc_sdcc2_apps_clk", 0, &clk_input_length-1)==STRING.CUT("&clk", -1))
    ( 
      &match=1
    )
  )	  
  else if ("gcc_sdcc2_apps_clk"=="&clk")
  (
    &match=1
  )
  
  if (&match==1)
  (
    &clk_test=&CLK_TEST_GCC_SDCC2_APPS_CLK
    &clk_reg=&HWIO_GCC_SDCC2_APPS_CBCR_ADDR
    &clk_reg_name="GCC_SDCC2_APPS_CBCR"
    &clk_name="gcc_sdcc2_apps_clk"
    &clk_reg_cbcr_type="sm_pscbc"

    gosub Print_Clk_Info_Line
  )

  &match=0
  &wild_head=0
  &wild_tail=0
  &clk_input_length=STRING.LENGTH("&clk")
  &clk_itr_length=STRING.LENGTH("gcc_sdcc3_apps_clk")

  if (STRING.SCAN("&clk", "*", 0)==0)
  (
    &wild_head=1
  )
  if (STRING.SCAN("&clk", "*", 1)==(STRING.LENGTH("&clk")-1))
  (
    &wild_tail=1
  )

  if ((&wild_head==1)&&(&wild_tail==1))
  (
    if (STRING.SCAN("gcc_sdcc3_apps_clk", STRING.MID("&clk", 1, &clk_input_length-2), 0)!=-1)
    ( 
      &match=1
    )
  )
  else if (&wild_head==1)
  (
    if (STRING.MID("gcc_sdcc3_apps_clk", &clk_itr_length-&clk_input_length+1, &clk_input_length-1)==STRING.CUT("&clk", 1))
    ( 
      &match=1
    )
  )
  else if (&wild_tail==1)
  (
    if (STRING.MID("gcc_sdcc3_apps_clk", 0, &clk_input_length-1)==STRING.CUT("&clk", -1))
    ( 
      &match=1
    )
  )	  
  else if ("gcc_sdcc3_apps_clk"=="&clk")
  (
    &match=1
  )
  
  if (&match==1)
  (
    &clk_test=&CLK_TEST_GCC_SDCC3_APPS_CLK
    &clk_reg=&HWIO_GCC_SDCC3_APPS_CBCR_ADDR
    &clk_reg_name="GCC_SDCC3_APPS_CBCR"
    &clk_name="gcc_sdcc3_apps_clk"
    &clk_reg_cbcr_type="sm_pscbc"

    gosub Print_Clk_Info_Line
  )

  &match=0
  &wild_head=0
  &wild_tail=0
  &clk_input_length=STRING.LENGTH("&clk")
  &clk_itr_length=STRING.LENGTH("gcc_sdcc4_apps_clk")

  if (STRING.SCAN("&clk", "*", 0)==0)
  (
    &wild_head=1
  )
  if (STRING.SCAN("&clk", "*", 1)==(STRING.LENGTH("&clk")-1))
  (
    &wild_tail=1
  )

  if ((&wild_head==1)&&(&wild_tail==1))
  (
    if (STRING.SCAN("gcc_sdcc4_apps_clk", STRING.MID("&clk", 1, &clk_input_length-2), 0)!=-1)
    ( 
      &match=1
    )
  )
  else if (&wild_head==1)
  (
    if (STRING.MID("gcc_sdcc4_apps_clk", &clk_itr_length-&clk_input_length+1, &clk_input_length-1)==STRING.CUT("&clk", 1))
    ( 
      &match=1
    )
  )
  else if (&wild_tail==1)
  (
    if (STRING.MID("gcc_sdcc4_apps_clk", 0, &clk_input_length-1)==STRING.CUT("&clk", -1))
    ( 
      &match=1
    )
  )	  
  else if ("gcc_sdcc4_apps_clk"=="&clk")
  (
    &match=1
  )
  
  if (&match==1)
  (
    &clk_test=&CLK_TEST_GCC_SDCC4_APPS_CLK
    &clk_reg=&HWIO_GCC_SDCC4_APPS_CBCR_ADDR
    &clk_reg_name="GCC_SDCC4_APPS_CBCR"
    &clk_name="gcc_sdcc4_apps_clk"
    &clk_reg_cbcr_type="sm_pscbc"

    gosub Print_Clk_Info_Line
  )

  &match=0
  &wild_head=0
  &wild_tail=0
  &clk_input_length=STRING.LENGTH("&clk")
  &clk_itr_length=STRING.LENGTH("gcc_sec_ctrl_clk")

  if (STRING.SCAN("&clk", "*", 0)==0)
  (
    &wild_head=1
  )
  if (STRING.SCAN("&clk", "*", 1)==(STRING.LENGTH("&clk")-1))
  (
    &wild_tail=1
  )

  if ((&wild_head==1)&&(&wild_tail==1))
  (
    if (STRING.SCAN("gcc_sec_ctrl_clk", STRING.MID("&clk", 1, &clk_input_length-2), 0)!=-1)
    ( 
      &match=1
    )
  )
  else if (&wild_head==1)
  (
    if (STRING.MID("gcc_sec_ctrl_clk", &clk_itr_length-&clk_input_length+1, &clk_input_length-1)==STRING.CUT("&clk", 1))
    ( 
      &match=1
    )
  )
  else if (&wild_tail==1)
  (
    if (STRING.MID("gcc_sec_ctrl_clk", 0, &clk_input_length-1)==STRING.CUT("&clk", -1))
    ( 
      &match=1
    )
  )	  
  else if ("gcc_sec_ctrl_clk"=="&clk")
  (
    &match=1
  )
  
  if (&match==1)
  (
    &clk_test=&CLK_TEST_GCC_SEC_CTRL_CLK
    &clk_reg=&HWIO_GCC_SEC_CTRL_CBCR_ADDR
    &clk_reg_name="GCC_SEC_CTRL_CBCR"
    &clk_name="gcc_sec_ctrl_clk"
    &clk_reg_cbcr_type="sm_pscbc"

    gosub Print_Clk_Info_Line
  )

  &match=0
  &wild_head=0
  &wild_tail=0
  &clk_input_length=STRING.LENGTH("&clk")
  &clk_itr_length=STRING.LENGTH("gcc_sec_ctrl_sense_clk")

  if (STRING.SCAN("&clk", "*", 0)==0)
  (
    &wild_head=1
  )
  if (STRING.SCAN("&clk", "*", 1)==(STRING.LENGTH("&clk")-1))
  (
    &wild_tail=1
  )

  if ((&wild_head==1)&&(&wild_tail==1))
  (
    if (STRING.SCAN("gcc_sec_ctrl_sense_clk", STRING.MID("&clk", 1, &clk_input_length-2), 0)!=-1)
    ( 
      &match=1
    )
  )
  else if (&wild_head==1)
  (
    if (STRING.MID("gcc_sec_ctrl_sense_clk", &clk_itr_length-&clk_input_length+1, &clk_input_length-1)==STRING.CUT("&clk", 1))
    ( 
      &match=1
    )
  )
  else if (&wild_tail==1)
  (
    if (STRING.MID("gcc_sec_ctrl_sense_clk", 0, &clk_input_length-1)==STRING.CUT("&clk", -1))
    ( 
      &match=1
    )
  )	  
  else if ("gcc_sec_ctrl_sense_clk"=="&clk")
  (
    &match=1
  )
  
  if (&match==1)
  (
    &clk_test=&CLK_TEST_GCC_SEC_CTRL_SENSE_CLK
    &clk_reg=&HWIO_GCC_SEC_CTRL_SENSE_CBCR_ADDR
    &clk_reg_name="GCC_SEC_CTRL_SENSE_CBCR"
    &clk_name="gcc_sec_ctrl_sense_clk"
    &clk_reg_cbcr_type="sm_cbc"

    gosub Print_Clk_Info_Line
  )

  &match=0
  &wild_head=0
  &wild_tail=0
  &clk_input_length=STRING.LENGTH("&clk")
  &clk_itr_length=STRING.LENGTH("gcc_spdm_bimc_cy_clk")

  if (STRING.SCAN("&clk", "*", 0)==0)
  (
    &wild_head=1
  )
  if (STRING.SCAN("&clk", "*", 1)==(STRING.LENGTH("&clk")-1))
  (
    &wild_tail=1
  )

  if ((&wild_head==1)&&(&wild_tail==1))
  (
    if (STRING.SCAN("gcc_spdm_bimc_cy_clk", STRING.MID("&clk", 1, &clk_input_length-2), 0)!=-1)
    ( 
      &match=1
    )
  )
  else if (&wild_head==1)
  (
    if (STRING.MID("gcc_spdm_bimc_cy_clk", &clk_itr_length-&clk_input_length+1, &clk_input_length-1)==STRING.CUT("&clk", 1))
    ( 
      &match=1
    )
  )
  else if (&wild_tail==1)
  (
    if (STRING.MID("gcc_spdm_bimc_cy_clk", 0, &clk_input_length-1)==STRING.CUT("&clk", -1))
    ( 
      &match=1
    )
  )	  
  else if ("gcc_spdm_bimc_cy_clk"=="&clk")
  (
    &match=1
  )
  
  if (&match==1)
  (
    &clk_test=&CLK_TEST_GCC_SPDM_BIMC_CY_CLK
    &clk_reg=&HWIO_GCC_SPDM_BIMC_CY_CBCR_ADDR
    &clk_reg_name="GCC_SPDM_BIMC_CY_CBCR"
    &clk_name="gcc_spdm_bimc_cy_clk"
    &clk_reg_cbcr_type="sm_cbc"

    gosub Print_Clk_Info_Line
  )

  &match=0
  &wild_head=0
  &wild_tail=0
  &clk_input_length=STRING.LENGTH("&clk")
  &clk_itr_length=STRING.LENGTH("gcc_spdm_debug_cy_clk")

  if (STRING.SCAN("&clk", "*", 0)==0)
  (
    &wild_head=1
  )
  if (STRING.SCAN("&clk", "*", 1)==(STRING.LENGTH("&clk")-1))
  (
    &wild_tail=1
  )

  if ((&wild_head==1)&&(&wild_tail==1))
  (
    if (STRING.SCAN("gcc_spdm_debug_cy_clk", STRING.MID("&clk", 1, &clk_input_length-2), 0)!=-1)
    ( 
      &match=1
    )
  )
  else if (&wild_head==1)
  (
    if (STRING.MID("gcc_spdm_debug_cy_clk", &clk_itr_length-&clk_input_length+1, &clk_input_length-1)==STRING.CUT("&clk", 1))
    ( 
      &match=1
    )
  )
  else if (&wild_tail==1)
  (
    if (STRING.MID("gcc_spdm_debug_cy_clk", 0, &clk_input_length-1)==STRING.CUT("&clk", -1))
    ( 
      &match=1
    )
  )	  
  else if ("gcc_spdm_debug_cy_clk"=="&clk")
  (
    &match=1
  )
  
  if (&match==1)
  (
    &clk_test=0
    &clk_reg=&HWIO_GCC_SPDM_DEBUG_CY_CBCR_ADDR
    &clk_reg_name="GCC_SPDM_DEBUG_CY_CBCR"
    &clk_name="gcc_spdm_debug_cy_clk"
    &clk_reg_cbcr_type="sm_cbc"

    gosub Print_Clk_Info_Line
  )

  &match=0
  &wild_head=0
  &wild_tail=0
  &clk_input_length=STRING.LENGTH("&clk")
  &clk_itr_length=STRING.LENGTH("gcc_spdm_ff_clk")

  if (STRING.SCAN("&clk", "*", 0)==0)
  (
    &wild_head=1
  )
  if (STRING.SCAN("&clk", "*", 1)==(STRING.LENGTH("&clk")-1))
  (
    &wild_tail=1
  )

  if ((&wild_head==1)&&(&wild_tail==1))
  (
    if (STRING.SCAN("gcc_spdm_ff_clk", STRING.MID("&clk", 1, &clk_input_length-2), 0)!=-1)
    ( 
      &match=1
    )
  )
  else if (&wild_head==1)
  (
    if (STRING.MID("gcc_spdm_ff_clk", &clk_itr_length-&clk_input_length+1, &clk_input_length-1)==STRING.CUT("&clk", 1))
    ( 
      &match=1
    )
  )
  else if (&wild_tail==1)
  (
    if (STRING.MID("gcc_spdm_ff_clk", 0, &clk_input_length-1)==STRING.CUT("&clk", -1))
    ( 
      &match=1
    )
  )	  
  else if ("gcc_spdm_ff_clk"=="&clk")
  (
    &match=1
  )
  
  if (&match==1)
  (
    &clk_test=&CLK_TEST_GCC_SPDM_FF_CLK
    &clk_reg=&HWIO_GCC_SPDM_FF_CBCR_ADDR
    &clk_reg_name="GCC_SPDM_FF_CBCR"
    &clk_name="gcc_spdm_ff_clk"
    &clk_reg_cbcr_type="sm_cbc"

    gosub Print_Clk_Info_Line
  )

  &match=0
  &wild_head=0
  &wild_tail=0
  &clk_input_length=STRING.LENGTH("&clk")
  &clk_itr_length=STRING.LENGTH("gcc_spdm_pnoc_cy_clk")

  if (STRING.SCAN("&clk", "*", 0)==0)
  (
    &wild_head=1
  )
  if (STRING.SCAN("&clk", "*", 1)==(STRING.LENGTH("&clk")-1))
  (
    &wild_tail=1
  )

  if ((&wild_head==1)&&(&wild_tail==1))
  (
    if (STRING.SCAN("gcc_spdm_pnoc_cy_clk", STRING.MID("&clk", 1, &clk_input_length-2), 0)!=-1)
    ( 
      &match=1
    )
  )
  else if (&wild_head==1)
  (
    if (STRING.MID("gcc_spdm_pnoc_cy_clk", &clk_itr_length-&clk_input_length+1, &clk_input_length-1)==STRING.CUT("&clk", 1))
    ( 
      &match=1
    )
  )
  else if (&wild_tail==1)
  (
    if (STRING.MID("gcc_spdm_pnoc_cy_clk", 0, &clk_input_length-1)==STRING.CUT("&clk", -1))
    ( 
      &match=1
    )
  )	  
  else if ("gcc_spdm_pnoc_cy_clk"=="&clk")
  (
    &match=1
  )
  
  if (&match==1)
  (
    &clk_test=&CLK_TEST_GCC_SPDM_PNOC_CY_CLK
    &clk_reg=&HWIO_GCC_SPDM_PNOC_CY_CBCR_ADDR
    &clk_reg_name="GCC_SPDM_PNOC_CY_CBCR"
    &clk_name="gcc_spdm_pnoc_cy_clk"
    &clk_reg_cbcr_type="sm_cbc"

    gosub Print_Clk_Info_Line
  )

  &match=0
  &wild_head=0
  &wild_tail=0
  &clk_input_length=STRING.LENGTH("&clk")
  &clk_itr_length=STRING.LENGTH("gcc_spdm_rpm_cy_clk")

  if (STRING.SCAN("&clk", "*", 0)==0)
  (
    &wild_head=1
  )
  if (STRING.SCAN("&clk", "*", 1)==(STRING.LENGTH("&clk")-1))
  (
    &wild_tail=1
  )

  if ((&wild_head==1)&&(&wild_tail==1))
  (
    if (STRING.SCAN("gcc_spdm_rpm_cy_clk", STRING.MID("&clk", 1, &clk_input_length-2), 0)!=-1)
    ( 
      &match=1
    )
  )
  else if (&wild_head==1)
  (
    if (STRING.MID("gcc_spdm_rpm_cy_clk", &clk_itr_length-&clk_input_length+1, &clk_input_length-1)==STRING.CUT("&clk", 1))
    ( 
      &match=1
    )
  )
  else if (&wild_tail==1)
  (
    if (STRING.MID("gcc_spdm_rpm_cy_clk", 0, &clk_input_length-1)==STRING.CUT("&clk", -1))
    ( 
      &match=1
    )
  )	  
  else if ("gcc_spdm_rpm_cy_clk"=="&clk")
  (
    &match=1
  )
  
  if (&match==1)
  (
    &clk_test=&CLK_TEST_GCC_SPDM_RPM_CY_CLK
    &clk_reg=&HWIO_GCC_SPDM_RPM_CY_CBCR_ADDR
    &clk_reg_name="GCC_SPDM_RPM_CY_CBCR"
    &clk_name="gcc_spdm_rpm_cy_clk"
    &clk_reg_cbcr_type="sm_cbc"

    gosub Print_Clk_Info_Line
  )

  &match=0
  &wild_head=0
  &wild_tail=0
  &clk_input_length=STRING.LENGTH("&clk")
  &clk_itr_length=STRING.LENGTH("gcc_spdm_snoc_cy_clk")

  if (STRING.SCAN("&clk", "*", 0)==0)
  (
    &wild_head=1
  )
  if (STRING.SCAN("&clk", "*", 1)==(STRING.LENGTH("&clk")-1))
  (
    &wild_tail=1
  )

  if ((&wild_head==1)&&(&wild_tail==1))
  (
    if (STRING.SCAN("gcc_spdm_snoc_cy_clk", STRING.MID("&clk", 1, &clk_input_length-2), 0)!=-1)
    ( 
      &match=1
    )
  )
  else if (&wild_head==1)
  (
    if (STRING.MID("gcc_spdm_snoc_cy_clk", &clk_itr_length-&clk_input_length+1, &clk_input_length-1)==STRING.CUT("&clk", 1))
    ( 
      &match=1
    )
  )
  else if (&wild_tail==1)
  (
    if (STRING.MID("gcc_spdm_snoc_cy_clk", 0, &clk_input_length-1)==STRING.CUT("&clk", -1))
    ( 
      &match=1
    )
  )	  
  else if ("gcc_spdm_snoc_cy_clk"=="&clk")
  (
    &match=1
  )
  
  if (&match==1)
  (
    &clk_test=&CLK_TEST_GCC_SPDM_SNOC_CY_CLK
    &clk_reg=&HWIO_GCC_SPDM_SNOC_CY_CBCR_ADDR
    &clk_reg_name="GCC_SPDM_SNOC_CY_CBCR"
    &clk_name="gcc_spdm_snoc_cy_clk"
    &clk_reg_cbcr_type="sm_cbc"

    gosub Print_Clk_Info_Line
  )

  &match=0
  &wild_head=0
  &wild_tail=0
  &clk_input_length=STRING.LENGTH("&clk")
  &clk_itr_length=STRING.LENGTH("gcc_spmi_ahb_clk")

  if (STRING.SCAN("&clk", "*", 0)==0)
  (
    &wild_head=1
  )
  if (STRING.SCAN("&clk", "*", 1)==(STRING.LENGTH("&clk")-1))
  (
    &wild_tail=1
  )

  if ((&wild_head==1)&&(&wild_tail==1))
  (
    if (STRING.SCAN("gcc_spmi_ahb_clk", STRING.MID("&clk", 1, &clk_input_length-2), 0)!=-1)
    ( 
      &match=1
    )
  )
  else if (&wild_head==1)
  (
    if (STRING.MID("gcc_spmi_ahb_clk", &clk_itr_length-&clk_input_length+1, &clk_input_length-1)==STRING.CUT("&clk", 1))
    ( 
      &match=1
    )
  )
  else if (&wild_tail==1)
  (
    if (STRING.MID("gcc_spmi_ahb_clk", 0, &clk_input_length-1)==STRING.CUT("&clk", -1))
    ( 
      &match=1
    )
  )	  
  else if ("gcc_spmi_ahb_clk"=="&clk")
  (
    &match=1
  )
  
  if (&match==1)
  (
    &clk_test=&CLK_TEST_GCC_SPMI_AHB_CLK
    &clk_reg=&HWIO_GCC_SPMI_AHB_CBCR_ADDR
    &clk_reg_name="GCC_SPMI_AHB_CBCR"
    &clk_name="gcc_spmi_ahb_clk"
    &clk_reg_cbcr_type="sm_pscbc"

    gosub Print_Clk_Info_Line
  )

  &match=0
  &wild_head=0
  &wild_tail=0
  &clk_input_length=STRING.LENGTH("&clk")
  &clk_itr_length=STRING.LENGTH("gcc_spmi_ser_clk")

  if (STRING.SCAN("&clk", "*", 0)==0)
  (
    &wild_head=1
  )
  if (STRING.SCAN("&clk", "*", 1)==(STRING.LENGTH("&clk")-1))
  (
    &wild_tail=1
  )

  if ((&wild_head==1)&&(&wild_tail==1))
  (
    if (STRING.SCAN("gcc_spmi_ser_clk", STRING.MID("&clk", 1, &clk_input_length-2), 0)!=-1)
    ( 
      &match=1
    )
  )
  else if (&wild_head==1)
  (
    if (STRING.MID("gcc_spmi_ser_clk", &clk_itr_length-&clk_input_length+1, &clk_input_length-1)==STRING.CUT("&clk", 1))
    ( 
      &match=1
    )
  )
  else if (&wild_tail==1)
  (
    if (STRING.MID("gcc_spmi_ser_clk", 0, &clk_input_length-1)==STRING.CUT("&clk", -1))
    ( 
      &match=1
    )
  )	  
  else if ("gcc_spmi_ser_clk"=="&clk")
  (
    &match=1
  )
  
  if (&match==1)
  (
    &clk_test=&CLK_TEST_GCC_SPMI_SER_CLK
    &clk_reg=&HWIO_GCC_SPMI_SER_CBCR_ADDR
    &clk_reg_name="GCC_SPMI_SER_CBCR"
    &clk_name="gcc_spmi_ser_clk"
    &clk_reg_cbcr_type="sm_pscbc"

    gosub Print_Clk_Info_Line
  )

  &match=0
  &wild_head=0
  &wild_tail=0
  &clk_input_length=STRING.LENGTH("&clk")
  &clk_itr_length=STRING.LENGTH("gcc_bimc_sysnoc_axi_clk")

  if (STRING.SCAN("&clk", "*", 0)==0)
  (
    &wild_head=1
  )
  if (STRING.SCAN("&clk", "*", 1)==(STRING.LENGTH("&clk")-1))
  (
    &wild_tail=1
  )

  if ((&wild_head==1)&&(&wild_tail==1))
  (
    if (STRING.SCAN("gcc_bimc_sysnoc_axi_clk", STRING.MID("&clk", 1, &clk_input_length-2), 0)!=-1)
    ( 
      &match=1
    )
  )
  else if (&wild_head==1)
  (
    if (STRING.MID("gcc_bimc_sysnoc_axi_clk", &clk_itr_length-&clk_input_length+1, &clk_input_length-1)==STRING.CUT("&clk", 1))
    ( 
      &match=1
    )
  )
  else if (&wild_tail==1)
  (
    if (STRING.MID("gcc_bimc_sysnoc_axi_clk", 0, &clk_input_length-1)==STRING.CUT("&clk", -1))
    ( 
      &match=1
    )
  )	  
  else if ("gcc_bimc_sysnoc_axi_clk"=="&clk")
  (
    &match=1
  )
  
  if (&match==1)
  (
    &clk_test=&CLK_TEST_GCC_BIMC_SYSNOC_AXI_CLK
    &clk_reg=&HWIO_GCC_BIMC_SYSNOC_AXI_CBCR_ADDR
    &clk_reg_name="GCC_BIMC_SYSNOC_AXI_CBCR"
    &clk_name="gcc_bimc_sysnoc_axi_clk"
    &clk_reg_cbcr_type="sm_cbc"

    gosub Print_Clk_Info_Line
  )

  &match=0
  &wild_head=0
  &wild_tail=0
  &clk_input_length=STRING.LENGTH("&clk")
  &clk_itr_length=STRING.LENGTH("gcc_ce1_axi_clk")

  if (STRING.SCAN("&clk", "*", 0)==0)
  (
    &wild_head=1
  )
  if (STRING.SCAN("&clk", "*", 1)==(STRING.LENGTH("&clk")-1))
  (
    &wild_tail=1
  )

  if ((&wild_head==1)&&(&wild_tail==1))
  (
    if (STRING.SCAN("gcc_ce1_axi_clk", STRING.MID("&clk", 1, &clk_input_length-2), 0)!=-1)
    ( 
      &match=1
    )
  )
  else if (&wild_head==1)
  (
    if (STRING.MID("gcc_ce1_axi_clk", &clk_itr_length-&clk_input_length+1, &clk_input_length-1)==STRING.CUT("&clk", 1))
    ( 
      &match=1
    )
  )
  else if (&wild_tail==1)
  (
    if (STRING.MID("gcc_ce1_axi_clk", 0, &clk_input_length-1)==STRING.CUT("&clk", -1))
    ( 
      &match=1
    )
  )	  
  else if ("gcc_ce1_axi_clk"=="&clk")
  (
    &match=1
  )
  
  if (&match==1)
  (
    &clk_test=&CLK_TEST_GCC_CE1_AXI_CLK
    &clk_reg=&HWIO_GCC_CE1_AXI_CBCR_ADDR
    &clk_reg_name="GCC_CE1_AXI_CBCR"
    &clk_name="gcc_ce1_axi_clk"
    &clk_reg_cbcr_type="sm_cbc"

    gosub Print_Clk_Info_Line
  )

  &match=0
  &wild_head=0
  &wild_tail=0
  &clk_input_length=STRING.LENGTH("&clk")
  &clk_itr_length=STRING.LENGTH("gcc_ce2_axi_clk")

  if (STRING.SCAN("&clk", "*", 0)==0)
  (
    &wild_head=1
  )
  if (STRING.SCAN("&clk", "*", 1)==(STRING.LENGTH("&clk")-1))
  (
    &wild_tail=1
  )

  if ((&wild_head==1)&&(&wild_tail==1))
  (
    if (STRING.SCAN("gcc_ce2_axi_clk", STRING.MID("&clk", 1, &clk_input_length-2), 0)!=-1)
    ( 
      &match=1
    )
  )
  else if (&wild_head==1)
  (
    if (STRING.MID("gcc_ce2_axi_clk", &clk_itr_length-&clk_input_length+1, &clk_input_length-1)==STRING.CUT("&clk", 1))
    ( 
      &match=1
    )
  )
  else if (&wild_tail==1)
  (
    if (STRING.MID("gcc_ce2_axi_clk", 0, &clk_input_length-1)==STRING.CUT("&clk", -1))
    ( 
      &match=1
    )
  )	  
  else if ("gcc_ce2_axi_clk"=="&clk")
  (
    &match=1
  )
  
  if (&match==1)
  (
    &clk_test=&CLK_TEST_GCC_CE2_AXI_CLK
    &clk_reg=&HWIO_GCC_CE2_AXI_CBCR_ADDR
    &clk_reg_name="GCC_CE2_AXI_CBCR"
    &clk_name="gcc_ce2_axi_clk"
    &clk_reg_cbcr_type="sm_cbc"

    gosub Print_Clk_Info_Line
  )

  &match=0
  &wild_head=0
  &wild_tail=0
  &clk_input_length=STRING.LENGTH("&clk")
  &clk_itr_length=STRING.LENGTH("gcc_ce3_axi_clk")

  if (STRING.SCAN("&clk", "*", 0)==0)
  (
    &wild_head=1
  )
  if (STRING.SCAN("&clk", "*", 1)==(STRING.LENGTH("&clk")-1))
  (
    &wild_tail=1
  )

  if ((&wild_head==1)&&(&wild_tail==1))
  (
    if (STRING.SCAN("gcc_ce3_axi_clk", STRING.MID("&clk", 1, &clk_input_length-2), 0)!=-1)
    ( 
      &match=1
    )
  )
  else if (&wild_head==1)
  (
    if (STRING.MID("gcc_ce3_axi_clk", &clk_itr_length-&clk_input_length+1, &clk_input_length-1)==STRING.CUT("&clk", 1))
    ( 
      &match=1
    )
  )
  else if (&wild_tail==1)
  (
    if (STRING.MID("gcc_ce3_axi_clk", 0, &clk_input_length-1)==STRING.CUT("&clk", -1))
    ( 
      &match=1
    )
  )	  
  else if ("gcc_ce3_axi_clk"=="&clk")
  (
    &match=1
  )
  
  if (&match==1)
  (
    &clk_test=&CLK_TEST_GCC_CE3_AXI_CLK
    &clk_reg=&HWIO_GCC_CE3_AXI_CBCR_ADDR
    &clk_reg_name="GCC_CE3_AXI_CBCR"
    &clk_name="gcc_ce3_axi_clk"
    &clk_reg_cbcr_type="sm_cbc"

    gosub Print_Clk_Info_Line
  )

  &match=0
  &wild_head=0
  &wild_tail=0
  &clk_input_length=STRING.LENGTH("&clk")
  &clk_itr_length=STRING.LENGTH("gcc_imem_axi_clk")

  if (STRING.SCAN("&clk", "*", 0)==0)
  (
    &wild_head=1
  )
  if (STRING.SCAN("&clk", "*", 1)==(STRING.LENGTH("&clk")-1))
  (
    &wild_tail=1
  )

  if ((&wild_head==1)&&(&wild_tail==1))
  (
    if (STRING.SCAN("gcc_imem_axi_clk", STRING.MID("&clk", 1, &clk_input_length-2), 0)!=-1)
    ( 
      &match=1
    )
  )
  else if (&wild_head==1)
  (
    if (STRING.MID("gcc_imem_axi_clk", &clk_itr_length-&clk_input_length+1, &clk_input_length-1)==STRING.CUT("&clk", 1))
    ( 
      &match=1
    )
  )
  else if (&wild_tail==1)
  (
    if (STRING.MID("gcc_imem_axi_clk", 0, &clk_input_length-1)==STRING.CUT("&clk", -1))
    ( 
      &match=1
    )
  )	  
  else if ("gcc_imem_axi_clk"=="&clk")
  (
    &match=1
  )
  
  if (&match==1)
  (
    &clk_test=&CLK_TEST_GCC_IMEM_AXI_CLK
    &clk_reg=&HWIO_GCC_IMEM_AXI_CBCR_ADDR
    &clk_reg_name="GCC_IMEM_AXI_CBCR"
    &clk_name="gcc_imem_axi_clk"
    &clk_reg_cbcr_type="sm_pscbc"

    gosub Print_Clk_Info_Line
  )

  &match=0
  &wild_head=0
  &wild_tail=0
  &clk_input_length=STRING.LENGTH("&clk")
  &clk_itr_length=STRING.LENGTH("gcc_lpass_mport_axi_clk")

  if (STRING.SCAN("&clk", "*", 0)==0)
  (
    &wild_head=1
  )
  if (STRING.SCAN("&clk", "*", 1)==(STRING.LENGTH("&clk")-1))
  (
    &wild_tail=1
  )

  if ((&wild_head==1)&&(&wild_tail==1))
  (
    if (STRING.SCAN("gcc_lpass_mport_axi_clk", STRING.MID("&clk", 1, &clk_input_length-2), 0)!=-1)
    ( 
      &match=1
    )
  )
  else if (&wild_head==1)
  (
    if (STRING.MID("gcc_lpass_mport_axi_clk", &clk_itr_length-&clk_input_length+1, &clk_input_length-1)==STRING.CUT("&clk", 1))
    ( 
      &match=1
    )
  )
  else if (&wild_tail==1)
  (
    if (STRING.MID("gcc_lpass_mport_axi_clk", 0, &clk_input_length-1)==STRING.CUT("&clk", -1))
    ( 
      &match=1
    )
  )	  
  else if ("gcc_lpass_mport_axi_clk"=="&clk")
  (
    &match=1
  )
  
  if (&match==1)
  (
    &clk_test=&CLK_TEST_GCC_LPASS_MPORT_AXI_CLK
    &clk_reg=&HWIO_GCC_LPASS_MPORT_AXI_CBCR_ADDR
    &clk_reg_name="GCC_LPASS_MPORT_AXI_CBCR"
    &clk_name="gcc_lpass_mport_axi_clk"
    &clk_reg_cbcr_type="sm_pscbc"

    gosub Print_Clk_Info_Line
  )

  &match=0
  &wild_head=0
  &wild_tail=0
  &clk_input_length=STRING.LENGTH("&clk")
  &clk_itr_length=STRING.LENGTH("gcc_lpass_q6_axi_clk")

  if (STRING.SCAN("&clk", "*", 0)==0)
  (
    &wild_head=1
  )
  if (STRING.SCAN("&clk", "*", 1)==(STRING.LENGTH("&clk")-1))
  (
    &wild_tail=1
  )

  if ((&wild_head==1)&&(&wild_tail==1))
  (
    if (STRING.SCAN("gcc_lpass_q6_axi_clk", STRING.MID("&clk", 1, &clk_input_length-2), 0)!=-1)
    ( 
      &match=1
    )
  )
  else if (&wild_head==1)
  (
    if (STRING.MID("gcc_lpass_q6_axi_clk", &clk_itr_length-&clk_input_length+1, &clk_input_length-1)==STRING.CUT("&clk", 1))
    ( 
      &match=1
    )
  )
  else if (&wild_tail==1)
  (
    if (STRING.MID("gcc_lpass_q6_axi_clk", 0, &clk_input_length-1)==STRING.CUT("&clk", -1))
    ( 
      &match=1
    )
  )	  
  else if ("gcc_lpass_q6_axi_clk"=="&clk")
  (
    &match=1
  )
  
  if (&match==1)
  (
    &clk_test=&CLK_TEST_GCC_LPASS_Q6_AXI_CLK
    &clk_reg=&HWIO_GCC_LPASS_Q6_AXI_CBCR_ADDR
    &clk_reg_name="GCC_LPASS_Q6_AXI_CBCR"
    &clk_name="gcc_lpass_q6_axi_clk"
    &clk_reg_cbcr_type="sm_pscbc"

    gosub Print_Clk_Info_Line
  )

  &match=0
  &wild_head=0
  &wild_tail=0
  &clk_input_length=STRING.LENGTH("&clk")
  &clk_itr_length=STRING.LENGTH("gcc_lpass_sway_clk")

  if (STRING.SCAN("&clk", "*", 0)==0)
  (
    &wild_head=1
  )
  if (STRING.SCAN("&clk", "*", 1)==(STRING.LENGTH("&clk")-1))
  (
    &wild_tail=1
  )

  if ((&wild_head==1)&&(&wild_tail==1))
  (
    if (STRING.SCAN("gcc_lpass_sway_clk", STRING.MID("&clk", 1, &clk_input_length-2), 0)!=-1)
    ( 
      &match=1
    )
  )
  else if (&wild_head==1)
  (
    if (STRING.MID("gcc_lpass_sway_clk", &clk_itr_length-&clk_input_length+1, &clk_input_length-1)==STRING.CUT("&clk", 1))
    ( 
      &match=1
    )
  )
  else if (&wild_tail==1)
  (
    if (STRING.MID("gcc_lpass_sway_clk", 0, &clk_input_length-1)==STRING.CUT("&clk", -1))
    ( 
      &match=1
    )
  )	  
  else if ("gcc_lpass_sway_clk"=="&clk")
  (
    &match=1
  )
  
  if (&match==1)
  (
    &clk_test=&CLK_TEST_GCC_LPASS_SWAY_CLK
    &clk_reg=&HWIO_GCC_LPASS_SWAY_CBCR_ADDR
    &clk_reg_name="GCC_LPASS_SWAY_CBCR"
    &clk_name="gcc_lpass_sway_clk"
    &clk_reg_cbcr_type="sm_cbc"

    gosub Print_Clk_Info_Line
  )

  &match=0
  &wild_head=0
  &wild_tail=0
  &clk_input_length=STRING.LENGTH("&clk")
  &clk_itr_length=STRING.LENGTH("gcc_ocmem_sys_noc_axi_clk")

  if (STRING.SCAN("&clk", "*", 0)==0)
  (
    &wild_head=1
  )
  if (STRING.SCAN("&clk", "*", 1)==(STRING.LENGTH("&clk")-1))
  (
    &wild_tail=1
  )

  if ((&wild_head==1)&&(&wild_tail==1))
  (
    if (STRING.SCAN("gcc_ocmem_sys_noc_axi_clk", STRING.MID("&clk", 1, &clk_input_length-2), 0)!=-1)
    ( 
      &match=1
    )
  )
  else if (&wild_head==1)
  (
    if (STRING.MID("gcc_ocmem_sys_noc_axi_clk", &clk_itr_length-&clk_input_length+1, &clk_input_length-1)==STRING.CUT("&clk", 1))
    ( 
      &match=1
    )
  )
  else if (&wild_tail==1)
  (
    if (STRING.MID("gcc_ocmem_sys_noc_axi_clk", 0, &clk_input_length-1)==STRING.CUT("&clk", -1))
    ( 
      &match=1
    )
  )	  
  else if ("gcc_ocmem_sys_noc_axi_clk"=="&clk")
  (
    &match=1
  )
  
  if (&match==1)
  (
    &clk_test=&CLK_TEST_GCC_OCMEM_SYS_NOC_AXI_CLK
    &clk_reg=&HWIO_GCC_OCMEM_SYS_NOC_AXI_CBCR_ADDR
    &clk_reg_name="GCC_OCMEM_SYS_NOC_AXI_CBCR"
    &clk_name="gcc_ocmem_sys_noc_axi_clk"
    &clk_reg_cbcr_type="sm_cbc"

    gosub Print_Clk_Info_Line
  )

  &match=0
  &wild_head=0
  &wild_tail=0
  &clk_input_length=STRING.LENGTH("&clk")
  &clk_itr_length=STRING.LENGTH("gcc_pcie_0_mstr_axi_clk")

  if (STRING.SCAN("&clk", "*", 0)==0)
  (
    &wild_head=1
  )
  if (STRING.SCAN("&clk", "*", 1)==(STRING.LENGTH("&clk")-1))
  (
    &wild_tail=1
  )

  if ((&wild_head==1)&&(&wild_tail==1))
  (
    if (STRING.SCAN("gcc_pcie_0_mstr_axi_clk", STRING.MID("&clk", 1, &clk_input_length-2), 0)!=-1)
    ( 
      &match=1
    )
  )
  else if (&wild_head==1)
  (
    if (STRING.MID("gcc_pcie_0_mstr_axi_clk", &clk_itr_length-&clk_input_length+1, &clk_input_length-1)==STRING.CUT("&clk", 1))
    ( 
      &match=1
    )
  )
  else if (&wild_tail==1)
  (
    if (STRING.MID("gcc_pcie_0_mstr_axi_clk", 0, &clk_input_length-1)==STRING.CUT("&clk", -1))
    ( 
      &match=1
    )
  )	  
  else if ("gcc_pcie_0_mstr_axi_clk"=="&clk")
  (
    &match=1
  )
  
  if (&match==1)
  (
    &clk_test=&CLK_TEST_GCC_PCIE_0_MSTR_AXI_CLK
    &clk_reg=&HWIO_GCC_PCIE_0_MSTR_AXI_CBCR_ADDR
    &clk_reg_name="GCC_PCIE_0_MSTR_AXI_CBCR"
    &clk_name="gcc_pcie_0_mstr_axi_clk"
    &clk_reg_cbcr_type="sm_pscbc"

    gosub Print_Clk_Info_Line
  )

  &match=0
  &wild_head=0
  &wild_tail=0
  &clk_input_length=STRING.LENGTH("&clk")
  &clk_itr_length=STRING.LENGTH("gcc_pcie_0_slv_axi_clk")

  if (STRING.SCAN("&clk", "*", 0)==0)
  (
    &wild_head=1
  )
  if (STRING.SCAN("&clk", "*", 1)==(STRING.LENGTH("&clk")-1))
  (
    &wild_tail=1
  )

  if ((&wild_head==1)&&(&wild_tail==1))
  (
    if (STRING.SCAN("gcc_pcie_0_slv_axi_clk", STRING.MID("&clk", 1, &clk_input_length-2), 0)!=-1)
    ( 
      &match=1
    )
  )
  else if (&wild_head==1)
  (
    if (STRING.MID("gcc_pcie_0_slv_axi_clk", &clk_itr_length-&clk_input_length+1, &clk_input_length-1)==STRING.CUT("&clk", 1))
    ( 
      &match=1
    )
  )
  else if (&wild_tail==1)
  (
    if (STRING.MID("gcc_pcie_0_slv_axi_clk", 0, &clk_input_length-1)==STRING.CUT("&clk", -1))
    ( 
      &match=1
    )
  )	  
  else if ("gcc_pcie_0_slv_axi_clk"=="&clk")
  (
    &match=1
  )
  
  if (&match==1)
  (
    &clk_test=&CLK_TEST_GCC_PCIE_0_SLV_AXI_CLK
    &clk_reg=&HWIO_GCC_PCIE_0_SLV_AXI_CBCR_ADDR
    &clk_reg_name="GCC_PCIE_0_SLV_AXI_CBCR"
    &clk_name="gcc_pcie_0_slv_axi_clk"
    &clk_reg_cbcr_type="sm_pscbc"

    gosub Print_Clk_Info_Line
  )

  &match=0
  &wild_head=0
  &wild_tail=0
  &clk_input_length=STRING.LENGTH("&clk")
  &clk_itr_length=STRING.LENGTH("gcc_pcie_1_mstr_axi_clk")

  if (STRING.SCAN("&clk", "*", 0)==0)
  (
    &wild_head=1
  )
  if (STRING.SCAN("&clk", "*", 1)==(STRING.LENGTH("&clk")-1))
  (
    &wild_tail=1
  )

  if ((&wild_head==1)&&(&wild_tail==1))
  (
    if (STRING.SCAN("gcc_pcie_1_mstr_axi_clk", STRING.MID("&clk", 1, &clk_input_length-2), 0)!=-1)
    ( 
      &match=1
    )
  )
  else if (&wild_head==1)
  (
    if (STRING.MID("gcc_pcie_1_mstr_axi_clk", &clk_itr_length-&clk_input_length+1, &clk_input_length-1)==STRING.CUT("&clk", 1))
    ( 
      &match=1
    )
  )
  else if (&wild_tail==1)
  (
    if (STRING.MID("gcc_pcie_1_mstr_axi_clk", 0, &clk_input_length-1)==STRING.CUT("&clk", -1))
    ( 
      &match=1
    )
  )	  
  else if ("gcc_pcie_1_mstr_axi_clk"=="&clk")
  (
    &match=1
  )
  
  if (&match==1)
  (
    &clk_test=&CLK_TEST_GCC_PCIE_1_MSTR_AXI_CLK
    &clk_reg=&HWIO_GCC_PCIE_1_MSTR_AXI_CBCR_ADDR
    &clk_reg_name="GCC_PCIE_1_MSTR_AXI_CBCR"
    &clk_name="gcc_pcie_1_mstr_axi_clk"
    &clk_reg_cbcr_type="sm_pscbc"

    gosub Print_Clk_Info_Line
  )

  &match=0
  &wild_head=0
  &wild_tail=0
  &clk_input_length=STRING.LENGTH("&clk")
  &clk_itr_length=STRING.LENGTH("gcc_pcie_1_slv_axi_clk")

  if (STRING.SCAN("&clk", "*", 0)==0)
  (
    &wild_head=1
  )
  if (STRING.SCAN("&clk", "*", 1)==(STRING.LENGTH("&clk")-1))
  (
    &wild_tail=1
  )

  if ((&wild_head==1)&&(&wild_tail==1))
  (
    if (STRING.SCAN("gcc_pcie_1_slv_axi_clk", STRING.MID("&clk", 1, &clk_input_length-2), 0)!=-1)
    ( 
      &match=1
    )
  )
  else if (&wild_head==1)
  (
    if (STRING.MID("gcc_pcie_1_slv_axi_clk", &clk_itr_length-&clk_input_length+1, &clk_input_length-1)==STRING.CUT("&clk", 1))
    ( 
      &match=1
    )
  )
  else if (&wild_tail==1)
  (
    if (STRING.MID("gcc_pcie_1_slv_axi_clk", 0, &clk_input_length-1)==STRING.CUT("&clk", -1))
    ( 
      &match=1
    )
  )	  
  else if ("gcc_pcie_1_slv_axi_clk"=="&clk")
  (
    &match=1
  )
  
  if (&match==1)
  (
    &clk_test=&CLK_TEST_GCC_PCIE_1_SLV_AXI_CLK
    &clk_reg=&HWIO_GCC_PCIE_1_SLV_AXI_CBCR_ADDR
    &clk_reg_name="GCC_PCIE_1_SLV_AXI_CBCR"
    &clk_name="gcc_pcie_1_slv_axi_clk"
    &clk_reg_cbcr_type="sm_pscbc"

    gosub Print_Clk_Info_Line
  )

  &match=0
  &wild_head=0
  &wild_tail=0
  &clk_input_length=STRING.LENGTH("&clk")
  &clk_itr_length=STRING.LENGTH("gcc_qdss_etr_usb_clk")

  if (STRING.SCAN("&clk", "*", 0)==0)
  (
    &wild_head=1
  )
  if (STRING.SCAN("&clk", "*", 1)==(STRING.LENGTH("&clk")-1))
  (
    &wild_tail=1
  )

  if ((&wild_head==1)&&(&wild_tail==1))
  (
    if (STRING.SCAN("gcc_qdss_etr_usb_clk", STRING.MID("&clk", 1, &clk_input_length-2), 0)!=-1)
    ( 
      &match=1
    )
  )
  else if (&wild_head==1)
  (
    if (STRING.MID("gcc_qdss_etr_usb_clk", &clk_itr_length-&clk_input_length+1, &clk_input_length-1)==STRING.CUT("&clk", 1))
    ( 
      &match=1
    )
  )
  else if (&wild_tail==1)
  (
    if (STRING.MID("gcc_qdss_etr_usb_clk", 0, &clk_input_length-1)==STRING.CUT("&clk", -1))
    ( 
      &match=1
    )
  )	  
  else if ("gcc_qdss_etr_usb_clk"=="&clk")
  (
    &match=1
  )
  
  if (&match==1)
  (
    &clk_test=&CLK_TEST_GCC_QDSS_ETR_USB_CLK
    &clk_reg=&HWIO_GCC_QDSS_ETR_USB_CBCR_ADDR
    &clk_reg_name="GCC_QDSS_ETR_USB_CBCR"
    &clk_name="gcc_qdss_etr_usb_clk"
    &clk_reg_cbcr_type="sm_cbc"

    gosub Print_Clk_Info_Line
  )

  &match=0
  &wild_head=0
  &wild_tail=0
  &clk_input_length=STRING.LENGTH("&clk")
  &clk_itr_length=STRING.LENGTH("gcc_snoc_bus_timeout1_ahb_clk")

  if (STRING.SCAN("&clk", "*", 0)==0)
  (
    &wild_head=1
  )
  if (STRING.SCAN("&clk", "*", 1)==(STRING.LENGTH("&clk")-1))
  (
    &wild_tail=1
  )

  if ((&wild_head==1)&&(&wild_tail==1))
  (
    if (STRING.SCAN("gcc_snoc_bus_timeout1_ahb_clk", STRING.MID("&clk", 1, &clk_input_length-2), 0)!=-1)
    ( 
      &match=1
    )
  )
  else if (&wild_head==1)
  (
    if (STRING.MID("gcc_snoc_bus_timeout1_ahb_clk", &clk_itr_length-&clk_input_length+1, &clk_input_length-1)==STRING.CUT("&clk", 1))
    ( 
      &match=1
    )
  )
  else if (&wild_tail==1)
  (
    if (STRING.MID("gcc_snoc_bus_timeout1_ahb_clk", 0, &clk_input_length-1)==STRING.CUT("&clk", -1))
    ( 
      &match=1
    )
  )	  
  else if ("gcc_snoc_bus_timeout1_ahb_clk"=="&clk")
  (
    &match=1
  )
  
  if (&match==1)
  (
    &clk_test=&CLK_TEST_GCC_SNOC_BUS_TIMEOUT1_AHB_CLK
    &clk_reg=&HWIO_GCC_SNOC_BUS_TIMEOUT1_AHB_CBCR_ADDR
    &clk_reg_name="GCC_SNOC_BUS_TIMEOUT1_AHB_CBCR"
    &clk_name="gcc_snoc_bus_timeout1_ahb_clk"
    &clk_reg_cbcr_type="sm_cbc"

    gosub Print_Clk_Info_Line
  )

  &match=0
  &wild_head=0
  &wild_tail=0
  &clk_input_length=STRING.LENGTH("&clk")
  &clk_itr_length=STRING.LENGTH("gcc_snoc_bus_timeout3_ahb_clk")

  if (STRING.SCAN("&clk", "*", 0)==0)
  (
    &wild_head=1
  )
  if (STRING.SCAN("&clk", "*", 1)==(STRING.LENGTH("&clk")-1))
  (
    &wild_tail=1
  )

  if ((&wild_head==1)&&(&wild_tail==1))
  (
    if (STRING.SCAN("gcc_snoc_bus_timeout3_ahb_clk", STRING.MID("&clk", 1, &clk_input_length-2), 0)!=-1)
    ( 
      &match=1
    )
  )
  else if (&wild_head==1)
  (
    if (STRING.MID("gcc_snoc_bus_timeout3_ahb_clk", &clk_itr_length-&clk_input_length+1, &clk_input_length-1)==STRING.CUT("&clk", 1))
    ( 
      &match=1
    )
  )
  else if (&wild_tail==1)
  (
    if (STRING.MID("gcc_snoc_bus_timeout3_ahb_clk", 0, &clk_input_length-1)==STRING.CUT("&clk", -1))
    ( 
      &match=1
    )
  )	  
  else if ("gcc_snoc_bus_timeout3_ahb_clk"=="&clk")
  (
    &match=1
  )
  
  if (&match==1)
  (
    &clk_test=&CLK_TEST_GCC_SNOC_BUS_TIMEOUT3_AHB_CLK
    &clk_reg=&HWIO_GCC_SNOC_BUS_TIMEOUT3_AHB_CBCR_ADDR
    &clk_reg_name="GCC_SNOC_BUS_TIMEOUT3_AHB_CBCR"
    &clk_name="gcc_snoc_bus_timeout3_ahb_clk"
    &clk_reg_cbcr_type="sm_cbc"

    gosub Print_Clk_Info_Line
  )

  &match=0
  &wild_head=0
  &wild_tail=0
  &clk_input_length=STRING.LENGTH("&clk")
  &clk_itr_length=STRING.LENGTH("gcc_sys_noc_axi_clk")

  if (STRING.SCAN("&clk", "*", 0)==0)
  (
    &wild_head=1
  )
  if (STRING.SCAN("&clk", "*", 1)==(STRING.LENGTH("&clk")-1))
  (
    &wild_tail=1
  )

  if ((&wild_head==1)&&(&wild_tail==1))
  (
    if (STRING.SCAN("gcc_sys_noc_axi_clk", STRING.MID("&clk", 1, &clk_input_length-2), 0)!=-1)
    ( 
      &match=1
    )
  )
  else if (&wild_head==1)
  (
    if (STRING.MID("gcc_sys_noc_axi_clk", &clk_itr_length-&clk_input_length+1, &clk_input_length-1)==STRING.CUT("&clk", 1))
    ( 
      &match=1
    )
  )
  else if (&wild_tail==1)
  (
    if (STRING.MID("gcc_sys_noc_axi_clk", 0, &clk_input_length-1)==STRING.CUT("&clk", -1))
    ( 
      &match=1
    )
  )	  
  else if ("gcc_sys_noc_axi_clk"=="&clk")||("buses"=="&clk")
  (
    &match=1
  )
  
  if (&match==1)
  (
    &clk_test=&CLK_TEST_GCC_SYS_NOC_AXI_CLK
    &clk_reg=&HWIO_GCC_SYS_NOC_AXI_CBCR_ADDR
    &clk_reg_name="GCC_SYS_NOC_AXI_CBCR"
    &clk_name="gcc_sys_noc_axi_clk"
    &clk_reg_cbcr_type="sm_cbc"

    gosub Print_Clk_Info_Line
  )

  &match=0
  &wild_head=0
  &wild_tail=0
  &clk_input_length=STRING.LENGTH("&clk")
  &clk_itr_length=STRING.LENGTH("gcc_cfg_noc_tic_clk")

  if (STRING.SCAN("&clk", "*", 0)==0)
  (
    &wild_head=1
  )
  if (STRING.SCAN("&clk", "*", 1)==(STRING.LENGTH("&clk")-1))
  (
    &wild_tail=1
  )

  if ((&wild_head==1)&&(&wild_tail==1))
  (
    if (STRING.SCAN("gcc_cfg_noc_tic_clk", STRING.MID("&clk", 1, &clk_input_length-2), 0)!=-1)
    ( 
      &match=1
    )
  )
  else if (&wild_head==1)
  (
    if (STRING.MID("gcc_cfg_noc_tic_clk", &clk_itr_length-&clk_input_length+1, &clk_input_length-1)==STRING.CUT("&clk", 1))
    ( 
      &match=1
    )
  )
  else if (&wild_tail==1)
  (
    if (STRING.MID("gcc_cfg_noc_tic_clk", 0, &clk_input_length-1)==STRING.CUT("&clk", -1))
    ( 
      &match=1
    )
  )	  
  else if ("gcc_cfg_noc_tic_clk"=="&clk")
  (
    &match=1
  )
  
  if (&match==1)
  (
    &clk_test=&CLK_TEST_GCC_CFG_NOC_TIC_CLK
    &clk_reg=0
    &clk_reg_name="No CBCR"
    &clk_name="gcc_cfg_noc_tic_clk"
    &clk_reg_cbcr_type=""

    gosub Print_Clk_Info_Line
  )

  &match=0
  &wild_head=0
  &wild_tail=0
  &clk_input_length=STRING.LENGTH("&clk")
  &clk_itr_length=STRING.LENGTH("gcc_tic_clk")

  if (STRING.SCAN("&clk", "*", 0)==0)
  (
    &wild_head=1
  )
  if (STRING.SCAN("&clk", "*", 1)==(STRING.LENGTH("&clk")-1))
  (
    &wild_tail=1
  )

  if ((&wild_head==1)&&(&wild_tail==1))
  (
    if (STRING.SCAN("gcc_tic_clk", STRING.MID("&clk", 1, &clk_input_length-2), 0)!=-1)
    ( 
      &match=1
    )
  )
  else if (&wild_head==1)
  (
    if (STRING.MID("gcc_tic_clk", &clk_itr_length-&clk_input_length+1, &clk_input_length-1)==STRING.CUT("&clk", 1))
    ( 
      &match=1
    )
  )
  else if (&wild_tail==1)
  (
    if (STRING.MID("gcc_tic_clk", 0, &clk_input_length-1)==STRING.CUT("&clk", -1))
    ( 
      &match=1
    )
  )	  
  else if ("gcc_tic_clk"=="&clk")
  (
    &match=1
  )
  
  if (&match==1)
  (
    &clk_test=0
    &clk_reg=0
    &clk_reg_name="No CBCR"
    &clk_name="gcc_tic_clk"
    &clk_reg_cbcr_type=""

    gosub Print_Clk_Info_Line
  )

  &match=0
  &wild_head=0
  &wild_tail=0
  &clk_input_length=STRING.LENGTH("&clk")
  &clk_itr_length=STRING.LENGTH("gcc_tsif_ref_clk")

  if (STRING.SCAN("&clk", "*", 0)==0)
  (
    &wild_head=1
  )
  if (STRING.SCAN("&clk", "*", 1)==(STRING.LENGTH("&clk")-1))
  (
    &wild_tail=1
  )

  if ((&wild_head==1)&&(&wild_tail==1))
  (
    if (STRING.SCAN("gcc_tsif_ref_clk", STRING.MID("&clk", 1, &clk_input_length-2), 0)!=-1)
    ( 
      &match=1
    )
  )
  else if (&wild_head==1)
  (
    if (STRING.MID("gcc_tsif_ref_clk", &clk_itr_length-&clk_input_length+1, &clk_input_length-1)==STRING.CUT("&clk", 1))
    ( 
      &match=1
    )
  )
  else if (&wild_tail==1)
  (
    if (STRING.MID("gcc_tsif_ref_clk", 0, &clk_input_length-1)==STRING.CUT("&clk", -1))
    ( 
      &match=1
    )
  )	  
  else if ("gcc_tsif_ref_clk"=="&clk")
  (
    &match=1
  )
  
  if (&match==1)
  (
    &clk_test=&CLK_TEST_GCC_TSIF_REF_CLK
    &clk_reg=&HWIO_GCC_TSIF_REF_CBCR_ADDR
    &clk_reg_name="GCC_TSIF_REF_CBCR"
    &clk_name="gcc_tsif_ref_clk"
    &clk_reg_cbcr_type="sm_cbc"

    gosub Print_Clk_Info_Line
  )

  &match=0
  &wild_head=0
  &wild_tail=0
  &clk_input_length=STRING.LENGTH("&clk")
  &clk_itr_length=STRING.LENGTH("gcc_sys_noc_ufs_axi_clk")

  if (STRING.SCAN("&clk", "*", 0)==0)
  (
    &wild_head=1
  )
  if (STRING.SCAN("&clk", "*", 1)==(STRING.LENGTH("&clk")-1))
  (
    &wild_tail=1
  )

  if ((&wild_head==1)&&(&wild_tail==1))
  (
    if (STRING.SCAN("gcc_sys_noc_ufs_axi_clk", STRING.MID("&clk", 1, &clk_input_length-2), 0)!=-1)
    ( 
      &match=1
    )
  )
  else if (&wild_head==1)
  (
    if (STRING.MID("gcc_sys_noc_ufs_axi_clk", &clk_itr_length-&clk_input_length+1, &clk_input_length-1)==STRING.CUT("&clk", 1))
    ( 
      &match=1
    )
  )
  else if (&wild_tail==1)
  (
    if (STRING.MID("gcc_sys_noc_ufs_axi_clk", 0, &clk_input_length-1)==STRING.CUT("&clk", -1))
    ( 
      &match=1
    )
  )	  
  else if ("gcc_sys_noc_ufs_axi_clk"=="&clk")
  (
    &match=1
  )
  
  if (&match==1)
  (
    &clk_test=&CLK_TEST_GCC_SYS_NOC_UFS_AXI_CLK
    &clk_reg=&HWIO_GCC_SYS_NOC_UFS_AXI_CBCR_ADDR
    &clk_reg_name="GCC_SYS_NOC_UFS_AXI_CBCR"
    &clk_name="gcc_sys_noc_ufs_axi_clk"
    &clk_reg_cbcr_type="sm_cbc"

    gosub Print_Clk_Info_Line
  )

  &match=0
  &wild_head=0
  &wild_tail=0
  &clk_input_length=STRING.LENGTH("&clk")
  &clk_itr_length=STRING.LENGTH("gcc_ufs_axi_clk")

  if (STRING.SCAN("&clk", "*", 0)==0)
  (
    &wild_head=1
  )
  if (STRING.SCAN("&clk", "*", 1)==(STRING.LENGTH("&clk")-1))
  (
    &wild_tail=1
  )

  if ((&wild_head==1)&&(&wild_tail==1))
  (
    if (STRING.SCAN("gcc_ufs_axi_clk", STRING.MID("&clk", 1, &clk_input_length-2), 0)!=-1)
    ( 
      &match=1
    )
  )
  else if (&wild_head==1)
  (
    if (STRING.MID("gcc_ufs_axi_clk", &clk_itr_length-&clk_input_length+1, &clk_input_length-1)==STRING.CUT("&clk", 1))
    ( 
      &match=1
    )
  )
  else if (&wild_tail==1)
  (
    if (STRING.MID("gcc_ufs_axi_clk", 0, &clk_input_length-1)==STRING.CUT("&clk", -1))
    ( 
      &match=1
    )
  )	  
  else if ("gcc_ufs_axi_clk"=="&clk")
  (
    &match=1
  )
  
  if (&match==1)
  (
    &clk_test=&CLK_TEST_GCC_UFS_AXI_CLK
    &clk_reg=&HWIO_GCC_UFS_AXI_CBCR_ADDR
    &clk_reg_name="GCC_UFS_AXI_CBCR"
    &clk_name="gcc_ufs_axi_clk"
    &clk_reg_cbcr_type="sm_pscbc"

    gosub Print_Clk_Info_Line
  )

  &match=0
  &wild_head=0
  &wild_tail=0
  &clk_input_length=STRING.LENGTH("&clk")
  &clk_itr_length=STRING.LENGTH("gcc_ufs_rx_cfg_clk")

  if (STRING.SCAN("&clk", "*", 0)==0)
  (
    &wild_head=1
  )
  if (STRING.SCAN("&clk", "*", 1)==(STRING.LENGTH("&clk")-1))
  (
    &wild_tail=1
  )

  if ((&wild_head==1)&&(&wild_tail==1))
  (
    if (STRING.SCAN("gcc_ufs_rx_cfg_clk", STRING.MID("&clk", 1, &clk_input_length-2), 0)!=-1)
    ( 
      &match=1
    )
  )
  else if (&wild_head==1)
  (
    if (STRING.MID("gcc_ufs_rx_cfg_clk", &clk_itr_length-&clk_input_length+1, &clk_input_length-1)==STRING.CUT("&clk", 1))
    ( 
      &match=1
    )
  )
  else if (&wild_tail==1)
  (
    if (STRING.MID("gcc_ufs_rx_cfg_clk", 0, &clk_input_length-1)==STRING.CUT("&clk", -1))
    ( 
      &match=1
    )
  )	  
  else if ("gcc_ufs_rx_cfg_clk"=="&clk")
  (
    &match=1
  )
  
  if (&match==1)
  (
    &clk_test=&CLK_TEST_GCC_UFS_RX_CFG_CLK
    &clk_reg=&HWIO_GCC_UFS_RX_CFG_CBCR_ADDR
    &clk_reg_name="GCC_UFS_RX_CFG_CBCR"
    &clk_name="gcc_ufs_rx_cfg_clk"
    &clk_reg_cbcr_type="sm_cbc"

    gosub Print_Clk_Info_Line
  )

  &match=0
  &wild_head=0
  &wild_tail=0
  &clk_input_length=STRING.LENGTH("&clk")
  &clk_itr_length=STRING.LENGTH("gcc_ufs_tx_cfg_clk")

  if (STRING.SCAN("&clk", "*", 0)==0)
  (
    &wild_head=1
  )
  if (STRING.SCAN("&clk", "*", 1)==(STRING.LENGTH("&clk")-1))
  (
    &wild_tail=1
  )

  if ((&wild_head==1)&&(&wild_tail==1))
  (
    if (STRING.SCAN("gcc_ufs_tx_cfg_clk", STRING.MID("&clk", 1, &clk_input_length-2), 0)!=-1)
    ( 
      &match=1
    )
  )
  else if (&wild_head==1)
  (
    if (STRING.MID("gcc_ufs_tx_cfg_clk", &clk_itr_length-&clk_input_length+1, &clk_input_length-1)==STRING.CUT("&clk", 1))
    ( 
      &match=1
    )
  )
  else if (&wild_tail==1)
  (
    if (STRING.MID("gcc_ufs_tx_cfg_clk", 0, &clk_input_length-1)==STRING.CUT("&clk", -1))
    ( 
      &match=1
    )
  )	  
  else if ("gcc_ufs_tx_cfg_clk"=="&clk")
  (
    &match=1
  )
  
  if (&match==1)
  (
    &clk_test=&CLK_TEST_GCC_UFS_TX_CFG_CLK
    &clk_reg=&HWIO_GCC_UFS_TX_CFG_CBCR_ADDR
    &clk_reg_name="GCC_UFS_TX_CFG_CBCR"
    &clk_name="gcc_ufs_tx_cfg_clk"
    &clk_reg_cbcr_type="sm_cbc"

    gosub Print_Clk_Info_Line
  )

  &match=0
  &wild_head=0
  &wild_tail=0
  &clk_input_length=STRING.LENGTH("&clk")
  &clk_itr_length=STRING.LENGTH("gcc_snoc_bus_timeout2_ahb_clk")

  if (STRING.SCAN("&clk", "*", 0)==0)
  (
    &wild_head=1
  )
  if (STRING.SCAN("&clk", "*", 1)==(STRING.LENGTH("&clk")-1))
  (
    &wild_tail=1
  )

  if ((&wild_head==1)&&(&wild_tail==1))
  (
    if (STRING.SCAN("gcc_snoc_bus_timeout2_ahb_clk", STRING.MID("&clk", 1, &clk_input_length-2), 0)!=-1)
    ( 
      &match=1
    )
  )
  else if (&wild_head==1)
  (
    if (STRING.MID("gcc_snoc_bus_timeout2_ahb_clk", &clk_itr_length-&clk_input_length+1, &clk_input_length-1)==STRING.CUT("&clk", 1))
    ( 
      &match=1
    )
  )
  else if (&wild_tail==1)
  (
    if (STRING.MID("gcc_snoc_bus_timeout2_ahb_clk", 0, &clk_input_length-1)==STRING.CUT("&clk", -1))
    ( 
      &match=1
    )
  )	  
  else if ("gcc_snoc_bus_timeout2_ahb_clk"=="&clk")
  (
    &match=1
  )
  
  if (&match==1)
  (
    &clk_test=&CLK_TEST_GCC_SNOC_BUS_TIMEOUT2_AHB_CLK
    &clk_reg=&HWIO_GCC_SNOC_BUS_TIMEOUT2_AHB_CBCR_ADDR
    &clk_reg_name="GCC_SNOC_BUS_TIMEOUT2_AHB_CBCR"
    &clk_name="gcc_snoc_bus_timeout2_ahb_clk"
    &clk_reg_cbcr_type="sm_cbc"

    gosub Print_Clk_Info_Line
  )

  &match=0
  &wild_head=0
  &wild_tail=0
  &clk_input_length=STRING.LENGTH("&clk")
  &clk_itr_length=STRING.LENGTH("gcc_sys_noc_usb3_axi_clk")

  if (STRING.SCAN("&clk", "*", 0)==0)
  (
    &wild_head=1
  )
  if (STRING.SCAN("&clk", "*", 1)==(STRING.LENGTH("&clk")-1))
  (
    &wild_tail=1
  )

  if ((&wild_head==1)&&(&wild_tail==1))
  (
    if (STRING.SCAN("gcc_sys_noc_usb3_axi_clk", STRING.MID("&clk", 1, &clk_input_length-2), 0)!=-1)
    ( 
      &match=1
    )
  )
  else if (&wild_head==1)
  (
    if (STRING.MID("gcc_sys_noc_usb3_axi_clk", &clk_itr_length-&clk_input_length+1, &clk_input_length-1)==STRING.CUT("&clk", 1))
    ( 
      &match=1
    )
  )
  else if (&wild_tail==1)
  (
    if (STRING.MID("gcc_sys_noc_usb3_axi_clk", 0, &clk_input_length-1)==STRING.CUT("&clk", -1))
    ( 
      &match=1
    )
  )	  
  else if ("gcc_sys_noc_usb3_axi_clk"=="&clk")
  (
    &match=1
  )
  
  if (&match==1)
  (
    &clk_test=&CLK_TEST_GCC_SYS_NOC_USB3_AXI_CLK
    &clk_reg=&HWIO_GCC_SYS_NOC_USB3_AXI_CBCR_ADDR
    &clk_reg_name="GCC_SYS_NOC_USB3_AXI_CBCR"
    &clk_name="gcc_sys_noc_usb3_axi_clk"
    &clk_reg_cbcr_type="sm_cbc"

    gosub Print_Clk_Info_Line
  )

  &match=0
  &wild_head=0
  &wild_tail=0
  &clk_input_length=STRING.LENGTH("&clk")
  &clk_itr_length=STRING.LENGTH("gcc_usb30_master_clk")

  if (STRING.SCAN("&clk", "*", 0)==0)
  (
    &wild_head=1
  )
  if (STRING.SCAN("&clk", "*", 1)==(STRING.LENGTH("&clk")-1))
  (
    &wild_tail=1
  )

  if ((&wild_head==1)&&(&wild_tail==1))
  (
    if (STRING.SCAN("gcc_usb30_master_clk", STRING.MID("&clk", 1, &clk_input_length-2), 0)!=-1)
    ( 
      &match=1
    )
  )
  else if (&wild_head==1)
  (
    if (STRING.MID("gcc_usb30_master_clk", &clk_itr_length-&clk_input_length+1, &clk_input_length-1)==STRING.CUT("&clk", 1))
    ( 
      &match=1
    )
  )
  else if (&wild_tail==1)
  (
    if (STRING.MID("gcc_usb30_master_clk", 0, &clk_input_length-1)==STRING.CUT("&clk", -1))
    ( 
      &match=1
    )
  )	  
  else if ("gcc_usb30_master_clk"=="&clk")
  (
    &match=1
  )
  
  if (&match==1)
  (
    &clk_test=&CLK_TEST_GCC_USB30_MASTER_CLK
    &clk_reg=&HWIO_GCC_USB30_MASTER_CBCR_ADDR
    &clk_reg_name="GCC_USB30_MASTER_CBCR"
    &clk_name="gcc_usb30_master_clk"
    &clk_reg_cbcr_type="sm_pscbc"

    gosub Print_Clk_Info_Line
  )

  &match=0
  &wild_head=0
  &wild_tail=0
  &clk_input_length=STRING.LENGTH("&clk")
  &clk_itr_length=STRING.LENGTH("gcc_usb30_mock_utmi_clk")

  if (STRING.SCAN("&clk", "*", 0)==0)
  (
    &wild_head=1
  )
  if (STRING.SCAN("&clk", "*", 1)==(STRING.LENGTH("&clk")-1))
  (
    &wild_tail=1
  )

  if ((&wild_head==1)&&(&wild_tail==1))
  (
    if (STRING.SCAN("gcc_usb30_mock_utmi_clk", STRING.MID("&clk", 1, &clk_input_length-2), 0)!=-1)
    ( 
      &match=1
    )
  )
  else if (&wild_head==1)
  (
    if (STRING.MID("gcc_usb30_mock_utmi_clk", &clk_itr_length-&clk_input_length+1, &clk_input_length-1)==STRING.CUT("&clk", 1))
    ( 
      &match=1
    )
  )
  else if (&wild_tail==1)
  (
    if (STRING.MID("gcc_usb30_mock_utmi_clk", 0, &clk_input_length-1)==STRING.CUT("&clk", -1))
    ( 
      &match=1
    )
  )	  
  else if ("gcc_usb30_mock_utmi_clk"=="&clk")
  (
    &match=1
  )
  
  if (&match==1)
  (
    &clk_test=&CLK_TEST_GCC_USB30_MOCK_UTMI_CLK
    &clk_reg=&HWIO_GCC_USB30_MOCK_UTMI_CBCR_ADDR
    &clk_reg_name="GCC_USB30_MOCK_UTMI_CBCR"
    &clk_name="gcc_usb30_mock_utmi_clk"
    &clk_reg_cbcr_type="sm_cbc"

    gosub Print_Clk_Info_Line
  )

  &match=0
  &wild_head=0
  &wild_tail=0
  &clk_input_length=STRING.LENGTH("&clk")
  &clk_itr_length=STRING.LENGTH("gcc_usb3_phy_aux_clk")

  if (STRING.SCAN("&clk", "*", 0)==0)
  (
    &wild_head=1
  )
  if (STRING.SCAN("&clk", "*", 1)==(STRING.LENGTH("&clk")-1))
  (
    &wild_tail=1
  )

  if ((&wild_head==1)&&(&wild_tail==1))
  (
    if (STRING.SCAN("gcc_usb3_phy_aux_clk", STRING.MID("&clk", 1, &clk_input_length-2), 0)!=-1)
    ( 
      &match=1
    )
  )
  else if (&wild_head==1)
  (
    if (STRING.MID("gcc_usb3_phy_aux_clk", &clk_itr_length-&clk_input_length+1, &clk_input_length-1)==STRING.CUT("&clk", 1))
    ( 
      &match=1
    )
  )
  else if (&wild_tail==1)
  (
    if (STRING.MID("gcc_usb3_phy_aux_clk", 0, &clk_input_length-1)==STRING.CUT("&clk", -1))
    ( 
      &match=1
    )
  )	  
  else if ("gcc_usb3_phy_aux_clk"=="&clk")
  (
    &match=1
  )
  
  if (&match==1)
  (
    &clk_test=&CLK_TEST_GCC_USB3_PHY_AUX_CLK
    &clk_reg=&HWIO_GCC_USB3_PHY_AUX_CBCR_ADDR
    &clk_reg_name="GCC_USB3_PHY_AUX_CBCR"
    &clk_name="gcc_usb3_phy_aux_clk"
    &clk_reg_cbcr_type="sm_cbc"

    gosub Print_Clk_Info_Line
  )

  &match=0
  &wild_head=0
  &wild_tail=0
  &clk_input_length=STRING.LENGTH("&clk")
  &clk_itr_length=STRING.LENGTH("gcc_usb_hs_system_clk")

  if (STRING.SCAN("&clk", "*", 0)==0)
  (
    &wild_head=1
  )
  if (STRING.SCAN("&clk", "*", 1)==(STRING.LENGTH("&clk")-1))
  (
    &wild_tail=1
  )

  if ((&wild_head==1)&&(&wild_tail==1))
  (
    if (STRING.SCAN("gcc_usb_hs_system_clk", STRING.MID("&clk", 1, &clk_input_length-2), 0)!=-1)
    ( 
      &match=1
    )
  )
  else if (&wild_head==1)
  (
    if (STRING.MID("gcc_usb_hs_system_clk", &clk_itr_length-&clk_input_length+1, &clk_input_length-1)==STRING.CUT("&clk", 1))
    ( 
      &match=1
    )
  )
  else if (&wild_tail==1)
  (
    if (STRING.MID("gcc_usb_hs_system_clk", 0, &clk_input_length-1)==STRING.CUT("&clk", -1))
    ( 
      &match=1
    )
  )	  
  else if ("gcc_usb_hs_system_clk"=="&clk")
  (
    &match=1
  )
  
  if (&match==1)
  (
    &clk_test=&CLK_TEST_GCC_USB_HS_SYSTEM_CLK
    &clk_reg=&HWIO_GCC_USB_HS_SYSTEM_CBCR_ADDR
    &clk_reg_name="GCC_USB_HS_SYSTEM_CBCR"
    &clk_name="gcc_usb_hs_system_clk"
    &clk_reg_cbcr_type="sm_pscbc"

    gosub Print_Clk_Info_Line
  )

  &match=0
  &wild_head=0
  &wild_tail=0
  &clk_input_length=STRING.LENGTH("&clk")
  &clk_itr_length=STRING.LENGTH("gcc_vs_clk")

  if (STRING.SCAN("&clk", "*", 0)==0)
  (
    &wild_head=1
  )
  if (STRING.SCAN("&clk", "*", 1)==(STRING.LENGTH("&clk")-1))
  (
    &wild_tail=1
  )

  if ((&wild_head==1)&&(&wild_tail==1))
  (
    if (STRING.SCAN("gcc_vs_clk", STRING.MID("&clk", 1, &clk_input_length-2), 0)!=-1)
    ( 
      &match=1
    )
  )
  else if (&wild_head==1)
  (
    if (STRING.MID("gcc_vs_clk", &clk_itr_length-&clk_input_length+1, &clk_input_length-1)==STRING.CUT("&clk", 1))
    ( 
      &match=1
    )
  )
  else if (&wild_tail==1)
  (
    if (STRING.MID("gcc_vs_clk", 0, &clk_input_length-1)==STRING.CUT("&clk", -1))
    ( 
      &match=1
    )
  )	  
  else if ("gcc_vs_clk"=="&clk")
  (
    &match=1
  )
  
  if (&match==1)
  (
    &clk_test=&CLK_TEST_GCC_VS_CLK
    &clk_reg=&HWIO_GCC_VS_CBCR_ADDR
    &clk_reg_name="GCC_VS_CBCR"
    &clk_name="gcc_vs_clk"
    &clk_reg_cbcr_type="sm_cbc"

    gosub Print_Clk_Info_Line
  )

  &match=0
  &wild_head=0
  &wild_tail=0
  &clk_input_length=STRING.LENGTH("&clk")
  &clk_itr_length=STRING.LENGTH("gpll0_dtest")

  if (STRING.SCAN("&clk", "*", 0)==0)
  (
    &wild_head=1
  )
  if (STRING.SCAN("&clk", "*", 1)==(STRING.LENGTH("&clk")-1))
  (
    &wild_tail=1
  )

  if ((&wild_head==1)&&(&wild_tail==1))
  (
    if (STRING.SCAN("gpll0_dtest", STRING.MID("&clk", 1, &clk_input_length-2), 0)!=-1)
    ( 
      &match=1
    )
  )
  else if (&wild_head==1)
  (
    if (STRING.MID("gpll0_dtest", &clk_itr_length-&clk_input_length+1, &clk_input_length-1)==STRING.CUT("&clk", 1))
    ( 
      &match=1
    )
  )
  else if (&wild_tail==1)
  (
    if (STRING.MID("gpll0_dtest", 0, &clk_input_length-1)==STRING.CUT("&clk", -1))
    ( 
      &match=1
    )
  )	  
  else if ("gpll0_dtest"=="&clk")
  (
    &match=1
  )
  
  if (&match==1)
  (
    &clk_test=&CLK_TEST_GPLL0_DTEST
    &clk_reg=0
    &clk_reg_name="No CBCR"
    &clk_name="gpll0_dtest"
    &clk_reg_cbcr_type=""

    gosub Print_Clk_Info_Line
  )

  &match=0
  &wild_head=0
  &wild_tail=0
  &clk_input_length=STRING.LENGTH("&clk")
  &clk_itr_length=STRING.LENGTH("gpll0_lock_det")

  if (STRING.SCAN("&clk", "*", 0)==0)
  (
    &wild_head=1
  )
  if (STRING.SCAN("&clk", "*", 1)==(STRING.LENGTH("&clk")-1))
  (
    &wild_tail=1
  )

  if ((&wild_head==1)&&(&wild_tail==1))
  (
    if (STRING.SCAN("gpll0_lock_det", STRING.MID("&clk", 1, &clk_input_length-2), 0)!=-1)
    ( 
      &match=1
    )
  )
  else if (&wild_head==1)
  (
    if (STRING.MID("gpll0_lock_det", &clk_itr_length-&clk_input_length+1, &clk_input_length-1)==STRING.CUT("&clk", 1))
    ( 
      &match=1
    )
  )
  else if (&wild_tail==1)
  (
    if (STRING.MID("gpll0_lock_det", 0, &clk_input_length-1)==STRING.CUT("&clk", -1))
    ( 
      &match=1
    )
  )	  
  else if ("gpll0_lock_det"=="&clk")
  (
    &match=1
  )
  
  if (&match==1)
  (
    &clk_test=&CLK_TEST_GPLL0_LOCK_DET
    &clk_reg=0
    &clk_reg_name="No CBCR"
    &clk_name="gpll0_lock_det"
    &clk_reg_cbcr_type=""

    gosub Print_Clk_Info_Line
  )

  &match=0
  &wild_head=0
  &wild_tail=0
  &clk_input_length=STRING.LENGTH("&clk")
  &clk_itr_length=STRING.LENGTH("gpll1_dtest")

  if (STRING.SCAN("&clk", "*", 0)==0)
  (
    &wild_head=1
  )
  if (STRING.SCAN("&clk", "*", 1)==(STRING.LENGTH("&clk")-1))
  (
    &wild_tail=1
  )

  if ((&wild_head==1)&&(&wild_tail==1))
  (
    if (STRING.SCAN("gpll1_dtest", STRING.MID("&clk", 1, &clk_input_length-2), 0)!=-1)
    ( 
      &match=1
    )
  )
  else if (&wild_head==1)
  (
    if (STRING.MID("gpll1_dtest", &clk_itr_length-&clk_input_length+1, &clk_input_length-1)==STRING.CUT("&clk", 1))
    ( 
      &match=1
    )
  )
  else if (&wild_tail==1)
  (
    if (STRING.MID("gpll1_dtest", 0, &clk_input_length-1)==STRING.CUT("&clk", -1))
    ( 
      &match=1
    )
  )	  
  else if ("gpll1_dtest"=="&clk")
  (
    &match=1
  )
  
  if (&match==1)
  (
    &clk_test=&CLK_TEST_GPLL1_DTEST
    &clk_reg=0
    &clk_reg_name="No CBCR"
    &clk_name="gpll1_dtest"
    &clk_reg_cbcr_type=""

    gosub Print_Clk_Info_Line
  )

  &match=0
  &wild_head=0
  &wild_tail=0
  &clk_input_length=STRING.LENGTH("&clk")
  &clk_itr_length=STRING.LENGTH("gpll1_lock_det")

  if (STRING.SCAN("&clk", "*", 0)==0)
  (
    &wild_head=1
  )
  if (STRING.SCAN("&clk", "*", 1)==(STRING.LENGTH("&clk")-1))
  (
    &wild_tail=1
  )

  if ((&wild_head==1)&&(&wild_tail==1))
  (
    if (STRING.SCAN("gpll1_lock_det", STRING.MID("&clk", 1, &clk_input_length-2), 0)!=-1)
    ( 
      &match=1
    )
  )
  else if (&wild_head==1)
  (
    if (STRING.MID("gpll1_lock_det", &clk_itr_length-&clk_input_length+1, &clk_input_length-1)==STRING.CUT("&clk", 1))
    ( 
      &match=1
    )
  )
  else if (&wild_tail==1)
  (
    if (STRING.MID("gpll1_lock_det", 0, &clk_input_length-1)==STRING.CUT("&clk", -1))
    ( 
      &match=1
    )
  )	  
  else if ("gpll1_lock_det"=="&clk")
  (
    &match=1
  )
  
  if (&match==1)
  (
    &clk_test=&CLK_TEST_GPLL1_LOCK_DET
    &clk_reg=0
    &clk_reg_name="No CBCR"
    &clk_name="gpll1_lock_det"
    &clk_reg_cbcr_type=""

    gosub Print_Clk_Info_Line
  )

  &match=0
  &wild_head=0
  &wild_tail=0
  &clk_input_length=STRING.LENGTH("&clk")
  &clk_itr_length=STRING.LENGTH("gpll2_dtest")

  if (STRING.SCAN("&clk", "*", 0)==0)
  (
    &wild_head=1
  )
  if (STRING.SCAN("&clk", "*", 1)==(STRING.LENGTH("&clk")-1))
  (
    &wild_tail=1
  )

  if ((&wild_head==1)&&(&wild_tail==1))
  (
    if (STRING.SCAN("gpll2_dtest", STRING.MID("&clk", 1, &clk_input_length-2), 0)!=-1)
    ( 
      &match=1
    )
  )
  else if (&wild_head==1)
  (
    if (STRING.MID("gpll2_dtest", &clk_itr_length-&clk_input_length+1, &clk_input_length-1)==STRING.CUT("&clk", 1))
    ( 
      &match=1
    )
  )
  else if (&wild_tail==1)
  (
    if (STRING.MID("gpll2_dtest", 0, &clk_input_length-1)==STRING.CUT("&clk", -1))
    ( 
      &match=1
    )
  )	  
  else if ("gpll2_dtest"=="&clk")
  (
    &match=1
  )
  
  if (&match==1)
  (
    &clk_test=&CLK_TEST_GPLL2_DTEST
    &clk_reg=0
    &clk_reg_name="No CBCR"
    &clk_name="gpll2_dtest"
    &clk_reg_cbcr_type=""

    gosub Print_Clk_Info_Line
  )

  &match=0
  &wild_head=0
  &wild_tail=0
  &clk_input_length=STRING.LENGTH("&clk")
  &clk_itr_length=STRING.LENGTH("gpll2_lock_det")

  if (STRING.SCAN("&clk", "*", 0)==0)
  (
    &wild_head=1
  )
  if (STRING.SCAN("&clk", "*", 1)==(STRING.LENGTH("&clk")-1))
  (
    &wild_tail=1
  )

  if ((&wild_head==1)&&(&wild_tail==1))
  (
    if (STRING.SCAN("gpll2_lock_det", STRING.MID("&clk", 1, &clk_input_length-2), 0)!=-1)
    ( 
      &match=1
    )
  )
  else if (&wild_head==1)
  (
    if (STRING.MID("gpll2_lock_det", &clk_itr_length-&clk_input_length+1, &clk_input_length-1)==STRING.CUT("&clk", 1))
    ( 
      &match=1
    )
  )
  else if (&wild_tail==1)
  (
    if (STRING.MID("gpll2_lock_det", 0, &clk_input_length-1)==STRING.CUT("&clk", -1))
    ( 
      &match=1
    )
  )	  
  else if ("gpll2_lock_det"=="&clk")
  (
    &match=1
  )
  
  if (&match==1)
  (
    &clk_test=&CLK_TEST_GPLL2_LOCK_DET
    &clk_reg=0
    &clk_reg_name="No CBCR"
    &clk_name="gpll2_lock_det"
    &clk_reg_cbcr_type=""

    gosub Print_Clk_Info_Line
  )

  &match=0
  &wild_head=0
  &wild_tail=0
  &clk_input_length=STRING.LENGTH("&clk")
  &clk_itr_length=STRING.LENGTH("gpll3_dtest")

  if (STRING.SCAN("&clk", "*", 0)==0)
  (
    &wild_head=1
  )
  if (STRING.SCAN("&clk", "*", 1)==(STRING.LENGTH("&clk")-1))
  (
    &wild_tail=1
  )

  if ((&wild_head==1)&&(&wild_tail==1))
  (
    if (STRING.SCAN("gpll3_dtest", STRING.MID("&clk", 1, &clk_input_length-2), 0)!=-1)
    ( 
      &match=1
    )
  )
  else if (&wild_head==1)
  (
    if (STRING.MID("gpll3_dtest", &clk_itr_length-&clk_input_length+1, &clk_input_length-1)==STRING.CUT("&clk", 1))
    ( 
      &match=1
    )
  )
  else if (&wild_tail==1)
  (
    if (STRING.MID("gpll3_dtest", 0, &clk_input_length-1)==STRING.CUT("&clk", -1))
    ( 
      &match=1
    )
  )	  
  else if ("gpll3_dtest"=="&clk")
  (
    &match=1
  )
  
  if (&match==1)
  (
    &clk_test=&CLK_TEST_GPLL3_DTEST
    &clk_reg=0
    &clk_reg_name="No CBCR"
    &clk_name="gpll3_dtest"
    &clk_reg_cbcr_type=""

    gosub Print_Clk_Info_Line
  )

  &match=0
  &wild_head=0
  &wild_tail=0
  &clk_input_length=STRING.LENGTH("&clk")
  &clk_itr_length=STRING.LENGTH("gpll3_lock_det")

  if (STRING.SCAN("&clk", "*", 0)==0)
  (
    &wild_head=1
  )
  if (STRING.SCAN("&clk", "*", 1)==(STRING.LENGTH("&clk")-1))
  (
    &wild_tail=1
  )

  if ((&wild_head==1)&&(&wild_tail==1))
  (
    if (STRING.SCAN("gpll3_lock_det", STRING.MID("&clk", 1, &clk_input_length-2), 0)!=-1)
    ( 
      &match=1
    )
  )
  else if (&wild_head==1)
  (
    if (STRING.MID("gpll3_lock_det", &clk_itr_length-&clk_input_length+1, &clk_input_length-1)==STRING.CUT("&clk", 1))
    ( 
      &match=1
    )
  )
  else if (&wild_tail==1)
  (
    if (STRING.MID("gpll3_lock_det", 0, &clk_input_length-1)==STRING.CUT("&clk", -1))
    ( 
      &match=1
    )
  )	  
  else if ("gpll3_lock_det"=="&clk")
  (
    &match=1
  )
  
  if (&match==1)
  (
    &clk_test=&CLK_TEST_GPLL3_LOCK_DET
    &clk_reg=0
    &clk_reg_name="No CBCR"
    &clk_name="gpll3_lock_det"
    &clk_reg_cbcr_type=""

    gosub Print_Clk_Info_Line
  )

  &match=0
  &wild_head=0
  &wild_tail=0
  &clk_input_length=STRING.LENGTH("&clk")
  &clk_itr_length=STRING.LENGTH("gpll4_dtest")

  if (STRING.SCAN("&clk", "*", 0)==0)
  (
    &wild_head=1
  )
  if (STRING.SCAN("&clk", "*", 1)==(STRING.LENGTH("&clk")-1))
  (
    &wild_tail=1
  )

  if ((&wild_head==1)&&(&wild_tail==1))
  (
    if (STRING.SCAN("gpll4_dtest", STRING.MID("&clk", 1, &clk_input_length-2), 0)!=-1)
    ( 
      &match=1
    )
  )
  else if (&wild_head==1)
  (
    if (STRING.MID("gpll4_dtest", &clk_itr_length-&clk_input_length+1, &clk_input_length-1)==STRING.CUT("&clk", 1))
    ( 
      &match=1
    )
  )
  else if (&wild_tail==1)
  (
    if (STRING.MID("gpll4_dtest", 0, &clk_input_length-1)==STRING.CUT("&clk", -1))
    ( 
      &match=1
    )
  )	  
  else if ("gpll4_dtest"=="&clk")
  (
    &match=1
  )
  
  if (&match==1)
  (
    &clk_test=&CLK_TEST_GPLL4_DTEST
    &clk_reg=0
    &clk_reg_name="No CBCR"
    &clk_name="gpll4_dtest"
    &clk_reg_cbcr_type=""

    gosub Print_Clk_Info_Line
  )

  &match=0
  &wild_head=0
  &wild_tail=0
  &clk_input_length=STRING.LENGTH("&clk")
  &clk_itr_length=STRING.LENGTH("gpll4_lock_det")

  if (STRING.SCAN("&clk", "*", 0)==0)
  (
    &wild_head=1
  )
  if (STRING.SCAN("&clk", "*", 1)==(STRING.LENGTH("&clk")-1))
  (
    &wild_tail=1
  )

  if ((&wild_head==1)&&(&wild_tail==1))
  (
    if (STRING.SCAN("gpll4_lock_det", STRING.MID("&clk", 1, &clk_input_length-2), 0)!=-1)
    ( 
      &match=1
    )
  )
  else if (&wild_head==1)
  (
    if (STRING.MID("gpll4_lock_det", &clk_itr_length-&clk_input_length+1, &clk_input_length-1)==STRING.CUT("&clk", 1))
    ( 
      &match=1
    )
  )
  else if (&wild_tail==1)
  (
    if (STRING.MID("gpll4_lock_det", 0, &clk_input_length-1)==STRING.CUT("&clk", -1))
    ( 
      &match=1
    )
  )	  
  else if ("gpll4_lock_det"=="&clk")
  (
    &match=1
  )
  
  if (&match==1)
  (
    &clk_test=&CLK_TEST_GPLL4_LOCK_DET
    &clk_reg=0
    &clk_reg_name="No CBCR"
    &clk_name="gpll4_lock_det"
    &clk_reg_cbcr_type=""

    gosub Print_Clk_Info_Line
  )

  &match=0
  &wild_head=0
  &wild_tail=0
  &clk_input_length=STRING.LENGTH("&clk")
  &clk_itr_length=STRING.LENGTH("kpss_gcc_dbg_clk")

  if (STRING.SCAN("&clk", "*", 0)==0)
  (
    &wild_head=1
  )
  if (STRING.SCAN("&clk", "*", 1)==(STRING.LENGTH("&clk")-1))
  (
    &wild_tail=1
  )

  if ((&wild_head==1)&&(&wild_tail==1))
  (
    if (STRING.SCAN("kpss_gcc_dbg_clk", STRING.MID("&clk", 1, &clk_input_length-2), 0)!=-1)
    ( 
      &match=1
    )
  )
  else if (&wild_head==1)
  (
    if (STRING.MID("kpss_gcc_dbg_clk", &clk_itr_length-&clk_input_length+1, &clk_input_length-1)==STRING.CUT("&clk", 1))
    ( 
      &match=1
    )
  )
  else if (&wild_tail==1)
  (
    if (STRING.MID("kpss_gcc_dbg_clk", 0, &clk_input_length-1)==STRING.CUT("&clk", -1))
    ( 
      &match=1
    )
  )	  
  else if ("kpss_gcc_dbg_clk"=="&clk")
  (
    &match=1
  )
  
  if (&match==1)
  (
    &clk_test=&CLK_TEST_KPSS_GCC_DBG_CLK
    &clk_reg=0
    &clk_reg_name="No CBCR"
    &clk_name="kpss_gcc_dbg_clk"
    &clk_reg_cbcr_type=""

    gosub Print_Clk_Info_Line
  )

  &match=0
  &wild_head=0
  &wild_tail=0
  &clk_input_length=STRING.LENGTH("&clk")
  &clk_itr_length=STRING.LENGTH("kpss_gcc_ringosc_clk")

  if (STRING.SCAN("&clk", "*", 0)==0)
  (
    &wild_head=1
  )
  if (STRING.SCAN("&clk", "*", 1)==(STRING.LENGTH("&clk")-1))
  (
    &wild_tail=1
  )

  if ((&wild_head==1)&&(&wild_tail==1))
  (
    if (STRING.SCAN("kpss_gcc_ringosc_clk", STRING.MID("&clk", 1, &clk_input_length-2), 0)!=-1)
    ( 
      &match=1
    )
  )
  else if (&wild_head==1)
  (
    if (STRING.MID("kpss_gcc_ringosc_clk", &clk_itr_length-&clk_input_length+1, &clk_input_length-1)==STRING.CUT("&clk", 1))
    ( 
      &match=1
    )
  )
  else if (&wild_tail==1)
  (
    if (STRING.MID("kpss_gcc_ringosc_clk", 0, &clk_input_length-1)==STRING.CUT("&clk", -1))
    ( 
      &match=1
    )
  )	  
  else if ("kpss_gcc_ringosc_clk"=="&clk")
  (
    &match=1
  )
  
  if (&match==1)
  (
    &clk_test=&CLK_TEST_KPSS_GCC_RINGOSC_CLK
    &clk_reg=0
    &clk_reg_name="No CBCR"
    &clk_name="kpss_gcc_ringosc_clk"
    &clk_reg_cbcr_type=""

    gosub Print_Clk_Info_Line
  )

  &match=0
  &wild_head=0
  &wild_tail=0
  &clk_input_length=STRING.LENGTH("&clk")
  &clk_itr_length=STRING.LENGTH("lpass_gcc_dbg_clk")

  if (STRING.SCAN("&clk", "*", 0)==0)
  (
    &wild_head=1
  )
  if (STRING.SCAN("&clk", "*", 1)==(STRING.LENGTH("&clk")-1))
  (
    &wild_tail=1
  )

  if ((&wild_head==1)&&(&wild_tail==1))
  (
    if (STRING.SCAN("lpass_gcc_dbg_clk", STRING.MID("&clk", 1, &clk_input_length-2), 0)!=-1)
    ( 
      &match=1
    )
  )
  else if (&wild_head==1)
  (
    if (STRING.MID("lpass_gcc_dbg_clk", &clk_itr_length-&clk_input_length+1, &clk_input_length-1)==STRING.CUT("&clk", 1))
    ( 
      &match=1
    )
  )
  else if (&wild_tail==1)
  (
    if (STRING.MID("lpass_gcc_dbg_clk", 0, &clk_input_length-1)==STRING.CUT("&clk", -1))
    ( 
      &match=1
    )
  )	  
  else if ("lpass_gcc_dbg_clk"=="&clk")
  (
    &match=1
  )
  
  if (&match==1)
  (
    &clk_test=&CLK_TEST_LPASS_GCC_DBG_CLK
    &clk_reg=0
    &clk_reg_name="No CBCR"
    &clk_name="lpass_gcc_dbg_clk"
    &clk_reg_cbcr_type=""

    gosub Print_Clk_Info_Line
  )

  &match=0
  &wild_head=0
  &wild_tail=0
  &clk_input_length=STRING.LENGTH("&clk")
  &clk_itr_length=STRING.LENGTH("mmss_gcc_dbg_clk")

  if (STRING.SCAN("&clk", "*", 0)==0)
  (
    &wild_head=1
  )
  if (STRING.SCAN("&clk", "*", 1)==(STRING.LENGTH("&clk")-1))
  (
    &wild_tail=1
  )

  if ((&wild_head==1)&&(&wild_tail==1))
  (
    if (STRING.SCAN("mmss_gcc_dbg_clk", STRING.MID("&clk", 1, &clk_input_length-2), 0)!=-1)
    ( 
      &match=1
    )
  )
  else if (&wild_head==1)
  (
    if (STRING.MID("mmss_gcc_dbg_clk", &clk_itr_length-&clk_input_length+1, &clk_input_length-1)==STRING.CUT("&clk", 1))
    ( 
      &match=1
    )
  )
  else if (&wild_tail==1)
  (
    if (STRING.MID("mmss_gcc_dbg_clk", 0, &clk_input_length-1)==STRING.CUT("&clk", -1))
    ( 
      &match=1
    )
  )	  
  else if ("mmss_gcc_dbg_clk"=="&clk")
  (
    &match=1
  )
  
  if (&match==1)
  (
    &clk_test=&CLK_TEST_MMSS_GCC_DBG_CLK
    &clk_reg=0
    &clk_reg_name="No CBCR"
    &clk_name="mmss_gcc_dbg_clk"
    &clk_reg_cbcr_type=""

    gosub Print_Clk_Info_Line
  )

  &match=0
  &wild_head=0
  &wild_tail=0
  &clk_input_length=STRING.LENGTH("&clk")
  &clk_itr_length=STRING.LENGTH("mpm_gcc_temp_sensor_ringosc_clk")

  if (STRING.SCAN("&clk", "*", 0)==0)
  (
    &wild_head=1
  )
  if (STRING.SCAN("&clk", "*", 1)==(STRING.LENGTH("&clk")-1))
  (
    &wild_tail=1
  )

  if ((&wild_head==1)&&(&wild_tail==1))
  (
    if (STRING.SCAN("mpm_gcc_temp_sensor_ringosc_clk", STRING.MID("&clk", 1, &clk_input_length-2), 0)!=-1)
    ( 
      &match=1
    )
  )
  else if (&wild_head==1)
  (
    if (STRING.MID("mpm_gcc_temp_sensor_ringosc_clk", &clk_itr_length-&clk_input_length+1, &clk_input_length-1)==STRING.CUT("&clk", 1))
    ( 
      &match=1
    )
  )
  else if (&wild_tail==1)
  (
    if (STRING.MID("mpm_gcc_temp_sensor_ringosc_clk", 0, &clk_input_length-1)==STRING.CUT("&clk", -1))
    ( 
      &match=1
    )
  )	  
  else if ("mpm_gcc_temp_sensor_ringosc_clk"=="&clk")
  (
    &match=1
  )
  
  if (&match==1)
  (
    &clk_test=&CLK_TEST_MPM_GCC_TEMP_SENSOR_RINGOSC_CLK
    &clk_reg=0
    &clk_reg_name="No CBCR"
    &clk_name="mpm_gcc_temp_sensor_ringosc_clk"
    &clk_reg_cbcr_type=""

    gosub Print_Clk_Info_Line
  )

  &match=0
  &wild_head=0
  &wild_tail=0
  &clk_input_length=STRING.LENGTH("&clk")
  &clk_itr_length=STRING.LENGTH("mss_gcc_dbg_clk")

  if (STRING.SCAN("&clk", "*", 0)==0)
  (
    &wild_head=1
  )
  if (STRING.SCAN("&clk", "*", 1)==(STRING.LENGTH("&clk")-1))
  (
    &wild_tail=1
  )

  if ((&wild_head==1)&&(&wild_tail==1))
  (
    if (STRING.SCAN("mss_gcc_dbg_clk", STRING.MID("&clk", 1, &clk_input_length-2), 0)!=-1)
    ( 
      &match=1
    )
  )
  else if (&wild_head==1)
  (
    if (STRING.MID("mss_gcc_dbg_clk", &clk_itr_length-&clk_input_length+1, &clk_input_length-1)==STRING.CUT("&clk", 1))
    ( 
      &match=1
    )
  )
  else if (&wild_tail==1)
  (
    if (STRING.MID("mss_gcc_dbg_clk", 0, &clk_input_length-1)==STRING.CUT("&clk", -1))
    ( 
      &match=1
    )
  )	  
  else if ("mss_gcc_dbg_clk"=="&clk")
  (
    &match=1
  )
  
  if (&match==1)
  (
    &clk_test=&CLK_TEST_MSS_GCC_DBG_CLK
    &clk_reg=0
    &clk_reg_name="No CBCR"
    &clk_name="mss_gcc_dbg_clk"
    &clk_reg_cbcr_type=""

    gosub Print_Clk_Info_Line
  )

  &match=0
  &wild_head=0
  &wild_tail=0
  &clk_input_length=STRING.LENGTH("&clk")
  &clk_itr_length=STRING.LENGTH("pcie_0_pipe_clk")

  if (STRING.SCAN("&clk", "*", 0)==0)
  (
    &wild_head=1
  )
  if (STRING.SCAN("&clk", "*", 1)==(STRING.LENGTH("&clk")-1))
  (
    &wild_tail=1
  )

  if ((&wild_head==1)&&(&wild_tail==1))
  (
    if (STRING.SCAN("pcie_0_pipe_clk", STRING.MID("&clk", 1, &clk_input_length-2), 0)!=-1)
    ( 
      &match=1
    )
  )
  else if (&wild_head==1)
  (
    if (STRING.MID("pcie_0_pipe_clk", &clk_itr_length-&clk_input_length+1, &clk_input_length-1)==STRING.CUT("&clk", 1))
    ( 
      &match=1
    )
  )
  else if (&wild_tail==1)
  (
    if (STRING.MID("pcie_0_pipe_clk", 0, &clk_input_length-1)==STRING.CUT("&clk", -1))
    ( 
      &match=1
    )
  )	  
  else if ("pcie_0_pipe_clk"=="&clk")
  (
    &match=1
  )
  
  if (&match==1)
  (
    &clk_test=&CLK_TEST_PCIE_0_PIPE_CLK
    &clk_reg=0
    &clk_reg_name="No CBCR"
    &clk_name="pcie_0_pipe_clk"
    &clk_reg_cbcr_type=""

    gosub Print_Clk_Info_Line
  )

  &match=0
  &wild_head=0
  &wild_tail=0
  &clk_input_length=STRING.LENGTH("&clk")
  &clk_itr_length=STRING.LENGTH("pcie_0_pipe_clk")

  if (STRING.SCAN("&clk", "*", 0)==0)
  (
    &wild_head=1
  )
  if (STRING.SCAN("&clk", "*", 1)==(STRING.LENGTH("&clk")-1))
  (
    &wild_tail=1
  )

  if ((&wild_head==1)&&(&wild_tail==1))
  (
    if (STRING.SCAN("pcie_0_pipe_clk", STRING.MID("&clk", 1, &clk_input_length-2), 0)!=-1)
    ( 
      &match=1
    )
  )
  else if (&wild_head==1)
  (
    if (STRING.MID("pcie_0_pipe_clk", &clk_itr_length-&clk_input_length+1, &clk_input_length-1)==STRING.CUT("&clk", 1))
    ( 
      &match=1
    )
  )
  else if (&wild_tail==1)
  (
    if (STRING.MID("pcie_0_pipe_clk", 0, &clk_input_length-1)==STRING.CUT("&clk", -1))
    ( 
      &match=1
    )
  )	  
  else if ("pcie_0_pipe_clk"=="&clk")
  (
    &match=1
  )
  
  if (&match==1)
  (
    &clk_test=&CLK_TEST_PCIE_0_PIPE_CLK
    &clk_reg=0
    &clk_reg_name="No CBCR"
    &clk_name="pcie_0_pipe_clk"
    &clk_reg_cbcr_type=""

    gosub Print_Clk_Info_Line
  )

  &match=0
  &wild_head=0
  &wild_tail=0
  &clk_input_length=STRING.LENGTH("&clk")
  &clk_itr_length=STRING.LENGTH("pcie_1_pipe_clk")

  if (STRING.SCAN("&clk", "*", 0)==0)
  (
    &wild_head=1
  )
  if (STRING.SCAN("&clk", "*", 1)==(STRING.LENGTH("&clk")-1))
  (
    &wild_tail=1
  )

  if ((&wild_head==1)&&(&wild_tail==1))
  (
    if (STRING.SCAN("pcie_1_pipe_clk", STRING.MID("&clk", 1, &clk_input_length-2), 0)!=-1)
    ( 
      &match=1
    )
  )
  else if (&wild_head==1)
  (
    if (STRING.MID("pcie_1_pipe_clk", &clk_itr_length-&clk_input_length+1, &clk_input_length-1)==STRING.CUT("&clk", 1))
    ( 
      &match=1
    )
  )
  else if (&wild_tail==1)
  (
    if (STRING.MID("pcie_1_pipe_clk", 0, &clk_input_length-1)==STRING.CUT("&clk", -1))
    ( 
      &match=1
    )
  )	  
  else if ("pcie_1_pipe_clk"=="&clk")
  (
    &match=1
  )
  
  if (&match==1)
  (
    &clk_test=&CLK_TEST_PCIE_1_PIPE_CLK
    &clk_reg=0
    &clk_reg_name="No CBCR"
    &clk_name="pcie_1_pipe_clk"
    &clk_reg_cbcr_type=""

    gosub Print_Clk_Info_Line
  )

  &match=0
  &wild_head=0
  &wild_tail=0
  &clk_input_length=STRING.LENGTH("&clk")
  &clk_itr_length=STRING.LENGTH("pcie_1_pipe_clk")

  if (STRING.SCAN("&clk", "*", 0)==0)
  (
    &wild_head=1
  )
  if (STRING.SCAN("&clk", "*", 1)==(STRING.LENGTH("&clk")-1))
  (
    &wild_tail=1
  )

  if ((&wild_head==1)&&(&wild_tail==1))
  (
    if (STRING.SCAN("pcie_1_pipe_clk", STRING.MID("&clk", 1, &clk_input_length-2), 0)!=-1)
    ( 
      &match=1
    )
  )
  else if (&wild_head==1)
  (
    if (STRING.MID("pcie_1_pipe_clk", &clk_itr_length-&clk_input_length+1, &clk_input_length-1)==STRING.CUT("&clk", 1))
    ( 
      &match=1
    )
  )
  else if (&wild_tail==1)
  (
    if (STRING.MID("pcie_1_pipe_clk", 0, &clk_input_length-1)==STRING.CUT("&clk", -1))
    ( 
      &match=1
    )
  )	  
  else if ("pcie_1_pipe_clk"=="&clk")
  (
    &match=1
  )
  
  if (&match==1)
  (
    &clk_test=&CLK_TEST_PCIE_1_PIPE_CLK
    &clk_reg=0
    &clk_reg_name="No CBCR"
    &clk_name="pcie_1_pipe_clk"
    &clk_reg_cbcr_type=""

    gosub Print_Clk_Info_Line
  )

  &match=0
  &wild_head=0
  &wild_tail=0
  &clk_input_length=STRING.LENGTH("&clk")
  &clk_itr_length=STRING.LENGTH("qusb2phy_clk_480m_test")

  if (STRING.SCAN("&clk", "*", 0)==0)
  (
    &wild_head=1
  )
  if (STRING.SCAN("&clk", "*", 1)==(STRING.LENGTH("&clk")-1))
  (
    &wild_tail=1
  )

  if ((&wild_head==1)&&(&wild_tail==1))
  (
    if (STRING.SCAN("qusb2phy_clk_480m_test", STRING.MID("&clk", 1, &clk_input_length-2), 0)!=-1)
    ( 
      &match=1
    )
  )
  else if (&wild_head==1)
  (
    if (STRING.MID("qusb2phy_clk_480m_test", &clk_itr_length-&clk_input_length+1, &clk_input_length-1)==STRING.CUT("&clk", 1))
    ( 
      &match=1
    )
  )
  else if (&wild_tail==1)
  (
    if (STRING.MID("qusb2phy_clk_480m_test", 0, &clk_input_length-1)==STRING.CUT("&clk", -1))
    ( 
      &match=1
    )
  )	  
  else if ("qusb2phy_clk_480m_test"=="&clk")
  (
    &match=1
  )
  
  if (&match==1)
  (
    &clk_test=&CLK_TEST_QUSB2PHY_CLK_480M_TEST
    &clk_reg=0
    &clk_reg_name="No CBCR"
    &clk_name="qusb2phy_clk_480m_test"
    &clk_reg_cbcr_type=""

    gosub Print_Clk_Info_Line
  )

  &match=0
  &wild_head=0
  &wild_tail=0
  &clk_input_length=STRING.LENGTH("&clk")
  &clk_itr_length=STRING.LENGTH("ufs_rx_symbol_0_clk")

  if (STRING.SCAN("&clk", "*", 0)==0)
  (
    &wild_head=1
  )
  if (STRING.SCAN("&clk", "*", 1)==(STRING.LENGTH("&clk")-1))
  (
    &wild_tail=1
  )

  if ((&wild_head==1)&&(&wild_tail==1))
  (
    if (STRING.SCAN("ufs_rx_symbol_0_clk", STRING.MID("&clk", 1, &clk_input_length-2), 0)!=-1)
    ( 
      &match=1
    )
  )
  else if (&wild_head==1)
  (
    if (STRING.MID("ufs_rx_symbol_0_clk", &clk_itr_length-&clk_input_length+1, &clk_input_length-1)==STRING.CUT("&clk", 1))
    ( 
      &match=1
    )
  )
  else if (&wild_tail==1)
  (
    if (STRING.MID("ufs_rx_symbol_0_clk", 0, &clk_input_length-1)==STRING.CUT("&clk", -1))
    ( 
      &match=1
    )
  )	  
  else if ("ufs_rx_symbol_0_clk"=="&clk")
  (
    &match=1
  )
  
  if (&match==1)
  (
    &clk_test=&CLK_TEST_UFS_RX_SYMBOL_0_CLK
    &clk_reg=0
    &clk_reg_name="No CBCR"
    &clk_name="ufs_rx_symbol_0_clk"
    &clk_reg_cbcr_type=""

    gosub Print_Clk_Info_Line
  )

  &match=0
  &wild_head=0
  &wild_tail=0
  &clk_input_length=STRING.LENGTH("&clk")
  &clk_itr_length=STRING.LENGTH("ufs_rx_symbol_0_clk")

  if (STRING.SCAN("&clk", "*", 0)==0)
  (
    &wild_head=1
  )
  if (STRING.SCAN("&clk", "*", 1)==(STRING.LENGTH("&clk")-1))
  (
    &wild_tail=1
  )

  if ((&wild_head==1)&&(&wild_tail==1))
  (
    if (STRING.SCAN("ufs_rx_symbol_0_clk", STRING.MID("&clk", 1, &clk_input_length-2), 0)!=-1)
    ( 
      &match=1
    )
  )
  else if (&wild_head==1)
  (
    if (STRING.MID("ufs_rx_symbol_0_clk", &clk_itr_length-&clk_input_length+1, &clk_input_length-1)==STRING.CUT("&clk", 1))
    ( 
      &match=1
    )
  )
  else if (&wild_tail==1)
  (
    if (STRING.MID("ufs_rx_symbol_0_clk", 0, &clk_input_length-1)==STRING.CUT("&clk", -1))
    ( 
      &match=1
    )
  )	  
  else if ("ufs_rx_symbol_0_clk"=="&clk")
  (
    &match=1
  )
  
  if (&match==1)
  (
    &clk_test=&CLK_TEST_UFS_RX_SYMBOL_0_CLK
    &clk_reg=0
    &clk_reg_name="No CBCR"
    &clk_name="ufs_rx_symbol_0_clk"
    &clk_reg_cbcr_type=""

    gosub Print_Clk_Info_Line
  )

  &match=0
  &wild_head=0
  &wild_tail=0
  &clk_input_length=STRING.LENGTH("&clk")
  &clk_itr_length=STRING.LENGTH("ufs_rx_symbol_1_clk")

  if (STRING.SCAN("&clk", "*", 0)==0)
  (
    &wild_head=1
  )
  if (STRING.SCAN("&clk", "*", 1)==(STRING.LENGTH("&clk")-1))
  (
    &wild_tail=1
  )

  if ((&wild_head==1)&&(&wild_tail==1))
  (
    if (STRING.SCAN("ufs_rx_symbol_1_clk", STRING.MID("&clk", 1, &clk_input_length-2), 0)!=-1)
    ( 
      &match=1
    )
  )
  else if (&wild_head==1)
  (
    if (STRING.MID("ufs_rx_symbol_1_clk", &clk_itr_length-&clk_input_length+1, &clk_input_length-1)==STRING.CUT("&clk", 1))
    ( 
      &match=1
    )
  )
  else if (&wild_tail==1)
  (
    if (STRING.MID("ufs_rx_symbol_1_clk", 0, &clk_input_length-1)==STRING.CUT("&clk", -1))
    ( 
      &match=1
    )
  )	  
  else if ("ufs_rx_symbol_1_clk"=="&clk")
  (
    &match=1
  )
  
  if (&match==1)
  (
    &clk_test=&CLK_TEST_UFS_RX_SYMBOL_1_CLK
    &clk_reg=0
    &clk_reg_name="No CBCR"
    &clk_name="ufs_rx_symbol_1_clk"
    &clk_reg_cbcr_type=""

    gosub Print_Clk_Info_Line
  )

  &match=0
  &wild_head=0
  &wild_tail=0
  &clk_input_length=STRING.LENGTH("&clk")
  &clk_itr_length=STRING.LENGTH("ufs_rx_symbol_1_clk")

  if (STRING.SCAN("&clk", "*", 0)==0)
  (
    &wild_head=1
  )
  if (STRING.SCAN("&clk", "*", 1)==(STRING.LENGTH("&clk")-1))
  (
    &wild_tail=1
  )

  if ((&wild_head==1)&&(&wild_tail==1))
  (
    if (STRING.SCAN("ufs_rx_symbol_1_clk", STRING.MID("&clk", 1, &clk_input_length-2), 0)!=-1)
    ( 
      &match=1
    )
  )
  else if (&wild_head==1)
  (
    if (STRING.MID("ufs_rx_symbol_1_clk", &clk_itr_length-&clk_input_length+1, &clk_input_length-1)==STRING.CUT("&clk", 1))
    ( 
      &match=1
    )
  )
  else if (&wild_tail==1)
  (
    if (STRING.MID("ufs_rx_symbol_1_clk", 0, &clk_input_length-1)==STRING.CUT("&clk", -1))
    ( 
      &match=1
    )
  )	  
  else if ("ufs_rx_symbol_1_clk"=="&clk")
  (
    &match=1
  )
  
  if (&match==1)
  (
    &clk_test=&CLK_TEST_UFS_RX_SYMBOL_1_CLK
    &clk_reg=0
    &clk_reg_name="No CBCR"
    &clk_name="ufs_rx_symbol_1_clk"
    &clk_reg_cbcr_type=""

    gosub Print_Clk_Info_Line
  )

  &match=0
  &wild_head=0
  &wild_tail=0
  &clk_input_length=STRING.LENGTH("&clk")
  &clk_itr_length=STRING.LENGTH("ufs_tx_symbol_0_clk")

  if (STRING.SCAN("&clk", "*", 0)==0)
  (
    &wild_head=1
  )
  if (STRING.SCAN("&clk", "*", 1)==(STRING.LENGTH("&clk")-1))
  (
    &wild_tail=1
  )

  if ((&wild_head==1)&&(&wild_tail==1))
  (
    if (STRING.SCAN("ufs_tx_symbol_0_clk", STRING.MID("&clk", 1, &clk_input_length-2), 0)!=-1)
    ( 
      &match=1
    )
  )
  else if (&wild_head==1)
  (
    if (STRING.MID("ufs_tx_symbol_0_clk", &clk_itr_length-&clk_input_length+1, &clk_input_length-1)==STRING.CUT("&clk", 1))
    ( 
      &match=1
    )
  )
  else if (&wild_tail==1)
  (
    if (STRING.MID("ufs_tx_symbol_0_clk", 0, &clk_input_length-1)==STRING.CUT("&clk", -1))
    ( 
      &match=1
    )
  )	  
  else if ("ufs_tx_symbol_0_clk"=="&clk")
  (
    &match=1
  )
  
  if (&match==1)
  (
    &clk_test=&CLK_TEST_UFS_TX_SYMBOL_0_CLK
    &clk_reg=0
    &clk_reg_name="No CBCR"
    &clk_name="ufs_tx_symbol_0_clk"
    &clk_reg_cbcr_type=""

    gosub Print_Clk_Info_Line
  )

  &match=0
  &wild_head=0
  &wild_tail=0
  &clk_input_length=STRING.LENGTH("&clk")
  &clk_itr_length=STRING.LENGTH("ufs_tx_symbol_0_clk")

  if (STRING.SCAN("&clk", "*", 0)==0)
  (
    &wild_head=1
  )
  if (STRING.SCAN("&clk", "*", 1)==(STRING.LENGTH("&clk")-1))
  (
    &wild_tail=1
  )

  if ((&wild_head==1)&&(&wild_tail==1))
  (
    if (STRING.SCAN("ufs_tx_symbol_0_clk", STRING.MID("&clk", 1, &clk_input_length-2), 0)!=-1)
    ( 
      &match=1
    )
  )
  else if (&wild_head==1)
  (
    if (STRING.MID("ufs_tx_symbol_0_clk", &clk_itr_length-&clk_input_length+1, &clk_input_length-1)==STRING.CUT("&clk", 1))
    ( 
      &match=1
    )
  )
  else if (&wild_tail==1)
  (
    if (STRING.MID("ufs_tx_symbol_0_clk", 0, &clk_input_length-1)==STRING.CUT("&clk", -1))
    ( 
      &match=1
    )
  )	  
  else if ("ufs_tx_symbol_0_clk"=="&clk")
  (
    &match=1
  )
  
  if (&match==1)
  (
    &clk_test=&CLK_TEST_UFS_TX_SYMBOL_0_CLK
    &clk_reg=0
    &clk_reg_name="No CBCR"
    &clk_name="ufs_tx_symbol_0_clk"
    &clk_reg_cbcr_type=""

    gosub Print_Clk_Info_Line
  )

  &match=0
  &wild_head=0
  &wild_tail=0
  &clk_input_length=STRING.LENGTH("&clk")
  &clk_itr_length=STRING.LENGTH("ufs_tx_symbol_1_clk")

  if (STRING.SCAN("&clk", "*", 0)==0)
  (
    &wild_head=1
  )
  if (STRING.SCAN("&clk", "*", 1)==(STRING.LENGTH("&clk")-1))
  (
    &wild_tail=1
  )

  if ((&wild_head==1)&&(&wild_tail==1))
  (
    if (STRING.SCAN("ufs_tx_symbol_1_clk", STRING.MID("&clk", 1, &clk_input_length-2), 0)!=-1)
    ( 
      &match=1
    )
  )
  else if (&wild_head==1)
  (
    if (STRING.MID("ufs_tx_symbol_1_clk", &clk_itr_length-&clk_input_length+1, &clk_input_length-1)==STRING.CUT("&clk", 1))
    ( 
      &match=1
    )
  )
  else if (&wild_tail==1)
  (
    if (STRING.MID("ufs_tx_symbol_1_clk", 0, &clk_input_length-1)==STRING.CUT("&clk", -1))
    ( 
      &match=1
    )
  )	  
  else if ("ufs_tx_symbol_1_clk"=="&clk")
  (
    &match=1
  )
  
  if (&match==1)
  (
    &clk_test=&CLK_TEST_UFS_TX_SYMBOL_1_CLK
    &clk_reg=0
    &clk_reg_name="No CBCR"
    &clk_name="ufs_tx_symbol_1_clk"
    &clk_reg_cbcr_type=""

    gosub Print_Clk_Info_Line
  )

  &match=0
  &wild_head=0
  &wild_tail=0
  &clk_input_length=STRING.LENGTH("&clk")
  &clk_itr_length=STRING.LENGTH("ufs_tx_symbol_1_clk")

  if (STRING.SCAN("&clk", "*", 0)==0)
  (
    &wild_head=1
  )
  if (STRING.SCAN("&clk", "*", 1)==(STRING.LENGTH("&clk")-1))
  (
    &wild_tail=1
  )

  if ((&wild_head==1)&&(&wild_tail==1))
  (
    if (STRING.SCAN("ufs_tx_symbol_1_clk", STRING.MID("&clk", 1, &clk_input_length-2), 0)!=-1)
    ( 
      &match=1
    )
  )
  else if (&wild_head==1)
  (
    if (STRING.MID("ufs_tx_symbol_1_clk", &clk_itr_length-&clk_input_length+1, &clk_input_length-1)==STRING.CUT("&clk", 1))
    ( 
      &match=1
    )
  )
  else if (&wild_tail==1)
  (
    if (STRING.MID("ufs_tx_symbol_1_clk", 0, &clk_input_length-1)==STRING.CUT("&clk", -1))
    ( 
      &match=1
    )
  )	  
  else if ("ufs_tx_symbol_1_clk"=="&clk")
  (
    &match=1
  )
  
  if (&match==1)
  (
    &clk_test=&CLK_TEST_UFS_TX_SYMBOL_1_CLK
    &clk_reg=0
    &clk_reg_name="No CBCR"
    &clk_name="ufs_tx_symbol_1_clk"
    &clk_reg_cbcr_type=""

    gosub Print_Clk_Info_Line
  )

  &match=0
  &wild_head=0
  &wild_tail=0
  &clk_input_length=STRING.LENGTH("&clk")
  &clk_itr_length=STRING.LENGTH("usb2_phy_wrapper_gcc_usb30_utmi_clk")

  if (STRING.SCAN("&clk", "*", 0)==0)
  (
    &wild_head=1
  )
  if (STRING.SCAN("&clk", "*", 1)==(STRING.LENGTH("&clk")-1))
  (
    &wild_tail=1
  )

  if ((&wild_head==1)&&(&wild_tail==1))
  (
    if (STRING.SCAN("usb2_phy_wrapper_gcc_usb30_utmi_clk", STRING.MID("&clk", 1, &clk_input_length-2), 0)!=-1)
    ( 
      &match=1
    )
  )
  else if (&wild_head==1)
  (
    if (STRING.MID("usb2_phy_wrapper_gcc_usb30_utmi_clk", &clk_itr_length-&clk_input_length+1, &clk_input_length-1)==STRING.CUT("&clk", 1))
    ( 
      &match=1
    )
  )
  else if (&wild_tail==1)
  (
    if (STRING.MID("usb2_phy_wrapper_gcc_usb30_utmi_clk", 0, &clk_input_length-1)==STRING.CUT("&clk", -1))
    ( 
      &match=1
    )
  )	  
  else if ("usb2_phy_wrapper_gcc_usb30_utmi_clk"=="&clk")
  (
    &match=1
  )
  
  if (&match==1)
  (
    &clk_test=&CLK_TEST_USB2_PHY_WRAPPER_GCC_USB30_UTMI_CLK
    &clk_reg=0
    &clk_reg_name="No CBCR"
    &clk_name="usb2_phy_wrapper_gcc_usb30_utmi_clk"
    &clk_reg_cbcr_type=""

    gosub Print_Clk_Info_Line
  )

  &match=0
  &wild_head=0
  &wild_tail=0
  &clk_input_length=STRING.LENGTH("&clk")
  &clk_itr_length=STRING.LENGTH("usb3_phy_wrapper_gcc_usb3_pipe_clk")

  if (STRING.SCAN("&clk", "*", 0)==0)
  (
    &wild_head=1
  )
  if (STRING.SCAN("&clk", "*", 1)==(STRING.LENGTH("&clk")-1))
  (
    &wild_tail=1
  )

  if ((&wild_head==1)&&(&wild_tail==1))
  (
    if (STRING.SCAN("usb3_phy_wrapper_gcc_usb3_pipe_clk", STRING.MID("&clk", 1, &clk_input_length-2), 0)!=-1)
    ( 
      &match=1
    )
  )
  else if (&wild_head==1)
  (
    if (STRING.MID("usb3_phy_wrapper_gcc_usb3_pipe_clk", &clk_itr_length-&clk_input_length+1, &clk_input_length-1)==STRING.CUT("&clk", 1))
    ( 
      &match=1
    )
  )
  else if (&wild_tail==1)
  (
    if (STRING.MID("usb3_phy_wrapper_gcc_usb3_pipe_clk", 0, &clk_input_length-1)==STRING.CUT("&clk", -1))
    ( 
      &match=1
    )
  )	  
  else if ("usb3_phy_wrapper_gcc_usb3_pipe_clk"=="&clk")
  (
    &match=1
  )
  
  if (&match==1)
  (
    &clk_test=&CLK_TEST_USB3_PHY_WRAPPER_GCC_USB3_PIPE_CLK
    &clk_reg=0
    &clk_reg_name="No CBCR"
    &clk_name="usb3_phy_wrapper_gcc_usb3_pipe_clk"
    &clk_reg_cbcr_type=""

    gosub Print_Clk_Info_Line
  )

  &match=0
  &wild_head=0
  &wild_tail=0
  &clk_input_length=STRING.LENGTH("&clk")
  &clk_itr_length=STRING.LENGTH("usb_hspw_gcc_480_test_clk")

  if (STRING.SCAN("&clk", "*", 0)==0)
  (
    &wild_head=1
  )
  if (STRING.SCAN("&clk", "*", 1)==(STRING.LENGTH("&clk")-1))
  (
    &wild_tail=1
  )

  if ((&wild_head==1)&&(&wild_tail==1))
  (
    if (STRING.SCAN("usb_hspw_gcc_480_test_clk", STRING.MID("&clk", 1, &clk_input_length-2), 0)!=-1)
    ( 
      &match=1
    )
  )
  else if (&wild_head==1)
  (
    if (STRING.MID("usb_hspw_gcc_480_test_clk", &clk_itr_length-&clk_input_length+1, &clk_input_length-1)==STRING.CUT("&clk", 1))
    ( 
      &match=1
    )
  )
  else if (&wild_tail==1)
  (
    if (STRING.MID("usb_hspw_gcc_480_test_clk", 0, &clk_input_length-1)==STRING.CUT("&clk", -1))
    ( 
      &match=1
    )
  )	  
  else if ("usb_hspw_gcc_480_test_clk"=="&clk")
  (
    &match=1
  )
  
  if (&match==1)
  (
    &clk_test=&CLK_TEST_USB_HSPW_GCC_480_TEST_CLK
    &clk_reg=0
    &clk_reg_name="No CBCR"
    &clk_name="usb_hspw_gcc_480_test_clk"
    &clk_reg_cbcr_type=""

    gosub Print_Clk_Info_Line
  )


  ; Set appropriate access mode for LPASS registers 
  &clk_access_mode="&lpass_access_mode"

  &match=0
  &wild_head=0
  &wild_tail=0
  &clk_input_length=STRING.LENGTH("&clk")
  &clk_itr_length=STRING.LENGTH("ahbfabric_clk_src")

  if (STRING.SCAN("&clk", "*", 0)==0)
  (
    &wild_head=1
  )
  if (STRING.SCAN("&clk", "*", 1)==(STRING.LENGTH("&clk")-1))
  (
    &wild_tail=1
  )

  if ((&wild_head==1)&&(&wild_tail==1))
  (
    if (STRING.SCAN("ahbfabric_clk_src", STRING.MID("&clk", 1, &clk_input_length-2), 0)!=-1)
    ( 
      &match=1
    )
  )
  else if (&wild_head==1)
  (
    if (STRING.MID("ahbfabric_clk_src", &clk_itr_length-&clk_input_length+1, &clk_input_length-1)==STRING.CUT("&clk", 1))
    ( 
      &match=1
    )
  )
  else if (&wild_tail==1)
  (
    if (STRING.MID("ahbfabric_clk_src", 0, &clk_input_length-1)==STRING.CUT("&clk", -1))
    ( 
      &match=1
    )
  )	  
  else if ("ahbfabric_clk_src"=="&clk")
  (
    &match=1
  )
  
  if (&match==1)
  (
    &clk_test=&CLK_TEST_AHBFABRIC_CLK_SRC
    &clk_reg=0
    &clk_reg_name="No CBCR"
    &clk_name="ahbfabric_clk_src"
    &clk_reg_cbcr_type=""

    gosub Print_Clk_Info_Line
  )

  &match=0
  &wild_head=0
  &wild_tail=0
  &clk_input_length=STRING.LENGTH("&clk")
  &clk_itr_length=STRING.LENGTH("ahb_spdmtm_clk")

  if (STRING.SCAN("&clk", "*", 0)==0)
  (
    &wild_head=1
  )
  if (STRING.SCAN("&clk", "*", 1)==(STRING.LENGTH("&clk")-1))
  (
    &wild_tail=1
  )

  if ((&wild_head==1)&&(&wild_tail==1))
  (
    if (STRING.SCAN("ahb_spdmtm_clk", STRING.MID("&clk", 1, &clk_input_length-2), 0)!=-1)
    ( 
      &match=1
    )
  )
  else if (&wild_head==1)
  (
    if (STRING.MID("ahb_spdmtm_clk", &clk_itr_length-&clk_input_length+1, &clk_input_length-1)==STRING.CUT("&clk", 1))
    ( 
      &match=1
    )
  )
  else if (&wild_tail==1)
  (
    if (STRING.MID("ahb_spdmtm_clk", 0, &clk_input_length-1)==STRING.CUT("&clk", -1))
    ( 
      &match=1
    )
  )	  
  else if ("ahb_spdmtm_clk"=="&clk")
  (
    &match=1
  )
  
  if (&match==1)
  (
    &clk_test=&CLK_TEST_AHB_SPDMTM_CLK
    &clk_reg=0
    &clk_reg_name="No CBCR"
    &clk_name="ahb_spdmtm_clk"
    &clk_reg_cbcr_type=""

    gosub Print_Clk_Info_Line
  )

  &match=0
  &wild_head=0
  &wild_tail=0
  &clk_input_length=STRING.LENGTH("&clk")
  &clk_itr_length=STRING.LENGTH("audio_core_aon_clk")

  if (STRING.SCAN("&clk", "*", 0)==0)
  (
    &wild_head=1
  )
  if (STRING.SCAN("&clk", "*", 1)==(STRING.LENGTH("&clk")-1))
  (
    &wild_tail=1
  )

  if ((&wild_head==1)&&(&wild_tail==1))
  (
    if (STRING.SCAN("audio_core_aon_clk", STRING.MID("&clk", 1, &clk_input_length-2), 0)!=-1)
    ( 
      &match=1
    )
  )
  else if (&wild_head==1)
  (
    if (STRING.MID("audio_core_aon_clk", &clk_itr_length-&clk_input_length+1, &clk_input_length-1)==STRING.CUT("&clk", 1))
    ( 
      &match=1
    )
  )
  else if (&wild_tail==1)
  (
    if (STRING.MID("audio_core_aon_clk", 0, &clk_input_length-1)==STRING.CUT("&clk", -1))
    ( 
      &match=1
    )
  )	  
  else if ("audio_core_aon_clk"=="&clk")
  (
    &match=1
  )
  
  if (&match==1)
  (
    &clk_test=&CLK_TEST_AUDIO_CORE_AON_CLK
    &clk_reg=&HWIO_LPASS_AUDIO_CORE_AON_CLK_CBCR_ADDR
    &clk_reg_name="LPASS_AUDIO_CORE_AON_CLK_CBCR"
    &clk_name="audio_core_aon_clk"
    &clk_reg_cbcr_type="sm_cbc"

    gosub Print_Clk_Info_Line
  )

  &match=0
  &wild_head=0
  &wild_tail=0
  &clk_input_length=STRING.LENGTH("&clk")
  &clk_itr_length=STRING.LENGTH("audio_core_avsync_csr_clk")

  if (STRING.SCAN("&clk", "*", 0)==0)
  (
    &wild_head=1
  )
  if (STRING.SCAN("&clk", "*", 1)==(STRING.LENGTH("&clk")-1))
  (
    &wild_tail=1
  )

  if ((&wild_head==1)&&(&wild_tail==1))
  (
    if (STRING.SCAN("audio_core_avsync_csr_clk", STRING.MID("&clk", 1, &clk_input_length-2), 0)!=-1)
    ( 
      &match=1
    )
  )
  else if (&wild_head==1)
  (
    if (STRING.MID("audio_core_avsync_csr_clk", &clk_itr_length-&clk_input_length+1, &clk_input_length-1)==STRING.CUT("&clk", 1))
    ( 
      &match=1
    )
  )
  else if (&wild_tail==1)
  (
    if (STRING.MID("audio_core_avsync_csr_clk", 0, &clk_input_length-1)==STRING.CUT("&clk", -1))
    ( 
      &match=1
    )
  )	  
  else if ("audio_core_avsync_csr_clk"=="&clk")
  (
    &match=1
  )
  
  if (&match==1)
  (
    &clk_test=&CLK_TEST_AUDIO_CORE_AVSYNC_CSR_CLK
    &clk_reg=&HWIO_LPASS_AUDIO_CORE_AVSYNC_CSR_CBCR_ADDR
    &clk_reg_name="LPASS_AUDIO_CORE_AVSYNC_CSR_CBCR"
    &clk_name="audio_core_avsync_csr_clk"
    &clk_reg_cbcr_type="sm_cbc"

    gosub Print_Clk_Info_Line
  )

  &match=0
  &wild_head=0
  &wild_tail=0
  &clk_input_length=STRING.LENGTH("&clk")
  &clk_itr_length=STRING.LENGTH("audio_core_csr_clk")

  if (STRING.SCAN("&clk", "*", 0)==0)
  (
    &wild_head=1
  )
  if (STRING.SCAN("&clk", "*", 1)==(STRING.LENGTH("&clk")-1))
  (
    &wild_tail=1
  )

  if ((&wild_head==1)&&(&wild_tail==1))
  (
    if (STRING.SCAN("audio_core_csr_clk", STRING.MID("&clk", 1, &clk_input_length-2), 0)!=-1)
    ( 
      &match=1
    )
  )
  else if (&wild_head==1)
  (
    if (STRING.MID("audio_core_csr_clk", &clk_itr_length-&clk_input_length+1, &clk_input_length-1)==STRING.CUT("&clk", 1))
    ( 
      &match=1
    )
  )
  else if (&wild_tail==1)
  (
    if (STRING.MID("audio_core_csr_clk", 0, &clk_input_length-1)==STRING.CUT("&clk", -1))
    ( 
      &match=1
    )
  )	  
  else if ("audio_core_csr_clk"=="&clk")
  (
    &match=1
  )
  
  if (&match==1)
  (
    &clk_test=&CLK_TEST_AUDIO_CORE_CSR_CLK
    &clk_reg=&HWIO_LPASS_AUDIO_CORE_CSR_CBCR_ADDR
    &clk_reg_name="LPASS_AUDIO_CORE_CSR_CBCR"
    &clk_name="audio_core_csr_clk"
    &clk_reg_cbcr_type="sm_cbc"

    gosub Print_Clk_Info_Line
  )

  &match=0
  &wild_head=0
  &wild_tail=0
  &clk_input_length=STRING.LENGTH("&clk")
  &clk_itr_length=STRING.LENGTH("audio_core_dml_clk")

  if (STRING.SCAN("&clk", "*", 0)==0)
  (
    &wild_head=1
  )
  if (STRING.SCAN("&clk", "*", 1)==(STRING.LENGTH("&clk")-1))
  (
    &wild_tail=1
  )

  if ((&wild_head==1)&&(&wild_tail==1))
  (
    if (STRING.SCAN("audio_core_dml_clk", STRING.MID("&clk", 1, &clk_input_length-2), 0)!=-1)
    ( 
      &match=1
    )
  )
  else if (&wild_head==1)
  (
    if (STRING.MID("audio_core_dml_clk", &clk_itr_length-&clk_input_length+1, &clk_input_length-1)==STRING.CUT("&clk", 1))
    ( 
      &match=1
    )
  )
  else if (&wild_tail==1)
  (
    if (STRING.MID("audio_core_dml_clk", 0, &clk_input_length-1)==STRING.CUT("&clk", -1))
    ( 
      &match=1
    )
  )	  
  else if ("audio_core_dml_clk"=="&clk")
  (
    &match=1
  )
  
  if (&match==1)
  (
    &clk_test=&CLK_TEST_AUDIO_CORE_DML_CLK
    &clk_reg=&HWIO_LPASS_AUDIO_CORE_DML_CBCR_ADDR
    &clk_reg_name="LPASS_AUDIO_CORE_DML_CBCR"
    &clk_name="audio_core_dml_clk"
    &clk_reg_cbcr_type="sm_cbc"

    gosub Print_Clk_Info_Line
  )

  &match=0
  &wild_head=0
  &wild_tail=0
  &clk_input_length=STRING.LENGTH("&clk")
  &clk_itr_length=STRING.LENGTH("audio_core_ixfabric_clk")

  if (STRING.SCAN("&clk", "*", 0)==0)
  (
    &wild_head=1
  )
  if (STRING.SCAN("&clk", "*", 1)==(STRING.LENGTH("&clk")-1))
  (
    &wild_tail=1
  )

  if ((&wild_head==1)&&(&wild_tail==1))
  (
    if (STRING.SCAN("audio_core_ixfabric_clk", STRING.MID("&clk", 1, &clk_input_length-2), 0)!=-1)
    ( 
      &match=1
    )
  )
  else if (&wild_head==1)
  (
    if (STRING.MID("audio_core_ixfabric_clk", &clk_itr_length-&clk_input_length+1, &clk_input_length-1)==STRING.CUT("&clk", 1))
    ( 
      &match=1
    )
  )
  else if (&wild_tail==1)
  (
    if (STRING.MID("audio_core_ixfabric_clk", 0, &clk_input_length-1)==STRING.CUT("&clk", -1))
    ( 
      &match=1
    )
  )	  
  else if ("audio_core_ixfabric_clk"=="&clk")
  (
    &match=1
  )
  
  if (&match==1)
  (
    &clk_test=&CLK_TEST_AUDIO_CORE_IXFABRIC_CLK
    &clk_reg=&HWIO_LPASS_AUDIO_CORE_IXFABRIC_CBCR_ADDR
    &clk_reg_name="LPASS_AUDIO_CORE_IXFABRIC_CBCR"
    &clk_name="audio_core_ixfabric_clk"
    &clk_reg_cbcr_type="sm_cbc"

    gosub Print_Clk_Info_Line
  )

  &match=0
  &wild_head=0
  &wild_tail=0
  &clk_input_length=STRING.LENGTH("&clk")
  &clk_itr_length=STRING.LENGTH("audio_core_ixfabric_spdmtm_csr_clk")

  if (STRING.SCAN("&clk", "*", 0)==0)
  (
    &wild_head=1
  )
  if (STRING.SCAN("&clk", "*", 1)==(STRING.LENGTH("&clk")-1))
  (
    &wild_tail=1
  )

  if ((&wild_head==1)&&(&wild_tail==1))
  (
    if (STRING.SCAN("audio_core_ixfabric_spdmtm_csr_clk", STRING.MID("&clk", 1, &clk_input_length-2), 0)!=-1)
    ( 
      &match=1
    )
  )
  else if (&wild_head==1)
  (
    if (STRING.MID("audio_core_ixfabric_spdmtm_csr_clk", &clk_itr_length-&clk_input_length+1, &clk_input_length-1)==STRING.CUT("&clk", 1))
    ( 
      &match=1
    )
  )
  else if (&wild_tail==1)
  (
    if (STRING.MID("audio_core_ixfabric_spdmtm_csr_clk", 0, &clk_input_length-1)==STRING.CUT("&clk", -1))
    ( 
      &match=1
    )
  )	  
  else if ("audio_core_ixfabric_spdmtm_csr_clk"=="&clk")
  (
    &match=1
  )
  
  if (&match==1)
  (
    &clk_test=&CLK_TEST_AUDIO_CORE_IXFABRIC_SPDMTM_CSR_CLK
    &clk_reg=&HWIO_LPASS_AUDIO_CORE_IXFABRIC_SPDMTM_CSR_CBCR_ADDR
    &clk_reg_name="LPASS_AUDIO_CORE_IXFABRIC_SPDMTM_CSR_CBCR"
    &clk_name="audio_core_ixfabric_spdmtm_csr_clk"
    &clk_reg_cbcr_type="sm_cbc"

    gosub Print_Clk_Info_Line
  )

  &match=0
  &wild_head=0
  &wild_tail=0
  &clk_input_length=STRING.LENGTH("&clk")
  &clk_itr_length=STRING.LENGTH("audio_core_lpaif_csr_clk")

  if (STRING.SCAN("&clk", "*", 0)==0)
  (
    &wild_head=1
  )
  if (STRING.SCAN("&clk", "*", 1)==(STRING.LENGTH("&clk")-1))
  (
    &wild_tail=1
  )

  if ((&wild_head==1)&&(&wild_tail==1))
  (
    if (STRING.SCAN("audio_core_lpaif_csr_clk", STRING.MID("&clk", 1, &clk_input_length-2), 0)!=-1)
    ( 
      &match=1
    )
  )
  else if (&wild_head==1)
  (
    if (STRING.MID("audio_core_lpaif_csr_clk", &clk_itr_length-&clk_input_length+1, &clk_input_length-1)==STRING.CUT("&clk", 1))
    ( 
      &match=1
    )
  )
  else if (&wild_tail==1)
  (
    if (STRING.MID("audio_core_lpaif_csr_clk", 0, &clk_input_length-1)==STRING.CUT("&clk", -1))
    ( 
      &match=1
    )
  )	  
  else if ("audio_core_lpaif_csr_clk"=="&clk")
  (
    &match=1
  )
  
  if (&match==1)
  (
    &clk_test=&CLK_TEST_AUDIO_CORE_LPAIF_CSR_CLK
    &clk_reg=&HWIO_LPASS_AUDIO_CORE_LPAIF_CSR_CBCR_ADDR
    &clk_reg_name="LPASS_AUDIO_CORE_LPAIF_CSR_CBCR"
    &clk_name="audio_core_lpaif_csr_clk"
    &clk_reg_cbcr_type="sm_cbc"

    gosub Print_Clk_Info_Line
  )

  &match=0
  &wild_head=0
  &wild_tail=0
  &clk_input_length=STRING.LENGTH("&clk")
  &clk_itr_length=STRING.LENGTH("audio_core_lpaif_dma_clk")

  if (STRING.SCAN("&clk", "*", 0)==0)
  (
    &wild_head=1
  )
  if (STRING.SCAN("&clk", "*", 1)==(STRING.LENGTH("&clk")-1))
  (
    &wild_tail=1
  )

  if ((&wild_head==1)&&(&wild_tail==1))
  (
    if (STRING.SCAN("audio_core_lpaif_dma_clk", STRING.MID("&clk", 1, &clk_input_length-2), 0)!=-1)
    ( 
      &match=1
    )
  )
  else if (&wild_head==1)
  (
    if (STRING.MID("audio_core_lpaif_dma_clk", &clk_itr_length-&clk_input_length+1, &clk_input_length-1)==STRING.CUT("&clk", 1))
    ( 
      &match=1
    )
  )
  else if (&wild_tail==1)
  (
    if (STRING.MID("audio_core_lpaif_dma_clk", 0, &clk_input_length-1)==STRING.CUT("&clk", -1))
    ( 
      &match=1
    )
  )	  
  else if ("audio_core_lpaif_dma_clk"=="&clk")
  (
    &match=1
  )
  
  if (&match==1)
  (
    &clk_test=&CLK_TEST_AUDIO_CORE_LPAIF_DMA_CLK
    &clk_reg=&HWIO_LPASS_AUDIO_CORE_LPAIF_DMA_CBCR_ADDR
    &clk_reg_name="LPASS_AUDIO_CORE_LPAIF_DMA_CBCR"
    &clk_name="audio_core_lpaif_dma_clk"
    &clk_reg_cbcr_type="sm_cbc"

    gosub Print_Clk_Info_Line
  )

  &match=0
  &wild_head=0
  &wild_tail=0
  &clk_input_length=STRING.LENGTH("&clk")
  &clk_itr_length=STRING.LENGTH("audio_core_lpm_clk")

  if (STRING.SCAN("&clk", "*", 0)==0)
  (
    &wild_head=1
  )
  if (STRING.SCAN("&clk", "*", 1)==(STRING.LENGTH("&clk")-1))
  (
    &wild_tail=1
  )

  if ((&wild_head==1)&&(&wild_tail==1))
  (
    if (STRING.SCAN("audio_core_lpm_clk", STRING.MID("&clk", 1, &clk_input_length-2), 0)!=-1)
    ( 
      &match=1
    )
  )
  else if (&wild_head==1)
  (
    if (STRING.MID("audio_core_lpm_clk", &clk_itr_length-&clk_input_length+1, &clk_input_length-1)==STRING.CUT("&clk", 1))
    ( 
      &match=1
    )
  )
  else if (&wild_tail==1)
  (
    if (STRING.MID("audio_core_lpm_clk", 0, &clk_input_length-1)==STRING.CUT("&clk", -1))
    ( 
      &match=1
    )
  )	  
  else if ("audio_core_lpm_clk"=="&clk")
  (
    &match=1
  )
  
  if (&match==1)
  (
    &clk_test=&CLK_TEST_AUDIO_CORE_LPM_CLK
    &clk_reg=&HWIO_LPASS_AUDIO_CORE_LPM_CBCR_ADDR
    &clk_reg_name="LPASS_AUDIO_CORE_LPM_CBCR"
    &clk_name="audio_core_lpm_clk"
    &clk_reg_cbcr_type="sm_pscbc"

    gosub Print_Clk_Info_Line
  )

  &match=0
  &wild_head=0
  &wild_tail=0
  &clk_input_length=STRING.LENGTH("&clk")
  &clk_itr_length=STRING.LENGTH("audio_core_resampler_lfabif_clk")

  if (STRING.SCAN("&clk", "*", 0)==0)
  (
    &wild_head=1
  )
  if (STRING.SCAN("&clk", "*", 1)==(STRING.LENGTH("&clk")-1))
  (
    &wild_tail=1
  )

  if ((&wild_head==1)&&(&wild_tail==1))
  (
    if (STRING.SCAN("audio_core_resampler_lfabif_clk", STRING.MID("&clk", 1, &clk_input_length-2), 0)!=-1)
    ( 
      &match=1
    )
  )
  else if (&wild_head==1)
  (
    if (STRING.MID("audio_core_resampler_lfabif_clk", &clk_itr_length-&clk_input_length+1, &clk_input_length-1)==STRING.CUT("&clk", 1))
    ( 
      &match=1
    )
  )
  else if (&wild_tail==1)
  (
    if (STRING.MID("audio_core_resampler_lfabif_clk", 0, &clk_input_length-1)==STRING.CUT("&clk", -1))
    ( 
      &match=1
    )
  )	  
  else if ("audio_core_resampler_lfabif_clk"=="&clk")
  (
    &match=1
  )
  
  if (&match==1)
  (
    &clk_test=&CLK_TEST_AUDIO_CORE_RESAMPLER_LFABIF_CLK
    &clk_reg=&HWIO_LPASS_AUDIO_CORE_RESAMPLER_LFABIF_CBCR_ADDR
    &clk_reg_name="LPASS_AUDIO_CORE_RESAMPLER_LFABIF_CBCR"
    &clk_name="audio_core_resampler_lfabif_clk"
    &clk_reg_cbcr_type="sm_pscbc"

    gosub Print_Clk_Info_Line
  )

  &match=0
  &wild_head=0
  &wild_tail=0
  &clk_input_length=STRING.LENGTH("&clk")
  &clk_itr_length=STRING.LENGTH("audio_core_security_clk")

  if (STRING.SCAN("&clk", "*", 0)==0)
  (
    &wild_head=1
  )
  if (STRING.SCAN("&clk", "*", 1)==(STRING.LENGTH("&clk")-1))
  (
    &wild_tail=1
  )

  if ((&wild_head==1)&&(&wild_tail==1))
  (
    if (STRING.SCAN("audio_core_security_clk", STRING.MID("&clk", 1, &clk_input_length-2), 0)!=-1)
    ( 
      &match=1
    )
  )
  else if (&wild_head==1)
  (
    if (STRING.MID("audio_core_security_clk", &clk_itr_length-&clk_input_length+1, &clk_input_length-1)==STRING.CUT("&clk", 1))
    ( 
      &match=1
    )
  )
  else if (&wild_tail==1)
  (
    if (STRING.MID("audio_core_security_clk", 0, &clk_input_length-1)==STRING.CUT("&clk", -1))
    ( 
      &match=1
    )
  )	  
  else if ("audio_core_security_clk"=="&clk")
  (
    &match=1
  )
  
  if (&match==1)
  (
    &clk_test=&CLK_TEST_AUDIO_CORE_SECURITY_CLK
    &clk_reg=&HWIO_LPASS_AUDIO_CORE_SECURITY_CBCR_ADDR
    &clk_reg_name="LPASS_AUDIO_CORE_SECURITY_CBCR"
    &clk_name="audio_core_security_clk"
    &clk_reg_cbcr_type="sm_cbc"

    gosub Print_Clk_Info_Line
  )

  &match=0
  &wild_head=0
  &wild_tail=0
  &clk_input_length=STRING.LENGTH("&clk")
  &clk_itr_length=STRING.LENGTH("audio_core_slimbus2_lfabif_clk")

  if (STRING.SCAN("&clk", "*", 0)==0)
  (
    &wild_head=1
  )
  if (STRING.SCAN("&clk", "*", 1)==(STRING.LENGTH("&clk")-1))
  (
    &wild_tail=1
  )

  if ((&wild_head==1)&&(&wild_tail==1))
  (
    if (STRING.SCAN("audio_core_slimbus2_lfabif_clk", STRING.MID("&clk", 1, &clk_input_length-2), 0)!=-1)
    ( 
      &match=1
    )
  )
  else if (&wild_head==1)
  (
    if (STRING.MID("audio_core_slimbus2_lfabif_clk", &clk_itr_length-&clk_input_length+1, &clk_input_length-1)==STRING.CUT("&clk", 1))
    ( 
      &match=1
    )
  )
  else if (&wild_tail==1)
  (
    if (STRING.MID("audio_core_slimbus2_lfabif_clk", 0, &clk_input_length-1)==STRING.CUT("&clk", -1))
    ( 
      &match=1
    )
  )	  
  else if ("audio_core_slimbus2_lfabif_clk"=="&clk")
  (
    &match=1
  )
  
  if (&match==1)
  (
    &clk_test=&CLK_TEST_AUDIO_CORE_SLIMBUS2_LFABIF_CLK
    &clk_reg=&HWIO_LPASS_AUDIO_CORE_SLIMBUS2_LFABIF_CBCR_ADDR
    &clk_reg_name="LPASS_AUDIO_CORE_SLIMBUS2_LFABIF_CBCR"
    &clk_name="audio_core_slimbus2_lfabif_clk"
    &clk_reg_cbcr_type="sm_pscbc"

    gosub Print_Clk_Info_Line
  )

  &match=0
  &wild_head=0
  &wild_tail=0
  &clk_input_length=STRING.LENGTH("&clk")
  &clk_itr_length=STRING.LENGTH("audio_core_slimbus_lfabif_clk")

  if (STRING.SCAN("&clk", "*", 0)==0)
  (
    &wild_head=1
  )
  if (STRING.SCAN("&clk", "*", 1)==(STRING.LENGTH("&clk")-1))
  (
    &wild_tail=1
  )

  if ((&wild_head==1)&&(&wild_tail==1))
  (
    if (STRING.SCAN("audio_core_slimbus_lfabif_clk", STRING.MID("&clk", 1, &clk_input_length-2), 0)!=-1)
    ( 
      &match=1
    )
  )
  else if (&wild_head==1)
  (
    if (STRING.MID("audio_core_slimbus_lfabif_clk", &clk_itr_length-&clk_input_length+1, &clk_input_length-1)==STRING.CUT("&clk", 1))
    ( 
      &match=1
    )
  )
  else if (&wild_tail==1)
  (
    if (STRING.MID("audio_core_slimbus_lfabif_clk", 0, &clk_input_length-1)==STRING.CUT("&clk", -1))
    ( 
      &match=1
    )
  )	  
  else if ("audio_core_slimbus_lfabif_clk"=="&clk")
  (
    &match=1
  )
  
  if (&match==1)
  (
    &clk_test=&CLK_TEST_AUDIO_CORE_SLIMBUS_LFABIF_CLK
    &clk_reg=&HWIO_LPASS_AUDIO_CORE_SLIMBUS_LFABIF_CBCR_ADDR
    &clk_reg_name="LPASS_AUDIO_CORE_SLIMBUS_LFABIF_CBCR"
    &clk_name="audio_core_slimbus_lfabif_clk"
    &clk_reg_cbcr_type="sm_pscbc"

    gosub Print_Clk_Info_Line
  )

  &match=0
  &wild_head=0
  &wild_tail=0
  &clk_input_length=STRING.LENGTH("&clk")
  &clk_itr_length=STRING.LENGTH("audio_core_sysnoc_clk")

  if (STRING.SCAN("&clk", "*", 0)==0)
  (
    &wild_head=1
  )
  if (STRING.SCAN("&clk", "*", 1)==(STRING.LENGTH("&clk")-1))
  (
    &wild_tail=1
  )

  if ((&wild_head==1)&&(&wild_tail==1))
  (
    if (STRING.SCAN("audio_core_sysnoc_clk", STRING.MID("&clk", 1, &clk_input_length-2), 0)!=-1)
    ( 
      &match=1
    )
  )
  else if (&wild_head==1)
  (
    if (STRING.MID("audio_core_sysnoc_clk", &clk_itr_length-&clk_input_length+1, &clk_input_length-1)==STRING.CUT("&clk", 1))
    ( 
      &match=1
    )
  )
  else if (&wild_tail==1)
  (
    if (STRING.MID("audio_core_sysnoc_clk", 0, &clk_input_length-1)==STRING.CUT("&clk", -1))
    ( 
      &match=1
    )
  )	  
  else if ("audio_core_sysnoc_clk"=="&clk")
  (
    &match=1
  )
  
  if (&match==1)
  (
    &clk_test=&CLK_TEST_AUDIO_CORE_SYSNOC_CLK
    &clk_reg=&HWIO_LPASS_AUDIO_CORE_SYSNOC_CBCR_ADDR
    &clk_reg_name="LPASS_AUDIO_CORE_SYSNOC_CBCR"
    &clk_name="audio_core_sysnoc_clk"
    &clk_reg_cbcr_type="sm_cbc"

    gosub Print_Clk_Info_Line
  )

  &match=0
  &wild_head=0
  &wild_tail=0
  &clk_input_length=STRING.LENGTH("&clk")
  &clk_itr_length=STRING.LENGTH("audio_core_timeout_clk")

  if (STRING.SCAN("&clk", "*", 0)==0)
  (
    &wild_head=1
  )
  if (STRING.SCAN("&clk", "*", 1)==(STRING.LENGTH("&clk")-1))
  (
    &wild_tail=1
  )

  if ((&wild_head==1)&&(&wild_tail==1))
  (
    if (STRING.SCAN("audio_core_timeout_clk", STRING.MID("&clk", 1, &clk_input_length-2), 0)!=-1)
    ( 
      &match=1
    )
  )
  else if (&wild_head==1)
  (
    if (STRING.MID("audio_core_timeout_clk", &clk_itr_length-&clk_input_length+1, &clk_input_length-1)==STRING.CUT("&clk", 1))
    ( 
      &match=1
    )
  )
  else if (&wild_tail==1)
  (
    if (STRING.MID("audio_core_timeout_clk", 0, &clk_input_length-1)==STRING.CUT("&clk", -1))
    ( 
      &match=1
    )
  )	  
  else if ("audio_core_timeout_clk"=="&clk")
  (
    &match=1
  )
  
  if (&match==1)
  (
    &clk_test=&CLK_TEST_AUDIO_CORE_TIMEOUT_CLK
    &clk_reg=&HWIO_LPASS_AUDIO_CORE_TIMEOUT_CBCR_ADDR
    &clk_reg_name="LPASS_AUDIO_CORE_TIMEOUT_CBCR"
    &clk_name="audio_core_timeout_clk"
    &clk_reg_cbcr_type="sm_cbc"

    gosub Print_Clk_Info_Line
  )

  &match=0
  &wild_head=0
  &wild_tail=0
  &clk_input_length=STRING.LENGTH("&clk")
  &clk_itr_length=STRING.LENGTH("audio_wrapper_aon_clk")

  if (STRING.SCAN("&clk", "*", 0)==0)
  (
    &wild_head=1
  )
  if (STRING.SCAN("&clk", "*", 1)==(STRING.LENGTH("&clk")-1))
  (
    &wild_tail=1
  )

  if ((&wild_head==1)&&(&wild_tail==1))
  (
    if (STRING.SCAN("audio_wrapper_aon_clk", STRING.MID("&clk", 1, &clk_input_length-2), 0)!=-1)
    ( 
      &match=1
    )
  )
  else if (&wild_head==1)
  (
    if (STRING.MID("audio_wrapper_aon_clk", &clk_itr_length-&clk_input_length+1, &clk_input_length-1)==STRING.CUT("&clk", 1))
    ( 
      &match=1
    )
  )
  else if (&wild_tail==1)
  (
    if (STRING.MID("audio_wrapper_aon_clk", 0, &clk_input_length-1)==STRING.CUT("&clk", -1))
    ( 
      &match=1
    )
  )	  
  else if ("audio_wrapper_aon_clk"=="&clk")
  (
    &match=1
  )
  
  if (&match==1)
  (
    &clk_test=&CLK_TEST_AUDIO_WRAPPER_AON_CLK
    &clk_reg=&HWIO_LPASS_AUDIO_WRAPPER_AON_CLK_CBCR_ADDR
    &clk_reg_name="LPASS_AUDIO_WRAPPER_AON_CLK_CBCR"
    &clk_name="audio_wrapper_aon_clk"
    &clk_reg_cbcr_type="sm_cbc"

    gosub Print_Clk_Info_Line
  )

  &match=0
  &wild_head=0
  &wild_tail=0
  &clk_input_length=STRING.LENGTH("&clk")
  &clk_itr_length=STRING.LENGTH("audio_wrapper_br_clk")

  if (STRING.SCAN("&clk", "*", 0)==0)
  (
    &wild_head=1
  )
  if (STRING.SCAN("&clk", "*", 1)==(STRING.LENGTH("&clk")-1))
  (
    &wild_tail=1
  )

  if ((&wild_head==1)&&(&wild_tail==1))
  (
    if (STRING.SCAN("audio_wrapper_br_clk", STRING.MID("&clk", 1, &clk_input_length-2), 0)!=-1)
    ( 
      &match=1
    )
  )
  else if (&wild_head==1)
  (
    if (STRING.MID("audio_wrapper_br_clk", &clk_itr_length-&clk_input_length+1, &clk_input_length-1)==STRING.CUT("&clk", 1))
    ( 
      &match=1
    )
  )
  else if (&wild_tail==1)
  (
    if (STRING.MID("audio_wrapper_br_clk", 0, &clk_input_length-1)==STRING.CUT("&clk", -1))
    ( 
      &match=1
    )
  )	  
  else if ("audio_wrapper_br_clk"=="&clk")
  (
    &match=1
  )
  
  if (&match==1)
  (
    &clk_test=&CLK_TEST_AUDIO_WRAPPER_BR_CLK
    &clk_reg=&HWIO_LPASS_AUDIO_WRAPPER_BR_CBCR_ADDR
    &clk_reg_name="LPASS_AUDIO_WRAPPER_BR_CBCR"
    &clk_name="audio_wrapper_br_clk"
    &clk_reg_cbcr_type="sm_cbc"

    gosub Print_Clk_Info_Line
  )

  &match=0
  &wild_head=0
  &wild_tail=0
  &clk_input_length=STRING.LENGTH("&clk")
  &clk_itr_length=STRING.LENGTH("audio_wrapper_efabric_clk")

  if (STRING.SCAN("&clk", "*", 0)==0)
  (
    &wild_head=1
  )
  if (STRING.SCAN("&clk", "*", 1)==(STRING.LENGTH("&clk")-1))
  (
    &wild_tail=1
  )

  if ((&wild_head==1)&&(&wild_tail==1))
  (
    if (STRING.SCAN("audio_wrapper_efabric_clk", STRING.MID("&clk", 1, &clk_input_length-2), 0)!=-1)
    ( 
      &match=1
    )
  )
  else if (&wild_head==1)
  (
    if (STRING.MID("audio_wrapper_efabric_clk", &clk_itr_length-&clk_input_length+1, &clk_input_length-1)==STRING.CUT("&clk", 1))
    ( 
      &match=1
    )
  )
  else if (&wild_tail==1)
  (
    if (STRING.MID("audio_wrapper_efabric_clk", 0, &clk_input_length-1)==STRING.CUT("&clk", -1))
    ( 
      &match=1
    )
  )	  
  else if ("audio_wrapper_efabric_clk"=="&clk")
  (
    &match=1
  )
  
  if (&match==1)
  (
    &clk_test=&CLK_TEST_AUDIO_WRAPPER_EFABRIC_CLK
    &clk_reg=&HWIO_LPASS_AUDIO_WRAPPER_EFABRIC_CBCR_ADDR
    &clk_reg_name="LPASS_AUDIO_WRAPPER_EFABRIC_CBCR"
    &clk_name="audio_wrapper_efabric_clk"
    &clk_reg_cbcr_type="sm_cbc"

    gosub Print_Clk_Info_Line
  )

  &match=0
  &wild_head=0
  &wild_tail=0
  &clk_input_length=STRING.LENGTH("&clk")
  &clk_itr_length=STRING.LENGTH("audio_wrapper_efabric_spdmtm_csr_clk")

  if (STRING.SCAN("&clk", "*", 0)==0)
  (
    &wild_head=1
  )
  if (STRING.SCAN("&clk", "*", 1)==(STRING.LENGTH("&clk")-1))
  (
    &wild_tail=1
  )

  if ((&wild_head==1)&&(&wild_tail==1))
  (
    if (STRING.SCAN("audio_wrapper_efabric_spdmtm_csr_clk", STRING.MID("&clk", 1, &clk_input_length-2), 0)!=-1)
    ( 
      &match=1
    )
  )
  else if (&wild_head==1)
  (
    if (STRING.MID("audio_wrapper_efabric_spdmtm_csr_clk", &clk_itr_length-&clk_input_length+1, &clk_input_length-1)==STRING.CUT("&clk", 1))
    ( 
      &match=1
    )
  )
  else if (&wild_tail==1)
  (
    if (STRING.MID("audio_wrapper_efabric_spdmtm_csr_clk", 0, &clk_input_length-1)==STRING.CUT("&clk", -1))
    ( 
      &match=1
    )
  )	  
  else if ("audio_wrapper_efabric_spdmtm_csr_clk"=="&clk")
  (
    &match=1
  )
  
  if (&match==1)
  (
    &clk_test=&CLK_TEST_AUDIO_WRAPPER_EFABRIC_SPDMTM_CSR_CLK
    &clk_reg=&HWIO_LPASS_AUDIO_WRAPPER_EFABRIC_SPDMTM_CSR_CBCR_ADDR
    &clk_reg_name="LPASS_AUDIO_WRAPPER_EFABRIC_SPDMTM_CSR_CBCR"
    &clk_name="audio_wrapper_efabric_spdmtm_csr_clk"
    &clk_reg_cbcr_type="sm_cbc"

    gosub Print_Clk_Info_Line
  )

  &match=0
  &wild_head=0
  &wild_tail=0
  &clk_input_length=STRING.LENGTH("&clk")
  &clk_itr_length=STRING.LENGTH("audio_wrapper_lcc_csr_clk")

  if (STRING.SCAN("&clk", "*", 0)==0)
  (
    &wild_head=1
  )
  if (STRING.SCAN("&clk", "*", 1)==(STRING.LENGTH("&clk")-1))
  (
    &wild_tail=1
  )

  if ((&wild_head==1)&&(&wild_tail==1))
  (
    if (STRING.SCAN("audio_wrapper_lcc_csr_clk", STRING.MID("&clk", 1, &clk_input_length-2), 0)!=-1)
    ( 
      &match=1
    )
  )
  else if (&wild_head==1)
  (
    if (STRING.MID("audio_wrapper_lcc_csr_clk", &clk_itr_length-&clk_input_length+1, &clk_input_length-1)==STRING.CUT("&clk", 1))
    ( 
      &match=1
    )
  )
  else if (&wild_tail==1)
  (
    if (STRING.MID("audio_wrapper_lcc_csr_clk", 0, &clk_input_length-1)==STRING.CUT("&clk", -1))
    ( 
      &match=1
    )
  )	  
  else if ("audio_wrapper_lcc_csr_clk"=="&clk")
  (
    &match=1
  )
  
  if (&match==1)
  (
    &clk_test=&CLK_TEST_AUDIO_WRAPPER_LCC_CSR_CLK
    &clk_reg=&HWIO_LPASS_AUDIO_WRAPPER_LCC_CSR_CBCR_ADDR
    &clk_reg_name="LPASS_AUDIO_WRAPPER_LCC_CSR_CBCR"
    &clk_name="audio_wrapper_lcc_csr_clk"
    &clk_reg_cbcr_type="sm_cbc"

    gosub Print_Clk_Info_Line
  )

  &match=0
  &wild_head=0
  &wild_tail=0
  &clk_input_length=STRING.LENGTH("&clk")
  &clk_itr_length=STRING.LENGTH("audio_wrapper_security_clk")

  if (STRING.SCAN("&clk", "*", 0)==0)
  (
    &wild_head=1
  )
  if (STRING.SCAN("&clk", "*", 1)==(STRING.LENGTH("&clk")-1))
  (
    &wild_tail=1
  )

  if ((&wild_head==1)&&(&wild_tail==1))
  (
    if (STRING.SCAN("audio_wrapper_security_clk", STRING.MID("&clk", 1, &clk_input_length-2), 0)!=-1)
    ( 
      &match=1
    )
  )
  else if (&wild_head==1)
  (
    if (STRING.MID("audio_wrapper_security_clk", &clk_itr_length-&clk_input_length+1, &clk_input_length-1)==STRING.CUT("&clk", 1))
    ( 
      &match=1
    )
  )
  else if (&wild_tail==1)
  (
    if (STRING.MID("audio_wrapper_security_clk", 0, &clk_input_length-1)==STRING.CUT("&clk", -1))
    ( 
      &match=1
    )
  )	  
  else if ("audio_wrapper_security_clk"=="&clk")
  (
    &match=1
  )
  
  if (&match==1)
  (
    &clk_test=&CLK_TEST_AUDIO_WRAPPER_SECURITY_CLK
    &clk_reg=&HWIO_LPASS_AUDIO_WRAPPER_SECURITY_CBCR_ADDR
    &clk_reg_name="LPASS_AUDIO_WRAPPER_SECURITY_CBCR"
    &clk_name="audio_wrapper_security_clk"
    &clk_reg_cbcr_type="sm_cbc"

    gosub Print_Clk_Info_Line
  )

  &match=0
  &wild_head=0
  &wild_tail=0
  &clk_input_length=STRING.LENGTH("&clk")
  &clk_itr_length=STRING.LENGTH("audio_wrapper_smem_clk")

  if (STRING.SCAN("&clk", "*", 0)==0)
  (
    &wild_head=1
  )
  if (STRING.SCAN("&clk", "*", 1)==(STRING.LENGTH("&clk")-1))
  (
    &wild_tail=1
  )

  if ((&wild_head==1)&&(&wild_tail==1))
  (
    if (STRING.SCAN("audio_wrapper_smem_clk", STRING.MID("&clk", 1, &clk_input_length-2), 0)!=-1)
    ( 
      &match=1
    )
  )
  else if (&wild_head==1)
  (
    if (STRING.MID("audio_wrapper_smem_clk", &clk_itr_length-&clk_input_length+1, &clk_input_length-1)==STRING.CUT("&clk", 1))
    ( 
      &match=1
    )
  )
  else if (&wild_tail==1)
  (
    if (STRING.MID("audio_wrapper_smem_clk", 0, &clk_input_length-1)==STRING.CUT("&clk", -1))
    ( 
      &match=1
    )
  )	  
  else if ("audio_wrapper_smem_clk"=="&clk")
  (
    &match=1
  )
  
  if (&match==1)
  (
    &clk_test=&CLK_TEST_AUDIO_WRAPPER_SMEM_CLK
    &clk_reg=&HWIO_LPASS_AUDIO_WRAPPER_SMEM_CBCR_ADDR
    &clk_reg_name="LPASS_AUDIO_WRAPPER_SMEM_CBCR"
    &clk_name="audio_wrapper_smem_clk"
    &clk_reg_cbcr_type="sm_pscbc"

    gosub Print_Clk_Info_Line
  )

  &match=0
  &wild_head=0
  &wild_tail=0
  &clk_input_length=STRING.LENGTH("&clk")
  &clk_itr_length=STRING.LENGTH("audio_wrapper_sysnoc_sway_clk")

  if (STRING.SCAN("&clk", "*", 0)==0)
  (
    &wild_head=1
  )
  if (STRING.SCAN("&clk", "*", 1)==(STRING.LENGTH("&clk")-1))
  (
    &wild_tail=1
  )

  if ((&wild_head==1)&&(&wild_tail==1))
  (
    if (STRING.SCAN("audio_wrapper_sysnoc_sway_clk", STRING.MID("&clk", 1, &clk_input_length-2), 0)!=-1)
    ( 
      &match=1
    )
  )
  else if (&wild_head==1)
  (
    if (STRING.MID("audio_wrapper_sysnoc_sway_clk", &clk_itr_length-&clk_input_length+1, &clk_input_length-1)==STRING.CUT("&clk", 1))
    ( 
      &match=1
    )
  )
  else if (&wild_tail==1)
  (
    if (STRING.MID("audio_wrapper_sysnoc_sway_clk", 0, &clk_input_length-1)==STRING.CUT("&clk", -1))
    ( 
      &match=1
    )
  )	  
  else if ("audio_wrapper_sysnoc_sway_clk"=="&clk")
  (
    &match=1
  )
  
  if (&match==1)
  (
    &clk_test=0
    &clk_reg=&HWIO_LPASS_AUDIO_WRAPPER_SYSNOC_SWAY_CBCR_ADDR
    &clk_reg_name="LPASS_AUDIO_WRAPPER_SYSNOC_SWAY_CBCR"
    &clk_name="audio_wrapper_sysnoc_sway_clk"
    &clk_reg_cbcr_type="sm_cbc"

    gosub Print_Clk_Info_Line
  )

  &match=0
  &wild_head=0
  &wild_tail=0
  &clk_input_length=STRING.LENGTH("&clk")
  &clk_itr_length=STRING.LENGTH("audio_wrapper_timeout_clk")

  if (STRING.SCAN("&clk", "*", 0)==0)
  (
    &wild_head=1
  )
  if (STRING.SCAN("&clk", "*", 1)==(STRING.LENGTH("&clk")-1))
  (
    &wild_tail=1
  )

  if ((&wild_head==1)&&(&wild_tail==1))
  (
    if (STRING.SCAN("audio_wrapper_timeout_clk", STRING.MID("&clk", 1, &clk_input_length-2), 0)!=-1)
    ( 
      &match=1
    )
  )
  else if (&wild_head==1)
  (
    if (STRING.MID("audio_wrapper_timeout_clk", &clk_itr_length-&clk_input_length+1, &clk_input_length-1)==STRING.CUT("&clk", 1))
    ( 
      &match=1
    )
  )
  else if (&wild_tail==1)
  (
    if (STRING.MID("audio_wrapper_timeout_clk", 0, &clk_input_length-1)==STRING.CUT("&clk", -1))
    ( 
      &match=1
    )
  )	  
  else if ("audio_wrapper_timeout_clk"=="&clk")
  (
    &match=1
  )
  
  if (&match==1)
  (
    &clk_test=&CLK_TEST_AUDIO_WRAPPER_TIMEOUT_CLK
    &clk_reg=&HWIO_LPASS_AUDIO_WRAPPER_TIMEOUT_CBCR_ADDR
    &clk_reg_name="LPASS_AUDIO_WRAPPER_TIMEOUT_CBCR"
    &clk_name="audio_wrapper_timeout_clk"
    &clk_reg_cbcr_type="sm_cbc"

    gosub Print_Clk_Info_Line
  )

  &match=0
  &wild_head=0
  &wild_tail=0
  &clk_input_length=STRING.LENGTH("&clk")
  &clk_itr_length=STRING.LENGTH("q6ss_ahb_lfabif_clk")

  if (STRING.SCAN("&clk", "*", 0)==0)
  (
    &wild_head=1
  )
  if (STRING.SCAN("&clk", "*", 1)==(STRING.LENGTH("&clk")-1))
  (
    &wild_tail=1
  )

  if ((&wild_head==1)&&(&wild_tail==1))
  (
    if (STRING.SCAN("q6ss_ahb_lfabif_clk", STRING.MID("&clk", 1, &clk_input_length-2), 0)!=-1)
    ( 
      &match=1
    )
  )
  else if (&wild_head==1)
  (
    if (STRING.MID("q6ss_ahb_lfabif_clk", &clk_itr_length-&clk_input_length+1, &clk_input_length-1)==STRING.CUT("&clk", 1))
    ( 
      &match=1
    )
  )
  else if (&wild_tail==1)
  (
    if (STRING.MID("q6ss_ahb_lfabif_clk", 0, &clk_input_length-1)==STRING.CUT("&clk", -1))
    ( 
      &match=1
    )
  )	  
  else if ("q6ss_ahb_lfabif_clk"=="&clk")
  (
    &match=1
  )
  
  if (&match==1)
  (
    &clk_test=&CLK_TEST_Q6SS_AHB_LFABIF_CLK
    &clk_reg=&HWIO_LPASS_Q6SS_AHB_LFABIF_CBCR_ADDR
    &clk_reg_name="LPASS_Q6SS_AHB_LFABIF_CBCR"
    &clk_name="q6ss_ahb_lfabif_clk"
    &clk_reg_cbcr_type="sm_cbc"

    gosub Print_Clk_Info_Line
  )

  &match=0
  &wild_head=0
  &wild_tail=0
  &clk_input_length=STRING.LENGTH("&clk")
  &clk_itr_length=STRING.LENGTH("q6ss_ahbm_clk")

  if (STRING.SCAN("&clk", "*", 0)==0)
  (
    &wild_head=1
  )
  if (STRING.SCAN("&clk", "*", 1)==(STRING.LENGTH("&clk")-1))
  (
    &wild_tail=1
  )

  if ((&wild_head==1)&&(&wild_tail==1))
  (
    if (STRING.SCAN("q6ss_ahbm_clk", STRING.MID("&clk", 1, &clk_input_length-2), 0)!=-1)
    ( 
      &match=1
    )
  )
  else if (&wild_head==1)
  (
    if (STRING.MID("q6ss_ahbm_clk", &clk_itr_length-&clk_input_length+1, &clk_input_length-1)==STRING.CUT("&clk", 1))
    ( 
      &match=1
    )
  )
  else if (&wild_tail==1)
  (
    if (STRING.MID("q6ss_ahbm_clk", 0, &clk_input_length-1)==STRING.CUT("&clk", -1))
    ( 
      &match=1
    )
  )	  
  else if ("q6ss_ahbm_clk"=="&clk")
  (
    &match=1
  )
  
  if (&match==1)
  (
    &clk_test=&CLK_TEST_Q6SS_AHBM_CLK
    &clk_reg=&HWIO_LPASS_Q6SS_AHBM_CBCR_ADDR
    &clk_reg_name="LPASS_Q6SS_AHBM_CBCR"
    &clk_name="q6ss_ahbm_clk"
    &clk_reg_cbcr_type="sm_cbc"

    gosub Print_Clk_Info_Line
  )

  &match=0
  &wild_head=0
  &wild_tail=0
  &clk_input_length=STRING.LENGTH("&clk")
  &clk_itr_length=STRING.LENGTH("q6ss_tcm_slave_clk")

  if (STRING.SCAN("&clk", "*", 0)==0)
  (
    &wild_head=1
  )
  if (STRING.SCAN("&clk", "*", 1)==(STRING.LENGTH("&clk")-1))
  (
    &wild_tail=1
  )

  if ((&wild_head==1)&&(&wild_tail==1))
  (
    if (STRING.SCAN("q6ss_tcm_slave_clk", STRING.MID("&clk", 1, &clk_input_length-2), 0)!=-1)
    ( 
      &match=1
    )
  )
  else if (&wild_head==1)
  (
    if (STRING.MID("q6ss_tcm_slave_clk", &clk_itr_length-&clk_input_length+1, &clk_input_length-1)==STRING.CUT("&clk", 1))
    ( 
      &match=1
    )
  )
  else if (&wild_tail==1)
  (
    if (STRING.MID("q6ss_tcm_slave_clk", 0, &clk_input_length-1)==STRING.CUT("&clk", -1))
    ( 
      &match=1
    )
  )	  
  else if ("q6ss_tcm_slave_clk"=="&clk")
  (
    &match=1
  )
  
  if (&match==1)
  (
    &clk_test=&CLK_TEST_Q6SS_TCM_SLAVE_CLK
    &clk_reg=&HWIO_LPASS_Q6SS_TCM_SLAVE_CBCR_ADDR
    &clk_reg_name="LPASS_Q6SS_TCM_SLAVE_CBCR"
    &clk_name="q6ss_tcm_slave_clk"
    &clk_reg_cbcr_type="sm_cbc"

    gosub Print_Clk_Info_Line
  )

  &match=0
  &wild_head=0
  &wild_tail=0
  &clk_input_length=STRING.LENGTH("&clk")
  &clk_itr_length=STRING.LENGTH("avtimer_xo_clk_src")

  if (STRING.SCAN("&clk", "*", 0)==0)
  (
    &wild_head=1
  )
  if (STRING.SCAN("&clk", "*", 1)==(STRING.LENGTH("&clk")-1))
  (
    &wild_tail=1
  )

  if ((&wild_head==1)&&(&wild_tail==1))
  (
    if (STRING.SCAN("avtimer_xo_clk_src", STRING.MID("&clk", 1, &clk_input_length-2), 0)!=-1)
    ( 
      &match=1
    )
  )
  else if (&wild_head==1)
  (
    if (STRING.MID("avtimer_xo_clk_src", &clk_itr_length-&clk_input_length+1, &clk_input_length-1)==STRING.CUT("&clk", 1))
    ( 
      &match=1
    )
  )
  else if (&wild_tail==1)
  (
    if (STRING.MID("avtimer_xo_clk_src", 0, &clk_input_length-1)==STRING.CUT("&clk", -1))
    ( 
      &match=1
    )
  )	  
  else if ("avtimer_xo_clk_src"=="&clk")
  (
    &match=1
  )
  
  if (&match==1)
  (
    &clk_test=&CLK_TEST_AVTIMER_XO_CLK_SRC
    &clk_reg=0
    &clk_reg_name="No CBCR"
    &clk_name="avtimer_xo_clk_src"
    &clk_reg_cbcr_type=""

    gosub Print_Clk_Info_Line
  )

  &match=0
  &wild_head=0
  &wild_tail=0
  &clk_input_length=STRING.LENGTH("&clk")
  &clk_itr_length=STRING.LENGTH("audio_core_avsync_avtimer_xo_clk")

  if (STRING.SCAN("&clk", "*", 0)==0)
  (
    &wild_head=1
  )
  if (STRING.SCAN("&clk", "*", 1)==(STRING.LENGTH("&clk")-1))
  (
    &wild_tail=1
  )

  if ((&wild_head==1)&&(&wild_tail==1))
  (
    if (STRING.SCAN("audio_core_avsync_avtimer_xo_clk", STRING.MID("&clk", 1, &clk_input_length-2), 0)!=-1)
    ( 
      &match=1
    )
  )
  else if (&wild_head==1)
  (
    if (STRING.MID("audio_core_avsync_avtimer_xo_clk", &clk_itr_length-&clk_input_length+1, &clk_input_length-1)==STRING.CUT("&clk", 1))
    ( 
      &match=1
    )
  )
  else if (&wild_tail==1)
  (
    if (STRING.MID("audio_core_avsync_avtimer_xo_clk", 0, &clk_input_length-1)==STRING.CUT("&clk", -1))
    ( 
      &match=1
    )
  )	  
  else if ("audio_core_avsync_avtimer_xo_clk"=="&clk")
  (
    &match=1
  )
  
  if (&match==1)
  (
    &clk_test=&CLK_TEST_AUDIO_CORE_AVSYNC_AVTIMER_XO_CLK
    &clk_reg=&HWIO_LPASS_AUDIO_CORE_AVSYNC_AVTIMER_XO_CBCR_ADDR
    &clk_reg_name="LPASS_AUDIO_CORE_AVSYNC_AVTIMER_XO_CBCR"
    &clk_name="audio_core_avsync_avtimer_xo_clk"
    &clk_reg_cbcr_type="sm_cbc"

    gosub Print_Clk_Info_Line
  )

  &match=0
  &wild_head=0
  &wild_tail=0
  &clk_input_length=STRING.LENGTH("&clk")
  &clk_itr_length=STRING.LENGTH("gdsc_xo_clk_src")

  if (STRING.SCAN("&clk", "*", 0)==0)
  (
    &wild_head=1
  )
  if (STRING.SCAN("&clk", "*", 1)==(STRING.LENGTH("&clk")-1))
  (
    &wild_tail=1
  )

  if ((&wild_head==1)&&(&wild_tail==1))
  (
    if (STRING.SCAN("gdsc_xo_clk_src", STRING.MID("&clk", 1, &clk_input_length-2), 0)!=-1)
    ( 
      &match=1
    )
  )
  else if (&wild_head==1)
  (
    if (STRING.MID("gdsc_xo_clk_src", &clk_itr_length-&clk_input_length+1, &clk_input_length-1)==STRING.CUT("&clk", 1))
    ( 
      &match=1
    )
  )
  else if (&wild_tail==1)
  (
    if (STRING.MID("gdsc_xo_clk_src", 0, &clk_input_length-1)==STRING.CUT("&clk", -1))
    ( 
      &match=1
    )
  )	  
  else if ("gdsc_xo_clk_src"=="&clk")
  (
    &match=1
  )
  
  if (&match==1)
  (
    &clk_test=&CLK_TEST_GDSC_XO_CLK_SRC
    &clk_reg=0
    &clk_reg_name="No CBCR"
    &clk_name="gdsc_xo_clk_src"
    &clk_reg_cbcr_type=""

    gosub Print_Clk_Info_Line
  )

  &match=0
  &wild_head=0
  &wild_tail=0
  &clk_input_length=STRING.LENGTH("&clk")
  &clk_itr_length=STRING.LENGTH("audio_core_gdsc_xo_clk")

  if (STRING.SCAN("&clk", "*", 0)==0)
  (
    &wild_head=1
  )
  if (STRING.SCAN("&clk", "*", 1)==(STRING.LENGTH("&clk")-1))
  (
    &wild_tail=1
  )

  if ((&wild_head==1)&&(&wild_tail==1))
  (
    if (STRING.SCAN("audio_core_gdsc_xo_clk", STRING.MID("&clk", 1, &clk_input_length-2), 0)!=-1)
    ( 
      &match=1
    )
  )
  else if (&wild_head==1)
  (
    if (STRING.MID("audio_core_gdsc_xo_clk", &clk_itr_length-&clk_input_length+1, &clk_input_length-1)==STRING.CUT("&clk", 1))
    ( 
      &match=1
    )
  )
  else if (&wild_tail==1)
  (
    if (STRING.MID("audio_core_gdsc_xo_clk", 0, &clk_input_length-1)==STRING.CUT("&clk", -1))
    ( 
      &match=1
    )
  )	  
  else if ("audio_core_gdsc_xo_clk"=="&clk")
  (
    &match=1
  )
  
  if (&match==1)
  (
    &clk_test=&CLK_TEST_AUDIO_CORE_GDSC_XO_CLK
    &clk_reg=&HWIO_LPASS_AUDIO_CORE_GDSC_XO_CBCR_ADDR
    &clk_reg_name="LPASS_AUDIO_CORE_GDSC_XO_CBCR"
    &clk_name="audio_core_gdsc_xo_clk"
    &clk_reg_cbcr_type="sm_cbc"

    gosub Print_Clk_Info_Line
  )

  &match=0
  &wild_head=0
  &wild_tail=0
  &clk_input_length=STRING.LENGTH("&clk")
  &clk_itr_length=STRING.LENGTH("lpaif_pcm0_clk_src")

  if (STRING.SCAN("&clk", "*", 0)==0)
  (
    &wild_head=1
  )
  if (STRING.SCAN("&clk", "*", 1)==(STRING.LENGTH("&clk")-1))
  (
    &wild_tail=1
  )

  if ((&wild_head==1)&&(&wild_tail==1))
  (
    if (STRING.SCAN("lpaif_pcm0_clk_src", STRING.MID("&clk", 1, &clk_input_length-2), 0)!=-1)
    ( 
      &match=1
    )
  )
  else if (&wild_head==1)
  (
    if (STRING.MID("lpaif_pcm0_clk_src", &clk_itr_length-&clk_input_length+1, &clk_input_length-1)==STRING.CUT("&clk", 1))
    ( 
      &match=1
    )
  )
  else if (&wild_tail==1)
  (
    if (STRING.MID("lpaif_pcm0_clk_src", 0, &clk_input_length-1)==STRING.CUT("&clk", -1))
    ( 
      &match=1
    )
  )	  
  else if ("lpaif_pcm0_clk_src"=="&clk")
  (
    &match=1
  )
  
  if (&match==1)
  (
    &clk_test=&CLK_TEST_LPAIF_PCM0_CLK_SRC
    &clk_reg=0
    &clk_reg_name="No CBCR"
    &clk_name="lpaif_pcm0_clk_src"
    &clk_reg_cbcr_type=""

    gosub Print_Clk_Info_Line
  )

  &match=0
  &wild_head=0
  &wild_tail=0
  &clk_input_length=STRING.LENGTH("&clk")
  &clk_itr_length=STRING.LENGTH("audio_core_lpaif_pcm0_ibit_clk")

  if (STRING.SCAN("&clk", "*", 0)==0)
  (
    &wild_head=1
  )
  if (STRING.SCAN("&clk", "*", 1)==(STRING.LENGTH("&clk")-1))
  (
    &wild_tail=1
  )

  if ((&wild_head==1)&&(&wild_tail==1))
  (
    if (STRING.SCAN("audio_core_lpaif_pcm0_ibit_clk", STRING.MID("&clk", 1, &clk_input_length-2), 0)!=-1)
    ( 
      &match=1
    )
  )
  else if (&wild_head==1)
  (
    if (STRING.MID("audio_core_lpaif_pcm0_ibit_clk", &clk_itr_length-&clk_input_length+1, &clk_input_length-1)==STRING.CUT("&clk", 1))
    ( 
      &match=1
    )
  )
  else if (&wild_tail==1)
  (
    if (STRING.MID("audio_core_lpaif_pcm0_ibit_clk", 0, &clk_input_length-1)==STRING.CUT("&clk", -1))
    ( 
      &match=1
    )
  )	  
  else if ("audio_core_lpaif_pcm0_ibit_clk"=="&clk")
  (
    &match=1
  )
  
  if (&match==1)
  (
    &clk_test=0
    &clk_reg=&HWIO_LPASS_AUDIO_CORE_LPAIF_PCM0_IBIT_CBCR_ADDR
    &clk_reg_name="LPASS_AUDIO_CORE_LPAIF_PCM0_IBIT_CBCR"
    &clk_name="audio_core_lpaif_pcm0_ibit_clk"
    &clk_reg_cbcr_type="sm_cbc"

    gosub Print_Clk_Info_Line
  )

  &match=0
  &wild_head=0
  &wild_tail=0
  &clk_input_length=STRING.LENGTH("&clk")
  &clk_itr_length=STRING.LENGTH("lpaif_pcm1_clk_src")

  if (STRING.SCAN("&clk", "*", 0)==0)
  (
    &wild_head=1
  )
  if (STRING.SCAN("&clk", "*", 1)==(STRING.LENGTH("&clk")-1))
  (
    &wild_tail=1
  )

  if ((&wild_head==1)&&(&wild_tail==1))
  (
    if (STRING.SCAN("lpaif_pcm1_clk_src", STRING.MID("&clk", 1, &clk_input_length-2), 0)!=-1)
    ( 
      &match=1
    )
  )
  else if (&wild_head==1)
  (
    if (STRING.MID("lpaif_pcm1_clk_src", &clk_itr_length-&clk_input_length+1, &clk_input_length-1)==STRING.CUT("&clk", 1))
    ( 
      &match=1
    )
  )
  else if (&wild_tail==1)
  (
    if (STRING.MID("lpaif_pcm1_clk_src", 0, &clk_input_length-1)==STRING.CUT("&clk", -1))
    ( 
      &match=1
    )
  )	  
  else if ("lpaif_pcm1_clk_src"=="&clk")
  (
    &match=1
  )
  
  if (&match==1)
  (
    &clk_test=&CLK_TEST_LPAIF_PCM1_CLK_SRC
    &clk_reg=0
    &clk_reg_name="No CBCR"
    &clk_name="lpaif_pcm1_clk_src"
    &clk_reg_cbcr_type=""

    gosub Print_Clk_Info_Line
  )

  &match=0
  &wild_head=0
  &wild_tail=0
  &clk_input_length=STRING.LENGTH("&clk")
  &clk_itr_length=STRING.LENGTH("audio_core_lpaif_pcm1_ibit_clk")

  if (STRING.SCAN("&clk", "*", 0)==0)
  (
    &wild_head=1
  )
  if (STRING.SCAN("&clk", "*", 1)==(STRING.LENGTH("&clk")-1))
  (
    &wild_tail=1
  )

  if ((&wild_head==1)&&(&wild_tail==1))
  (
    if (STRING.SCAN("audio_core_lpaif_pcm1_ibit_clk", STRING.MID("&clk", 1, &clk_input_length-2), 0)!=-1)
    ( 
      &match=1
    )
  )
  else if (&wild_head==1)
  (
    if (STRING.MID("audio_core_lpaif_pcm1_ibit_clk", &clk_itr_length-&clk_input_length+1, &clk_input_length-1)==STRING.CUT("&clk", 1))
    ( 
      &match=1
    )
  )
  else if (&wild_tail==1)
  (
    if (STRING.MID("audio_core_lpaif_pcm1_ibit_clk", 0, &clk_input_length-1)==STRING.CUT("&clk", -1))
    ( 
      &match=1
    )
  )	  
  else if ("audio_core_lpaif_pcm1_ibit_clk"=="&clk")
  (
    &match=1
  )
  
  if (&match==1)
  (
    &clk_test=0
    &clk_reg=&HWIO_LPASS_AUDIO_CORE_LPAIF_PCM1_IBIT_CBCR_ADDR
    &clk_reg_name="LPASS_AUDIO_CORE_LPAIF_PCM1_IBIT_CBCR"
    &clk_name="audio_core_lpaif_pcm1_ibit_clk"
    &clk_reg_cbcr_type="sm_cbc"

    gosub Print_Clk_Info_Line
  )

  &match=0
  &wild_head=0
  &wild_tail=0
  &clk_input_length=STRING.LENGTH("&clk")
  &clk_itr_length=STRING.LENGTH("lpaif_pcmoe_clk_src")

  if (STRING.SCAN("&clk", "*", 0)==0)
  (
    &wild_head=1
  )
  if (STRING.SCAN("&clk", "*", 1)==(STRING.LENGTH("&clk")-1))
  (
    &wild_tail=1
  )

  if ((&wild_head==1)&&(&wild_tail==1))
  (
    if (STRING.SCAN("lpaif_pcmoe_clk_src", STRING.MID("&clk", 1, &clk_input_length-2), 0)!=-1)
    ( 
      &match=1
    )
  )
  else if (&wild_head==1)
  (
    if (STRING.MID("lpaif_pcmoe_clk_src", &clk_itr_length-&clk_input_length+1, &clk_input_length-1)==STRING.CUT("&clk", 1))
    ( 
      &match=1
    )
  )
  else if (&wild_tail==1)
  (
    if (STRING.MID("lpaif_pcmoe_clk_src", 0, &clk_input_length-1)==STRING.CUT("&clk", -1))
    ( 
      &match=1
    )
  )	  
  else if ("lpaif_pcmoe_clk_src"=="&clk")
  (
    &match=1
  )
  
  if (&match==1)
  (
    &clk_test=&CLK_TEST_LPAIF_PCMOE_CLK_SRC
    &clk_reg=0
    &clk_reg_name="No CBCR"
    &clk_name="lpaif_pcmoe_clk_src"
    &clk_reg_cbcr_type=""

    gosub Print_Clk_Info_Line
  )

  &match=0
  &wild_head=0
  &wild_tail=0
  &clk_input_length=STRING.LENGTH("&clk")
  &clk_itr_length=STRING.LENGTH("audio_core_lpaif_pcm_data_oe_clk")

  if (STRING.SCAN("&clk", "*", 0)==0)
  (
    &wild_head=1
  )
  if (STRING.SCAN("&clk", "*", 1)==(STRING.LENGTH("&clk")-1))
  (
    &wild_tail=1
  )

  if ((&wild_head==1)&&(&wild_tail==1))
  (
    if (STRING.SCAN("audio_core_lpaif_pcm_data_oe_clk", STRING.MID("&clk", 1, &clk_input_length-2), 0)!=-1)
    ( 
      &match=1
    )
  )
  else if (&wild_head==1)
  (
    if (STRING.MID("audio_core_lpaif_pcm_data_oe_clk", &clk_itr_length-&clk_input_length+1, &clk_input_length-1)==STRING.CUT("&clk", 1))
    ( 
      &match=1
    )
  )
  else if (&wild_tail==1)
  (
    if (STRING.MID("audio_core_lpaif_pcm_data_oe_clk", 0, &clk_input_length-1)==STRING.CUT("&clk", -1))
    ( 
      &match=1
    )
  )	  
  else if ("audio_core_lpaif_pcm_data_oe_clk"=="&clk")
  (
    &match=1
  )
  
  if (&match==1)
  (
    &clk_test=&CLK_TEST_AUDIO_CORE_LPAIF_PCM_DATA_OE_CLK
    &clk_reg=&HWIO_LPASS_AUDIO_CORE_LPAIF_PCM_DATA_OE_CBCR_ADDR
    &clk_reg_name="LPASS_AUDIO_CORE_LPAIF_PCM_DATA_OE_CBCR"
    &clk_name="audio_core_lpaif_pcm_data_oe_clk"
    &clk_reg_cbcr_type="sm_cbc"

    gosub Print_Clk_Info_Line
  )

  &match=0
  &wild_head=0
  &wild_tail=0
  &clk_input_length=STRING.LENGTH("&clk")
  &clk_itr_length=STRING.LENGTH("lpaif_pri_clk_src")

  if (STRING.SCAN("&clk", "*", 0)==0)
  (
    &wild_head=1
  )
  if (STRING.SCAN("&clk", "*", 1)==(STRING.LENGTH("&clk")-1))
  (
    &wild_tail=1
  )

  if ((&wild_head==1)&&(&wild_tail==1))
  (
    if (STRING.SCAN("lpaif_pri_clk_src", STRING.MID("&clk", 1, &clk_input_length-2), 0)!=-1)
    ( 
      &match=1
    )
  )
  else if (&wild_head==1)
  (
    if (STRING.MID("lpaif_pri_clk_src", &clk_itr_length-&clk_input_length+1, &clk_input_length-1)==STRING.CUT("&clk", 1))
    ( 
      &match=1
    )
  )
  else if (&wild_tail==1)
  (
    if (STRING.MID("lpaif_pri_clk_src", 0, &clk_input_length-1)==STRING.CUT("&clk", -1))
    ( 
      &match=1
    )
  )	  
  else if ("lpaif_pri_clk_src"=="&clk")
  (
    &match=1
  )
  
  if (&match==1)
  (
    &clk_test=&CLK_TEST_LPAIF_PRI_CLK_SRC
    &clk_reg=0
    &clk_reg_name="No CBCR"
    &clk_name="lpaif_pri_clk_src"
    &clk_reg_cbcr_type=""

    gosub Print_Clk_Info_Line
  )

  &match=0
  &wild_head=0
  &wild_tail=0
  &clk_input_length=STRING.LENGTH("&clk")
  &clk_itr_length=STRING.LENGTH("audio_core_lpaif_pri_ibit_clk")

  if (STRING.SCAN("&clk", "*", 0)==0)
  (
    &wild_head=1
  )
  if (STRING.SCAN("&clk", "*", 1)==(STRING.LENGTH("&clk")-1))
  (
    &wild_tail=1
  )

  if ((&wild_head==1)&&(&wild_tail==1))
  (
    if (STRING.SCAN("audio_core_lpaif_pri_ibit_clk", STRING.MID("&clk", 1, &clk_input_length-2), 0)!=-1)
    ( 
      &match=1
    )
  )
  else if (&wild_head==1)
  (
    if (STRING.MID("audio_core_lpaif_pri_ibit_clk", &clk_itr_length-&clk_input_length+1, &clk_input_length-1)==STRING.CUT("&clk", 1))
    ( 
      &match=1
    )
  )
  else if (&wild_tail==1)
  (
    if (STRING.MID("audio_core_lpaif_pri_ibit_clk", 0, &clk_input_length-1)==STRING.CUT("&clk", -1))
    ( 
      &match=1
    )
  )	  
  else if ("audio_core_lpaif_pri_ibit_clk"=="&clk")
  (
    &match=1
  )
  
  if (&match==1)
  (
    &clk_test=0
    &clk_reg=&HWIO_LPASS_AUDIO_CORE_LPAIF_PRI_IBIT_CBCR_ADDR
    &clk_reg_name="LPASS_AUDIO_CORE_LPAIF_PRI_IBIT_CBCR"
    &clk_name="audio_core_lpaif_pri_ibit_clk"
    &clk_reg_cbcr_type="sm_cbc"

    gosub Print_Clk_Info_Line
  )

  &match=0
  &wild_head=0
  &wild_tail=0
  &clk_input_length=STRING.LENGTH("&clk")
  &clk_itr_length=STRING.LENGTH("audio_core_lpaif_pri_osr_clk")

  if (STRING.SCAN("&clk", "*", 0)==0)
  (
    &wild_head=1
  )
  if (STRING.SCAN("&clk", "*", 1)==(STRING.LENGTH("&clk")-1))
  (
    &wild_tail=1
  )

  if ((&wild_head==1)&&(&wild_tail==1))
  (
    if (STRING.SCAN("audio_core_lpaif_pri_osr_clk", STRING.MID("&clk", 1, &clk_input_length-2), 0)!=-1)
    ( 
      &match=1
    )
  )
  else if (&wild_head==1)
  (
    if (STRING.MID("audio_core_lpaif_pri_osr_clk", &clk_itr_length-&clk_input_length+1, &clk_input_length-1)==STRING.CUT("&clk", 1))
    ( 
      &match=1
    )
  )
  else if (&wild_tail==1)
  (
    if (STRING.MID("audio_core_lpaif_pri_osr_clk", 0, &clk_input_length-1)==STRING.CUT("&clk", -1))
    ( 
      &match=1
    )
  )	  
  else if ("audio_core_lpaif_pri_osr_clk"=="&clk")
  (
    &match=1
  )
  
  if (&match==1)
  (
    &clk_test=0
    &clk_reg=&HWIO_LPASS_AUDIO_CORE_LPAIF_PRI_OSR_CBCR_ADDR
    &clk_reg_name="LPASS_AUDIO_CORE_LPAIF_PRI_OSR_CBCR"
    &clk_name="audio_core_lpaif_pri_osr_clk"
    &clk_reg_cbcr_type="sm_cbc"

    gosub Print_Clk_Info_Line
  )

  &match=0
  &wild_head=0
  &wild_tail=0
  &clk_input_length=STRING.LENGTH("&clk")
  &clk_itr_length=STRING.LENGTH("lpaif_quad_clk_src")

  if (STRING.SCAN("&clk", "*", 0)==0)
  (
    &wild_head=1
  )
  if (STRING.SCAN("&clk", "*", 1)==(STRING.LENGTH("&clk")-1))
  (
    &wild_tail=1
  )

  if ((&wild_head==1)&&(&wild_tail==1))
  (
    if (STRING.SCAN("lpaif_quad_clk_src", STRING.MID("&clk", 1, &clk_input_length-2), 0)!=-1)
    ( 
      &match=1
    )
  )
  else if (&wild_head==1)
  (
    if (STRING.MID("lpaif_quad_clk_src", &clk_itr_length-&clk_input_length+1, &clk_input_length-1)==STRING.CUT("&clk", 1))
    ( 
      &match=1
    )
  )
  else if (&wild_tail==1)
  (
    if (STRING.MID("lpaif_quad_clk_src", 0, &clk_input_length-1)==STRING.CUT("&clk", -1))
    ( 
      &match=1
    )
  )	  
  else if ("lpaif_quad_clk_src"=="&clk")
  (
    &match=1
  )
  
  if (&match==1)
  (
    &clk_test=&CLK_TEST_LPAIF_QUAD_CLK_SRC
    &clk_reg=0
    &clk_reg_name="No CBCR"
    &clk_name="lpaif_quad_clk_src"
    &clk_reg_cbcr_type=""

    gosub Print_Clk_Info_Line
  )

  &match=0
  &wild_head=0
  &wild_tail=0
  &clk_input_length=STRING.LENGTH("&clk")
  &clk_itr_length=STRING.LENGTH("audio_core_lpaif_quad_ibit_clk")

  if (STRING.SCAN("&clk", "*", 0)==0)
  (
    &wild_head=1
  )
  if (STRING.SCAN("&clk", "*", 1)==(STRING.LENGTH("&clk")-1))
  (
    &wild_tail=1
  )

  if ((&wild_head==1)&&(&wild_tail==1))
  (
    if (STRING.SCAN("audio_core_lpaif_quad_ibit_clk", STRING.MID("&clk", 1, &clk_input_length-2), 0)!=-1)
    ( 
      &match=1
    )
  )
  else if (&wild_head==1)
  (
    if (STRING.MID("audio_core_lpaif_quad_ibit_clk", &clk_itr_length-&clk_input_length+1, &clk_input_length-1)==STRING.CUT("&clk", 1))
    ( 
      &match=1
    )
  )
  else if (&wild_tail==1)
  (
    if (STRING.MID("audio_core_lpaif_quad_ibit_clk", 0, &clk_input_length-1)==STRING.CUT("&clk", -1))
    ( 
      &match=1
    )
  )	  
  else if ("audio_core_lpaif_quad_ibit_clk"=="&clk")
  (
    &match=1
  )
  
  if (&match==1)
  (
    &clk_test=0
    &clk_reg=&HWIO_LPASS_AUDIO_CORE_LPAIF_QUAD_IBIT_CBCR_ADDR
    &clk_reg_name="LPASS_AUDIO_CORE_LPAIF_QUAD_IBIT_CBCR"
    &clk_name="audio_core_lpaif_quad_ibit_clk"
    &clk_reg_cbcr_type="sm_cbc"

    gosub Print_Clk_Info_Line
  )

  &match=0
  &wild_head=0
  &wild_tail=0
  &clk_input_length=STRING.LENGTH("&clk")
  &clk_itr_length=STRING.LENGTH("audio_core_lpaif_quad_osr_clk")

  if (STRING.SCAN("&clk", "*", 0)==0)
  (
    &wild_head=1
  )
  if (STRING.SCAN("&clk", "*", 1)==(STRING.LENGTH("&clk")-1))
  (
    &wild_tail=1
  )

  if ((&wild_head==1)&&(&wild_tail==1))
  (
    if (STRING.SCAN("audio_core_lpaif_quad_osr_clk", STRING.MID("&clk", 1, &clk_input_length-2), 0)!=-1)
    ( 
      &match=1
    )
  )
  else if (&wild_head==1)
  (
    if (STRING.MID("audio_core_lpaif_quad_osr_clk", &clk_itr_length-&clk_input_length+1, &clk_input_length-1)==STRING.CUT("&clk", 1))
    ( 
      &match=1
    )
  )
  else if (&wild_tail==1)
  (
    if (STRING.MID("audio_core_lpaif_quad_osr_clk", 0, &clk_input_length-1)==STRING.CUT("&clk", -1))
    ( 
      &match=1
    )
  )	  
  else if ("audio_core_lpaif_quad_osr_clk"=="&clk")
  (
    &match=1
  )
  
  if (&match==1)
  (
    &clk_test=0
    &clk_reg=&HWIO_LPASS_AUDIO_CORE_LPAIF_QUAD_OSR_CBCR_ADDR
    &clk_reg_name="LPASS_AUDIO_CORE_LPAIF_QUAD_OSR_CBCR"
    &clk_name="audio_core_lpaif_quad_osr_clk"
    &clk_reg_cbcr_type="sm_cbc"

    gosub Print_Clk_Info_Line
  )

  &match=0
  &wild_head=0
  &wild_tail=0
  &clk_input_length=STRING.LENGTH("&clk")
  &clk_itr_length=STRING.LENGTH("lpaif_sec_clk_src")

  if (STRING.SCAN("&clk", "*", 0)==0)
  (
    &wild_head=1
  )
  if (STRING.SCAN("&clk", "*", 1)==(STRING.LENGTH("&clk")-1))
  (
    &wild_tail=1
  )

  if ((&wild_head==1)&&(&wild_tail==1))
  (
    if (STRING.SCAN("lpaif_sec_clk_src", STRING.MID("&clk", 1, &clk_input_length-2), 0)!=-1)
    ( 
      &match=1
    )
  )
  else if (&wild_head==1)
  (
    if (STRING.MID("lpaif_sec_clk_src", &clk_itr_length-&clk_input_length+1, &clk_input_length-1)==STRING.CUT("&clk", 1))
    ( 
      &match=1
    )
  )
  else if (&wild_tail==1)
  (
    if (STRING.MID("lpaif_sec_clk_src", 0, &clk_input_length-1)==STRING.CUT("&clk", -1))
    ( 
      &match=1
    )
  )	  
  else if ("lpaif_sec_clk_src"=="&clk")
  (
    &match=1
  )
  
  if (&match==1)
  (
    &clk_test=&CLK_TEST_LPAIF_SEC_CLK_SRC
    &clk_reg=0
    &clk_reg_name="No CBCR"
    &clk_name="lpaif_sec_clk_src"
    &clk_reg_cbcr_type=""

    gosub Print_Clk_Info_Line
  )

  &match=0
  &wild_head=0
  &wild_tail=0
  &clk_input_length=STRING.LENGTH("&clk")
  &clk_itr_length=STRING.LENGTH("audio_core_lpaif_sec_ibit_clk")

  if (STRING.SCAN("&clk", "*", 0)==0)
  (
    &wild_head=1
  )
  if (STRING.SCAN("&clk", "*", 1)==(STRING.LENGTH("&clk")-1))
  (
    &wild_tail=1
  )

  if ((&wild_head==1)&&(&wild_tail==1))
  (
    if (STRING.SCAN("audio_core_lpaif_sec_ibit_clk", STRING.MID("&clk", 1, &clk_input_length-2), 0)!=-1)
    ( 
      &match=1
    )
  )
  else if (&wild_head==1)
  (
    if (STRING.MID("audio_core_lpaif_sec_ibit_clk", &clk_itr_length-&clk_input_length+1, &clk_input_length-1)==STRING.CUT("&clk", 1))
    ( 
      &match=1
    )
  )
  else if (&wild_tail==1)
  (
    if (STRING.MID("audio_core_lpaif_sec_ibit_clk", 0, &clk_input_length-1)==STRING.CUT("&clk", -1))
    ( 
      &match=1
    )
  )	  
  else if ("audio_core_lpaif_sec_ibit_clk"=="&clk")
  (
    &match=1
  )
  
  if (&match==1)
  (
    &clk_test=0
    &clk_reg=&HWIO_LPASS_AUDIO_CORE_LPAIF_SEC_IBIT_CBCR_ADDR
    &clk_reg_name="LPASS_AUDIO_CORE_LPAIF_SEC_IBIT_CBCR"
    &clk_name="audio_core_lpaif_sec_ibit_clk"
    &clk_reg_cbcr_type="sm_cbc"

    gosub Print_Clk_Info_Line
  )

  &match=0
  &wild_head=0
  &wild_tail=0
  &clk_input_length=STRING.LENGTH("&clk")
  &clk_itr_length=STRING.LENGTH("audio_core_lpaif_sec_osr_clk")

  if (STRING.SCAN("&clk", "*", 0)==0)
  (
    &wild_head=1
  )
  if (STRING.SCAN("&clk", "*", 1)==(STRING.LENGTH("&clk")-1))
  (
    &wild_tail=1
  )

  if ((&wild_head==1)&&(&wild_tail==1))
  (
    if (STRING.SCAN("audio_core_lpaif_sec_osr_clk", STRING.MID("&clk", 1, &clk_input_length-2), 0)!=-1)
    ( 
      &match=1
    )
  )
  else if (&wild_head==1)
  (
    if (STRING.MID("audio_core_lpaif_sec_osr_clk", &clk_itr_length-&clk_input_length+1, &clk_input_length-1)==STRING.CUT("&clk", 1))
    ( 
      &match=1
    )
  )
  else if (&wild_tail==1)
  (
    if (STRING.MID("audio_core_lpaif_sec_osr_clk", 0, &clk_input_length-1)==STRING.CUT("&clk", -1))
    ( 
      &match=1
    )
  )	  
  else if ("audio_core_lpaif_sec_osr_clk"=="&clk")
  (
    &match=1
  )
  
  if (&match==1)
  (
    &clk_test=0
    &clk_reg=&HWIO_LPASS_AUDIO_CORE_LPAIF_SEC_OSR_CBCR_ADDR
    &clk_reg_name="LPASS_AUDIO_CORE_LPAIF_SEC_OSR_CBCR"
    &clk_name="audio_core_lpaif_sec_osr_clk"
    &clk_reg_cbcr_type="sm_cbc"

    gosub Print_Clk_Info_Line
  )

  &match=0
  &wild_head=0
  &wild_tail=0
  &clk_input_length=STRING.LENGTH("&clk")
  &clk_itr_length=STRING.LENGTH("lpaif_spkr_clk_src")

  if (STRING.SCAN("&clk", "*", 0)==0)
  (
    &wild_head=1
  )
  if (STRING.SCAN("&clk", "*", 1)==(STRING.LENGTH("&clk")-1))
  (
    &wild_tail=1
  )

  if ((&wild_head==1)&&(&wild_tail==1))
  (
    if (STRING.SCAN("lpaif_spkr_clk_src", STRING.MID("&clk", 1, &clk_input_length-2), 0)!=-1)
    ( 
      &match=1
    )
  )
  else if (&wild_head==1)
  (
    if (STRING.MID("lpaif_spkr_clk_src", &clk_itr_length-&clk_input_length+1, &clk_input_length-1)==STRING.CUT("&clk", 1))
    ( 
      &match=1
    )
  )
  else if (&wild_tail==1)
  (
    if (STRING.MID("lpaif_spkr_clk_src", 0, &clk_input_length-1)==STRING.CUT("&clk", -1))
    ( 
      &match=1
    )
  )	  
  else if ("lpaif_spkr_clk_src"=="&clk")
  (
    &match=1
  )
  
  if (&match==1)
  (
    &clk_test=&CLK_TEST_LPAIF_SPKR_CLK_SRC
    &clk_reg=0
    &clk_reg_name="No CBCR"
    &clk_name="lpaif_spkr_clk_src"
    &clk_reg_cbcr_type=""

    gosub Print_Clk_Info_Line
  )

  &match=0
  &wild_head=0
  &wild_tail=0
  &clk_input_length=STRING.LENGTH("&clk")
  &clk_itr_length=STRING.LENGTH("audio_core_lpaif_codec_spkr_ibit_clk")

  if (STRING.SCAN("&clk", "*", 0)==0)
  (
    &wild_head=1
  )
  if (STRING.SCAN("&clk", "*", 1)==(STRING.LENGTH("&clk")-1))
  (
    &wild_tail=1
  )

  if ((&wild_head==1)&&(&wild_tail==1))
  (
    if (STRING.SCAN("audio_core_lpaif_codec_spkr_ibit_clk", STRING.MID("&clk", 1, &clk_input_length-2), 0)!=-1)
    ( 
      &match=1
    )
  )
  else if (&wild_head==1)
  (
    if (STRING.MID("audio_core_lpaif_codec_spkr_ibit_clk", &clk_itr_length-&clk_input_length+1, &clk_input_length-1)==STRING.CUT("&clk", 1))
    ( 
      &match=1
    )
  )
  else if (&wild_tail==1)
  (
    if (STRING.MID("audio_core_lpaif_codec_spkr_ibit_clk", 0, &clk_input_length-1)==STRING.CUT("&clk", -1))
    ( 
      &match=1
    )
  )	  
  else if ("audio_core_lpaif_codec_spkr_ibit_clk"=="&clk")
  (
    &match=1
  )
  
  if (&match==1)
  (
    &clk_test=0
    &clk_reg=&HWIO_LPASS_AUDIO_CORE_LPAIF_CODEC_SPKR_IBIT_CBCR_ADDR
    &clk_reg_name="LPASS_AUDIO_CORE_LPAIF_CODEC_SPKR_IBIT_CBCR"
    &clk_name="audio_core_lpaif_codec_spkr_ibit_clk"
    &clk_reg_cbcr_type="sm_cbc"

    gosub Print_Clk_Info_Line
  )

  &match=0
  &wild_head=0
  &wild_tail=0
  &clk_input_length=STRING.LENGTH("&clk")
  &clk_itr_length=STRING.LENGTH("audio_core_lpaif_codec_spkr_osr_clk")

  if (STRING.SCAN("&clk", "*", 0)==0)
  (
    &wild_head=1
  )
  if (STRING.SCAN("&clk", "*", 1)==(STRING.LENGTH("&clk")-1))
  (
    &wild_tail=1
  )

  if ((&wild_head==1)&&(&wild_tail==1))
  (
    if (STRING.SCAN("audio_core_lpaif_codec_spkr_osr_clk", STRING.MID("&clk", 1, &clk_input_length-2), 0)!=-1)
    ( 
      &match=1
    )
  )
  else if (&wild_head==1)
  (
    if (STRING.MID("audio_core_lpaif_codec_spkr_osr_clk", &clk_itr_length-&clk_input_length+1, &clk_input_length-1)==STRING.CUT("&clk", 1))
    ( 
      &match=1
    )
  )
  else if (&wild_tail==1)
  (
    if (STRING.MID("audio_core_lpaif_codec_spkr_osr_clk", 0, &clk_input_length-1)==STRING.CUT("&clk", -1))
    ( 
      &match=1
    )
  )	  
  else if ("audio_core_lpaif_codec_spkr_osr_clk"=="&clk")
  (
    &match=1
  )
  
  if (&match==1)
  (
    &clk_test=0
    &clk_reg=&HWIO_LPASS_AUDIO_CORE_LPAIF_CODEC_SPKR_OSR_CBCR_ADDR
    &clk_reg_name="LPASS_AUDIO_CORE_LPAIF_CODEC_SPKR_OSR_CBCR"
    &clk_name="audio_core_lpaif_codec_spkr_osr_clk"
    &clk_reg_cbcr_type="sm_cbc"

    gosub Print_Clk_Info_Line
  )

  &match=0
  &wild_head=0
  &wild_tail=0
  &clk_input_length=STRING.LENGTH("&clk")
  &clk_itr_length=STRING.LENGTH("lpaif_ter_clk_src")

  if (STRING.SCAN("&clk", "*", 0)==0)
  (
    &wild_head=1
  )
  if (STRING.SCAN("&clk", "*", 1)==(STRING.LENGTH("&clk")-1))
  (
    &wild_tail=1
  )

  if ((&wild_head==1)&&(&wild_tail==1))
  (
    if (STRING.SCAN("lpaif_ter_clk_src", STRING.MID("&clk", 1, &clk_input_length-2), 0)!=-1)
    ( 
      &match=1
    )
  )
  else if (&wild_head==1)
  (
    if (STRING.MID("lpaif_ter_clk_src", &clk_itr_length-&clk_input_length+1, &clk_input_length-1)==STRING.CUT("&clk", 1))
    ( 
      &match=1
    )
  )
  else if (&wild_tail==1)
  (
    if (STRING.MID("lpaif_ter_clk_src", 0, &clk_input_length-1)==STRING.CUT("&clk", -1))
    ( 
      &match=1
    )
  )	  
  else if ("lpaif_ter_clk_src"=="&clk")
  (
    &match=1
  )
  
  if (&match==1)
  (
    &clk_test=&CLK_TEST_LPAIF_TER_CLK_SRC
    &clk_reg=0
    &clk_reg_name="No CBCR"
    &clk_name="lpaif_ter_clk_src"
    &clk_reg_cbcr_type=""

    gosub Print_Clk_Info_Line
  )

  &match=0
  &wild_head=0
  &wild_tail=0
  &clk_input_length=STRING.LENGTH("&clk")
  &clk_itr_length=STRING.LENGTH("audio_core_lpaif_ter_ibit_clk")

  if (STRING.SCAN("&clk", "*", 0)==0)
  (
    &wild_head=1
  )
  if (STRING.SCAN("&clk", "*", 1)==(STRING.LENGTH("&clk")-1))
  (
    &wild_tail=1
  )

  if ((&wild_head==1)&&(&wild_tail==1))
  (
    if (STRING.SCAN("audio_core_lpaif_ter_ibit_clk", STRING.MID("&clk", 1, &clk_input_length-2), 0)!=-1)
    ( 
      &match=1
    )
  )
  else if (&wild_head==1)
  (
    if (STRING.MID("audio_core_lpaif_ter_ibit_clk", &clk_itr_length-&clk_input_length+1, &clk_input_length-1)==STRING.CUT("&clk", 1))
    ( 
      &match=1
    )
  )
  else if (&wild_tail==1)
  (
    if (STRING.MID("audio_core_lpaif_ter_ibit_clk", 0, &clk_input_length-1)==STRING.CUT("&clk", -1))
    ( 
      &match=1
    )
  )	  
  else if ("audio_core_lpaif_ter_ibit_clk"=="&clk")
  (
    &match=1
  )
  
  if (&match==1)
  (
    &clk_test=0
    &clk_reg=&HWIO_LPASS_AUDIO_CORE_LPAIF_TER_IBIT_CBCR_ADDR
    &clk_reg_name="LPASS_AUDIO_CORE_LPAIF_TER_IBIT_CBCR"
    &clk_name="audio_core_lpaif_ter_ibit_clk"
    &clk_reg_cbcr_type="sm_cbc"

    gosub Print_Clk_Info_Line
  )

  &match=0
  &wild_head=0
  &wild_tail=0
  &clk_input_length=STRING.LENGTH("&clk")
  &clk_itr_length=STRING.LENGTH("audio_core_lpaif_ter_osr_clk")

  if (STRING.SCAN("&clk", "*", 0)==0)
  (
    &wild_head=1
  )
  if (STRING.SCAN("&clk", "*", 1)==(STRING.LENGTH("&clk")-1))
  (
    &wild_tail=1
  )

  if ((&wild_head==1)&&(&wild_tail==1))
  (
    if (STRING.SCAN("audio_core_lpaif_ter_osr_clk", STRING.MID("&clk", 1, &clk_input_length-2), 0)!=-1)
    ( 
      &match=1
    )
  )
  else if (&wild_head==1)
  (
    if (STRING.MID("audio_core_lpaif_ter_osr_clk", &clk_itr_length-&clk_input_length+1, &clk_input_length-1)==STRING.CUT("&clk", 1))
    ( 
      &match=1
    )
  )
  else if (&wild_tail==1)
  (
    if (STRING.MID("audio_core_lpaif_ter_osr_clk", 0, &clk_input_length-1)==STRING.CUT("&clk", -1))
    ( 
      &match=1
    )
  )	  
  else if ("audio_core_lpaif_ter_osr_clk"=="&clk")
  (
    &match=1
  )
  
  if (&match==1)
  (
    &clk_test=0
    &clk_reg=&HWIO_LPASS_AUDIO_CORE_LPAIF_TER_OSR_CBCR_ADDR
    &clk_reg_name="LPASS_AUDIO_CORE_LPAIF_TER_OSR_CBCR"
    &clk_name="audio_core_lpaif_ter_osr_clk"
    &clk_reg_cbcr_type="sm_cbc"

    gosub Print_Clk_Info_Line
  )

  &match=0
  &wild_head=0
  &wild_tail=0
  &clk_input_length=STRING.LENGTH("&clk")
  &clk_itr_length=STRING.LENGTH("pri_mclk_clk_src")

  if (STRING.SCAN("&clk", "*", 0)==0)
  (
    &wild_head=1
  )
  if (STRING.SCAN("&clk", "*", 1)==(STRING.LENGTH("&clk")-1))
  (
    &wild_tail=1
  )

  if ((&wild_head==1)&&(&wild_tail==1))
  (
    if (STRING.SCAN("pri_mclk_clk_src", STRING.MID("&clk", 1, &clk_input_length-2), 0)!=-1)
    ( 
      &match=1
    )
  )
  else if (&wild_head==1)
  (
    if (STRING.MID("pri_mclk_clk_src", &clk_itr_length-&clk_input_length+1, &clk_input_length-1)==STRING.CUT("&clk", 1))
    ( 
      &match=1
    )
  )
  else if (&wild_tail==1)
  (
    if (STRING.MID("pri_mclk_clk_src", 0, &clk_input_length-1)==STRING.CUT("&clk", -1))
    ( 
      &match=1
    )
  )	  
  else if ("pri_mclk_clk_src"=="&clk")
  (
    &match=1
  )
  
  if (&match==1)
  (
    &clk_test=&CLK_TEST_PRI_MCLK_CLK_SRC
    &clk_reg=0
    &clk_reg_name="No CBCR"
    &clk_name="pri_mclk_clk_src"
    &clk_reg_cbcr_type=""

    gosub Print_Clk_Info_Line
  )

  &match=0
  &wild_head=0
  &wild_tail=0
  &clk_input_length=STRING.LENGTH("&clk")
  &clk_itr_length=STRING.LENGTH("audio_wrapper_pri_mclk_clk")

  if (STRING.SCAN("&clk", "*", 0)==0)
  (
    &wild_head=1
  )
  if (STRING.SCAN("&clk", "*", 1)==(STRING.LENGTH("&clk")-1))
  (
    &wild_tail=1
  )

  if ((&wild_head==1)&&(&wild_tail==1))
  (
    if (STRING.SCAN("audio_wrapper_pri_mclk_clk", STRING.MID("&clk", 1, &clk_input_length-2), 0)!=-1)
    ( 
      &match=1
    )
  )
  else if (&wild_head==1)
  (
    if (STRING.MID("audio_wrapper_pri_mclk_clk", &clk_itr_length-&clk_input_length+1, &clk_input_length-1)==STRING.CUT("&clk", 1))
    ( 
      &match=1
    )
  )
  else if (&wild_tail==1)
  (
    if (STRING.MID("audio_wrapper_pri_mclk_clk", 0, &clk_input_length-1)==STRING.CUT("&clk", -1))
    ( 
      &match=1
    )
  )	  
  else if ("audio_wrapper_pri_mclk_clk"=="&clk")
  (
    &match=1
  )
  
  if (&match==1)
  (
    &clk_test=&CLK_TEST_AUDIO_WRAPPER_PRI_MCLK_CLK
    &clk_reg=&HWIO_LPASS_AUDIO_WRAPPER_PRI_MCLK_CBCR_ADDR
    &clk_reg_name="LPASS_AUDIO_WRAPPER_PRI_MCLK_CBCR"
    &clk_name="audio_wrapper_pri_mclk_clk"
    &clk_reg_cbcr_type="sm_cbc"

    gosub Print_Clk_Info_Line
  )

  &match=0
  &wild_head=0
  &wild_tail=0
  &clk_input_length=STRING.LENGTH("&clk")
  &clk_itr_length=STRING.LENGTH("q6_spdm_clk_src")

  if (STRING.SCAN("&clk", "*", 0)==0)
  (
    &wild_head=1
  )
  if (STRING.SCAN("&clk", "*", 1)==(STRING.LENGTH("&clk")-1))
  (
    &wild_tail=1
  )

  if ((&wild_head==1)&&(&wild_tail==1))
  (
    if (STRING.SCAN("q6_spdm_clk_src", STRING.MID("&clk", 1, &clk_input_length-2), 0)!=-1)
    ( 
      &match=1
    )
  )
  else if (&wild_head==1)
  (
    if (STRING.MID("q6_spdm_clk_src", &clk_itr_length-&clk_input_length+1, &clk_input_length-1)==STRING.CUT("&clk", 1))
    ( 
      &match=1
    )
  )
  else if (&wild_tail==1)
  (
    if (STRING.MID("q6_spdm_clk_src", 0, &clk_input_length-1)==STRING.CUT("&clk", -1))
    ( 
      &match=1
    )
  )	  
  else if ("q6_spdm_clk_src"=="&clk")
  (
    &match=1
  )
  
  if (&match==1)
  (
    &clk_test=&CLK_TEST_Q6_SPDM_CLK_SRC
    &clk_reg=0
    &clk_reg_name="No CBCR"
    &clk_name="q6_spdm_clk_src"
    &clk_reg_cbcr_type=""

    gosub Print_Clk_Info_Line
  )

  &match=0
  &wild_head=0
  &wild_tail=0
  &clk_input_length=STRING.LENGTH("&clk")
  &clk_itr_length=STRING.LENGTH("q6_spdm_clk")

  if (STRING.SCAN("&clk", "*", 0)==0)
  (
    &wild_head=1
  )
  if (STRING.SCAN("&clk", "*", 1)==(STRING.LENGTH("&clk")-1))
  (
    &wild_tail=1
  )

  if ((&wild_head==1)&&(&wild_tail==1))
  (
    if (STRING.SCAN("q6_spdm_clk", STRING.MID("&clk", 1, &clk_input_length-2), 0)!=-1)
    ( 
      &match=1
    )
  )
  else if (&wild_head==1)
  (
    if (STRING.MID("q6_spdm_clk", &clk_itr_length-&clk_input_length+1, &clk_input_length-1)==STRING.CUT("&clk", 1))
    ( 
      &match=1
    )
  )
  else if (&wild_tail==1)
  (
    if (STRING.MID("q6_spdm_clk", 0, &clk_input_length-1)==STRING.CUT("&clk", -1))
    ( 
      &match=1
    )
  )	  
  else if ("q6_spdm_clk"=="&clk")
  (
    &match=1
  )
  
  if (&match==1)
  (
    &clk_test=&CLK_TEST_Q6_SPDM_CLK
    &clk_reg=&HWIO_LPASS_Q6_SPDM_CBCR_ADDR
    &clk_reg_name="LPASS_Q6_SPDM_CBCR"
    &clk_name="q6_spdm_clk"
    &clk_reg_cbcr_type="sm_cbc"

    gosub Print_Clk_Info_Line
  )

  &match=0
  &wild_head=0
  &wild_tail=0
  &clk_input_length=STRING.LENGTH("&clk")
  &clk_itr_length=STRING.LENGTH("q6ss_bcr_slp_clk_src")

  if (STRING.SCAN("&clk", "*", 0)==0)
  (
    &wild_head=1
  )
  if (STRING.SCAN("&clk", "*", 1)==(STRING.LENGTH("&clk")-1))
  (
    &wild_tail=1
  )

  if ((&wild_head==1)&&(&wild_tail==1))
  (
    if (STRING.SCAN("q6ss_bcr_slp_clk_src", STRING.MID("&clk", 1, &clk_input_length-2), 0)!=-1)
    ( 
      &match=1
    )
  )
  else if (&wild_head==1)
  (
    if (STRING.MID("q6ss_bcr_slp_clk_src", &clk_itr_length-&clk_input_length+1, &clk_input_length-1)==STRING.CUT("&clk", 1))
    ( 
      &match=1
    )
  )
  else if (&wild_tail==1)
  (
    if (STRING.MID("q6ss_bcr_slp_clk_src", 0, &clk_input_length-1)==STRING.CUT("&clk", -1))
    ( 
      &match=1
    )
  )	  
  else if ("q6ss_bcr_slp_clk_src"=="&clk")
  (
    &match=1
  )
  
  if (&match==1)
  (
    &clk_test=&CLK_TEST_Q6SS_BCR_SLP_CLK_SRC
    &clk_reg=0
    &clk_reg_name="No CBCR"
    &clk_name="q6ss_bcr_slp_clk_src"
    &clk_reg_cbcr_type=""

    gosub Print_Clk_Info_Line
  )

  &match=0
  &wild_head=0
  &wild_tail=0
  &clk_input_length=STRING.LENGTH("&clk")
  &clk_itr_length=STRING.LENGTH("audio_core_bcr_slp_clk")

  if (STRING.SCAN("&clk", "*", 0)==0)
  (
    &wild_head=1
  )
  if (STRING.SCAN("&clk", "*", 1)==(STRING.LENGTH("&clk")-1))
  (
    &wild_tail=1
  )

  if ((&wild_head==1)&&(&wild_tail==1))
  (
    if (STRING.SCAN("audio_core_bcr_slp_clk", STRING.MID("&clk", 1, &clk_input_length-2), 0)!=-1)
    ( 
      &match=1
    )
  )
  else if (&wild_head==1)
  (
    if (STRING.MID("audio_core_bcr_slp_clk", &clk_itr_length-&clk_input_length+1, &clk_input_length-1)==STRING.CUT("&clk", 1))
    ( 
      &match=1
    )
  )
  else if (&wild_tail==1)
  (
    if (STRING.MID("audio_core_bcr_slp_clk", 0, &clk_input_length-1)==STRING.CUT("&clk", -1))
    ( 
      &match=1
    )
  )	  
  else if ("audio_core_bcr_slp_clk"=="&clk")
  (
    &match=1
  )
  
  if (&match==1)
  (
    &clk_test=&CLK_TEST_AUDIO_CORE_BCR_SLP_CLK
    &clk_reg=&HWIO_LPASS_AUDIO_CORE_BCR_SLP_CBCR_ADDR
    &clk_reg_name="LPASS_AUDIO_CORE_BCR_SLP_CBCR"
    &clk_name="audio_core_bcr_slp_clk"
    &clk_reg_cbcr_type="sm_cbc"

    gosub Print_Clk_Info_Line
  )

  &match=0
  &wild_head=0
  &wild_tail=0
  &clk_input_length=STRING.LENGTH("&clk")
  &clk_itr_length=STRING.LENGTH("q6ss_bcr_slp_clk")

  if (STRING.SCAN("&clk", "*", 0)==0)
  (
    &wild_head=1
  )
  if (STRING.SCAN("&clk", "*", 1)==(STRING.LENGTH("&clk")-1))
  (
    &wild_tail=1
  )

  if ((&wild_head==1)&&(&wild_tail==1))
  (
    if (STRING.SCAN("q6ss_bcr_slp_clk", STRING.MID("&clk", 1, &clk_input_length-2), 0)!=-1)
    ( 
      &match=1
    )
  )
  else if (&wild_head==1)
  (
    if (STRING.MID("q6ss_bcr_slp_clk", &clk_itr_length-&clk_input_length+1, &clk_input_length-1)==STRING.CUT("&clk", 1))
    ( 
      &match=1
    )
  )
  else if (&wild_tail==1)
  (
    if (STRING.MID("q6ss_bcr_slp_clk", 0, &clk_input_length-1)==STRING.CUT("&clk", -1))
    ( 
      &match=1
    )
  )	  
  else if ("q6ss_bcr_slp_clk"=="&clk")
  (
    &match=1
  )
  
  if (&match==1)
  (
    &clk_test=&CLK_TEST_Q6SS_BCR_SLP_CLK
    &clk_reg=&HWIO_LPASS_Q6SS_BCR_SLP_CBCR_ADDR
    &clk_reg_name="LPASS_Q6SS_BCR_SLP_CBCR"
    &clk_name="q6ss_bcr_slp_clk"
    &clk_reg_cbcr_type="sm_cbc"

    gosub Print_Clk_Info_Line
  )

  &match=0
  &wild_head=0
  &wild_tail=0
  &clk_input_length=STRING.LENGTH("&clk")
  &clk_itr_length=STRING.LENGTH("q6_xo_clk_src")

  if (STRING.SCAN("&clk", "*", 0)==0)
  (
    &wild_head=1
  )
  if (STRING.SCAN("&clk", "*", 1)==(STRING.LENGTH("&clk")-1))
  (
    &wild_tail=1
  )

  if ((&wild_head==1)&&(&wild_tail==1))
  (
    if (STRING.SCAN("q6_xo_clk_src", STRING.MID("&clk", 1, &clk_input_length-2), 0)!=-1)
    ( 
      &match=1
    )
  )
  else if (&wild_head==1)
  (
    if (STRING.MID("q6_xo_clk_src", &clk_itr_length-&clk_input_length+1, &clk_input_length-1)==STRING.CUT("&clk", 1))
    ( 
      &match=1
    )
  )
  else if (&wild_tail==1)
  (
    if (STRING.MID("q6_xo_clk_src", 0, &clk_input_length-1)==STRING.CUT("&clk", -1))
    ( 
      &match=1
    )
  )	  
  else if ("q6_xo_clk_src"=="&clk")
  (
    &match=1
  )
  
  if (&match==1)
  (
    &clk_test=&CLK_TEST_Q6_XO_CLK_SRC
    &clk_reg=0
    &clk_reg_name="No CBCR"
    &clk_name="q6_xo_clk_src"
    &clk_reg_cbcr_type=""

    gosub Print_Clk_Info_Line
  )

  &match=0
  &wild_head=0
  &wild_tail=0
  &clk_input_length=STRING.LENGTH("&clk")
  &clk_itr_length=STRING.LENGTH("q6ss_xo_clk")

  if (STRING.SCAN("&clk", "*", 0)==0)
  (
    &wild_head=1
  )
  if (STRING.SCAN("&clk", "*", 1)==(STRING.LENGTH("&clk")-1))
  (
    &wild_tail=1
  )

  if ((&wild_head==1)&&(&wild_tail==1))
  (
    if (STRING.SCAN("q6ss_xo_clk", STRING.MID("&clk", 1, &clk_input_length-2), 0)!=-1)
    ( 
      &match=1
    )
  )
  else if (&wild_head==1)
  (
    if (STRING.MID("q6ss_xo_clk", &clk_itr_length-&clk_input_length+1, &clk_input_length-1)==STRING.CUT("&clk", 1))
    ( 
      &match=1
    )
  )
  else if (&wild_tail==1)
  (
    if (STRING.MID("q6ss_xo_clk", 0, &clk_input_length-1)==STRING.CUT("&clk", -1))
    ( 
      &match=1
    )
  )	  
  else if ("q6ss_xo_clk"=="&clk")
  (
    &match=1
  )
  
  if (&match==1)
  (
    &clk_test=0
    &clk_reg=&HWIO_LPASS_Q6SS_XO_CBCR_ADDR
    &clk_reg_name="LPASS_Q6SS_XO_CBCR"
    &clk_name="q6ss_xo_clk"
    &clk_reg_cbcr_type="sm_cbc"

    gosub Print_Clk_Info_Line
  )

  &match=0
  &wild_head=0
  &wild_tail=0
  &clk_input_length=STRING.LENGTH("&clk")
  &clk_itr_length=STRING.LENGTH("quad_mclk_clk_src")

  if (STRING.SCAN("&clk", "*", 0)==0)
  (
    &wild_head=1
  )
  if (STRING.SCAN("&clk", "*", 1)==(STRING.LENGTH("&clk")-1))
  (
    &wild_tail=1
  )

  if ((&wild_head==1)&&(&wild_tail==1))
  (
    if (STRING.SCAN("quad_mclk_clk_src", STRING.MID("&clk", 1, &clk_input_length-2), 0)!=-1)
    ( 
      &match=1
    )
  )
  else if (&wild_head==1)
  (
    if (STRING.MID("quad_mclk_clk_src", &clk_itr_length-&clk_input_length+1, &clk_input_length-1)==STRING.CUT("&clk", 1))
    ( 
      &match=1
    )
  )
  else if (&wild_tail==1)
  (
    if (STRING.MID("quad_mclk_clk_src", 0, &clk_input_length-1)==STRING.CUT("&clk", -1))
    ( 
      &match=1
    )
  )	  
  else if ("quad_mclk_clk_src"=="&clk")
  (
    &match=1
  )
  
  if (&match==1)
  (
    &clk_test=&CLK_TEST_QUAD_MCLK_CLK_SRC
    &clk_reg=0
    &clk_reg_name="No CBCR"
    &clk_name="quad_mclk_clk_src"
    &clk_reg_cbcr_type=""

    gosub Print_Clk_Info_Line
  )

  &match=0
  &wild_head=0
  &wild_tail=0
  &clk_input_length=STRING.LENGTH("&clk")
  &clk_itr_length=STRING.LENGTH("audio_wrapper_quad_mclk_clk")

  if (STRING.SCAN("&clk", "*", 0)==0)
  (
    &wild_head=1
  )
  if (STRING.SCAN("&clk", "*", 1)==(STRING.LENGTH("&clk")-1))
  (
    &wild_tail=1
  )

  if ((&wild_head==1)&&(&wild_tail==1))
  (
    if (STRING.SCAN("audio_wrapper_quad_mclk_clk", STRING.MID("&clk", 1, &clk_input_length-2), 0)!=-1)
    ( 
      &match=1
    )
  )
  else if (&wild_head==1)
  (
    if (STRING.MID("audio_wrapper_quad_mclk_clk", &clk_itr_length-&clk_input_length+1, &clk_input_length-1)==STRING.CUT("&clk", 1))
    ( 
      &match=1
    )
  )
  else if (&wild_tail==1)
  (
    if (STRING.MID("audio_wrapper_quad_mclk_clk", 0, &clk_input_length-1)==STRING.CUT("&clk", -1))
    ( 
      &match=1
    )
  )	  
  else if ("audio_wrapper_quad_mclk_clk"=="&clk")
  (
    &match=1
  )
  
  if (&match==1)
  (
    &clk_test=&CLK_TEST_AUDIO_WRAPPER_QUAD_MCLK_CLK
    &clk_reg=&HWIO_LPASS_AUDIO_WRAPPER_QUAD_MCLK_CBCR_ADDR
    &clk_reg_name="LPASS_AUDIO_WRAPPER_QUAD_MCLK_CBCR"
    &clk_name="audio_wrapper_quad_mclk_clk"
    &clk_reg_cbcr_type="sm_cbc"

    gosub Print_Clk_Info_Line
  )

  &match=0
  &wild_head=0
  &wild_tail=0
  &clk_input_length=STRING.LENGTH("&clk")
  &clk_itr_length=STRING.LENGTH("resampler_clk_src")

  if (STRING.SCAN("&clk", "*", 0)==0)
  (
    &wild_head=1
  )
  if (STRING.SCAN("&clk", "*", 1)==(STRING.LENGTH("&clk")-1))
  (
    &wild_tail=1
  )

  if ((&wild_head==1)&&(&wild_tail==1))
  (
    if (STRING.SCAN("resampler_clk_src", STRING.MID("&clk", 1, &clk_input_length-2), 0)!=-1)
    ( 
      &match=1
    )
  )
  else if (&wild_head==1)
  (
    if (STRING.MID("resampler_clk_src", &clk_itr_length-&clk_input_length+1, &clk_input_length-1)==STRING.CUT("&clk", 1))
    ( 
      &match=1
    )
  )
  else if (&wild_tail==1)
  (
    if (STRING.MID("resampler_clk_src", 0, &clk_input_length-1)==STRING.CUT("&clk", -1))
    ( 
      &match=1
    )
  )	  
  else if ("resampler_clk_src"=="&clk")
  (
    &match=1
  )
  
  if (&match==1)
  (
    &clk_test=&CLK_TEST_RESAMPLER_CLK_SRC
    &clk_reg=0
    &clk_reg_name="No CBCR"
    &clk_name="resampler_clk_src"
    &clk_reg_cbcr_type=""

    gosub Print_Clk_Info_Line
  )

  &match=0
  &wild_head=0
  &wild_tail=0
  &clk_input_length=STRING.LENGTH("&clk")
  &clk_itr_length=STRING.LENGTH("audio_core_resampler_core_clk")

  if (STRING.SCAN("&clk", "*", 0)==0)
  (
    &wild_head=1
  )
  if (STRING.SCAN("&clk", "*", 1)==(STRING.LENGTH("&clk")-1))
  (
    &wild_tail=1
  )

  if ((&wild_head==1)&&(&wild_tail==1))
  (
    if (STRING.SCAN("audio_core_resampler_core_clk", STRING.MID("&clk", 1, &clk_input_length-2), 0)!=-1)
    ( 
      &match=1
    )
  )
  else if (&wild_head==1)
  (
    if (STRING.MID("audio_core_resampler_core_clk", &clk_itr_length-&clk_input_length+1, &clk_input_length-1)==STRING.CUT("&clk", 1))
    ( 
      &match=1
    )
  )
  else if (&wild_tail==1)
  (
    if (STRING.MID("audio_core_resampler_core_clk", 0, &clk_input_length-1)==STRING.CUT("&clk", -1))
    ( 
      &match=1
    )
  )	  
  else if ("audio_core_resampler_core_clk"=="&clk")
  (
    &match=1
  )
  
  if (&match==1)
  (
    &clk_test=&CLK_TEST_AUDIO_CORE_RESAMPLER_CORE_CLK
    &clk_reg=&HWIO_LPASS_AUDIO_CORE_RESAMPLER_CORE_CBCR_ADDR
    &clk_reg_name="LPASS_AUDIO_CORE_RESAMPLER_CORE_CBCR"
    &clk_name="audio_core_resampler_core_clk"
    &clk_reg_cbcr_type="sm_pscbc"

    gosub Print_Clk_Info_Line
  )

  &match=0
  &wild_head=0
  &wild_tail=0
  &clk_input_length=STRING.LENGTH("&clk")
  &clk_itr_length=STRING.LENGTH("sec_mclk_clk_src")

  if (STRING.SCAN("&clk", "*", 0)==0)
  (
    &wild_head=1
  )
  if (STRING.SCAN("&clk", "*", 1)==(STRING.LENGTH("&clk")-1))
  (
    &wild_tail=1
  )

  if ((&wild_head==1)&&(&wild_tail==1))
  (
    if (STRING.SCAN("sec_mclk_clk_src", STRING.MID("&clk", 1, &clk_input_length-2), 0)!=-1)
    ( 
      &match=1
    )
  )
  else if (&wild_head==1)
  (
    if (STRING.MID("sec_mclk_clk_src", &clk_itr_length-&clk_input_length+1, &clk_input_length-1)==STRING.CUT("&clk", 1))
    ( 
      &match=1
    )
  )
  else if (&wild_tail==1)
  (
    if (STRING.MID("sec_mclk_clk_src", 0, &clk_input_length-1)==STRING.CUT("&clk", -1))
    ( 
      &match=1
    )
  )	  
  else if ("sec_mclk_clk_src"=="&clk")
  (
    &match=1
  )
  
  if (&match==1)
  (
    &clk_test=&CLK_TEST_SEC_MCLK_CLK_SRC
    &clk_reg=0
    &clk_reg_name="No CBCR"
    &clk_name="sec_mclk_clk_src"
    &clk_reg_cbcr_type=""

    gosub Print_Clk_Info_Line
  )

  &match=0
  &wild_head=0
  &wild_tail=0
  &clk_input_length=STRING.LENGTH("&clk")
  &clk_itr_length=STRING.LENGTH("audio_wrapper_sec_mclk_clk")

  if (STRING.SCAN("&clk", "*", 0)==0)
  (
    &wild_head=1
  )
  if (STRING.SCAN("&clk", "*", 1)==(STRING.LENGTH("&clk")-1))
  (
    &wild_tail=1
  )

  if ((&wild_head==1)&&(&wild_tail==1))
  (
    if (STRING.SCAN("audio_wrapper_sec_mclk_clk", STRING.MID("&clk", 1, &clk_input_length-2), 0)!=-1)
    ( 
      &match=1
    )
  )
  else if (&wild_head==1)
  (
    if (STRING.MID("audio_wrapper_sec_mclk_clk", &clk_itr_length-&clk_input_length+1, &clk_input_length-1)==STRING.CUT("&clk", 1))
    ( 
      &match=1
    )
  )
  else if (&wild_tail==1)
  (
    if (STRING.MID("audio_wrapper_sec_mclk_clk", 0, &clk_input_length-1)==STRING.CUT("&clk", -1))
    ( 
      &match=1
    )
  )	  
  else if ("audio_wrapper_sec_mclk_clk"=="&clk")
  (
    &match=1
  )
  
  if (&match==1)
  (
    &clk_test=&CLK_TEST_AUDIO_WRAPPER_SEC_MCLK_CLK
    &clk_reg=&HWIO_LPASS_AUDIO_WRAPPER_SEC_MCLK_CBCR_ADDR
    &clk_reg_name="LPASS_AUDIO_WRAPPER_SEC_MCLK_CBCR"
    &clk_name="audio_wrapper_sec_mclk_clk"
    &clk_reg_cbcr_type="sm_cbc"

    gosub Print_Clk_Info_Line
  )

  &match=0
  &wild_head=0
  &wild_tail=0
  &clk_input_length=STRING.LENGTH("&clk")
  &clk_itr_length=STRING.LENGTH("sleep_clk_src")

  if (STRING.SCAN("&clk", "*", 0)==0)
  (
    &wild_head=1
  )
  if (STRING.SCAN("&clk", "*", 1)==(STRING.LENGTH("&clk")-1))
  (
    &wild_tail=1
  )

  if ((&wild_head==1)&&(&wild_tail==1))
  (
    if (STRING.SCAN("sleep_clk_src", STRING.MID("&clk", 1, &clk_input_length-2), 0)!=-1)
    ( 
      &match=1
    )
  )
  else if (&wild_head==1)
  (
    if (STRING.MID("sleep_clk_src", &clk_itr_length-&clk_input_length+1, &clk_input_length-1)==STRING.CUT("&clk", 1))
    ( 
      &match=1
    )
  )
  else if (&wild_tail==1)
  (
    if (STRING.MID("sleep_clk_src", 0, &clk_input_length-1)==STRING.CUT("&clk", -1))
    ( 
      &match=1
    )
  )	  
  else if ("sleep_clk_src"=="&clk")
  (
    &match=1
  )
  
  if (&match==1)
  (
    &clk_test=&CLK_TEST_SLEEP_CLK_SRC
    &clk_reg=0
    &clk_reg_name="No CBCR"
    &clk_name="sleep_clk_src"
    &clk_reg_cbcr_type=""

    gosub Print_Clk_Info_Line
  )

  &match=0
  &wild_head=0
  &wild_tail=0
  &clk_input_length=STRING.LENGTH("&clk")
  &clk_itr_length=STRING.LENGTH("q6ss_slp_clk")

  if (STRING.SCAN("&clk", "*", 0)==0)
  (
    &wild_head=1
  )
  if (STRING.SCAN("&clk", "*", 1)==(STRING.LENGTH("&clk")-1))
  (
    &wild_tail=1
  )

  if ((&wild_head==1)&&(&wild_tail==1))
  (
    if (STRING.SCAN("q6ss_slp_clk", STRING.MID("&clk", 1, &clk_input_length-2), 0)!=-1)
    ( 
      &match=1
    )
  )
  else if (&wild_head==1)
  (
    if (STRING.MID("q6ss_slp_clk", &clk_itr_length-&clk_input_length+1, &clk_input_length-1)==STRING.CUT("&clk", 1))
    ( 
      &match=1
    )
  )
  else if (&wild_tail==1)
  (
    if (STRING.MID("q6ss_slp_clk", 0, &clk_input_length-1)==STRING.CUT("&clk", -1))
    ( 
      &match=1
    )
  )	  
  else if ("q6ss_slp_clk"=="&clk")
  (
    &match=1
  )
  
  if (&match==1)
  (
    &clk_test=0
    &clk_reg=&HWIO_LPASS_Q6SS_SLP_CBCR_ADDR
    &clk_reg_name="LPASS_Q6SS_SLP_CBCR"
    &clk_name="q6ss_slp_clk"
    &clk_reg_cbcr_type="sm_cbc"

    gosub Print_Clk_Info_Line
  )

  &match=0
  &wild_head=0
  &wild_tail=0
  &clk_input_length=STRING.LENGTH("&clk")
  &clk_itr_length=STRING.LENGTH("slimbus_clk_src")

  if (STRING.SCAN("&clk", "*", 0)==0)
  (
    &wild_head=1
  )
  if (STRING.SCAN("&clk", "*", 1)==(STRING.LENGTH("&clk")-1))
  (
    &wild_tail=1
  )

  if ((&wild_head==1)&&(&wild_tail==1))
  (
    if (STRING.SCAN("slimbus_clk_src", STRING.MID("&clk", 1, &clk_input_length-2), 0)!=-1)
    ( 
      &match=1
    )
  )
  else if (&wild_head==1)
  (
    if (STRING.MID("slimbus_clk_src", &clk_itr_length-&clk_input_length+1, &clk_input_length-1)==STRING.CUT("&clk", 1))
    ( 
      &match=1
    )
  )
  else if (&wild_tail==1)
  (
    if (STRING.MID("slimbus_clk_src", 0, &clk_input_length-1)==STRING.CUT("&clk", -1))
    ( 
      &match=1
    )
  )	  
  else if ("slimbus_clk_src"=="&clk")
  (
    &match=1
  )
  
  if (&match==1)
  (
    &clk_test=&CLK_TEST_SLIMBUS_CLK_SRC
    &clk_reg=0
    &clk_reg_name="No CBCR"
    &clk_name="slimbus_clk_src"
    &clk_reg_cbcr_type=""

    gosub Print_Clk_Info_Line
  )

  &match=0
  &wild_head=0
  &wild_tail=0
  &clk_input_length=STRING.LENGTH("&clk")
  &clk_itr_length=STRING.LENGTH("audio_core_slimbus_core_clk")

  if (STRING.SCAN("&clk", "*", 0)==0)
  (
    &wild_head=1
  )
  if (STRING.SCAN("&clk", "*", 1)==(STRING.LENGTH("&clk")-1))
  (
    &wild_tail=1
  )

  if ((&wild_head==1)&&(&wild_tail==1))
  (
    if (STRING.SCAN("audio_core_slimbus_core_clk", STRING.MID("&clk", 1, &clk_input_length-2), 0)!=-1)
    ( 
      &match=1
    )
  )
  else if (&wild_head==1)
  (
    if (STRING.MID("audio_core_slimbus_core_clk", &clk_itr_length-&clk_input_length+1, &clk_input_length-1)==STRING.CUT("&clk", 1))
    ( 
      &match=1
    )
  )
  else if (&wild_tail==1)
  (
    if (STRING.MID("audio_core_slimbus_core_clk", 0, &clk_input_length-1)==STRING.CUT("&clk", -1))
    ( 
      &match=1
    )
  )	  
  else if ("audio_core_slimbus_core_clk"=="&clk")
  (
    &match=1
  )
  
  if (&match==1)
  (
    &clk_test=&CLK_TEST_AUDIO_CORE_SLIMBUS_CORE_CLK
    &clk_reg=&HWIO_LPASS_AUDIO_CORE_SLIMBUS_CORE_CBCR_ADDR
    &clk_reg_name="LPASS_AUDIO_CORE_SLIMBUS_CORE_CBCR"
    &clk_name="audio_core_slimbus_core_clk"
    &clk_reg_cbcr_type="sm_cbc"

    gosub Print_Clk_Info_Line
  )

  &match=0
  &wild_head=0
  &wild_tail=0
  &clk_input_length=STRING.LENGTH("&clk")
  &clk_itr_length=STRING.LENGTH("slimbus2_clk_src")

  if (STRING.SCAN("&clk", "*", 0)==0)
  (
    &wild_head=1
  )
  if (STRING.SCAN("&clk", "*", 1)==(STRING.LENGTH("&clk")-1))
  (
    &wild_tail=1
  )

  if ((&wild_head==1)&&(&wild_tail==1))
  (
    if (STRING.SCAN("slimbus2_clk_src", STRING.MID("&clk", 1, &clk_input_length-2), 0)!=-1)
    ( 
      &match=1
    )
  )
  else if (&wild_head==1)
  (
    if (STRING.MID("slimbus2_clk_src", &clk_itr_length-&clk_input_length+1, &clk_input_length-1)==STRING.CUT("&clk", 1))
    ( 
      &match=1
    )
  )
  else if (&wild_tail==1)
  (
    if (STRING.MID("slimbus2_clk_src", 0, &clk_input_length-1)==STRING.CUT("&clk", -1))
    ( 
      &match=1
    )
  )	  
  else if ("slimbus2_clk_src"=="&clk")
  (
    &match=1
  )
  
  if (&match==1)
  (
    &clk_test=&CLK_TEST_SLIMBUS2_CLK_SRC
    &clk_reg=0
    &clk_reg_name="No CBCR"
    &clk_name="slimbus2_clk_src"
    &clk_reg_cbcr_type=""

    gosub Print_Clk_Info_Line
  )

  &match=0
  &wild_head=0
  &wild_tail=0
  &clk_input_length=STRING.LENGTH("&clk")
  &clk_itr_length=STRING.LENGTH("audio_core_slimbus2_core_clk")

  if (STRING.SCAN("&clk", "*", 0)==0)
  (
    &wild_head=1
  )
  if (STRING.SCAN("&clk", "*", 1)==(STRING.LENGTH("&clk")-1))
  (
    &wild_tail=1
  )

  if ((&wild_head==1)&&(&wild_tail==1))
  (
    if (STRING.SCAN("audio_core_slimbus2_core_clk", STRING.MID("&clk", 1, &clk_input_length-2), 0)!=-1)
    ( 
      &match=1
    )
  )
  else if (&wild_head==1)
  (
    if (STRING.MID("audio_core_slimbus2_core_clk", &clk_itr_length-&clk_input_length+1, &clk_input_length-1)==STRING.CUT("&clk", 1))
    ( 
      &match=1
    )
  )
  else if (&wild_tail==1)
  (
    if (STRING.MID("audio_core_slimbus2_core_clk", 0, &clk_input_length-1)==STRING.CUT("&clk", -1))
    ( 
      &match=1
    )
  )	  
  else if ("audio_core_slimbus2_core_clk"=="&clk")
  (
    &match=1
  )
  
  if (&match==1)
  (
    &clk_test=&CLK_TEST_AUDIO_CORE_SLIMBUS2_CORE_CLK
    &clk_reg=&HWIO_LPASS_AUDIO_CORE_SLIMBUS2_CORE_CBCR_ADDR
    &clk_reg_name="LPASS_AUDIO_CORE_SLIMBUS2_CORE_CBCR"
    &clk_name="audio_core_slimbus2_core_clk"
    &clk_reg_cbcr_type="sm_cbc"

    gosub Print_Clk_Info_Line
  )

  &match=0
  &wild_head=0
  &wild_tail=0
  &clk_input_length=STRING.LENGTH("&clk")
  &clk_itr_length=STRING.LENGTH("stm_xo_clk_src")

  if (STRING.SCAN("&clk", "*", 0)==0)
  (
    &wild_head=1
  )
  if (STRING.SCAN("&clk", "*", 1)==(STRING.LENGTH("&clk")-1))
  (
    &wild_tail=1
  )

  if ((&wild_head==1)&&(&wild_tail==1))
  (
    if (STRING.SCAN("stm_xo_clk_src", STRING.MID("&clk", 1, &clk_input_length-2), 0)!=-1)
    ( 
      &match=1
    )
  )
  else if (&wild_head==1)
  (
    if (STRING.MID("stm_xo_clk_src", &clk_itr_length-&clk_input_length+1, &clk_input_length-1)==STRING.CUT("&clk", 1))
    ( 
      &match=1
    )
  )
  else if (&wild_tail==1)
  (
    if (STRING.MID("stm_xo_clk_src", 0, &clk_input_length-1)==STRING.CUT("&clk", -1))
    ( 
      &match=1
    )
  )	  
  else if ("stm_xo_clk_src"=="&clk")
  (
    &match=1
  )
  
  if (&match==1)
  (
    &clk_test=&CLK_TEST_STM_XO_CLK_SRC
    &clk_reg=0
    &clk_reg_name="No CBCR"
    &clk_name="stm_xo_clk_src"
    &clk_reg_cbcr_type=""

    gosub Print_Clk_Info_Line
  )

  &match=0
  &wild_head=0
  &wild_tail=0
  &clk_input_length=STRING.LENGTH("&clk")
  &clk_itr_length=STRING.LENGTH("audio_wrapper_stm_xo_clk")

  if (STRING.SCAN("&clk", "*", 0)==0)
  (
    &wild_head=1
  )
  if (STRING.SCAN("&clk", "*", 1)==(STRING.LENGTH("&clk")-1))
  (
    &wild_tail=1
  )

  if ((&wild_head==1)&&(&wild_tail==1))
  (
    if (STRING.SCAN("audio_wrapper_stm_xo_clk", STRING.MID("&clk", 1, &clk_input_length-2), 0)!=-1)
    ( 
      &match=1
    )
  )
  else if (&wild_head==1)
  (
    if (STRING.MID("audio_wrapper_stm_xo_clk", &clk_itr_length-&clk_input_length+1, &clk_input_length-1)==STRING.CUT("&clk", 1))
    ( 
      &match=1
    )
  )
  else if (&wild_tail==1)
  (
    if (STRING.MID("audio_wrapper_stm_xo_clk", 0, &clk_input_length-1)==STRING.CUT("&clk", -1))
    ( 
      &match=1
    )
  )	  
  else if ("audio_wrapper_stm_xo_clk"=="&clk")
  (
    &match=1
  )
  
  if (&match==1)
  (
    &clk_test=0
    &clk_reg=&HWIO_LPASS_AUDIO_WRAPPER_STM_XO_CBCR_ADDR
    &clk_reg_name="LPASS_AUDIO_WRAPPER_STM_XO_CBCR"
    &clk_name="audio_wrapper_stm_xo_clk"
    &clk_reg_cbcr_type="sm_cbc"

    gosub Print_Clk_Info_Line
  )

  &match=0
  &wild_head=0
  &wild_tail=0
  &clk_input_length=STRING.LENGTH("&clk")
  &clk_itr_length=STRING.LENGTH("ter_mclk_clk_src")

  if (STRING.SCAN("&clk", "*", 0)==0)
  (
    &wild_head=1
  )
  if (STRING.SCAN("&clk", "*", 1)==(STRING.LENGTH("&clk")-1))
  (
    &wild_tail=1
  )

  if ((&wild_head==1)&&(&wild_tail==1))
  (
    if (STRING.SCAN("ter_mclk_clk_src", STRING.MID("&clk", 1, &clk_input_length-2), 0)!=-1)
    ( 
      &match=1
    )
  )
  else if (&wild_head==1)
  (
    if (STRING.MID("ter_mclk_clk_src", &clk_itr_length-&clk_input_length+1, &clk_input_length-1)==STRING.CUT("&clk", 1))
    ( 
      &match=1
    )
  )
  else if (&wild_tail==1)
  (
    if (STRING.MID("ter_mclk_clk_src", 0, &clk_input_length-1)==STRING.CUT("&clk", -1))
    ( 
      &match=1
    )
  )	  
  else if ("ter_mclk_clk_src"=="&clk")
  (
    &match=1
  )
  
  if (&match==1)
  (
    &clk_test=&CLK_TEST_TER_MCLK_CLK_SRC
    &clk_reg=0
    &clk_reg_name="No CBCR"
    &clk_name="ter_mclk_clk_src"
    &clk_reg_cbcr_type=""

    gosub Print_Clk_Info_Line
  )

  &match=0
  &wild_head=0
  &wild_tail=0
  &clk_input_length=STRING.LENGTH("&clk")
  &clk_itr_length=STRING.LENGTH("audio_wrapper_ter_mclk_clk")

  if (STRING.SCAN("&clk", "*", 0)==0)
  (
    &wild_head=1
  )
  if (STRING.SCAN("&clk", "*", 1)==(STRING.LENGTH("&clk")-1))
  (
    &wild_tail=1
  )

  if ((&wild_head==1)&&(&wild_tail==1))
  (
    if (STRING.SCAN("audio_wrapper_ter_mclk_clk", STRING.MID("&clk", 1, &clk_input_length-2), 0)!=-1)
    ( 
      &match=1
    )
  )
  else if (&wild_head==1)
  (
    if (STRING.MID("audio_wrapper_ter_mclk_clk", &clk_itr_length-&clk_input_length+1, &clk_input_length-1)==STRING.CUT("&clk", 1))
    ( 
      &match=1
    )
  )
  else if (&wild_tail==1)
  (
    if (STRING.MID("audio_wrapper_ter_mclk_clk", 0, &clk_input_length-1)==STRING.CUT("&clk", -1))
    ( 
      &match=1
    )
  )	  
  else if ("audio_wrapper_ter_mclk_clk"=="&clk")
  (
    &match=1
  )
  
  if (&match==1)
  (
    &clk_test=&CLK_TEST_AUDIO_WRAPPER_TER_MCLK_CLK
    &clk_reg=&HWIO_LPASS_AUDIO_WRAPPER_TER_MCLK_CBCR_ADDR
    &clk_reg_name="LPASS_AUDIO_WRAPPER_TER_MCLK_CBCR"
    &clk_name="audio_wrapper_ter_mclk_clk"
    &clk_reg_cbcr_type="sm_cbc"

    gosub Print_Clk_Info_Line
  )

  &match=0
  &wild_head=0
  &wild_tail=0
  &clk_input_length=STRING.LENGTH("&clk")
  &clk_itr_length=STRING.LENGTH("lpass_qdsp6ss_q6_core_clk")

  if (STRING.SCAN("&clk", "*", 0)==0)
  (
    &wild_head=1
  )
  if (STRING.SCAN("&clk", "*", 1)==(STRING.LENGTH("&clk")-1))
  (
    &wild_tail=1
  )

  if ((&wild_head==1)&&(&wild_tail==1))
  (
    if (STRING.SCAN("lpass_qdsp6ss_q6_core_clk", STRING.MID("&clk", 1, &clk_input_length-2), 0)!=-1)
    ( 
      &match=1
    )
  )
  else if (&wild_head==1)
  (
    if (STRING.MID("lpass_qdsp6ss_q6_core_clk", &clk_itr_length-&clk_input_length+1, &clk_input_length-1)==STRING.CUT("&clk", 1))
    ( 
      &match=1
    )
  )
  else if (&wild_tail==1)
  (
    if (STRING.MID("lpass_qdsp6ss_q6_core_clk", 0, &clk_input_length-1)==STRING.CUT("&clk", -1))
    ( 
      &match=1
    )
  )	  
  else if ("lpass_qdsp6ss_q6_core_clk"=="&clk")
  (
    &match=1
  )
  
  if (&match==1)
  (
    &clk_test=&CLK_TEST_LPASS_QDSP6SS_Q6_CORE_CLK
    &clk_reg=0
    &clk_reg_name="No CBCR"
    &clk_name="lpass_qdsp6ss_q6_core_clk"
    &clk_reg_cbcr_type=""

    gosub Print_Clk_Info_Line
  )

  &match=0
  &wild_head=0
  &wild_tail=0
  &clk_input_length=STRING.LENGTH("&clk")
  &clk_itr_length=STRING.LENGTH("lpass_qdsp6ss_axi_m_clk")

  if (STRING.SCAN("&clk", "*", 0)==0)
  (
    &wild_head=1
  )
  if (STRING.SCAN("&clk", "*", 1)==(STRING.LENGTH("&clk")-1))
  (
    &wild_tail=1
  )

  if ((&wild_head==1)&&(&wild_tail==1))
  (
    if (STRING.SCAN("lpass_qdsp6ss_axi_m_clk", STRING.MID("&clk", 1, &clk_input_length-2), 0)!=-1)
    ( 
      &match=1
    )
  )
  else if (&wild_head==1)
  (
    if (STRING.MID("lpass_qdsp6ss_axi_m_clk", &clk_itr_length-&clk_input_length+1, &clk_input_length-1)==STRING.CUT("&clk", 1))
    ( 
      &match=1
    )
  )
  else if (&wild_tail==1)
  (
    if (STRING.MID("lpass_qdsp6ss_axi_m_clk", 0, &clk_input_length-1)==STRING.CUT("&clk", -1))
    ( 
      &match=1
    )
  )	  
  else if ("lpass_qdsp6ss_axi_m_clk"=="&clk")
  (
    &match=1
  )
  
  if (&match==1)
  (
    &clk_test=&CLK_TEST_LPASS_QDSP6SS_AXI_M_CLK
    &clk_reg=0
    &clk_reg_name="No CBCR"
    &clk_name="lpass_qdsp6ss_axi_m_clk"
    &clk_reg_cbcr_type=""

    gosub Print_Clk_Info_Line
  )

  &match=0
  &wild_head=0
  &wild_tail=0
  &clk_input_length=STRING.LENGTH("&clk")
  &clk_itr_length=STRING.LENGTH("lpass_qdsp6ss_ldo_nmo_out")

  if (STRING.SCAN("&clk", "*", 0)==0)
  (
    &wild_head=1
  )
  if (STRING.SCAN("&clk", "*", 1)==(STRING.LENGTH("&clk")-1))
  (
    &wild_tail=1
  )

  if ((&wild_head==1)&&(&wild_tail==1))
  (
    if (STRING.SCAN("lpass_qdsp6ss_ldo_nmo_out", STRING.MID("&clk", 1, &clk_input_length-2), 0)!=-1)
    ( 
      &match=1
    )
  )
  else if (&wild_head==1)
  (
    if (STRING.MID("lpass_qdsp6ss_ldo_nmo_out", &clk_itr_length-&clk_input_length+1, &clk_input_length-1)==STRING.CUT("&clk", 1))
    ( 
      &match=1
    )
  )
  else if (&wild_tail==1)
  (
    if (STRING.MID("lpass_qdsp6ss_ldo_nmo_out", 0, &clk_input_length-1)==STRING.CUT("&clk", -1))
    ( 
      &match=1
    )
  )	  
  else if ("lpass_qdsp6ss_ldo_nmo_out"=="&clk")
  (
    &match=1
  )
  
  if (&match==1)
  (
    &clk_test=&CLK_TEST_LPASS_QDSP6SS_LDO_NMO_OUT
    &clk_reg=0
    &clk_reg_name="No CBCR"
    &clk_name="lpass_qdsp6ss_ldo_nmo_out"
    &clk_reg_cbcr_type=""

    gosub Print_Clk_Info_Line
  )

  &match=0
  &wild_head=0
  &wild_tail=0
  &clk_input_length=STRING.LENGTH("&clk")
  &clk_itr_length=STRING.LENGTH("lpass_qdsp6ss_ahb_m_clk")

  if (STRING.SCAN("&clk", "*", 0)==0)
  (
    &wild_head=1
  )
  if (STRING.SCAN("&clk", "*", 1)==(STRING.LENGTH("&clk")-1))
  (
    &wild_tail=1
  )

  if ((&wild_head==1)&&(&wild_tail==1))
  (
    if (STRING.SCAN("lpass_qdsp6ss_ahb_m_clk", STRING.MID("&clk", 1, &clk_input_length-2), 0)!=-1)
    ( 
      &match=1
    )
  )
  else if (&wild_head==1)
  (
    if (STRING.MID("lpass_qdsp6ss_ahb_m_clk", &clk_itr_length-&clk_input_length+1, &clk_input_length-1)==STRING.CUT("&clk", 1))
    ( 
      &match=1
    )
  )
  else if (&wild_tail==1)
  (
    if (STRING.MID("lpass_qdsp6ss_ahb_m_clk", 0, &clk_input_length-1)==STRING.CUT("&clk", -1))
    ( 
      &match=1
    )
  )	  
  else if ("lpass_qdsp6ss_ahb_m_clk"=="&clk")
  (
    &match=1
  )
  
  if (&match==1)
  (
    &clk_test=&CLK_TEST_LPASS_QDSP6SS_AHB_M_CLK
    &clk_reg=0
    &clk_reg_name="No CBCR"
    &clk_name="lpass_qdsp6ss_ahb_m_clk"
    &clk_reg_cbcr_type=""

    gosub Print_Clk_Info_Line
  )

  &match=0
  &wild_head=0
  &wild_tail=0
  &clk_input_length=STRING.LENGTH("&clk")
  &clk_itr_length=STRING.LENGTH("lpass_qdsp6ss_ahb_s_clk")

  if (STRING.SCAN("&clk", "*", 0)==0)
  (
    &wild_head=1
  )
  if (STRING.SCAN("&clk", "*", 1)==(STRING.LENGTH("&clk")-1))
  (
    &wild_tail=1
  )

  if ((&wild_head==1)&&(&wild_tail==1))
  (
    if (STRING.SCAN("lpass_qdsp6ss_ahb_s_clk", STRING.MID("&clk", 1, &clk_input_length-2), 0)!=-1)
    ( 
      &match=1
    )
  )
  else if (&wild_head==1)
  (
    if (STRING.MID("lpass_qdsp6ss_ahb_s_clk", &clk_itr_length-&clk_input_length+1, &clk_input_length-1)==STRING.CUT("&clk", 1))
    ( 
      &match=1
    )
  )
  else if (&wild_tail==1)
  (
    if (STRING.MID("lpass_qdsp6ss_ahb_s_clk", 0, &clk_input_length-1)==STRING.CUT("&clk", -1))
    ( 
      &match=1
    )
  )	  
  else if ("lpass_qdsp6ss_ahb_s_clk"=="&clk")
  (
    &match=1
  )
  
  if (&match==1)
  (
    &clk_test=&CLK_TEST_LPASS_QDSP6SS_AHB_S_CLK
    &clk_reg=0
    &clk_reg_name="No CBCR"
    &clk_name="lpass_qdsp6ss_ahb_s_clk"
    &clk_reg_cbcr_type=""

    gosub Print_Clk_Info_Line
  )

  &match=0
  &wild_head=0
  &wild_tail=0
  &clk_input_length=STRING.LENGTH("&clk")
  &clk_itr_length=STRING.LENGTH("lpass_qdsp6ss_xo_clk")

  if (STRING.SCAN("&clk", "*", 0)==0)
  (
    &wild_head=1
  )
  if (STRING.SCAN("&clk", "*", 1)==(STRING.LENGTH("&clk")-1))
  (
    &wild_tail=1
  )

  if ((&wild_head==1)&&(&wild_tail==1))
  (
    if (STRING.SCAN("lpass_qdsp6ss_xo_clk", STRING.MID("&clk", 1, &clk_input_length-2), 0)!=-1)
    ( 
      &match=1
    )
  )
  else if (&wild_head==1)
  (
    if (STRING.MID("lpass_qdsp6ss_xo_clk", &clk_itr_length-&clk_input_length+1, &clk_input_length-1)==STRING.CUT("&clk", 1))
    ( 
      &match=1
    )
  )
  else if (&wild_tail==1)
  (
    if (STRING.MID("lpass_qdsp6ss_xo_clk", 0, &clk_input_length-1)==STRING.CUT("&clk", -1))
    ( 
      &match=1
    )
  )	  
  else if ("lpass_qdsp6ss_xo_clk"=="&clk")
  (
    &match=1
  )
  
  if (&match==1)
  (
    &clk_test=&CLK_TEST_LPASS_QDSP6SS_XO_CLK
    &clk_reg=0
    &clk_reg_name="No CBCR"
    &clk_name="lpass_qdsp6ss_xo_clk"
    &clk_reg_cbcr_type=""

    gosub Print_Clk_Info_Line
  )

  &match=0
  &wild_head=0
  &wild_tail=0
  &clk_input_length=STRING.LENGTH("&clk")
  &clk_itr_length=STRING.LENGTH("lpass_qdsp6ss_sleep_clk")

  if (STRING.SCAN("&clk", "*", 0)==0)
  (
    &wild_head=1
  )
  if (STRING.SCAN("&clk", "*", 1)==(STRING.LENGTH("&clk")-1))
  (
    &wild_tail=1
  )

  if ((&wild_head==1)&&(&wild_tail==1))
  (
    if (STRING.SCAN("lpass_qdsp6ss_sleep_clk", STRING.MID("&clk", 1, &clk_input_length-2), 0)!=-1)
    ( 
      &match=1
    )
  )
  else if (&wild_head==1)
  (
    if (STRING.MID("lpass_qdsp6ss_sleep_clk", &clk_itr_length-&clk_input_length+1, &clk_input_length-1)==STRING.CUT("&clk", 1))
    ( 
      &match=1
    )
  )
  else if (&wild_tail==1)
  (
    if (STRING.MID("lpass_qdsp6ss_sleep_clk", 0, &clk_input_length-1)==STRING.CUT("&clk", -1))
    ( 
      &match=1
    )
  )	  
  else if ("lpass_qdsp6ss_sleep_clk"=="&clk")
  (
    &match=1
  )
  
  if (&match==1)
  (
    &clk_test=&CLK_TEST_LPASS_QDSP6SS_SLEEP_CLK
    &clk_reg=0
    &clk_reg_name="No CBCR"
    &clk_name="lpass_qdsp6ss_sleep_clk"
    &clk_reg_cbcr_type=""

    gosub Print_Clk_Info_Line
  )

  &match=0
  &wild_head=0
  &wild_tail=0
  &clk_input_length=STRING.LENGTH("&clk")
  &clk_itr_length=STRING.LENGTH("lpass_qdsp6ss_jtag_tck")

  if (STRING.SCAN("&clk", "*", 0)==0)
  (
    &wild_head=1
  )
  if (STRING.SCAN("&clk", "*", 1)==(STRING.LENGTH("&clk")-1))
  (
    &wild_tail=1
  )

  if ((&wild_head==1)&&(&wild_tail==1))
  (
    if (STRING.SCAN("lpass_qdsp6ss_jtag_tck", STRING.MID("&clk", 1, &clk_input_length-2), 0)!=-1)
    ( 
      &match=1
    )
  )
  else if (&wild_head==1)
  (
    if (STRING.MID("lpass_qdsp6ss_jtag_tck", &clk_itr_length-&clk_input_length+1, &clk_input_length-1)==STRING.CUT("&clk", 1))
    ( 
      &match=1
    )
  )
  else if (&wild_tail==1)
  (
    if (STRING.MID("lpass_qdsp6ss_jtag_tck", 0, &clk_input_length-1)==STRING.CUT("&clk", -1))
    ( 
      &match=1
    )
  )	  
  else if ("lpass_qdsp6ss_jtag_tck"=="&clk")
  (
    &match=1
  )
  
  if (&match==1)
  (
    &clk_test=&CLK_TEST_LPASS_QDSP6SS_JTAG_TCK
    &clk_reg=0
    &clk_reg_name="No CBCR"
    &clk_name="lpass_qdsp6ss_jtag_tck"
    &clk_reg_cbcr_type=""

    gosub Print_Clk_Info_Line
  )

  &match=0
  &wild_head=0
  &wild_tail=0
  &clk_input_length=STRING.LENGTH("&clk")
  &clk_itr_length=STRING.LENGTH("lpass_qdsp6ss_atb_clk")

  if (STRING.SCAN("&clk", "*", 0)==0)
  (
    &wild_head=1
  )
  if (STRING.SCAN("&clk", "*", 1)==(STRING.LENGTH("&clk")-1))
  (
    &wild_tail=1
  )

  if ((&wild_head==1)&&(&wild_tail==1))
  (
    if (STRING.SCAN("lpass_qdsp6ss_atb_clk", STRING.MID("&clk", 1, &clk_input_length-2), 0)!=-1)
    ( 
      &match=1
    )
  )
  else if (&wild_head==1)
  (
    if (STRING.MID("lpass_qdsp6ss_atb_clk", &clk_itr_length-&clk_input_length+1, &clk_input_length-1)==STRING.CUT("&clk", 1))
    ( 
      &match=1
    )
  )
  else if (&wild_tail==1)
  (
    if (STRING.MID("lpass_qdsp6ss_atb_clk", 0, &clk_input_length-1)==STRING.CUT("&clk", -1))
    ( 
      &match=1
    )
  )	  
  else if ("lpass_qdsp6ss_atb_clk"=="&clk")
  (
    &match=1
  )
  
  if (&match==1)
  (
    &clk_test=&CLK_TEST_LPASS_QDSP6SS_ATB_CLK
    &clk_reg=0
    &clk_reg_name="No CBCR"
    &clk_name="lpass_qdsp6ss_atb_clk"
    &clk_reg_cbcr_type=""

    gosub Print_Clk_Info_Line
  )

  &match=0
  &wild_head=0
  &wild_tail=0
  &clk_input_length=STRING.LENGTH("&clk")
  &clk_itr_length=STRING.LENGTH("lpass_qdsp6ss_apb_clk")

  if (STRING.SCAN("&clk", "*", 0)==0)
  (
    &wild_head=1
  )
  if (STRING.SCAN("&clk", "*", 1)==(STRING.LENGTH("&clk")-1))
  (
    &wild_tail=1
  )

  if ((&wild_head==1)&&(&wild_tail==1))
  (
    if (STRING.SCAN("lpass_qdsp6ss_apb_clk", STRING.MID("&clk", 1, &clk_input_length-2), 0)!=-1)
    ( 
      &match=1
    )
  )
  else if (&wild_head==1)
  (
    if (STRING.MID("lpass_qdsp6ss_apb_clk", &clk_itr_length-&clk_input_length+1, &clk_input_length-1)==STRING.CUT("&clk", 1))
    ( 
      &match=1
    )
  )
  else if (&wild_tail==1)
  (
    if (STRING.MID("lpass_qdsp6ss_apb_clk", 0, &clk_input_length-1)==STRING.CUT("&clk", -1))
    ( 
      &match=1
    )
  )	  
  else if ("lpass_qdsp6ss_apb_clk"=="&clk")
  (
    &match=1
  )
  
  if (&match==1)
  (
    &clk_test=&CLK_TEST_LPASS_QDSP6SS_APB_CLK
    &clk_reg=0
    &clk_reg_name="No CBCR"
    &clk_name="lpass_qdsp6ss_apb_clk"
    &clk_reg_cbcr_type=""

    gosub Print_Clk_Info_Line
  )

  &match=0
  &wild_head=0
  &wild_tail=0
  &clk_input_length=STRING.LENGTH("&clk")
  &clk_itr_length=STRING.LENGTH("lpass_qdsp6ss_timestamp_clk")

  if (STRING.SCAN("&clk", "*", 0)==0)
  (
    &wild_head=1
  )
  if (STRING.SCAN("&clk", "*", 1)==(STRING.LENGTH("&clk")-1))
  (
    &wild_tail=1
  )

  if ((&wild_head==1)&&(&wild_tail==1))
  (
    if (STRING.SCAN("lpass_qdsp6ss_timestamp_clk", STRING.MID("&clk", 1, &clk_input_length-2), 0)!=-1)
    ( 
      &match=1
    )
  )
  else if (&wild_head==1)
  (
    if (STRING.MID("lpass_qdsp6ss_timestamp_clk", &clk_itr_length-&clk_input_length+1, &clk_input_length-1)==STRING.CUT("&clk", 1))
    ( 
      &match=1
    )
  )
  else if (&wild_tail==1)
  (
    if (STRING.MID("lpass_qdsp6ss_timestamp_clk", 0, &clk_input_length-1)==STRING.CUT("&clk", -1))
    ( 
      &match=1
    )
  )	  
  else if ("lpass_qdsp6ss_timestamp_clk"=="&clk")
  (
    &match=1
  )
  
  if (&match==1)
  (
    &clk_test=&CLK_TEST_LPASS_QDSP6SS_TIMESTAMP_CLK
    &clk_reg=0
    &clk_reg_name="No CBCR"
    &clk_name="lpass_qdsp6ss_timestamp_clk"
    &clk_reg_cbcr_type=""

    gosub Print_Clk_Info_Line
  )


  return



;-----------------------------------------------------------------------------
; Set appropriate mux settings for configurable clocks 
;-----------------------------------------------------------------------------

Set_Clock_Freq_Enter:

  ; Return for now. Need to figure out a way to map source to HW.
  return

  if ("&clk"=="gcc_sec_ctrl_acc_clk")||("&clk"=="sec_ctrl_acc_clk_src")
  (
    gosub PRINT_SET_CLOCK_FREQ_WARNING

    &clk_cmd_rcgr_addr=&HWIO_GCC_ACC_CMD_RCGR_ADDR
    &clk_cfg_rcgr_addr=&HWIO_GCC_ACC_CFG_RCGR_ADDR

    print "Choose frequency (MHz) from list below: " 

    print "19.2           37.5           75.0           " 
    print "150.0          200.0          " 

    print ""
    print "Enter desired frequency (r to return): "
    enter &clk_desired_freq
    print ""

    if ("&clk_desired_freq"=="19.2")
    (
      &clk_src_name="XO"
      &clk_src_sel=SRC_SEL TODO.
      &clk_src_div=2.
      &clk_m_val=0.
      &clk_n_val=0.
      &clk_2d_val=0.
      
      gosub Set_Clock_Freq
      return
    )
    else if ("&clk_desired_freq"=="37.5")
    (
      &clk_src_name="GPLL0"
      &clk_src_sel=SRC_SEL TODO.
      &clk_src_div=32.
      &clk_m_val=0.
      &clk_n_val=0.
      &clk_2d_val=0.
      
      gosub Set_Clock_Freq
      return
    )
    else if ("&clk_desired_freq"=="75.0")
    (
      &clk_src_name="GPLL0"
      &clk_src_sel=SRC_SEL TODO.
      &clk_src_div=16.
      &clk_m_val=0.
      &clk_n_val=0.
      &clk_2d_val=0.
      
      gosub Set_Clock_Freq
      return
    )
    else if ("&clk_desired_freq"=="150.0")
    (
      &clk_src_name="GPLL0"
      &clk_src_sel=SRC_SEL TODO.
      &clk_src_div=8.
      &clk_m_val=0.
      &clk_n_val=0.
      &clk_2d_val=0.
      
      gosub Set_Clock_Freq
      return
    )
    else if ("&clk_desired_freq"=="200.0")
    (
      &clk_src_name="GPLL0"
      &clk_src_sel=SRC_SEL TODO.
      &clk_src_div=6.
      &clk_m_val=0.
      &clk_n_val=0.
      &clk_2d_val=0.
      
      gosub Set_Clock_Freq
      return
    )
    else if ("&clk_desired_freq"=="r")
    (
      return
    )
    else
    (
      print "Invalid selection."
      goto Set_Clock_Freq_Enter
    )
  )

  if ("&clk"=="gcc_bimc_clk")
  (
    gosub PRINT_SET_CLOCK_FREQ_WARNING

    &clk_cmd_rcgr_addr=&HWIO_GCC_BIMC_CORE_KPSS_AXI_CMD_RCGR_ADDR
    &clk_cfg_rcgr_addr=&HWIO_GCC_BIMC_CORE_KPSS_AXI_CFG_RCGR_ADDR

    print "Choose frequency (MHz) from list below: " 

    print "19.2           166.5          333.0          " 
    print "400.0          533.0          " 

    print ""
    print "Enter desired frequency (r to return): "
    enter &clk_desired_freq
    print ""

    if ("&clk_desired_freq"=="19.2")
    (
      &clk_src_name="XO"
      &clk_src_sel=SRC_SEL TODO.
      &clk_src_div=2.
      &clk_m_val=0.
      &clk_n_val=0.
      &clk_2d_val=0.
      
      gosub Set_Clock_Freq
      return
    )
    else if ("&clk_desired_freq"=="166.5")
    (
      &clk_src_name="GPLL1"
      &clk_src_sel=SRC_SEL TODO.
      &clk_src_div=16.
      &clk_m_val=0.
      &clk_n_val=0.
      &clk_2d_val=0.
      
      gosub Set_Clock_Freq
      return
    )
    else if ("&clk_desired_freq"=="333.0")
    (
      &clk_src_name="GPLL1"
      &clk_src_sel=SRC_SEL TODO.
      &clk_src_div=8.
      &clk_m_val=0.
      &clk_n_val=0.
      &clk_2d_val=0.
      
      gosub Set_Clock_Freq
      return
    )
    else if ("&clk_desired_freq"=="400.0")
    (
      &clk_src_name="GPLL3"
      &clk_src_sel=SRC_SEL TODO.
      &clk_src_div=4.
      &clk_m_val=0.
      &clk_n_val=0.
      &clk_2d_val=0.
      
      gosub Set_Clock_Freq
      return
    )
    else if ("&clk_desired_freq"=="533.0")
    (
      &clk_src_name="GPLL1"
      &clk_src_sel=SRC_SEL TODO.
      &clk_src_div=2.
      &clk_m_val=0.
      &clk_n_val=0.
      &clk_2d_val=0.
      
      gosub Set_Clock_Freq
      return
    )
    else if ("&clk_desired_freq"=="r")
    (
      return
    )
    else
    (
      print "Invalid selection."
      goto Set_Clock_Freq_Enter
    )
  )

  if ("&clk"=="gcc_blsp1_qup1_i2c_apps_clk")
  (
    gosub PRINT_SET_CLOCK_FREQ_WARNING

    &clk_cmd_rcgr_addr=&HWIO_GCC_BLSP1_QUP1_I2C_APPS_CMD_RCGR_ADDR
    &clk_cfg_rcgr_addr=&HWIO_GCC_BLSP1_QUP1_I2C_APPS_CFG_RCGR_ADDR

    print "Choose frequency (MHz) from list below: " 

    print "19.2           50.0           " 

    print ""
    print "Enter desired frequency (r to return): "
    enter &clk_desired_freq
    print ""

    if ("&clk_desired_freq"=="19.2")
    (
      &clk_src_name="XO"
      &clk_src_sel=SRC_SEL TODO.
      &clk_src_div=2.
      &clk_m_val=0.
      &clk_n_val=0.
      &clk_2d_val=0.
      
      gosub Set_Clock_Freq
      return
    )
    else if ("&clk_desired_freq"=="50.0")
    (
      &clk_src_name="GPLL0"
      &clk_src_sel=SRC_SEL TODO.
      &clk_src_div=24.
      &clk_m_val=0.
      &clk_n_val=0.
      &clk_2d_val=0.
      
      gosub Set_Clock_Freq
      return
    )
    else if ("&clk_desired_freq"=="r")
    (
      return
    )
    else
    (
      print "Invalid selection."
      goto Set_Clock_Freq_Enter
    )
  )

  if ("&clk"=="gcc_blsp1_qup1_spi_apps_clk")
  (
    gosub PRINT_SET_CLOCK_FREQ_WARNING

    &clk_cmd_rcgr_addr=&HWIO_GCC_BLSP1_QUP1_SPI_APPS_CMD_RCGR_ADDR
    &clk_cfg_rcgr_addr=&HWIO_GCC_BLSP1_QUP1_SPI_APPS_CFG_RCGR_ADDR

    print "Choose frequency (MHz) from list below: " 

    print "0.96           4.8            9.6            " 
    print "15.0           19.2           25.0           " 
    print "50.0           " 

    print ""
    print "Enter desired frequency (r to return): "
    enter &clk_desired_freq
    print ""

    if ("&clk_desired_freq"=="0.96")
    (
      &clk_src_name="XO"
      &clk_src_sel=SRC_SEL TODO.
      &clk_src_div=20.
      &clk_m_val=1.
      &clk_n_val=2.
      &clk_2d_val=2.
      
      gosub Set_Clock_Freq
      return
    )
    else if ("&clk_desired_freq"=="4.8")
    (
      &clk_src_name="XO"
      &clk_src_sel=SRC_SEL TODO.
      &clk_src_div=8.
      &clk_m_val=0.
      &clk_n_val=0.
      &clk_2d_val=0.
      
      gosub Set_Clock_Freq
      return
    )
    else if ("&clk_desired_freq"=="9.6")
    (
      &clk_src_name="XO"
      &clk_src_sel=SRC_SEL TODO.
      &clk_src_div=4.
      &clk_m_val=0.
      &clk_n_val=0.
      &clk_2d_val=0.
      
      gosub Set_Clock_Freq
      return
    )
    else if ("&clk_desired_freq"=="15.0")
    (
      &clk_src_name="GPLL0"
      &clk_src_sel=SRC_SEL TODO.
      &clk_src_div=20.
      &clk_m_val=1.
      &clk_n_val=4.
      &clk_2d_val=4.
      
      gosub Set_Clock_Freq
      return
    )
    else if ("&clk_desired_freq"=="19.2")
    (
      &clk_src_name="XO"
      &clk_src_sel=SRC_SEL TODO.
      &clk_src_div=2.
      &clk_m_val=0.
      &clk_n_val=0.
      &clk_2d_val=0.
      
      gosub Set_Clock_Freq
      return
    )
    else if ("&clk_desired_freq"=="25.0")
    (
      &clk_src_name="GPLL0"
      &clk_src_sel=SRC_SEL TODO.
      &clk_src_div=24.
      &clk_m_val=1.
      &clk_n_val=2.
      &clk_2d_val=2.
      
      gosub Set_Clock_Freq
      return
    )
    else if ("&clk_desired_freq"=="50.0")
    (
      &clk_src_name="GPLL0"
      &clk_src_sel=SRC_SEL TODO.
      &clk_src_div=24.
      &clk_m_val=0.
      &clk_n_val=0.
      &clk_2d_val=0.
      
      gosub Set_Clock_Freq
      return
    )
    else if ("&clk_desired_freq"=="r")
    (
      return
    )
    else
    (
      print "Invalid selection."
      goto Set_Clock_Freq_Enter
    )
  )

  if ("&clk"=="gcc_blsp1_qup2_i2c_apps_clk")
  (
    gosub PRINT_SET_CLOCK_FREQ_WARNING

    &clk_cmd_rcgr_addr=&HWIO_GCC_BLSP1_QUP2_I2C_APPS_CMD_RCGR_ADDR
    &clk_cfg_rcgr_addr=&HWIO_GCC_BLSP1_QUP2_I2C_APPS_CFG_RCGR_ADDR

    print "Choose frequency (MHz) from list below: " 

    print "19.2           50.0           " 

    print ""
    print "Enter desired frequency (r to return): "
    enter &clk_desired_freq
    print ""

    if ("&clk_desired_freq"=="19.2")
    (
      &clk_src_name="XO"
      &clk_src_sel=SRC_SEL TODO.
      &clk_src_div=2.
      &clk_m_val=0.
      &clk_n_val=0.
      &clk_2d_val=0.
      
      gosub Set_Clock_Freq
      return
    )
    else if ("&clk_desired_freq"=="50.0")
    (
      &clk_src_name="GPLL0"
      &clk_src_sel=SRC_SEL TODO.
      &clk_src_div=24.
      &clk_m_val=0.
      &clk_n_val=0.
      &clk_2d_val=0.
      
      gosub Set_Clock_Freq
      return
    )
    else if ("&clk_desired_freq"=="r")
    (
      return
    )
    else
    (
      print "Invalid selection."
      goto Set_Clock_Freq_Enter
    )
  )

  if ("&clk"=="gcc_blsp1_qup2_spi_apps_clk")
  (
    gosub PRINT_SET_CLOCK_FREQ_WARNING

    &clk_cmd_rcgr_addr=&HWIO_GCC_BLSP1_QUP2_SPI_APPS_CMD_RCGR_ADDR
    &clk_cfg_rcgr_addr=&HWIO_GCC_BLSP1_QUP2_SPI_APPS_CFG_RCGR_ADDR

    print "Choose frequency (MHz) from list below: " 

    print "0.96           4.8            9.6            " 
    print "15.0           19.2           25.0           " 
    print "50.0           " 

    print ""
    print "Enter desired frequency (r to return): "
    enter &clk_desired_freq
    print ""

    if ("&clk_desired_freq"=="0.96")
    (
      &clk_src_name="XO"
      &clk_src_sel=SRC_SEL TODO.
      &clk_src_div=20.
      &clk_m_val=1.
      &clk_n_val=2.
      &clk_2d_val=2.
      
      gosub Set_Clock_Freq
      return
    )
    else if ("&clk_desired_freq"=="4.8")
    (
      &clk_src_name="XO"
      &clk_src_sel=SRC_SEL TODO.
      &clk_src_div=8.
      &clk_m_val=0.
      &clk_n_val=0.
      &clk_2d_val=0.
      
      gosub Set_Clock_Freq
      return
    )
    else if ("&clk_desired_freq"=="9.6")
    (
      &clk_src_name="XO"
      &clk_src_sel=SRC_SEL TODO.
      &clk_src_div=4.
      &clk_m_val=0.
      &clk_n_val=0.
      &clk_2d_val=0.
      
      gosub Set_Clock_Freq
      return
    )
    else if ("&clk_desired_freq"=="15.0")
    (
      &clk_src_name="GPLL0"
      &clk_src_sel=SRC_SEL TODO.
      &clk_src_div=20.
      &clk_m_val=1.
      &clk_n_val=4.
      &clk_2d_val=4.
      
      gosub Set_Clock_Freq
      return
    )
    else if ("&clk_desired_freq"=="19.2")
    (
      &clk_src_name="XO"
      &clk_src_sel=SRC_SEL TODO.
      &clk_src_div=2.
      &clk_m_val=0.
      &clk_n_val=0.
      &clk_2d_val=0.
      
      gosub Set_Clock_Freq
      return
    )
    else if ("&clk_desired_freq"=="25.0")
    (
      &clk_src_name="GPLL0"
      &clk_src_sel=SRC_SEL TODO.
      &clk_src_div=24.
      &clk_m_val=1.
      &clk_n_val=2.
      &clk_2d_val=2.
      
      gosub Set_Clock_Freq
      return
    )
    else if ("&clk_desired_freq"=="50.0")
    (
      &clk_src_name="GPLL0"
      &clk_src_sel=SRC_SEL TODO.
      &clk_src_div=24.
      &clk_m_val=0.
      &clk_n_val=0.
      &clk_2d_val=0.
      
      gosub Set_Clock_Freq
      return
    )
    else if ("&clk_desired_freq"=="r")
    (
      return
    )
    else
    (
      print "Invalid selection."
      goto Set_Clock_Freq_Enter
    )
  )

  if ("&clk"=="gcc_blsp1_qup3_i2c_apps_clk")
  (
    gosub PRINT_SET_CLOCK_FREQ_WARNING

    &clk_cmd_rcgr_addr=&HWIO_GCC_BLSP1_QUP3_I2C_APPS_CMD_RCGR_ADDR
    &clk_cfg_rcgr_addr=&HWIO_GCC_BLSP1_QUP3_I2C_APPS_CFG_RCGR_ADDR

    print "Choose frequency (MHz) from list below: " 

    print "19.2           50.0           " 

    print ""
    print "Enter desired frequency (r to return): "
    enter &clk_desired_freq
    print ""

    if ("&clk_desired_freq"=="19.2")
    (
      &clk_src_name="XO"
      &clk_src_sel=SRC_SEL TODO.
      &clk_src_div=2.
      &clk_m_val=0.
      &clk_n_val=0.
      &clk_2d_val=0.
      
      gosub Set_Clock_Freq
      return
    )
    else if ("&clk_desired_freq"=="50.0")
    (
      &clk_src_name="GPLL0"
      &clk_src_sel=SRC_SEL TODO.
      &clk_src_div=24.
      &clk_m_val=0.
      &clk_n_val=0.
      &clk_2d_val=0.
      
      gosub Set_Clock_Freq
      return
    )
    else if ("&clk_desired_freq"=="r")
    (
      return
    )
    else
    (
      print "Invalid selection."
      goto Set_Clock_Freq_Enter
    )
  )

  if ("&clk"=="gcc_blsp1_qup3_spi_apps_clk")
  (
    gosub PRINT_SET_CLOCK_FREQ_WARNING

    &clk_cmd_rcgr_addr=&HWIO_GCC_BLSP1_QUP3_SPI_APPS_CMD_RCGR_ADDR
    &clk_cfg_rcgr_addr=&HWIO_GCC_BLSP1_QUP3_SPI_APPS_CFG_RCGR_ADDR

    print "Choose frequency (MHz) from list below: " 

    print "0.96           4.8            9.6            " 
    print "15.0           19.2           25.0           " 
    print "50.0           " 

    print ""
    print "Enter desired frequency (r to return): "
    enter &clk_desired_freq
    print ""

    if ("&clk_desired_freq"=="0.96")
    (
      &clk_src_name="XO"
      &clk_src_sel=SRC_SEL TODO.
      &clk_src_div=20.
      &clk_m_val=1.
      &clk_n_val=2.
      &clk_2d_val=2.
      
      gosub Set_Clock_Freq
      return
    )
    else if ("&clk_desired_freq"=="4.8")
    (
      &clk_src_name="XO"
      &clk_src_sel=SRC_SEL TODO.
      &clk_src_div=8.
      &clk_m_val=0.
      &clk_n_val=0.
      &clk_2d_val=0.
      
      gosub Set_Clock_Freq
      return
    )
    else if ("&clk_desired_freq"=="9.6")
    (
      &clk_src_name="XO"
      &clk_src_sel=SRC_SEL TODO.
      &clk_src_div=4.
      &clk_m_val=0.
      &clk_n_val=0.
      &clk_2d_val=0.
      
      gosub Set_Clock_Freq
      return
    )
    else if ("&clk_desired_freq"=="15.0")
    (
      &clk_src_name="GPLL0"
      &clk_src_sel=SRC_SEL TODO.
      &clk_src_div=20.
      &clk_m_val=1.
      &clk_n_val=4.
      &clk_2d_val=4.
      
      gosub Set_Clock_Freq
      return
    )
    else if ("&clk_desired_freq"=="19.2")
    (
      &clk_src_name="XO"
      &clk_src_sel=SRC_SEL TODO.
      &clk_src_div=2.
      &clk_m_val=0.
      &clk_n_val=0.
      &clk_2d_val=0.
      
      gosub Set_Clock_Freq
      return
    )
    else if ("&clk_desired_freq"=="25.0")
    (
      &clk_src_name="GPLL0"
      &clk_src_sel=SRC_SEL TODO.
      &clk_src_div=24.
      &clk_m_val=1.
      &clk_n_val=2.
      &clk_2d_val=2.
      
      gosub Set_Clock_Freq
      return
    )
    else if ("&clk_desired_freq"=="50.0")
    (
      &clk_src_name="GPLL0"
      &clk_src_sel=SRC_SEL TODO.
      &clk_src_div=24.
      &clk_m_val=0.
      &clk_n_val=0.
      &clk_2d_val=0.
      
      gosub Set_Clock_Freq
      return
    )
    else if ("&clk_desired_freq"=="r")
    (
      return
    )
    else
    (
      print "Invalid selection."
      goto Set_Clock_Freq_Enter
    )
  )

  if ("&clk"=="gcc_blsp1_qup4_i2c_apps_clk")
  (
    gosub PRINT_SET_CLOCK_FREQ_WARNING

    &clk_cmd_rcgr_addr=&HWIO_GCC_BLSP1_QUP4_I2C_APPS_CMD_RCGR_ADDR
    &clk_cfg_rcgr_addr=&HWIO_GCC_BLSP1_QUP4_I2C_APPS_CFG_RCGR_ADDR

    print "Choose frequency (MHz) from list below: " 

    print "19.2           50.0           " 

    print ""
    print "Enter desired frequency (r to return): "
    enter &clk_desired_freq
    print ""

    if ("&clk_desired_freq"=="19.2")
    (
      &clk_src_name="XO"
      &clk_src_sel=SRC_SEL TODO.
      &clk_src_div=2.
      &clk_m_val=0.
      &clk_n_val=0.
      &clk_2d_val=0.
      
      gosub Set_Clock_Freq
      return
    )
    else if ("&clk_desired_freq"=="50.0")
    (
      &clk_src_name="GPLL0"
      &clk_src_sel=SRC_SEL TODO.
      &clk_src_div=24.
      &clk_m_val=0.
      &clk_n_val=0.
      &clk_2d_val=0.
      
      gosub Set_Clock_Freq
      return
    )
    else if ("&clk_desired_freq"=="r")
    (
      return
    )
    else
    (
      print "Invalid selection."
      goto Set_Clock_Freq_Enter
    )
  )

  if ("&clk"=="gcc_blsp1_qup4_spi_apps_clk")
  (
    gosub PRINT_SET_CLOCK_FREQ_WARNING

    &clk_cmd_rcgr_addr=&HWIO_GCC_BLSP1_QUP4_SPI_APPS_CMD_RCGR_ADDR
    &clk_cfg_rcgr_addr=&HWIO_GCC_BLSP1_QUP4_SPI_APPS_CFG_RCGR_ADDR

    print "Choose frequency (MHz) from list below: " 

    print "0.96           4.8            9.6            " 
    print "15.0           19.2           25.0           " 
    print "50.0           " 

    print ""
    print "Enter desired frequency (r to return): "
    enter &clk_desired_freq
    print ""

    if ("&clk_desired_freq"=="0.96")
    (
      &clk_src_name="XO"
      &clk_src_sel=SRC_SEL TODO.
      &clk_src_div=20.
      &clk_m_val=1.
      &clk_n_val=2.
      &clk_2d_val=2.
      
      gosub Set_Clock_Freq
      return
    )
    else if ("&clk_desired_freq"=="4.8")
    (
      &clk_src_name="XO"
      &clk_src_sel=SRC_SEL TODO.
      &clk_src_div=8.
      &clk_m_val=0.
      &clk_n_val=0.
      &clk_2d_val=0.
      
      gosub Set_Clock_Freq
      return
    )
    else if ("&clk_desired_freq"=="9.6")
    (
      &clk_src_name="XO"
      &clk_src_sel=SRC_SEL TODO.
      &clk_src_div=4.
      &clk_m_val=0.
      &clk_n_val=0.
      &clk_2d_val=0.
      
      gosub Set_Clock_Freq
      return
    )
    else if ("&clk_desired_freq"=="15.0")
    (
      &clk_src_name="GPLL0"
      &clk_src_sel=SRC_SEL TODO.
      &clk_src_div=20.
      &clk_m_val=1.
      &clk_n_val=4.
      &clk_2d_val=4.
      
      gosub Set_Clock_Freq
      return
    )
    else if ("&clk_desired_freq"=="19.2")
    (
      &clk_src_name="XO"
      &clk_src_sel=SRC_SEL TODO.
      &clk_src_div=2.
      &clk_m_val=0.
      &clk_n_val=0.
      &clk_2d_val=0.
      
      gosub Set_Clock_Freq
      return
    )
    else if ("&clk_desired_freq"=="25.0")
    (
      &clk_src_name="GPLL0"
      &clk_src_sel=SRC_SEL TODO.
      &clk_src_div=24.
      &clk_m_val=1.
      &clk_n_val=2.
      &clk_2d_val=2.
      
      gosub Set_Clock_Freq
      return
    )
    else if ("&clk_desired_freq"=="50.0")
    (
      &clk_src_name="GPLL0"
      &clk_src_sel=SRC_SEL TODO.
      &clk_src_div=24.
      &clk_m_val=0.
      &clk_n_val=0.
      &clk_2d_val=0.
      
      gosub Set_Clock_Freq
      return
    )
    else if ("&clk_desired_freq"=="r")
    (
      return
    )
    else
    (
      print "Invalid selection."
      goto Set_Clock_Freq_Enter
    )
  )

  if ("&clk"=="gcc_blsp1_qup5_i2c_apps_clk")
  (
    gosub PRINT_SET_CLOCK_FREQ_WARNING

    &clk_cmd_rcgr_addr=&HWIO_GCC_BLSP1_QUP5_I2C_APPS_CMD_RCGR_ADDR
    &clk_cfg_rcgr_addr=&HWIO_GCC_BLSP1_QUP5_I2C_APPS_CFG_RCGR_ADDR

    print "Choose frequency (MHz) from list below: " 

    print "19.2           50.0           " 

    print ""
    print "Enter desired frequency (r to return): "
    enter &clk_desired_freq
    print ""

    if ("&clk_desired_freq"=="19.2")
    (
      &clk_src_name="XO"
      &clk_src_sel=SRC_SEL TODO.
      &clk_src_div=2.
      &clk_m_val=0.
      &clk_n_val=0.
      &clk_2d_val=0.
      
      gosub Set_Clock_Freq
      return
    )
    else if ("&clk_desired_freq"=="50.0")
    (
      &clk_src_name="GPLL0"
      &clk_src_sel=SRC_SEL TODO.
      &clk_src_div=24.
      &clk_m_val=0.
      &clk_n_val=0.
      &clk_2d_val=0.
      
      gosub Set_Clock_Freq
      return
    )
    else if ("&clk_desired_freq"=="r")
    (
      return
    )
    else
    (
      print "Invalid selection."
      goto Set_Clock_Freq_Enter
    )
  )

  if ("&clk"=="gcc_blsp1_qup5_spi_apps_clk")
  (
    gosub PRINT_SET_CLOCK_FREQ_WARNING

    &clk_cmd_rcgr_addr=&HWIO_GCC_BLSP1_QUP5_SPI_APPS_CMD_RCGR_ADDR
    &clk_cfg_rcgr_addr=&HWIO_GCC_BLSP1_QUP5_SPI_APPS_CFG_RCGR_ADDR

    print "Choose frequency (MHz) from list below: " 

    print "0.96           4.8            9.6            " 
    print "15.0           19.2           25.0           " 
    print "50.0           " 

    print ""
    print "Enter desired frequency (r to return): "
    enter &clk_desired_freq
    print ""

    if ("&clk_desired_freq"=="0.96")
    (
      &clk_src_name="XO"
      &clk_src_sel=SRC_SEL TODO.
      &clk_src_div=20.
      &clk_m_val=1.
      &clk_n_val=2.
      &clk_2d_val=2.
      
      gosub Set_Clock_Freq
      return
    )
    else if ("&clk_desired_freq"=="4.8")
    (
      &clk_src_name="XO"
      &clk_src_sel=SRC_SEL TODO.
      &clk_src_div=8.
      &clk_m_val=0.
      &clk_n_val=0.
      &clk_2d_val=0.
      
      gosub Set_Clock_Freq
      return
    )
    else if ("&clk_desired_freq"=="9.6")
    (
      &clk_src_name="XO"
      &clk_src_sel=SRC_SEL TODO.
      &clk_src_div=4.
      &clk_m_val=0.
      &clk_n_val=0.
      &clk_2d_val=0.
      
      gosub Set_Clock_Freq
      return
    )
    else if ("&clk_desired_freq"=="15.0")
    (
      &clk_src_name="GPLL0"
      &clk_src_sel=SRC_SEL TODO.
      &clk_src_div=20.
      &clk_m_val=1.
      &clk_n_val=4.
      &clk_2d_val=4.
      
      gosub Set_Clock_Freq
      return
    )
    else if ("&clk_desired_freq"=="19.2")
    (
      &clk_src_name="XO"
      &clk_src_sel=SRC_SEL TODO.
      &clk_src_div=2.
      &clk_m_val=0.
      &clk_n_val=0.
      &clk_2d_val=0.
      
      gosub Set_Clock_Freq
      return
    )
    else if ("&clk_desired_freq"=="25.0")
    (
      &clk_src_name="GPLL0"
      &clk_src_sel=SRC_SEL TODO.
      &clk_src_div=24.
      &clk_m_val=1.
      &clk_n_val=2.
      &clk_2d_val=2.
      
      gosub Set_Clock_Freq
      return
    )
    else if ("&clk_desired_freq"=="50.0")
    (
      &clk_src_name="GPLL0"
      &clk_src_sel=SRC_SEL TODO.
      &clk_src_div=24.
      &clk_m_val=0.
      &clk_n_val=0.
      &clk_2d_val=0.
      
      gosub Set_Clock_Freq
      return
    )
    else if ("&clk_desired_freq"=="r")
    (
      return
    )
    else
    (
      print "Invalid selection."
      goto Set_Clock_Freq_Enter
    )
  )

  if ("&clk"=="gcc_blsp1_qup6_i2c_apps_clk")
  (
    gosub PRINT_SET_CLOCK_FREQ_WARNING

    &clk_cmd_rcgr_addr=&HWIO_GCC_BLSP1_QUP6_I2C_APPS_CMD_RCGR_ADDR
    &clk_cfg_rcgr_addr=&HWIO_GCC_BLSP1_QUP6_I2C_APPS_CFG_RCGR_ADDR

    print "Choose frequency (MHz) from list below: " 

    print "19.2           50.0           " 

    print ""
    print "Enter desired frequency (r to return): "
    enter &clk_desired_freq
    print ""

    if ("&clk_desired_freq"=="19.2")
    (
      &clk_src_name="XO"
      &clk_src_sel=SRC_SEL TODO.
      &clk_src_div=2.
      &clk_m_val=0.
      &clk_n_val=0.
      &clk_2d_val=0.
      
      gosub Set_Clock_Freq
      return
    )
    else if ("&clk_desired_freq"=="50.0")
    (
      &clk_src_name="GPLL0"
      &clk_src_sel=SRC_SEL TODO.
      &clk_src_div=24.
      &clk_m_val=0.
      &clk_n_val=0.
      &clk_2d_val=0.
      
      gosub Set_Clock_Freq
      return
    )
    else if ("&clk_desired_freq"=="r")
    (
      return
    )
    else
    (
      print "Invalid selection."
      goto Set_Clock_Freq_Enter
    )
  )

  if ("&clk"=="gcc_blsp1_qup6_spi_apps_clk")
  (
    gosub PRINT_SET_CLOCK_FREQ_WARNING

    &clk_cmd_rcgr_addr=&HWIO_GCC_BLSP1_QUP6_SPI_APPS_CMD_RCGR_ADDR
    &clk_cfg_rcgr_addr=&HWIO_GCC_BLSP1_QUP6_SPI_APPS_CFG_RCGR_ADDR

    print "Choose frequency (MHz) from list below: " 

    print "0.96           4.8            9.6            " 
    print "15.0           19.2           25.0           " 
    print "50.0           " 

    print ""
    print "Enter desired frequency (r to return): "
    enter &clk_desired_freq
    print ""

    if ("&clk_desired_freq"=="0.96")
    (
      &clk_src_name="XO"
      &clk_src_sel=SRC_SEL TODO.
      &clk_src_div=20.
      &clk_m_val=1.
      &clk_n_val=2.
      &clk_2d_val=2.
      
      gosub Set_Clock_Freq
      return
    )
    else if ("&clk_desired_freq"=="4.8")
    (
      &clk_src_name="XO"
      &clk_src_sel=SRC_SEL TODO.
      &clk_src_div=8.
      &clk_m_val=0.
      &clk_n_val=0.
      &clk_2d_val=0.
      
      gosub Set_Clock_Freq
      return
    )
    else if ("&clk_desired_freq"=="9.6")
    (
      &clk_src_name="XO"
      &clk_src_sel=SRC_SEL TODO.
      &clk_src_div=4.
      &clk_m_val=0.
      &clk_n_val=0.
      &clk_2d_val=0.
      
      gosub Set_Clock_Freq
      return
    )
    else if ("&clk_desired_freq"=="15.0")
    (
      &clk_src_name="GPLL0"
      &clk_src_sel=SRC_SEL TODO.
      &clk_src_div=20.
      &clk_m_val=1.
      &clk_n_val=4.
      &clk_2d_val=4.
      
      gosub Set_Clock_Freq
      return
    )
    else if ("&clk_desired_freq"=="19.2")
    (
      &clk_src_name="XO"
      &clk_src_sel=SRC_SEL TODO.
      &clk_src_div=2.
      &clk_m_val=0.
      &clk_n_val=0.
      &clk_2d_val=0.
      
      gosub Set_Clock_Freq
      return
    )
    else if ("&clk_desired_freq"=="25.0")
    (
      &clk_src_name="GPLL0"
      &clk_src_sel=SRC_SEL TODO.
      &clk_src_div=24.
      &clk_m_val=1.
      &clk_n_val=2.
      &clk_2d_val=2.
      
      gosub Set_Clock_Freq
      return
    )
    else if ("&clk_desired_freq"=="50.0")
    (
      &clk_src_name="GPLL0"
      &clk_src_sel=SRC_SEL TODO.
      &clk_src_div=24.
      &clk_m_val=0.
      &clk_n_val=0.
      &clk_2d_val=0.
      
      gosub Set_Clock_Freq
      return
    )
    else if ("&clk_desired_freq"=="r")
    (
      return
    )
    else
    (
      print "Invalid selection."
      goto Set_Clock_Freq_Enter
    )
  )

  if ("&clk"=="gcc_blsp1_uart1_apps_clk")
  (
    gosub PRINT_SET_CLOCK_FREQ_WARNING

    &clk_cmd_rcgr_addr=&HWIO_GCC_BLSP1_UART1_APPS_CMD_RCGR_ADDR
    &clk_cfg_rcgr_addr=&HWIO_GCC_BLSP1_UART1_APPS_CFG_RCGR_ADDR

    print "Choose frequency (MHz) from list below: " 

    print "3.6864         7.3728         14.7456        " 
    print "16.0           19.2           24.0           " 
    print "32.0           40.0           46.4           " 
    print "48.0           51.2           56.0           " 
    print "58.9824        60.0           63.16          " 

    print ""
    print "Enter desired frequency (r to return): "
    enter &clk_desired_freq
    print ""

    if ("&clk_desired_freq"=="3.6864")
    (
      &clk_src_name="GPLL0"
      &clk_src_sel=SRC_SEL TODO.
      &clk_src_div=2.
      &clk_m_val=96.
      &clk_n_val=15625.
      &clk_2d_val=15625.
      
      gosub Set_Clock_Freq
      return
    )
    else if ("&clk_desired_freq"=="7.3728")
    (
      &clk_src_name="GPLL0"
      &clk_src_sel=SRC_SEL TODO.
      &clk_src_div=2.
      &clk_m_val=192.
      &clk_n_val=15625.
      &clk_2d_val=15625.
      
      gosub Set_Clock_Freq
      return
    )
    else if ("&clk_desired_freq"=="14.7456")
    (
      &clk_src_name="GPLL0"
      &clk_src_sel=SRC_SEL TODO.
      &clk_src_div=2.
      &clk_m_val=384.
      &clk_n_val=15625.
      &clk_2d_val=15625.
      
      gosub Set_Clock_Freq
      return
    )
    else if ("&clk_desired_freq"=="16.0")
    (
      &clk_src_name="GPLL0"
      &clk_src_sel=SRC_SEL TODO.
      &clk_src_div=10.
      &clk_m_val=2.
      &clk_n_val=15.
      &clk_2d_val=15.
      
      gosub Set_Clock_Freq
      return
    )
    else if ("&clk_desired_freq"=="19.2")
    (
      &clk_src_name="XO"
      &clk_src_sel=SRC_SEL TODO.
      &clk_src_div=2.
      &clk_m_val=0.
      &clk_n_val=0.
      &clk_2d_val=0.
      
      gosub Set_Clock_Freq
      return
    )
    else if ("&clk_desired_freq"=="24.0")
    (
      &clk_src_name="GPLL0"
      &clk_src_sel=SRC_SEL TODO.
      &clk_src_div=10.
      &clk_m_val=1.
      &clk_n_val=5.
      &clk_2d_val=5.
      
      gosub Set_Clock_Freq
      return
    )
    else if ("&clk_desired_freq"=="32.0")
    (
      &clk_src_name="GPLL0"
      &clk_src_sel=SRC_SEL TODO.
      &clk_src_div=2.
      &clk_m_val=4.
      &clk_n_val=75.
      &clk_2d_val=75.
      
      gosub Set_Clock_Freq
      return
    )
    else if ("&clk_desired_freq"=="40.0")
    (
      &clk_src_name="GPLL0"
      &clk_src_sel=SRC_SEL TODO.
      &clk_src_div=30.
      &clk_m_val=0.
      &clk_n_val=0.
      &clk_2d_val=0.
      
      gosub Set_Clock_Freq
      return
    )
    else if ("&clk_desired_freq"=="46.4")
    (
      &clk_src_name="GPLL0"
      &clk_src_sel=SRC_SEL TODO.
      &clk_src_div=2.
      &clk_m_val=29.
      &clk_n_val=375.
      &clk_2d_val=375.
      
      gosub Set_Clock_Freq
      return
    )
    else if ("&clk_desired_freq"=="48.0")
    (
      &clk_src_name="GPLL0"
      &clk_src_sel=SRC_SEL TODO.
      &clk_src_div=25.
      &clk_m_val=0.
      &clk_n_val=0.
      &clk_2d_val=0.
      
      gosub Set_Clock_Freq
      return
    )
    else if ("&clk_desired_freq"=="51.2")
    (
      &clk_src_name="GPLL0"
      &clk_src_sel=SRC_SEL TODO.
      &clk_src_div=2.
      &clk_m_val=32.
      &clk_n_val=375.
      &clk_2d_val=375.
      
      gosub Set_Clock_Freq
      return
    )
    else if ("&clk_desired_freq"=="56.0")
    (
      &clk_src_name="GPLL0"
      &clk_src_sel=SRC_SEL TODO.
      &clk_src_div=2.
      &clk_m_val=7.
      &clk_n_val=75.
      &clk_2d_val=75.
      
      gosub Set_Clock_Freq
      return
    )
    else if ("&clk_desired_freq"=="58.9824")
    (
      &clk_src_name="GPLL0"
      &clk_src_sel=SRC_SEL TODO.
      &clk_src_div=2.
      &clk_m_val=1536.
      &clk_n_val=15625.
      &clk_2d_val=15625.
      
      gosub Set_Clock_Freq
      return
    )
    else if ("&clk_desired_freq"=="60.0")
    (
      &clk_src_name="GPLL0"
      &clk_src_sel=SRC_SEL TODO.
      &clk_src_div=20.
      &clk_m_val=0.
      &clk_n_val=0.
      &clk_2d_val=0.
      
      gosub Set_Clock_Freq
      return
    )
    else if ("&clk_desired_freq"=="63.16")
    (
      &clk_src_name="GPLL0"
      &clk_src_sel=SRC_SEL TODO.
      &clk_src_div=19.
      &clk_m_val=0.
      &clk_n_val=0.
      &clk_2d_val=0.
      
      gosub Set_Clock_Freq
      return
    )
    else if ("&clk_desired_freq"=="r")
    (
      return
    )
    else
    (
      print "Invalid selection."
      goto Set_Clock_Freq_Enter
    )
  )

  if ("&clk"=="gcc_blsp1_uart2_apps_clk")
  (
    gosub PRINT_SET_CLOCK_FREQ_WARNING

    &clk_cmd_rcgr_addr=&HWIO_GCC_BLSP1_UART2_APPS_CMD_RCGR_ADDR
    &clk_cfg_rcgr_addr=&HWIO_GCC_BLSP1_UART2_APPS_CFG_RCGR_ADDR

    print "Choose frequency (MHz) from list below: " 

    print "3.6864         7.3728         14.7456        " 
    print "16.0           19.2           24.0           " 
    print "32.0           40.0           46.4           " 
    print "48.0           51.2           56.0           " 
    print "58.9824        60.0           63.16          " 

    print ""
    print "Enter desired frequency (r to return): "
    enter &clk_desired_freq
    print ""

    if ("&clk_desired_freq"=="3.6864")
    (
      &clk_src_name="GPLL0"
      &clk_src_sel=SRC_SEL TODO.
      &clk_src_div=2.
      &clk_m_val=96.
      &clk_n_val=15625.
      &clk_2d_val=15625.
      
      gosub Set_Clock_Freq
      return
    )
    else if ("&clk_desired_freq"=="7.3728")
    (
      &clk_src_name="GPLL0"
      &clk_src_sel=SRC_SEL TODO.
      &clk_src_div=2.
      &clk_m_val=192.
      &clk_n_val=15625.
      &clk_2d_val=15625.
      
      gosub Set_Clock_Freq
      return
    )
    else if ("&clk_desired_freq"=="14.7456")
    (
      &clk_src_name="GPLL0"
      &clk_src_sel=SRC_SEL TODO.
      &clk_src_div=2.
      &clk_m_val=384.
      &clk_n_val=15625.
      &clk_2d_val=15625.
      
      gosub Set_Clock_Freq
      return
    )
    else if ("&clk_desired_freq"=="16.0")
    (
      &clk_src_name="GPLL0"
      &clk_src_sel=SRC_SEL TODO.
      &clk_src_div=10.
      &clk_m_val=2.
      &clk_n_val=15.
      &clk_2d_val=15.
      
      gosub Set_Clock_Freq
      return
    )
    else if ("&clk_desired_freq"=="19.2")
    (
      &clk_src_name="XO"
      &clk_src_sel=SRC_SEL TODO.
      &clk_src_div=2.
      &clk_m_val=0.
      &clk_n_val=0.
      &clk_2d_val=0.
      
      gosub Set_Clock_Freq
      return
    )
    else if ("&clk_desired_freq"=="24.0")
    (
      &clk_src_name="GPLL0"
      &clk_src_sel=SRC_SEL TODO.
      &clk_src_div=10.
      &clk_m_val=1.
      &clk_n_val=5.
      &clk_2d_val=5.
      
      gosub Set_Clock_Freq
      return
    )
    else if ("&clk_desired_freq"=="32.0")
    (
      &clk_src_name="GPLL0"
      &clk_src_sel=SRC_SEL TODO.
      &clk_src_div=2.
      &clk_m_val=4.
      &clk_n_val=75.
      &clk_2d_val=75.
      
      gosub Set_Clock_Freq
      return
    )
    else if ("&clk_desired_freq"=="40.0")
    (
      &clk_src_name="GPLL0"
      &clk_src_sel=SRC_SEL TODO.
      &clk_src_div=30.
      &clk_m_val=0.
      &clk_n_val=0.
      &clk_2d_val=0.
      
      gosub Set_Clock_Freq
      return
    )
    else if ("&clk_desired_freq"=="46.4")
    (
      &clk_src_name="GPLL0"
      &clk_src_sel=SRC_SEL TODO.
      &clk_src_div=2.
      &clk_m_val=29.
      &clk_n_val=375.
      &clk_2d_val=375.
      
      gosub Set_Clock_Freq
      return
    )
    else if ("&clk_desired_freq"=="48.0")
    (
      &clk_src_name="GPLL0"
      &clk_src_sel=SRC_SEL TODO.
      &clk_src_div=25.
      &clk_m_val=0.
      &clk_n_val=0.
      &clk_2d_val=0.
      
      gosub Set_Clock_Freq
      return
    )
    else if ("&clk_desired_freq"=="51.2")
    (
      &clk_src_name="GPLL0"
      &clk_src_sel=SRC_SEL TODO.
      &clk_src_div=2.
      &clk_m_val=32.
      &clk_n_val=375.
      &clk_2d_val=375.
      
      gosub Set_Clock_Freq
      return
    )
    else if ("&clk_desired_freq"=="56.0")
    (
      &clk_src_name="GPLL0"
      &clk_src_sel=SRC_SEL TODO.
      &clk_src_div=2.
      &clk_m_val=7.
      &clk_n_val=75.
      &clk_2d_val=75.
      
      gosub Set_Clock_Freq
      return
    )
    else if ("&clk_desired_freq"=="58.9824")
    (
      &clk_src_name="GPLL0"
      &clk_src_sel=SRC_SEL TODO.
      &clk_src_div=2.
      &clk_m_val=1536.
      &clk_n_val=15625.
      &clk_2d_val=15625.
      
      gosub Set_Clock_Freq
      return
    )
    else if ("&clk_desired_freq"=="60.0")
    (
      &clk_src_name="GPLL0"
      &clk_src_sel=SRC_SEL TODO.
      &clk_src_div=20.
      &clk_m_val=0.
      &clk_n_val=0.
      &clk_2d_val=0.
      
      gosub Set_Clock_Freq
      return
    )
    else if ("&clk_desired_freq"=="63.16")
    (
      &clk_src_name="GPLL0"
      &clk_src_sel=SRC_SEL TODO.
      &clk_src_div=19.
      &clk_m_val=0.
      &clk_n_val=0.
      &clk_2d_val=0.
      
      gosub Set_Clock_Freq
      return
    )
    else if ("&clk_desired_freq"=="r")
    (
      return
    )
    else
    (
      print "Invalid selection."
      goto Set_Clock_Freq_Enter
    )
  )

  if ("&clk"=="gcc_blsp1_uart3_apps_clk")
  (
    gosub PRINT_SET_CLOCK_FREQ_WARNING

    &clk_cmd_rcgr_addr=&HWIO_GCC_BLSP1_UART3_APPS_CMD_RCGR_ADDR
    &clk_cfg_rcgr_addr=&HWIO_GCC_BLSP1_UART3_APPS_CFG_RCGR_ADDR

    print "Choose frequency (MHz) from list below: " 

    print "3.6864         7.3728         14.7456        " 
    print "16.0           19.2           24.0           " 
    print "32.0           40.0           46.4           " 
    print "48.0           51.2           56.0           " 
    print "58.9824        60.0           63.16          " 

    print ""
    print "Enter desired frequency (r to return): "
    enter &clk_desired_freq
    print ""

    if ("&clk_desired_freq"=="3.6864")
    (
      &clk_src_name="GPLL0"
      &clk_src_sel=SRC_SEL TODO.
      &clk_src_div=2.
      &clk_m_val=96.
      &clk_n_val=15625.
      &clk_2d_val=15625.
      
      gosub Set_Clock_Freq
      return
    )
    else if ("&clk_desired_freq"=="7.3728")
    (
      &clk_src_name="GPLL0"
      &clk_src_sel=SRC_SEL TODO.
      &clk_src_div=2.
      &clk_m_val=192.
      &clk_n_val=15625.
      &clk_2d_val=15625.
      
      gosub Set_Clock_Freq
      return
    )
    else if ("&clk_desired_freq"=="14.7456")
    (
      &clk_src_name="GPLL0"
      &clk_src_sel=SRC_SEL TODO.
      &clk_src_div=2.
      &clk_m_val=384.
      &clk_n_val=15625.
      &clk_2d_val=15625.
      
      gosub Set_Clock_Freq
      return
    )
    else if ("&clk_desired_freq"=="16.0")
    (
      &clk_src_name="GPLL0"
      &clk_src_sel=SRC_SEL TODO.
      &clk_src_div=10.
      &clk_m_val=2.
      &clk_n_val=15.
      &clk_2d_val=15.
      
      gosub Set_Clock_Freq
      return
    )
    else if ("&clk_desired_freq"=="19.2")
    (
      &clk_src_name="XO"
      &clk_src_sel=SRC_SEL TODO.
      &clk_src_div=2.
      &clk_m_val=0.
      &clk_n_val=0.
      &clk_2d_val=0.
      
      gosub Set_Clock_Freq
      return
    )
    else if ("&clk_desired_freq"=="24.0")
    (
      &clk_src_name="GPLL0"
      &clk_src_sel=SRC_SEL TODO.
      &clk_src_div=10.
      &clk_m_val=1.
      &clk_n_val=5.
      &clk_2d_val=5.
      
      gosub Set_Clock_Freq
      return
    )
    else if ("&clk_desired_freq"=="32.0")
    (
      &clk_src_name="GPLL0"
      &clk_src_sel=SRC_SEL TODO.
      &clk_src_div=2.
      &clk_m_val=4.
      &clk_n_val=75.
      &clk_2d_val=75.
      
      gosub Set_Clock_Freq
      return
    )
    else if ("&clk_desired_freq"=="40.0")
    (
      &clk_src_name="GPLL0"
      &clk_src_sel=SRC_SEL TODO.
      &clk_src_div=30.
      &clk_m_val=0.
      &clk_n_val=0.
      &clk_2d_val=0.
      
      gosub Set_Clock_Freq
      return
    )
    else if ("&clk_desired_freq"=="46.4")
    (
      &clk_src_name="GPLL0"
      &clk_src_sel=SRC_SEL TODO.
      &clk_src_div=2.
      &clk_m_val=29.
      &clk_n_val=375.
      &clk_2d_val=375.
      
      gosub Set_Clock_Freq
      return
    )
    else if ("&clk_desired_freq"=="48.0")
    (
      &clk_src_name="GPLL0"
      &clk_src_sel=SRC_SEL TODO.
      &clk_src_div=25.
      &clk_m_val=0.
      &clk_n_val=0.
      &clk_2d_val=0.
      
      gosub Set_Clock_Freq
      return
    )
    else if ("&clk_desired_freq"=="51.2")
    (
      &clk_src_name="GPLL0"
      &clk_src_sel=SRC_SEL TODO.
      &clk_src_div=2.
      &clk_m_val=32.
      &clk_n_val=375.
      &clk_2d_val=375.
      
      gosub Set_Clock_Freq
      return
    )
    else if ("&clk_desired_freq"=="56.0")
    (
      &clk_src_name="GPLL0"
      &clk_src_sel=SRC_SEL TODO.
      &clk_src_div=2.
      &clk_m_val=7.
      &clk_n_val=75.
      &clk_2d_val=75.
      
      gosub Set_Clock_Freq
      return
    )
    else if ("&clk_desired_freq"=="58.9824")
    (
      &clk_src_name="GPLL0"
      &clk_src_sel=SRC_SEL TODO.
      &clk_src_div=2.
      &clk_m_val=1536.
      &clk_n_val=15625.
      &clk_2d_val=15625.
      
      gosub Set_Clock_Freq
      return
    )
    else if ("&clk_desired_freq"=="60.0")
    (
      &clk_src_name="GPLL0"
      &clk_src_sel=SRC_SEL TODO.
      &clk_src_div=20.
      &clk_m_val=0.
      &clk_n_val=0.
      &clk_2d_val=0.
      
      gosub Set_Clock_Freq
      return
    )
    else if ("&clk_desired_freq"=="63.16")
    (
      &clk_src_name="GPLL0"
      &clk_src_sel=SRC_SEL TODO.
      &clk_src_div=19.
      &clk_m_val=0.
      &clk_n_val=0.
      &clk_2d_val=0.
      
      gosub Set_Clock_Freq
      return
    )
    else if ("&clk_desired_freq"=="r")
    (
      return
    )
    else
    (
      print "Invalid selection."
      goto Set_Clock_Freq_Enter
    )
  )

  if ("&clk"=="gcc_blsp1_uart4_apps_clk")
  (
    gosub PRINT_SET_CLOCK_FREQ_WARNING

    &clk_cmd_rcgr_addr=&HWIO_GCC_BLSP1_UART4_APPS_CMD_RCGR_ADDR
    &clk_cfg_rcgr_addr=&HWIO_GCC_BLSP1_UART4_APPS_CFG_RCGR_ADDR

    print "Choose frequency (MHz) from list below: " 

    print "3.6864         7.3728         14.7456        " 
    print "16.0           19.2           24.0           " 
    print "32.0           40.0           46.4           " 
    print "48.0           51.2           56.0           " 
    print "58.9824        60.0           63.16          " 

    print ""
    print "Enter desired frequency (r to return): "
    enter &clk_desired_freq
    print ""

    if ("&clk_desired_freq"=="3.6864")
    (
      &clk_src_name="GPLL0"
      &clk_src_sel=SRC_SEL TODO.
      &clk_src_div=2.
      &clk_m_val=96.
      &clk_n_val=15625.
      &clk_2d_val=15625.
      
      gosub Set_Clock_Freq
      return
    )
    else if ("&clk_desired_freq"=="7.3728")
    (
      &clk_src_name="GPLL0"
      &clk_src_sel=SRC_SEL TODO.
      &clk_src_div=2.
      &clk_m_val=192.
      &clk_n_val=15625.
      &clk_2d_val=15625.
      
      gosub Set_Clock_Freq
      return
    )
    else if ("&clk_desired_freq"=="14.7456")
    (
      &clk_src_name="GPLL0"
      &clk_src_sel=SRC_SEL TODO.
      &clk_src_div=2.
      &clk_m_val=384.
      &clk_n_val=15625.
      &clk_2d_val=15625.
      
      gosub Set_Clock_Freq
      return
    )
    else if ("&clk_desired_freq"=="16.0")
    (
      &clk_src_name="GPLL0"
      &clk_src_sel=SRC_SEL TODO.
      &clk_src_div=10.
      &clk_m_val=2.
      &clk_n_val=15.
      &clk_2d_val=15.
      
      gosub Set_Clock_Freq
      return
    )
    else if ("&clk_desired_freq"=="19.2")
    (
      &clk_src_name="XO"
      &clk_src_sel=SRC_SEL TODO.
      &clk_src_div=2.
      &clk_m_val=0.
      &clk_n_val=0.
      &clk_2d_val=0.
      
      gosub Set_Clock_Freq
      return
    )
    else if ("&clk_desired_freq"=="24.0")
    (
      &clk_src_name="GPLL0"
      &clk_src_sel=SRC_SEL TODO.
      &clk_src_div=10.
      &clk_m_val=1.
      &clk_n_val=5.
      &clk_2d_val=5.
      
      gosub Set_Clock_Freq
      return
    )
    else if ("&clk_desired_freq"=="32.0")
    (
      &clk_src_name="GPLL0"
      &clk_src_sel=SRC_SEL TODO.
      &clk_src_div=2.
      &clk_m_val=4.
      &clk_n_val=75.
      &clk_2d_val=75.
      
      gosub Set_Clock_Freq
      return
    )
    else if ("&clk_desired_freq"=="40.0")
    (
      &clk_src_name="GPLL0"
      &clk_src_sel=SRC_SEL TODO.
      &clk_src_div=30.
      &clk_m_val=0.
      &clk_n_val=0.
      &clk_2d_val=0.
      
      gosub Set_Clock_Freq
      return
    )
    else if ("&clk_desired_freq"=="46.4")
    (
      &clk_src_name="GPLL0"
      &clk_src_sel=SRC_SEL TODO.
      &clk_src_div=2.
      &clk_m_val=29.
      &clk_n_val=375.
      &clk_2d_val=375.
      
      gosub Set_Clock_Freq
      return
    )
    else if ("&clk_desired_freq"=="48.0")
    (
      &clk_src_name="GPLL0"
      &clk_src_sel=SRC_SEL TODO.
      &clk_src_div=25.
      &clk_m_val=0.
      &clk_n_val=0.
      &clk_2d_val=0.
      
      gosub Set_Clock_Freq
      return
    )
    else if ("&clk_desired_freq"=="51.2")
    (
      &clk_src_name="GPLL0"
      &clk_src_sel=SRC_SEL TODO.
      &clk_src_div=2.
      &clk_m_val=32.
      &clk_n_val=375.
      &clk_2d_val=375.
      
      gosub Set_Clock_Freq
      return
    )
    else if ("&clk_desired_freq"=="56.0")
    (
      &clk_src_name="GPLL0"
      &clk_src_sel=SRC_SEL TODO.
      &clk_src_div=2.
      &clk_m_val=7.
      &clk_n_val=75.
      &clk_2d_val=75.
      
      gosub Set_Clock_Freq
      return
    )
    else if ("&clk_desired_freq"=="58.9824")
    (
      &clk_src_name="GPLL0"
      &clk_src_sel=SRC_SEL TODO.
      &clk_src_div=2.
      &clk_m_val=1536.
      &clk_n_val=15625.
      &clk_2d_val=15625.
      
      gosub Set_Clock_Freq
      return
    )
    else if ("&clk_desired_freq"=="60.0")
    (
      &clk_src_name="GPLL0"
      &clk_src_sel=SRC_SEL TODO.
      &clk_src_div=20.
      &clk_m_val=0.
      &clk_n_val=0.
      &clk_2d_val=0.
      
      gosub Set_Clock_Freq
      return
    )
    else if ("&clk_desired_freq"=="63.16")
    (
      &clk_src_name="GPLL0"
      &clk_src_sel=SRC_SEL TODO.
      &clk_src_div=19.
      &clk_m_val=0.
      &clk_n_val=0.
      &clk_2d_val=0.
      
      gosub Set_Clock_Freq
      return
    )
    else if ("&clk_desired_freq"=="r")
    (
      return
    )
    else
    (
      print "Invalid selection."
      goto Set_Clock_Freq_Enter
    )
  )

  if ("&clk"=="gcc_blsp1_uart5_apps_clk")
  (
    gosub PRINT_SET_CLOCK_FREQ_WARNING

    &clk_cmd_rcgr_addr=&HWIO_GCC_BLSP1_UART5_APPS_CMD_RCGR_ADDR
    &clk_cfg_rcgr_addr=&HWIO_GCC_BLSP1_UART5_APPS_CFG_RCGR_ADDR

    print "Choose frequency (MHz) from list below: " 

    print "3.6864         7.3728         14.7456        " 
    print "16.0           19.2           24.0           " 
    print "32.0           40.0           46.4           " 
    print "48.0           51.2           56.0           " 
    print "58.9824        60.0           63.16          " 

    print ""
    print "Enter desired frequency (r to return): "
    enter &clk_desired_freq
    print ""

    if ("&clk_desired_freq"=="3.6864")
    (
      &clk_src_name="GPLL0"
      &clk_src_sel=SRC_SEL TODO.
      &clk_src_div=2.
      &clk_m_val=96.
      &clk_n_val=15625.
      &clk_2d_val=15625.
      
      gosub Set_Clock_Freq
      return
    )
    else if ("&clk_desired_freq"=="7.3728")
    (
      &clk_src_name="GPLL0"
      &clk_src_sel=SRC_SEL TODO.
      &clk_src_div=2.
      &clk_m_val=192.
      &clk_n_val=15625.
      &clk_2d_val=15625.
      
      gosub Set_Clock_Freq
      return
    )
    else if ("&clk_desired_freq"=="14.7456")
    (
      &clk_src_name="GPLL0"
      &clk_src_sel=SRC_SEL TODO.
      &clk_src_div=2.
      &clk_m_val=384.
      &clk_n_val=15625.
      &clk_2d_val=15625.
      
      gosub Set_Clock_Freq
      return
    )
    else if ("&clk_desired_freq"=="16.0")
    (
      &clk_src_name="GPLL0"
      &clk_src_sel=SRC_SEL TODO.
      &clk_src_div=10.
      &clk_m_val=2.
      &clk_n_val=15.
      &clk_2d_val=15.
      
      gosub Set_Clock_Freq
      return
    )
    else if ("&clk_desired_freq"=="19.2")
    (
      &clk_src_name="XO"
      &clk_src_sel=SRC_SEL TODO.
      &clk_src_div=2.
      &clk_m_val=0.
      &clk_n_val=0.
      &clk_2d_val=0.
      
      gosub Set_Clock_Freq
      return
    )
    else if ("&clk_desired_freq"=="24.0")
    (
      &clk_src_name="GPLL0"
      &clk_src_sel=SRC_SEL TODO.
      &clk_src_div=10.
      &clk_m_val=1.
      &clk_n_val=5.
      &clk_2d_val=5.
      
      gosub Set_Clock_Freq
      return
    )
    else if ("&clk_desired_freq"=="32.0")
    (
      &clk_src_name="GPLL0"
      &clk_src_sel=SRC_SEL TODO.
      &clk_src_div=2.
      &clk_m_val=4.
      &clk_n_val=75.
      &clk_2d_val=75.
      
      gosub Set_Clock_Freq
      return
    )
    else if ("&clk_desired_freq"=="40.0")
    (
      &clk_src_name="GPLL0"
      &clk_src_sel=SRC_SEL TODO.
      &clk_src_div=30.
      &clk_m_val=0.
      &clk_n_val=0.
      &clk_2d_val=0.
      
      gosub Set_Clock_Freq
      return
    )
    else if ("&clk_desired_freq"=="46.4")
    (
      &clk_src_name="GPLL0"
      &clk_src_sel=SRC_SEL TODO.
      &clk_src_div=2.
      &clk_m_val=29.
      &clk_n_val=375.
      &clk_2d_val=375.
      
      gosub Set_Clock_Freq
      return
    )
    else if ("&clk_desired_freq"=="48.0")
    (
      &clk_src_name="GPLL0"
      &clk_src_sel=SRC_SEL TODO.
      &clk_src_div=25.
      &clk_m_val=0.
      &clk_n_val=0.
      &clk_2d_val=0.
      
      gosub Set_Clock_Freq
      return
    )
    else if ("&clk_desired_freq"=="51.2")
    (
      &clk_src_name="GPLL0"
      &clk_src_sel=SRC_SEL TODO.
      &clk_src_div=2.
      &clk_m_val=32.
      &clk_n_val=375.
      &clk_2d_val=375.
      
      gosub Set_Clock_Freq
      return
    )
    else if ("&clk_desired_freq"=="56.0")
    (
      &clk_src_name="GPLL0"
      &clk_src_sel=SRC_SEL TODO.
      &clk_src_div=2.
      &clk_m_val=7.
      &clk_n_val=75.
      &clk_2d_val=75.
      
      gosub Set_Clock_Freq
      return
    )
    else if ("&clk_desired_freq"=="58.9824")
    (
      &clk_src_name="GPLL0"
      &clk_src_sel=SRC_SEL TODO.
      &clk_src_div=2.
      &clk_m_val=1536.
      &clk_n_val=15625.
      &clk_2d_val=15625.
      
      gosub Set_Clock_Freq
      return
    )
    else if ("&clk_desired_freq"=="60.0")
    (
      &clk_src_name="GPLL0"
      &clk_src_sel=SRC_SEL TODO.
      &clk_src_div=20.
      &clk_m_val=0.
      &clk_n_val=0.
      &clk_2d_val=0.
      
      gosub Set_Clock_Freq
      return
    )
    else if ("&clk_desired_freq"=="63.16")
    (
      &clk_src_name="GPLL0"
      &clk_src_sel=SRC_SEL TODO.
      &clk_src_div=19.
      &clk_m_val=0.
      &clk_n_val=0.
      &clk_2d_val=0.
      
      gosub Set_Clock_Freq
      return
    )
    else if ("&clk_desired_freq"=="r")
    (
      return
    )
    else
    (
      print "Invalid selection."
      goto Set_Clock_Freq_Enter
    )
  )

  if ("&clk"=="gcc_blsp1_uart6_apps_clk")
  (
    gosub PRINT_SET_CLOCK_FREQ_WARNING

    &clk_cmd_rcgr_addr=&HWIO_GCC_BLSP1_UART6_APPS_CMD_RCGR_ADDR
    &clk_cfg_rcgr_addr=&HWIO_GCC_BLSP1_UART6_APPS_CFG_RCGR_ADDR

    print "Choose frequency (MHz) from list below: " 

    print "3.6864         7.3728         14.7456        " 
    print "16.0           19.2           24.0           " 
    print "32.0           40.0           46.4           " 
    print "48.0           51.2           56.0           " 
    print "58.9824        60.0           63.16          " 

    print ""
    print "Enter desired frequency (r to return): "
    enter &clk_desired_freq
    print ""

    if ("&clk_desired_freq"=="3.6864")
    (
      &clk_src_name="GPLL0"
      &clk_src_sel=SRC_SEL TODO.
      &clk_src_div=2.
      &clk_m_val=96.
      &clk_n_val=15625.
      &clk_2d_val=15625.
      
      gosub Set_Clock_Freq
      return
    )
    else if ("&clk_desired_freq"=="7.3728")
    (
      &clk_src_name="GPLL0"
      &clk_src_sel=SRC_SEL TODO.
      &clk_src_div=2.
      &clk_m_val=192.
      &clk_n_val=15625.
      &clk_2d_val=15625.
      
      gosub Set_Clock_Freq
      return
    )
    else if ("&clk_desired_freq"=="14.7456")
    (
      &clk_src_name="GPLL0"
      &clk_src_sel=SRC_SEL TODO.
      &clk_src_div=2.
      &clk_m_val=384.
      &clk_n_val=15625.
      &clk_2d_val=15625.
      
      gosub Set_Clock_Freq
      return
    )
    else if ("&clk_desired_freq"=="16.0")
    (
      &clk_src_name="GPLL0"
      &clk_src_sel=SRC_SEL TODO.
      &clk_src_div=10.
      &clk_m_val=2.
      &clk_n_val=15.
      &clk_2d_val=15.
      
      gosub Set_Clock_Freq
      return
    )
    else if ("&clk_desired_freq"=="19.2")
    (
      &clk_src_name="XO"
      &clk_src_sel=SRC_SEL TODO.
      &clk_src_div=2.
      &clk_m_val=0.
      &clk_n_val=0.
      &clk_2d_val=0.
      
      gosub Set_Clock_Freq
      return
    )
    else if ("&clk_desired_freq"=="24.0")
    (
      &clk_src_name="GPLL0"
      &clk_src_sel=SRC_SEL TODO.
      &clk_src_div=10.
      &clk_m_val=1.
      &clk_n_val=5.
      &clk_2d_val=5.
      
      gosub Set_Clock_Freq
      return
    )
    else if ("&clk_desired_freq"=="32.0")
    (
      &clk_src_name="GPLL0"
      &clk_src_sel=SRC_SEL TODO.
      &clk_src_div=2.
      &clk_m_val=4.
      &clk_n_val=75.
      &clk_2d_val=75.
      
      gosub Set_Clock_Freq
      return
    )
    else if ("&clk_desired_freq"=="40.0")
    (
      &clk_src_name="GPLL0"
      &clk_src_sel=SRC_SEL TODO.
      &clk_src_div=30.
      &clk_m_val=0.
      &clk_n_val=0.
      &clk_2d_val=0.
      
      gosub Set_Clock_Freq
      return
    )
    else if ("&clk_desired_freq"=="46.4")
    (
      &clk_src_name="GPLL0"
      &clk_src_sel=SRC_SEL TODO.
      &clk_src_div=2.
      &clk_m_val=29.
      &clk_n_val=375.
      &clk_2d_val=375.
      
      gosub Set_Clock_Freq
      return
    )
    else if ("&clk_desired_freq"=="48.0")
    (
      &clk_src_name="GPLL0"
      &clk_src_sel=SRC_SEL TODO.
      &clk_src_div=25.
      &clk_m_val=0.
      &clk_n_val=0.
      &clk_2d_val=0.
      
      gosub Set_Clock_Freq
      return
    )
    else if ("&clk_desired_freq"=="51.2")
    (
      &clk_src_name="GPLL0"
      &clk_src_sel=SRC_SEL TODO.
      &clk_src_div=2.
      &clk_m_val=32.
      &clk_n_val=375.
      &clk_2d_val=375.
      
      gosub Set_Clock_Freq
      return
    )
    else if ("&clk_desired_freq"=="56.0")
    (
      &clk_src_name="GPLL0"
      &clk_src_sel=SRC_SEL TODO.
      &clk_src_div=2.
      &clk_m_val=7.
      &clk_n_val=75.
      &clk_2d_val=75.
      
      gosub Set_Clock_Freq
      return
    )
    else if ("&clk_desired_freq"=="58.9824")
    (
      &clk_src_name="GPLL0"
      &clk_src_sel=SRC_SEL TODO.
      &clk_src_div=2.
      &clk_m_val=1536.
      &clk_n_val=15625.
      &clk_2d_val=15625.
      
      gosub Set_Clock_Freq
      return
    )
    else if ("&clk_desired_freq"=="60.0")
    (
      &clk_src_name="GPLL0"
      &clk_src_sel=SRC_SEL TODO.
      &clk_src_div=20.
      &clk_m_val=0.
      &clk_n_val=0.
      &clk_2d_val=0.
      
      gosub Set_Clock_Freq
      return
    )
    else if ("&clk_desired_freq"=="63.16")
    (
      &clk_src_name="GPLL0"
      &clk_src_sel=SRC_SEL TODO.
      &clk_src_div=19.
      &clk_m_val=0.
      &clk_n_val=0.
      &clk_2d_val=0.
      
      gosub Set_Clock_Freq
      return
    )
    else if ("&clk_desired_freq"=="r")
    (
      return
    )
    else
    (
      print "Invalid selection."
      goto Set_Clock_Freq_Enter
    )
  )

  if ("&clk"=="gcc_blsp2_qup1_i2c_apps_clk")
  (
    gosub PRINT_SET_CLOCK_FREQ_WARNING

    &clk_cmd_rcgr_addr=&HWIO_GCC_BLSP2_QUP1_I2C_APPS_CMD_RCGR_ADDR
    &clk_cfg_rcgr_addr=&HWIO_GCC_BLSP2_QUP1_I2C_APPS_CFG_RCGR_ADDR

    print "Choose frequency (MHz) from list below: " 

    print "19.2           50.0           " 

    print ""
    print "Enter desired frequency (r to return): "
    enter &clk_desired_freq
    print ""

    if ("&clk_desired_freq"=="19.2")
    (
      &clk_src_name="XO"
      &clk_src_sel=SRC_SEL TODO.
      &clk_src_div=2.
      &clk_m_val=0.
      &clk_n_val=0.
      &clk_2d_val=0.
      
      gosub Set_Clock_Freq
      return
    )
    else if ("&clk_desired_freq"=="50.0")
    (
      &clk_src_name="GPLL0"
      &clk_src_sel=SRC_SEL TODO.
      &clk_src_div=24.
      &clk_m_val=0.
      &clk_n_val=0.
      &clk_2d_val=0.
      
      gosub Set_Clock_Freq
      return
    )
    else if ("&clk_desired_freq"=="r")
    (
      return
    )
    else
    (
      print "Invalid selection."
      goto Set_Clock_Freq_Enter
    )
  )

  if ("&clk"=="gcc_blsp2_qup1_spi_apps_clk")
  (
    gosub PRINT_SET_CLOCK_FREQ_WARNING

    &clk_cmd_rcgr_addr=&HWIO_GCC_BLSP2_QUP1_SPI_APPS_CMD_RCGR_ADDR
    &clk_cfg_rcgr_addr=&HWIO_GCC_BLSP2_QUP1_SPI_APPS_CFG_RCGR_ADDR

    print "Choose frequency (MHz) from list below: " 

    print "0.96           4.8            9.6            " 
    print "15.0           19.2           25.0           " 
    print "50.0           " 

    print ""
    print "Enter desired frequency (r to return): "
    enter &clk_desired_freq
    print ""

    if ("&clk_desired_freq"=="0.96")
    (
      &clk_src_name="XO"
      &clk_src_sel=SRC_SEL TODO.
      &clk_src_div=20.
      &clk_m_val=1.
      &clk_n_val=2.
      &clk_2d_val=2.
      
      gosub Set_Clock_Freq
      return
    )
    else if ("&clk_desired_freq"=="4.8")
    (
      &clk_src_name="XO"
      &clk_src_sel=SRC_SEL TODO.
      &clk_src_div=8.
      &clk_m_val=0.
      &clk_n_val=0.
      &clk_2d_val=0.
      
      gosub Set_Clock_Freq
      return
    )
    else if ("&clk_desired_freq"=="9.6")
    (
      &clk_src_name="XO"
      &clk_src_sel=SRC_SEL TODO.
      &clk_src_div=4.
      &clk_m_val=0.
      &clk_n_val=0.
      &clk_2d_val=0.
      
      gosub Set_Clock_Freq
      return
    )
    else if ("&clk_desired_freq"=="15.0")
    (
      &clk_src_name="GPLL0"
      &clk_src_sel=SRC_SEL TODO.
      &clk_src_div=20.
      &clk_m_val=1.
      &clk_n_val=4.
      &clk_2d_val=4.
      
      gosub Set_Clock_Freq
      return
    )
    else if ("&clk_desired_freq"=="19.2")
    (
      &clk_src_name="XO"
      &clk_src_sel=SRC_SEL TODO.
      &clk_src_div=2.
      &clk_m_val=0.
      &clk_n_val=0.
      &clk_2d_val=0.
      
      gosub Set_Clock_Freq
      return
    )
    else if ("&clk_desired_freq"=="25.0")
    (
      &clk_src_name="GPLL0"
      &clk_src_sel=SRC_SEL TODO.
      &clk_src_div=24.
      &clk_m_val=1.
      &clk_n_val=2.
      &clk_2d_val=2.
      
      gosub Set_Clock_Freq
      return
    )
    else if ("&clk_desired_freq"=="50.0")
    (
      &clk_src_name="GPLL0"
      &clk_src_sel=SRC_SEL TODO.
      &clk_src_div=24.
      &clk_m_val=0.
      &clk_n_val=0.
      &clk_2d_val=0.
      
      gosub Set_Clock_Freq
      return
    )
    else if ("&clk_desired_freq"=="r")
    (
      return
    )
    else
    (
      print "Invalid selection."
      goto Set_Clock_Freq_Enter
    )
  )

  if ("&clk"=="gcc_blsp2_qup2_i2c_apps_clk")
  (
    gosub PRINT_SET_CLOCK_FREQ_WARNING

    &clk_cmd_rcgr_addr=&HWIO_GCC_BLSP2_QUP2_I2C_APPS_CMD_RCGR_ADDR
    &clk_cfg_rcgr_addr=&HWIO_GCC_BLSP2_QUP2_I2C_APPS_CFG_RCGR_ADDR

    print "Choose frequency (MHz) from list below: " 

    print "19.2           50.0           " 

    print ""
    print "Enter desired frequency (r to return): "
    enter &clk_desired_freq
    print ""

    if ("&clk_desired_freq"=="19.2")
    (
      &clk_src_name="XO"
      &clk_src_sel=SRC_SEL TODO.
      &clk_src_div=2.
      &clk_m_val=0.
      &clk_n_val=0.
      &clk_2d_val=0.
      
      gosub Set_Clock_Freq
      return
    )
    else if ("&clk_desired_freq"=="50.0")
    (
      &clk_src_name="GPLL0"
      &clk_src_sel=SRC_SEL TODO.
      &clk_src_div=24.
      &clk_m_val=0.
      &clk_n_val=0.
      &clk_2d_val=0.
      
      gosub Set_Clock_Freq
      return
    )
    else if ("&clk_desired_freq"=="r")
    (
      return
    )
    else
    (
      print "Invalid selection."
      goto Set_Clock_Freq_Enter
    )
  )

  if ("&clk"=="gcc_blsp2_qup2_spi_apps_clk")
  (
    gosub PRINT_SET_CLOCK_FREQ_WARNING

    &clk_cmd_rcgr_addr=&HWIO_GCC_BLSP2_QUP2_SPI_APPS_CMD_RCGR_ADDR
    &clk_cfg_rcgr_addr=&HWIO_GCC_BLSP2_QUP2_SPI_APPS_CFG_RCGR_ADDR

    print "Choose frequency (MHz) from list below: " 

    print "0.96           4.8            9.6            " 
    print "15.0           19.2           25.0           " 
    print "50.0           " 

    print ""
    print "Enter desired frequency (r to return): "
    enter &clk_desired_freq
    print ""

    if ("&clk_desired_freq"=="0.96")
    (
      &clk_src_name="XO"
      &clk_src_sel=SRC_SEL TODO.
      &clk_src_div=20.
      &clk_m_val=1.
      &clk_n_val=2.
      &clk_2d_val=2.
      
      gosub Set_Clock_Freq
      return
    )
    else if ("&clk_desired_freq"=="4.8")
    (
      &clk_src_name="XO"
      &clk_src_sel=SRC_SEL TODO.
      &clk_src_div=8.
      &clk_m_val=0.
      &clk_n_val=0.
      &clk_2d_val=0.
      
      gosub Set_Clock_Freq
      return
    )
    else if ("&clk_desired_freq"=="9.6")
    (
      &clk_src_name="XO"
      &clk_src_sel=SRC_SEL TODO.
      &clk_src_div=4.
      &clk_m_val=0.
      &clk_n_val=0.
      &clk_2d_val=0.
      
      gosub Set_Clock_Freq
      return
    )
    else if ("&clk_desired_freq"=="15.0")
    (
      &clk_src_name="GPLL0"
      &clk_src_sel=SRC_SEL TODO.
      &clk_src_div=20.
      &clk_m_val=1.
      &clk_n_val=4.
      &clk_2d_val=4.
      
      gosub Set_Clock_Freq
      return
    )
    else if ("&clk_desired_freq"=="19.2")
    (
      &clk_src_name="XO"
      &clk_src_sel=SRC_SEL TODO.
      &clk_src_div=2.
      &clk_m_val=0.
      &clk_n_val=0.
      &clk_2d_val=0.
      
      gosub Set_Clock_Freq
      return
    )
    else if ("&clk_desired_freq"=="25.0")
    (
      &clk_src_name="GPLL0"
      &clk_src_sel=SRC_SEL TODO.
      &clk_src_div=24.
      &clk_m_val=1.
      &clk_n_val=2.
      &clk_2d_val=2.
      
      gosub Set_Clock_Freq
      return
    )
    else if ("&clk_desired_freq"=="50.0")
    (
      &clk_src_name="GPLL0"
      &clk_src_sel=SRC_SEL TODO.
      &clk_src_div=24.
      &clk_m_val=0.
      &clk_n_val=0.
      &clk_2d_val=0.
      
      gosub Set_Clock_Freq
      return
    )
    else if ("&clk_desired_freq"=="r")
    (
      return
    )
    else
    (
      print "Invalid selection."
      goto Set_Clock_Freq_Enter
    )
  )

  if ("&clk"=="gcc_blsp2_qup3_i2c_apps_clk")
  (
    gosub PRINT_SET_CLOCK_FREQ_WARNING

    &clk_cmd_rcgr_addr=&HWIO_GCC_BLSP2_QUP3_I2C_APPS_CMD_RCGR_ADDR
    &clk_cfg_rcgr_addr=&HWIO_GCC_BLSP2_QUP3_I2C_APPS_CFG_RCGR_ADDR

    print "Choose frequency (MHz) from list below: " 

    print "19.2           50.0           " 

    print ""
    print "Enter desired frequency (r to return): "
    enter &clk_desired_freq
    print ""

    if ("&clk_desired_freq"=="19.2")
    (
      &clk_src_name="XO"
      &clk_src_sel=SRC_SEL TODO.
      &clk_src_div=2.
      &clk_m_val=0.
      &clk_n_val=0.
      &clk_2d_val=0.
      
      gosub Set_Clock_Freq
      return
    )
    else if ("&clk_desired_freq"=="50.0")
    (
      &clk_src_name="GPLL0"
      &clk_src_sel=SRC_SEL TODO.
      &clk_src_div=24.
      &clk_m_val=0.
      &clk_n_val=0.
      &clk_2d_val=0.
      
      gosub Set_Clock_Freq
      return
    )
    else if ("&clk_desired_freq"=="r")
    (
      return
    )
    else
    (
      print "Invalid selection."
      goto Set_Clock_Freq_Enter
    )
  )

  if ("&clk"=="gcc_blsp2_qup3_spi_apps_clk")
  (
    gosub PRINT_SET_CLOCK_FREQ_WARNING

    &clk_cmd_rcgr_addr=&HWIO_GCC_BLSP2_QUP3_SPI_APPS_CMD_RCGR_ADDR
    &clk_cfg_rcgr_addr=&HWIO_GCC_BLSP2_QUP3_SPI_APPS_CFG_RCGR_ADDR

    print "Choose frequency (MHz) from list below: " 

    print "0.96           4.8            9.6            " 
    print "15.0           19.2           25.0           " 
    print "50.0           " 

    print ""
    print "Enter desired frequency (r to return): "
    enter &clk_desired_freq
    print ""

    if ("&clk_desired_freq"=="0.96")
    (
      &clk_src_name="XO"
      &clk_src_sel=SRC_SEL TODO.
      &clk_src_div=20.
      &clk_m_val=1.
      &clk_n_val=2.
      &clk_2d_val=2.
      
      gosub Set_Clock_Freq
      return
    )
    else if ("&clk_desired_freq"=="4.8")
    (
      &clk_src_name="XO"
      &clk_src_sel=SRC_SEL TODO.
      &clk_src_div=8.
      &clk_m_val=0.
      &clk_n_val=0.
      &clk_2d_val=0.
      
      gosub Set_Clock_Freq
      return
    )
    else if ("&clk_desired_freq"=="9.6")
    (
      &clk_src_name="XO"
      &clk_src_sel=SRC_SEL TODO.
      &clk_src_div=4.
      &clk_m_val=0.
      &clk_n_val=0.
      &clk_2d_val=0.
      
      gosub Set_Clock_Freq
      return
    )
    else if ("&clk_desired_freq"=="15.0")
    (
      &clk_src_name="GPLL0"
      &clk_src_sel=SRC_SEL TODO.
      &clk_src_div=20.
      &clk_m_val=1.
      &clk_n_val=4.
      &clk_2d_val=4.
      
      gosub Set_Clock_Freq
      return
    )
    else if ("&clk_desired_freq"=="19.2")
    (
      &clk_src_name="XO"
      &clk_src_sel=SRC_SEL TODO.
      &clk_src_div=2.
      &clk_m_val=0.
      &clk_n_val=0.
      &clk_2d_val=0.
      
      gosub Set_Clock_Freq
      return
    )
    else if ("&clk_desired_freq"=="25.0")
    (
      &clk_src_name="GPLL0"
      &clk_src_sel=SRC_SEL TODO.
      &clk_src_div=24.
      &clk_m_val=1.
      &clk_n_val=2.
      &clk_2d_val=2.
      
      gosub Set_Clock_Freq
      return
    )
    else if ("&clk_desired_freq"=="50.0")
    (
      &clk_src_name="GPLL0"
      &clk_src_sel=SRC_SEL TODO.
      &clk_src_div=24.
      &clk_m_val=0.
      &clk_n_val=0.
      &clk_2d_val=0.
      
      gosub Set_Clock_Freq
      return
    )
    else if ("&clk_desired_freq"=="r")
    (
      return
    )
    else
    (
      print "Invalid selection."
      goto Set_Clock_Freq_Enter
    )
  )

  if ("&clk"=="gcc_blsp2_qup4_i2c_apps_clk")
  (
    gosub PRINT_SET_CLOCK_FREQ_WARNING

    &clk_cmd_rcgr_addr=&HWIO_GCC_BLSP2_QUP4_I2C_APPS_CMD_RCGR_ADDR
    &clk_cfg_rcgr_addr=&HWIO_GCC_BLSP2_QUP4_I2C_APPS_CFG_RCGR_ADDR

    print "Choose frequency (MHz) from list below: " 

    print "19.2           50.0           " 

    print ""
    print "Enter desired frequency (r to return): "
    enter &clk_desired_freq
    print ""

    if ("&clk_desired_freq"=="19.2")
    (
      &clk_src_name="XO"
      &clk_src_sel=SRC_SEL TODO.
      &clk_src_div=2.
      &clk_m_val=0.
      &clk_n_val=0.
      &clk_2d_val=0.
      
      gosub Set_Clock_Freq
      return
    )
    else if ("&clk_desired_freq"=="50.0")
    (
      &clk_src_name="GPLL0"
      &clk_src_sel=SRC_SEL TODO.
      &clk_src_div=24.
      &clk_m_val=0.
      &clk_n_val=0.
      &clk_2d_val=0.
      
      gosub Set_Clock_Freq
      return
    )
    else if ("&clk_desired_freq"=="r")
    (
      return
    )
    else
    (
      print "Invalid selection."
      goto Set_Clock_Freq_Enter
    )
  )

  if ("&clk"=="gcc_blsp2_qup4_spi_apps_clk")
  (
    gosub PRINT_SET_CLOCK_FREQ_WARNING

    &clk_cmd_rcgr_addr=&HWIO_GCC_BLSP2_QUP4_SPI_APPS_CMD_RCGR_ADDR
    &clk_cfg_rcgr_addr=&HWIO_GCC_BLSP2_QUP4_SPI_APPS_CFG_RCGR_ADDR

    print "Choose frequency (MHz) from list below: " 

    print "0.96           4.8            9.6            " 
    print "15.0           19.2           25.0           " 
    print "50.0           " 

    print ""
    print "Enter desired frequency (r to return): "
    enter &clk_desired_freq
    print ""

    if ("&clk_desired_freq"=="0.96")
    (
      &clk_src_name="XO"
      &clk_src_sel=SRC_SEL TODO.
      &clk_src_div=20.
      &clk_m_val=1.
      &clk_n_val=2.
      &clk_2d_val=2.
      
      gosub Set_Clock_Freq
      return
    )
    else if ("&clk_desired_freq"=="4.8")
    (
      &clk_src_name="XO"
      &clk_src_sel=SRC_SEL TODO.
      &clk_src_div=8.
      &clk_m_val=0.
      &clk_n_val=0.
      &clk_2d_val=0.
      
      gosub Set_Clock_Freq
      return
    )
    else if ("&clk_desired_freq"=="9.6")
    (
      &clk_src_name="XO"
      &clk_src_sel=SRC_SEL TODO.
      &clk_src_div=4.
      &clk_m_val=0.
      &clk_n_val=0.
      &clk_2d_val=0.
      
      gosub Set_Clock_Freq
      return
    )
    else if ("&clk_desired_freq"=="15.0")
    (
      &clk_src_name="GPLL0"
      &clk_src_sel=SRC_SEL TODO.
      &clk_src_div=20.
      &clk_m_val=1.
      &clk_n_val=4.
      &clk_2d_val=4.
      
      gosub Set_Clock_Freq
      return
    )
    else if ("&clk_desired_freq"=="19.2")
    (
      &clk_src_name="XO"
      &clk_src_sel=SRC_SEL TODO.
      &clk_src_div=2.
      &clk_m_val=0.
      &clk_n_val=0.
      &clk_2d_val=0.
      
      gosub Set_Clock_Freq
      return
    )
    else if ("&clk_desired_freq"=="25.0")
    (
      &clk_src_name="GPLL0"
      &clk_src_sel=SRC_SEL TODO.
      &clk_src_div=24.
      &clk_m_val=1.
      &clk_n_val=2.
      &clk_2d_val=2.
      
      gosub Set_Clock_Freq
      return
    )
    else if ("&clk_desired_freq"=="50.0")
    (
      &clk_src_name="GPLL0"
      &clk_src_sel=SRC_SEL TODO.
      &clk_src_div=24.
      &clk_m_val=0.
      &clk_n_val=0.
      &clk_2d_val=0.
      
      gosub Set_Clock_Freq
      return
    )
    else if ("&clk_desired_freq"=="r")
    (
      return
    )
    else
    (
      print "Invalid selection."
      goto Set_Clock_Freq_Enter
    )
  )

  if ("&clk"=="gcc_blsp2_qup5_i2c_apps_clk")
  (
    gosub PRINT_SET_CLOCK_FREQ_WARNING

    &clk_cmd_rcgr_addr=&HWIO_GCC_BLSP2_QUP5_I2C_APPS_CMD_RCGR_ADDR
    &clk_cfg_rcgr_addr=&HWIO_GCC_BLSP2_QUP5_I2C_APPS_CFG_RCGR_ADDR

    print "Choose frequency (MHz) from list below: " 

    print "19.2           50.0           " 

    print ""
    print "Enter desired frequency (r to return): "
    enter &clk_desired_freq
    print ""

    if ("&clk_desired_freq"=="19.2")
    (
      &clk_src_name="XO"
      &clk_src_sel=SRC_SEL TODO.
      &clk_src_div=2.
      &clk_m_val=0.
      &clk_n_val=0.
      &clk_2d_val=0.
      
      gosub Set_Clock_Freq
      return
    )
    else if ("&clk_desired_freq"=="50.0")
    (
      &clk_src_name="GPLL0"
      &clk_src_sel=SRC_SEL TODO.
      &clk_src_div=24.
      &clk_m_val=0.
      &clk_n_val=0.
      &clk_2d_val=0.
      
      gosub Set_Clock_Freq
      return
    )
    else if ("&clk_desired_freq"=="r")
    (
      return
    )
    else
    (
      print "Invalid selection."
      goto Set_Clock_Freq_Enter
    )
  )

  if ("&clk"=="gcc_blsp2_qup5_spi_apps_clk")
  (
    gosub PRINT_SET_CLOCK_FREQ_WARNING

    &clk_cmd_rcgr_addr=&HWIO_GCC_BLSP2_QUP5_SPI_APPS_CMD_RCGR_ADDR
    &clk_cfg_rcgr_addr=&HWIO_GCC_BLSP2_QUP5_SPI_APPS_CFG_RCGR_ADDR

    print "Choose frequency (MHz) from list below: " 

    print "0.96           4.8            9.6            " 
    print "15.0           19.2           25.0           " 
    print "50.0           " 

    print ""
    print "Enter desired frequency (r to return): "
    enter &clk_desired_freq
    print ""

    if ("&clk_desired_freq"=="0.96")
    (
      &clk_src_name="XO"
      &clk_src_sel=SRC_SEL TODO.
      &clk_src_div=20.
      &clk_m_val=1.
      &clk_n_val=2.
      &clk_2d_val=2.
      
      gosub Set_Clock_Freq
      return
    )
    else if ("&clk_desired_freq"=="4.8")
    (
      &clk_src_name="XO"
      &clk_src_sel=SRC_SEL TODO.
      &clk_src_div=8.
      &clk_m_val=0.
      &clk_n_val=0.
      &clk_2d_val=0.
      
      gosub Set_Clock_Freq
      return
    )
    else if ("&clk_desired_freq"=="9.6")
    (
      &clk_src_name="XO"
      &clk_src_sel=SRC_SEL TODO.
      &clk_src_div=4.
      &clk_m_val=0.
      &clk_n_val=0.
      &clk_2d_val=0.
      
      gosub Set_Clock_Freq
      return
    )
    else if ("&clk_desired_freq"=="15.0")
    (
      &clk_src_name="GPLL0"
      &clk_src_sel=SRC_SEL TODO.
      &clk_src_div=20.
      &clk_m_val=1.
      &clk_n_val=4.
      &clk_2d_val=4.
      
      gosub Set_Clock_Freq
      return
    )
    else if ("&clk_desired_freq"=="19.2")
    (
      &clk_src_name="XO"
      &clk_src_sel=SRC_SEL TODO.
      &clk_src_div=2.
      &clk_m_val=0.
      &clk_n_val=0.
      &clk_2d_val=0.
      
      gosub Set_Clock_Freq
      return
    )
    else if ("&clk_desired_freq"=="25.0")
    (
      &clk_src_name="GPLL0"
      &clk_src_sel=SRC_SEL TODO.
      &clk_src_div=24.
      &clk_m_val=1.
      &clk_n_val=2.
      &clk_2d_val=2.
      
      gosub Set_Clock_Freq
      return
    )
    else if ("&clk_desired_freq"=="50.0")
    (
      &clk_src_name="GPLL0"
      &clk_src_sel=SRC_SEL TODO.
      &clk_src_div=24.
      &clk_m_val=0.
      &clk_n_val=0.
      &clk_2d_val=0.
      
      gosub Set_Clock_Freq
      return
    )
    else if ("&clk_desired_freq"=="r")
    (
      return
    )
    else
    (
      print "Invalid selection."
      goto Set_Clock_Freq_Enter
    )
  )

  if ("&clk"=="gcc_blsp2_qup6_i2c_apps_clk")
  (
    gosub PRINT_SET_CLOCK_FREQ_WARNING

    &clk_cmd_rcgr_addr=&HWIO_GCC_BLSP2_QUP6_I2C_APPS_CMD_RCGR_ADDR
    &clk_cfg_rcgr_addr=&HWIO_GCC_BLSP2_QUP6_I2C_APPS_CFG_RCGR_ADDR

    print "Choose frequency (MHz) from list below: " 

    print "19.2           50.0           " 

    print ""
    print "Enter desired frequency (r to return): "
    enter &clk_desired_freq
    print ""

    if ("&clk_desired_freq"=="19.2")
    (
      &clk_src_name="XO"
      &clk_src_sel=SRC_SEL TODO.
      &clk_src_div=2.
      &clk_m_val=0.
      &clk_n_val=0.
      &clk_2d_val=0.
      
      gosub Set_Clock_Freq
      return
    )
    else if ("&clk_desired_freq"=="50.0")
    (
      &clk_src_name="GPLL0"
      &clk_src_sel=SRC_SEL TODO.
      &clk_src_div=24.
      &clk_m_val=0.
      &clk_n_val=0.
      &clk_2d_val=0.
      
      gosub Set_Clock_Freq
      return
    )
    else if ("&clk_desired_freq"=="r")
    (
      return
    )
    else
    (
      print "Invalid selection."
      goto Set_Clock_Freq_Enter
    )
  )

  if ("&clk"=="gcc_blsp2_qup6_spi_apps_clk")
  (
    gosub PRINT_SET_CLOCK_FREQ_WARNING

    &clk_cmd_rcgr_addr=&HWIO_GCC_BLSP2_QUP6_SPI_APPS_CMD_RCGR_ADDR
    &clk_cfg_rcgr_addr=&HWIO_GCC_BLSP2_QUP6_SPI_APPS_CFG_RCGR_ADDR

    print "Choose frequency (MHz) from list below: " 

    print "0.96           4.8            9.6            " 
    print "15.0           19.2           25.0           " 
    print "50.0           " 

    print ""
    print "Enter desired frequency (r to return): "
    enter &clk_desired_freq
    print ""

    if ("&clk_desired_freq"=="0.96")
    (
      &clk_src_name="XO"
      &clk_src_sel=SRC_SEL TODO.
      &clk_src_div=20.
      &clk_m_val=1.
      &clk_n_val=2.
      &clk_2d_val=2.
      
      gosub Set_Clock_Freq
      return
    )
    else if ("&clk_desired_freq"=="4.8")
    (
      &clk_src_name="XO"
      &clk_src_sel=SRC_SEL TODO.
      &clk_src_div=8.
      &clk_m_val=0.
      &clk_n_val=0.
      &clk_2d_val=0.
      
      gosub Set_Clock_Freq
      return
    )
    else if ("&clk_desired_freq"=="9.6")
    (
      &clk_src_name="XO"
      &clk_src_sel=SRC_SEL TODO.
      &clk_src_div=4.
      &clk_m_val=0.
      &clk_n_val=0.
      &clk_2d_val=0.
      
      gosub Set_Clock_Freq
      return
    )
    else if ("&clk_desired_freq"=="15.0")
    (
      &clk_src_name="GPLL0"
      &clk_src_sel=SRC_SEL TODO.
      &clk_src_div=20.
      &clk_m_val=1.
      &clk_n_val=4.
      &clk_2d_val=4.
      
      gosub Set_Clock_Freq
      return
    )
    else if ("&clk_desired_freq"=="19.2")
    (
      &clk_src_name="XO"
      &clk_src_sel=SRC_SEL TODO.
      &clk_src_div=2.
      &clk_m_val=0.
      &clk_n_val=0.
      &clk_2d_val=0.
      
      gosub Set_Clock_Freq
      return
    )
    else if ("&clk_desired_freq"=="25.0")
    (
      &clk_src_name="GPLL0"
      &clk_src_sel=SRC_SEL TODO.
      &clk_src_div=24.
      &clk_m_val=1.
      &clk_n_val=2.
      &clk_2d_val=2.
      
      gosub Set_Clock_Freq
      return
    )
    else if ("&clk_desired_freq"=="50.0")
    (
      &clk_src_name="GPLL0"
      &clk_src_sel=SRC_SEL TODO.
      &clk_src_div=24.
      &clk_m_val=0.
      &clk_n_val=0.
      &clk_2d_val=0.
      
      gosub Set_Clock_Freq
      return
    )
    else if ("&clk_desired_freq"=="r")
    (
      return
    )
    else
    (
      print "Invalid selection."
      goto Set_Clock_Freq_Enter
    )
  )

  if ("&clk"=="gcc_blsp2_uart1_apps_clk")
  (
    gosub PRINT_SET_CLOCK_FREQ_WARNING

    &clk_cmd_rcgr_addr=&HWIO_GCC_BLSP2_UART1_APPS_CMD_RCGR_ADDR
    &clk_cfg_rcgr_addr=&HWIO_GCC_BLSP2_UART1_APPS_CFG_RCGR_ADDR

    print "Choose frequency (MHz) from list below: " 

    print "3.6864         7.3728         14.7456        " 
    print "16.0           19.2           24.0           " 
    print "32.0           40.0           46.4           " 
    print "48.0           51.2           56.0           " 
    print "58.9824        60.0           63.16          " 

    print ""
    print "Enter desired frequency (r to return): "
    enter &clk_desired_freq
    print ""

    if ("&clk_desired_freq"=="3.6864")
    (
      &clk_src_name="GPLL0"
      &clk_src_sel=SRC_SEL TODO.
      &clk_src_div=2.
      &clk_m_val=96.
      &clk_n_val=15625.
      &clk_2d_val=15625.
      
      gosub Set_Clock_Freq
      return
    )
    else if ("&clk_desired_freq"=="7.3728")
    (
      &clk_src_name="GPLL0"
      &clk_src_sel=SRC_SEL TODO.
      &clk_src_div=2.
      &clk_m_val=192.
      &clk_n_val=15625.
      &clk_2d_val=15625.
      
      gosub Set_Clock_Freq
      return
    )
    else if ("&clk_desired_freq"=="14.7456")
    (
      &clk_src_name="GPLL0"
      &clk_src_sel=SRC_SEL TODO.
      &clk_src_div=2.
      &clk_m_val=384.
      &clk_n_val=15625.
      &clk_2d_val=15625.
      
      gosub Set_Clock_Freq
      return
    )
    else if ("&clk_desired_freq"=="16.0")
    (
      &clk_src_name="GPLL0"
      &clk_src_sel=SRC_SEL TODO.
      &clk_src_div=10.
      &clk_m_val=2.
      &clk_n_val=15.
      &clk_2d_val=15.
      
      gosub Set_Clock_Freq
      return
    )
    else if ("&clk_desired_freq"=="19.2")
    (
      &clk_src_name="XO"
      &clk_src_sel=SRC_SEL TODO.
      &clk_src_div=2.
      &clk_m_val=0.
      &clk_n_val=0.
      &clk_2d_val=0.
      
      gosub Set_Clock_Freq
      return
    )
    else if ("&clk_desired_freq"=="24.0")
    (
      &clk_src_name="GPLL0"
      &clk_src_sel=SRC_SEL TODO.
      &clk_src_div=10.
      &clk_m_val=1.
      &clk_n_val=5.
      &clk_2d_val=5.
      
      gosub Set_Clock_Freq
      return
    )
    else if ("&clk_desired_freq"=="32.0")
    (
      &clk_src_name="GPLL0"
      &clk_src_sel=SRC_SEL TODO.
      &clk_src_div=2.
      &clk_m_val=4.
      &clk_n_val=75.
      &clk_2d_val=75.
      
      gosub Set_Clock_Freq
      return
    )
    else if ("&clk_desired_freq"=="40.0")
    (
      &clk_src_name="GPLL0"
      &clk_src_sel=SRC_SEL TODO.
      &clk_src_div=30.
      &clk_m_val=0.
      &clk_n_val=0.
      &clk_2d_val=0.
      
      gosub Set_Clock_Freq
      return
    )
    else if ("&clk_desired_freq"=="46.4")
    (
      &clk_src_name="GPLL0"
      &clk_src_sel=SRC_SEL TODO.
      &clk_src_div=2.
      &clk_m_val=29.
      &clk_n_val=375.
      &clk_2d_val=375.
      
      gosub Set_Clock_Freq
      return
    )
    else if ("&clk_desired_freq"=="48.0")
    (
      &clk_src_name="GPLL0"
      &clk_src_sel=SRC_SEL TODO.
      &clk_src_div=25.
      &clk_m_val=0.
      &clk_n_val=0.
      &clk_2d_val=0.
      
      gosub Set_Clock_Freq
      return
    )
    else if ("&clk_desired_freq"=="51.2")
    (
      &clk_src_name="GPLL0"
      &clk_src_sel=SRC_SEL TODO.
      &clk_src_div=2.
      &clk_m_val=32.
      &clk_n_val=375.
      &clk_2d_val=375.
      
      gosub Set_Clock_Freq
      return
    )
    else if ("&clk_desired_freq"=="56.0")
    (
      &clk_src_name="GPLL0"
      &clk_src_sel=SRC_SEL TODO.
      &clk_src_div=2.
      &clk_m_val=7.
      &clk_n_val=75.
      &clk_2d_val=75.
      
      gosub Set_Clock_Freq
      return
    )
    else if ("&clk_desired_freq"=="58.9824")
    (
      &clk_src_name="GPLL0"
      &clk_src_sel=SRC_SEL TODO.
      &clk_src_div=2.
      &clk_m_val=1536.
      &clk_n_val=15625.
      &clk_2d_val=15625.
      
      gosub Set_Clock_Freq
      return
    )
    else if ("&clk_desired_freq"=="60.0")
    (
      &clk_src_name="GPLL0"
      &clk_src_sel=SRC_SEL TODO.
      &clk_src_div=20.
      &clk_m_val=0.
      &clk_n_val=0.
      &clk_2d_val=0.
      
      gosub Set_Clock_Freq
      return
    )
    else if ("&clk_desired_freq"=="63.16")
    (
      &clk_src_name="GPLL0"
      &clk_src_sel=SRC_SEL TODO.
      &clk_src_div=19.
      &clk_m_val=0.
      &clk_n_val=0.
      &clk_2d_val=0.
      
      gosub Set_Clock_Freq
      return
    )
    else if ("&clk_desired_freq"=="r")
    (
      return
    )
    else
    (
      print "Invalid selection."
      goto Set_Clock_Freq_Enter
    )
  )

  if ("&clk"=="gcc_blsp2_uart2_apps_clk")
  (
    gosub PRINT_SET_CLOCK_FREQ_WARNING

    &clk_cmd_rcgr_addr=&HWIO_GCC_BLSP2_UART2_APPS_CMD_RCGR_ADDR
    &clk_cfg_rcgr_addr=&HWIO_GCC_BLSP2_UART2_APPS_CFG_RCGR_ADDR

    print "Choose frequency (MHz) from list below: " 

    print "3.6864         7.3728         14.7456        " 
    print "16.0           19.2           24.0           " 
    print "32.0           40.0           46.4           " 
    print "48.0           51.2           56.0           " 
    print "58.9824        60.0           63.16          " 

    print ""
    print "Enter desired frequency (r to return): "
    enter &clk_desired_freq
    print ""

    if ("&clk_desired_freq"=="3.6864")
    (
      &clk_src_name="GPLL0"
      &clk_src_sel=SRC_SEL TODO.
      &clk_src_div=2.
      &clk_m_val=96.
      &clk_n_val=15625.
      &clk_2d_val=15625.
      
      gosub Set_Clock_Freq
      return
    )
    else if ("&clk_desired_freq"=="7.3728")
    (
      &clk_src_name="GPLL0"
      &clk_src_sel=SRC_SEL TODO.
      &clk_src_div=2.
      &clk_m_val=192.
      &clk_n_val=15625.
      &clk_2d_val=15625.
      
      gosub Set_Clock_Freq
      return
    )
    else if ("&clk_desired_freq"=="14.7456")
    (
      &clk_src_name="GPLL0"
      &clk_src_sel=SRC_SEL TODO.
      &clk_src_div=2.
      &clk_m_val=384.
      &clk_n_val=15625.
      &clk_2d_val=15625.
      
      gosub Set_Clock_Freq
      return
    )
    else if ("&clk_desired_freq"=="16.0")
    (
      &clk_src_name="GPLL0"
      &clk_src_sel=SRC_SEL TODO.
      &clk_src_div=10.
      &clk_m_val=2.
      &clk_n_val=15.
      &clk_2d_val=15.
      
      gosub Set_Clock_Freq
      return
    )
    else if ("&clk_desired_freq"=="19.2")
    (
      &clk_src_name="XO"
      &clk_src_sel=SRC_SEL TODO.
      &clk_src_div=2.
      &clk_m_val=0.
      &clk_n_val=0.
      &clk_2d_val=0.
      
      gosub Set_Clock_Freq
      return
    )
    else if ("&clk_desired_freq"=="24.0")
    (
      &clk_src_name="GPLL0"
      &clk_src_sel=SRC_SEL TODO.
      &clk_src_div=10.
      &clk_m_val=1.
      &clk_n_val=5.
      &clk_2d_val=5.
      
      gosub Set_Clock_Freq
      return
    )
    else if ("&clk_desired_freq"=="32.0")
    (
      &clk_src_name="GPLL0"
      &clk_src_sel=SRC_SEL TODO.
      &clk_src_div=2.
      &clk_m_val=4.
      &clk_n_val=75.
      &clk_2d_val=75.
      
      gosub Set_Clock_Freq
      return
    )
    else if ("&clk_desired_freq"=="40.0")
    (
      &clk_src_name="GPLL0"
      &clk_src_sel=SRC_SEL TODO.
      &clk_src_div=30.
      &clk_m_val=0.
      &clk_n_val=0.
      &clk_2d_val=0.
      
      gosub Set_Clock_Freq
      return
    )
    else if ("&clk_desired_freq"=="46.4")
    (
      &clk_src_name="GPLL0"
      &clk_src_sel=SRC_SEL TODO.
      &clk_src_div=2.
      &clk_m_val=29.
      &clk_n_val=375.
      &clk_2d_val=375.
      
      gosub Set_Clock_Freq
      return
    )
    else if ("&clk_desired_freq"=="48.0")
    (
      &clk_src_name="GPLL0"
      &clk_src_sel=SRC_SEL TODO.
      &clk_src_div=25.
      &clk_m_val=0.
      &clk_n_val=0.
      &clk_2d_val=0.
      
      gosub Set_Clock_Freq
      return
    )
    else if ("&clk_desired_freq"=="51.2")
    (
      &clk_src_name="GPLL0"
      &clk_src_sel=SRC_SEL TODO.
      &clk_src_div=2.
      &clk_m_val=32.
      &clk_n_val=375.
      &clk_2d_val=375.
      
      gosub Set_Clock_Freq
      return
    )
    else if ("&clk_desired_freq"=="56.0")
    (
      &clk_src_name="GPLL0"
      &clk_src_sel=SRC_SEL TODO.
      &clk_src_div=2.
      &clk_m_val=7.
      &clk_n_val=75.
      &clk_2d_val=75.
      
      gosub Set_Clock_Freq
      return
    )
    else if ("&clk_desired_freq"=="58.9824")
    (
      &clk_src_name="GPLL0"
      &clk_src_sel=SRC_SEL TODO.
      &clk_src_div=2.
      &clk_m_val=1536.
      &clk_n_val=15625.
      &clk_2d_val=15625.
      
      gosub Set_Clock_Freq
      return
    )
    else if ("&clk_desired_freq"=="60.0")
    (
      &clk_src_name="GPLL0"
      &clk_src_sel=SRC_SEL TODO.
      &clk_src_div=20.
      &clk_m_val=0.
      &clk_n_val=0.
      &clk_2d_val=0.
      
      gosub Set_Clock_Freq
      return
    )
    else if ("&clk_desired_freq"=="63.16")
    (
      &clk_src_name="GPLL0"
      &clk_src_sel=SRC_SEL TODO.
      &clk_src_div=19.
      &clk_m_val=0.
      &clk_n_val=0.
      &clk_2d_val=0.
      
      gosub Set_Clock_Freq
      return
    )
    else if ("&clk_desired_freq"=="r")
    (
      return
    )
    else
    (
      print "Invalid selection."
      goto Set_Clock_Freq_Enter
    )
  )

  if ("&clk"=="gcc_blsp2_uart3_apps_clk")
  (
    gosub PRINT_SET_CLOCK_FREQ_WARNING

    &clk_cmd_rcgr_addr=&HWIO_GCC_BLSP2_UART3_APPS_CMD_RCGR_ADDR
    &clk_cfg_rcgr_addr=&HWIO_GCC_BLSP2_UART3_APPS_CFG_RCGR_ADDR

    print "Choose frequency (MHz) from list below: " 

    print "3.6864         7.3728         14.7456        " 
    print "16.0           19.2           24.0           " 
    print "32.0           40.0           46.4           " 
    print "48.0           51.2           56.0           " 
    print "58.9824        60.0           63.16          " 

    print ""
    print "Enter desired frequency (r to return): "
    enter &clk_desired_freq
    print ""

    if ("&clk_desired_freq"=="3.6864")
    (
      &clk_src_name="GPLL0"
      &clk_src_sel=SRC_SEL TODO.
      &clk_src_div=2.
      &clk_m_val=96.
      &clk_n_val=15625.
      &clk_2d_val=15625.
      
      gosub Set_Clock_Freq
      return
    )
    else if ("&clk_desired_freq"=="7.3728")
    (
      &clk_src_name="GPLL0"
      &clk_src_sel=SRC_SEL TODO.
      &clk_src_div=2.
      &clk_m_val=192.
      &clk_n_val=15625.
      &clk_2d_val=15625.
      
      gosub Set_Clock_Freq
      return
    )
    else if ("&clk_desired_freq"=="14.7456")
    (
      &clk_src_name="GPLL0"
      &clk_src_sel=SRC_SEL TODO.
      &clk_src_div=2.
      &clk_m_val=384.
      &clk_n_val=15625.
      &clk_2d_val=15625.
      
      gosub Set_Clock_Freq
      return
    )
    else if ("&clk_desired_freq"=="16.0")
    (
      &clk_src_name="GPLL0"
      &clk_src_sel=SRC_SEL TODO.
      &clk_src_div=10.
      &clk_m_val=2.
      &clk_n_val=15.
      &clk_2d_val=15.
      
      gosub Set_Clock_Freq
      return
    )
    else if ("&clk_desired_freq"=="19.2")
    (
      &clk_src_name="XO"
      &clk_src_sel=SRC_SEL TODO.
      &clk_src_div=2.
      &clk_m_val=0.
      &clk_n_val=0.
      &clk_2d_val=0.
      
      gosub Set_Clock_Freq
      return
    )
    else if ("&clk_desired_freq"=="24.0")
    (
      &clk_src_name="GPLL0"
      &clk_src_sel=SRC_SEL TODO.
      &clk_src_div=10.
      &clk_m_val=1.
      &clk_n_val=5.
      &clk_2d_val=5.
      
      gosub Set_Clock_Freq
      return
    )
    else if ("&clk_desired_freq"=="32.0")
    (
      &clk_src_name="GPLL0"
      &clk_src_sel=SRC_SEL TODO.
      &clk_src_div=2.
      &clk_m_val=4.
      &clk_n_val=75.
      &clk_2d_val=75.
      
      gosub Set_Clock_Freq
      return
    )
    else if ("&clk_desired_freq"=="40.0")
    (
      &clk_src_name="GPLL0"
      &clk_src_sel=SRC_SEL TODO.
      &clk_src_div=30.
      &clk_m_val=0.
      &clk_n_val=0.
      &clk_2d_val=0.
      
      gosub Set_Clock_Freq
      return
    )
    else if ("&clk_desired_freq"=="46.4")
    (
      &clk_src_name="GPLL0"
      &clk_src_sel=SRC_SEL TODO.
      &clk_src_div=2.
      &clk_m_val=29.
      &clk_n_val=375.
      &clk_2d_val=375.
      
      gosub Set_Clock_Freq
      return
    )
    else if ("&clk_desired_freq"=="48.0")
    (
      &clk_src_name="GPLL0"
      &clk_src_sel=SRC_SEL TODO.
      &clk_src_div=25.
      &clk_m_val=0.
      &clk_n_val=0.
      &clk_2d_val=0.
      
      gosub Set_Clock_Freq
      return
    )
    else if ("&clk_desired_freq"=="51.2")
    (
      &clk_src_name="GPLL0"
      &clk_src_sel=SRC_SEL TODO.
      &clk_src_div=2.
      &clk_m_val=32.
      &clk_n_val=375.
      &clk_2d_val=375.
      
      gosub Set_Clock_Freq
      return
    )
    else if ("&clk_desired_freq"=="56.0")
    (
      &clk_src_name="GPLL0"
      &clk_src_sel=SRC_SEL TODO.
      &clk_src_div=2.
      &clk_m_val=7.
      &clk_n_val=75.
      &clk_2d_val=75.
      
      gosub Set_Clock_Freq
      return
    )
    else if ("&clk_desired_freq"=="58.9824")
    (
      &clk_src_name="GPLL0"
      &clk_src_sel=SRC_SEL TODO.
      &clk_src_div=2.
      &clk_m_val=1536.
      &clk_n_val=15625.
      &clk_2d_val=15625.
      
      gosub Set_Clock_Freq
      return
    )
    else if ("&clk_desired_freq"=="60.0")
    (
      &clk_src_name="GPLL0"
      &clk_src_sel=SRC_SEL TODO.
      &clk_src_div=20.
      &clk_m_val=0.
      &clk_n_val=0.
      &clk_2d_val=0.
      
      gosub Set_Clock_Freq
      return
    )
    else if ("&clk_desired_freq"=="63.16")
    (
      &clk_src_name="GPLL0"
      &clk_src_sel=SRC_SEL TODO.
      &clk_src_div=19.
      &clk_m_val=0.
      &clk_n_val=0.
      &clk_2d_val=0.
      
      gosub Set_Clock_Freq
      return
    )
    else if ("&clk_desired_freq"=="r")
    (
      return
    )
    else
    (
      print "Invalid selection."
      goto Set_Clock_Freq_Enter
    )
  )

  if ("&clk"=="gcc_blsp2_uart4_apps_clk")
  (
    gosub PRINT_SET_CLOCK_FREQ_WARNING

    &clk_cmd_rcgr_addr=&HWIO_GCC_BLSP2_UART4_APPS_CMD_RCGR_ADDR
    &clk_cfg_rcgr_addr=&HWIO_GCC_BLSP2_UART4_APPS_CFG_RCGR_ADDR

    print "Choose frequency (MHz) from list below: " 

    print "3.6864         7.3728         14.7456        " 
    print "16.0           19.2           24.0           " 
    print "32.0           40.0           46.4           " 
    print "48.0           51.2           56.0           " 
    print "58.9824        60.0           63.16          " 

    print ""
    print "Enter desired frequency (r to return): "
    enter &clk_desired_freq
    print ""

    if ("&clk_desired_freq"=="3.6864")
    (
      &clk_src_name="GPLL0"
      &clk_src_sel=SRC_SEL TODO.
      &clk_src_div=2.
      &clk_m_val=96.
      &clk_n_val=15625.
      &clk_2d_val=15625.
      
      gosub Set_Clock_Freq
      return
    )
    else if ("&clk_desired_freq"=="7.3728")
    (
      &clk_src_name="GPLL0"
      &clk_src_sel=SRC_SEL TODO.
      &clk_src_div=2.
      &clk_m_val=192.
      &clk_n_val=15625.
      &clk_2d_val=15625.
      
      gosub Set_Clock_Freq
      return
    )
    else if ("&clk_desired_freq"=="14.7456")
    (
      &clk_src_name="GPLL0"
      &clk_src_sel=SRC_SEL TODO.
      &clk_src_div=2.
      &clk_m_val=384.
      &clk_n_val=15625.
      &clk_2d_val=15625.
      
      gosub Set_Clock_Freq
      return
    )
    else if ("&clk_desired_freq"=="16.0")
    (
      &clk_src_name="GPLL0"
      &clk_src_sel=SRC_SEL TODO.
      &clk_src_div=10.
      &clk_m_val=2.
      &clk_n_val=15.
      &clk_2d_val=15.
      
      gosub Set_Clock_Freq
      return
    )
    else if ("&clk_desired_freq"=="19.2")
    (
      &clk_src_name="XO"
      &clk_src_sel=SRC_SEL TODO.
      &clk_src_div=2.
      &clk_m_val=0.
      &clk_n_val=0.
      &clk_2d_val=0.
      
      gosub Set_Clock_Freq
      return
    )
    else if ("&clk_desired_freq"=="24.0")
    (
      &clk_src_name="GPLL0"
      &clk_src_sel=SRC_SEL TODO.
      &clk_src_div=10.
      &clk_m_val=1.
      &clk_n_val=5.
      &clk_2d_val=5.
      
      gosub Set_Clock_Freq
      return
    )
    else if ("&clk_desired_freq"=="32.0")
    (
      &clk_src_name="GPLL0"
      &clk_src_sel=SRC_SEL TODO.
      &clk_src_div=2.
      &clk_m_val=4.
      &clk_n_val=75.
      &clk_2d_val=75.
      
      gosub Set_Clock_Freq
      return
    )
    else if ("&clk_desired_freq"=="40.0")
    (
      &clk_src_name="GPLL0"
      &clk_src_sel=SRC_SEL TODO.
      &clk_src_div=30.
      &clk_m_val=0.
      &clk_n_val=0.
      &clk_2d_val=0.
      
      gosub Set_Clock_Freq
      return
    )
    else if ("&clk_desired_freq"=="46.4")
    (
      &clk_src_name="GPLL0"
      &clk_src_sel=SRC_SEL TODO.
      &clk_src_div=2.
      &clk_m_val=29.
      &clk_n_val=375.
      &clk_2d_val=375.
      
      gosub Set_Clock_Freq
      return
    )
    else if ("&clk_desired_freq"=="48.0")
    (
      &clk_src_name="GPLL0"
      &clk_src_sel=SRC_SEL TODO.
      &clk_src_div=25.
      &clk_m_val=0.
      &clk_n_val=0.
      &clk_2d_val=0.
      
      gosub Set_Clock_Freq
      return
    )
    else if ("&clk_desired_freq"=="51.2")
    (
      &clk_src_name="GPLL0"
      &clk_src_sel=SRC_SEL TODO.
      &clk_src_div=2.
      &clk_m_val=32.
      &clk_n_val=375.
      &clk_2d_val=375.
      
      gosub Set_Clock_Freq
      return
    )
    else if ("&clk_desired_freq"=="56.0")
    (
      &clk_src_name="GPLL0"
      &clk_src_sel=SRC_SEL TODO.
      &clk_src_div=2.
      &clk_m_val=7.
      &clk_n_val=75.
      &clk_2d_val=75.
      
      gosub Set_Clock_Freq
      return
    )
    else if ("&clk_desired_freq"=="58.9824")
    (
      &clk_src_name="GPLL0"
      &clk_src_sel=SRC_SEL TODO.
      &clk_src_div=2.
      &clk_m_val=1536.
      &clk_n_val=15625.
      &clk_2d_val=15625.
      
      gosub Set_Clock_Freq
      return
    )
    else if ("&clk_desired_freq"=="60.0")
    (
      &clk_src_name="GPLL0"
      &clk_src_sel=SRC_SEL TODO.
      &clk_src_div=20.
      &clk_m_val=0.
      &clk_n_val=0.
      &clk_2d_val=0.
      
      gosub Set_Clock_Freq
      return
    )
    else if ("&clk_desired_freq"=="63.16")
    (
      &clk_src_name="GPLL0"
      &clk_src_sel=SRC_SEL TODO.
      &clk_src_div=19.
      &clk_m_val=0.
      &clk_n_val=0.
      &clk_2d_val=0.
      
      gosub Set_Clock_Freq
      return
    )
    else if ("&clk_desired_freq"=="r")
    (
      return
    )
    else
    (
      print "Invalid selection."
      goto Set_Clock_Freq_Enter
    )
  )

  if ("&clk"=="gcc_blsp2_uart5_apps_clk")
  (
    gosub PRINT_SET_CLOCK_FREQ_WARNING

    &clk_cmd_rcgr_addr=&HWIO_GCC_BLSP2_UART5_APPS_CMD_RCGR_ADDR
    &clk_cfg_rcgr_addr=&HWIO_GCC_BLSP2_UART5_APPS_CFG_RCGR_ADDR

    print "Choose frequency (MHz) from list below: " 

    print "3.6864         7.3728         14.7456        " 
    print "16.0           19.2           24.0           " 
    print "32.0           40.0           46.4           " 
    print "48.0           51.2           56.0           " 
    print "58.9824        60.0           63.16          " 

    print ""
    print "Enter desired frequency (r to return): "
    enter &clk_desired_freq
    print ""

    if ("&clk_desired_freq"=="3.6864")
    (
      &clk_src_name="GPLL0"
      &clk_src_sel=SRC_SEL TODO.
      &clk_src_div=2.
      &clk_m_val=96.
      &clk_n_val=15625.
      &clk_2d_val=15625.
      
      gosub Set_Clock_Freq
      return
    )
    else if ("&clk_desired_freq"=="7.3728")
    (
      &clk_src_name="GPLL0"
      &clk_src_sel=SRC_SEL TODO.
      &clk_src_div=2.
      &clk_m_val=192.
      &clk_n_val=15625.
      &clk_2d_val=15625.
      
      gosub Set_Clock_Freq
      return
    )
    else if ("&clk_desired_freq"=="14.7456")
    (
      &clk_src_name="GPLL0"
      &clk_src_sel=SRC_SEL TODO.
      &clk_src_div=2.
      &clk_m_val=384.
      &clk_n_val=15625.
      &clk_2d_val=15625.
      
      gosub Set_Clock_Freq
      return
    )
    else if ("&clk_desired_freq"=="16.0")
    (
      &clk_src_name="GPLL0"
      &clk_src_sel=SRC_SEL TODO.
      &clk_src_div=10.
      &clk_m_val=2.
      &clk_n_val=15.
      &clk_2d_val=15.
      
      gosub Set_Clock_Freq
      return
    )
    else if ("&clk_desired_freq"=="19.2")
    (
      &clk_src_name="XO"
      &clk_src_sel=SRC_SEL TODO.
      &clk_src_div=2.
      &clk_m_val=0.
      &clk_n_val=0.
      &clk_2d_val=0.
      
      gosub Set_Clock_Freq
      return
    )
    else if ("&clk_desired_freq"=="24.0")
    (
      &clk_src_name="GPLL0"
      &clk_src_sel=SRC_SEL TODO.
      &clk_src_div=10.
      &clk_m_val=1.
      &clk_n_val=5.
      &clk_2d_val=5.
      
      gosub Set_Clock_Freq
      return
    )
    else if ("&clk_desired_freq"=="32.0")
    (
      &clk_src_name="GPLL0"
      &clk_src_sel=SRC_SEL TODO.
      &clk_src_div=2.
      &clk_m_val=4.
      &clk_n_val=75.
      &clk_2d_val=75.
      
      gosub Set_Clock_Freq
      return
    )
    else if ("&clk_desired_freq"=="40.0")
    (
      &clk_src_name="GPLL0"
      &clk_src_sel=SRC_SEL TODO.
      &clk_src_div=30.
      &clk_m_val=0.
      &clk_n_val=0.
      &clk_2d_val=0.
      
      gosub Set_Clock_Freq
      return
    )
    else if ("&clk_desired_freq"=="46.4")
    (
      &clk_src_name="GPLL0"
      &clk_src_sel=SRC_SEL TODO.
      &clk_src_div=2.
      &clk_m_val=29.
      &clk_n_val=375.
      &clk_2d_val=375.
      
      gosub Set_Clock_Freq
      return
    )
    else if ("&clk_desired_freq"=="48.0")
    (
      &clk_src_name="GPLL0"
      &clk_src_sel=SRC_SEL TODO.
      &clk_src_div=25.
      &clk_m_val=0.
      &clk_n_val=0.
      &clk_2d_val=0.
      
      gosub Set_Clock_Freq
      return
    )
    else if ("&clk_desired_freq"=="51.2")
    (
      &clk_src_name="GPLL0"
      &clk_src_sel=SRC_SEL TODO.
      &clk_src_div=2.
      &clk_m_val=32.
      &clk_n_val=375.
      &clk_2d_val=375.
      
      gosub Set_Clock_Freq
      return
    )
    else if ("&clk_desired_freq"=="56.0")
    (
      &clk_src_name="GPLL0"
      &clk_src_sel=SRC_SEL TODO.
      &clk_src_div=2.
      &clk_m_val=7.
      &clk_n_val=75.
      &clk_2d_val=75.
      
      gosub Set_Clock_Freq
      return
    )
    else if ("&clk_desired_freq"=="58.9824")
    (
      &clk_src_name="GPLL0"
      &clk_src_sel=SRC_SEL TODO.
      &clk_src_div=2.
      &clk_m_val=1536.
      &clk_n_val=15625.
      &clk_2d_val=15625.
      
      gosub Set_Clock_Freq
      return
    )
    else if ("&clk_desired_freq"=="60.0")
    (
      &clk_src_name="GPLL0"
      &clk_src_sel=SRC_SEL TODO.
      &clk_src_div=20.
      &clk_m_val=0.
      &clk_n_val=0.
      &clk_2d_val=0.
      
      gosub Set_Clock_Freq
      return
    )
    else if ("&clk_desired_freq"=="63.16")
    (
      &clk_src_name="GPLL0"
      &clk_src_sel=SRC_SEL TODO.
      &clk_src_div=19.
      &clk_m_val=0.
      &clk_n_val=0.
      &clk_2d_val=0.
      
      gosub Set_Clock_Freq
      return
    )
    else if ("&clk_desired_freq"=="r")
    (
      return
    )
    else
    (
      print "Invalid selection."
      goto Set_Clock_Freq_Enter
    )
  )

  if ("&clk"=="gcc_blsp2_uart6_apps_clk")
  (
    gosub PRINT_SET_CLOCK_FREQ_WARNING

    &clk_cmd_rcgr_addr=&HWIO_GCC_BLSP2_UART6_APPS_CMD_RCGR_ADDR
    &clk_cfg_rcgr_addr=&HWIO_GCC_BLSP2_UART6_APPS_CFG_RCGR_ADDR

    print "Choose frequency (MHz) from list below: " 

    print "3.6864         7.3728         14.7456        " 
    print "16.0           19.2           24.0           " 
    print "32.0           40.0           46.4           " 
    print "48.0           51.2           56.0           " 
    print "58.9824        60.0           63.16          " 

    print ""
    print "Enter desired frequency (r to return): "
    enter &clk_desired_freq
    print ""

    if ("&clk_desired_freq"=="3.6864")
    (
      &clk_src_name="GPLL0"
      &clk_src_sel=SRC_SEL TODO.
      &clk_src_div=2.
      &clk_m_val=96.
      &clk_n_val=15625.
      &clk_2d_val=15625.
      
      gosub Set_Clock_Freq
      return
    )
    else if ("&clk_desired_freq"=="7.3728")
    (
      &clk_src_name="GPLL0"
      &clk_src_sel=SRC_SEL TODO.
      &clk_src_div=2.
      &clk_m_val=192.
      &clk_n_val=15625.
      &clk_2d_val=15625.
      
      gosub Set_Clock_Freq
      return
    )
    else if ("&clk_desired_freq"=="14.7456")
    (
      &clk_src_name="GPLL0"
      &clk_src_sel=SRC_SEL TODO.
      &clk_src_div=2.
      &clk_m_val=384.
      &clk_n_val=15625.
      &clk_2d_val=15625.
      
      gosub Set_Clock_Freq
      return
    )
    else if ("&clk_desired_freq"=="16.0")
    (
      &clk_src_name="GPLL0"
      &clk_src_sel=SRC_SEL TODO.
      &clk_src_div=10.
      &clk_m_val=2.
      &clk_n_val=15.
      &clk_2d_val=15.
      
      gosub Set_Clock_Freq
      return
    )
    else if ("&clk_desired_freq"=="19.2")
    (
      &clk_src_name="XO"
      &clk_src_sel=SRC_SEL TODO.
      &clk_src_div=2.
      &clk_m_val=0.
      &clk_n_val=0.
      &clk_2d_val=0.
      
      gosub Set_Clock_Freq
      return
    )
    else if ("&clk_desired_freq"=="24.0")
    (
      &clk_src_name="GPLL0"
      &clk_src_sel=SRC_SEL TODO.
      &clk_src_div=10.
      &clk_m_val=1.
      &clk_n_val=5.
      &clk_2d_val=5.
      
      gosub Set_Clock_Freq
      return
    )
    else if ("&clk_desired_freq"=="32.0")
    (
      &clk_src_name="GPLL0"
      &clk_src_sel=SRC_SEL TODO.
      &clk_src_div=2.
      &clk_m_val=4.
      &clk_n_val=75.
      &clk_2d_val=75.
      
      gosub Set_Clock_Freq
      return
    )
    else if ("&clk_desired_freq"=="40.0")
    (
      &clk_src_name="GPLL0"
      &clk_src_sel=SRC_SEL TODO.
      &clk_src_div=30.
      &clk_m_val=0.
      &clk_n_val=0.
      &clk_2d_val=0.
      
      gosub Set_Clock_Freq
      return
    )
    else if ("&clk_desired_freq"=="46.4")
    (
      &clk_src_name="GPLL0"
      &clk_src_sel=SRC_SEL TODO.
      &clk_src_div=2.
      &clk_m_val=29.
      &clk_n_val=375.
      &clk_2d_val=375.
      
      gosub Set_Clock_Freq
      return
    )
    else if ("&clk_desired_freq"=="48.0")
    (
      &clk_src_name="GPLL0"
      &clk_src_sel=SRC_SEL TODO.
      &clk_src_div=25.
      &clk_m_val=0.
      &clk_n_val=0.
      &clk_2d_val=0.
      
      gosub Set_Clock_Freq
      return
    )
    else if ("&clk_desired_freq"=="51.2")
    (
      &clk_src_name="GPLL0"
      &clk_src_sel=SRC_SEL TODO.
      &clk_src_div=2.
      &clk_m_val=32.
      &clk_n_val=375.
      &clk_2d_val=375.
      
      gosub Set_Clock_Freq
      return
    )
    else if ("&clk_desired_freq"=="56.0")
    (
      &clk_src_name="GPLL0"
      &clk_src_sel=SRC_SEL TODO.
      &clk_src_div=2.
      &clk_m_val=7.
      &clk_n_val=75.
      &clk_2d_val=75.
      
      gosub Set_Clock_Freq
      return
    )
    else if ("&clk_desired_freq"=="58.9824")
    (
      &clk_src_name="GPLL0"
      &clk_src_sel=SRC_SEL TODO.
      &clk_src_div=2.
      &clk_m_val=1536.
      &clk_n_val=15625.
      &clk_2d_val=15625.
      
      gosub Set_Clock_Freq
      return
    )
    else if ("&clk_desired_freq"=="60.0")
    (
      &clk_src_name="GPLL0"
      &clk_src_sel=SRC_SEL TODO.
      &clk_src_div=20.
      &clk_m_val=0.
      &clk_n_val=0.
      &clk_2d_val=0.
      
      gosub Set_Clock_Freq
      return
    )
    else if ("&clk_desired_freq"=="63.16")
    (
      &clk_src_name="GPLL0"
      &clk_src_sel=SRC_SEL TODO.
      &clk_src_div=19.
      &clk_m_val=0.
      &clk_n_val=0.
      &clk_2d_val=0.
      
      gosub Set_Clock_Freq
      return
    )
    else if ("&clk_desired_freq"=="r")
    (
      return
    )
    else
    (
      print "Invalid selection."
      goto Set_Clock_Freq_Enter
    )
  )

  if ("&clk"=="gcc_blsp1_uart1_sim_clk")||("&clk"=="gcc_blsp1_uart2_sim_clk")||("&clk"=="gcc_blsp1_uart3_sim_clk")||("&clk"=="gcc_blsp1_uart4_sim_clk")||("&clk"=="gcc_blsp1_uart5_sim_clk")||("&clk"=="gcc_blsp1_uart6_sim_clk")||("&clk"=="gcc_blsp2_uart1_sim_clk")||("&clk"=="gcc_blsp2_uart2_sim_clk")||("&clk"=="gcc_blsp2_uart3_sim_clk")||("&clk"=="gcc_blsp2_uart4_sim_clk")||("&clk"=="gcc_blsp2_uart5_sim_clk")||("&clk"=="gcc_blsp2_uart6_sim_clk")
  (
    gosub PRINT_SET_CLOCK_FREQ_WARNING

    &clk_cmd_rcgr_addr=&HWIO_GCC_BLSP_UART_SIM_CMD_RCGR_ADDR
    &clk_cfg_rcgr_addr=&HWIO_GCC_BLSP_UART_SIM_CFG_RCGR_ADDR

    print "Choose frequency (MHz) from list below: " 

    print "3.84           " 

    print ""
    print "Enter desired frequency (r to return): "
    enter &clk_desired_freq
    print ""

    if ("&clk_desired_freq"=="3.84")
    (
      &clk_src_name="XO"
      &clk_src_sel=SRC_SEL TODO.
      &clk_src_div=10.
      &clk_m_val=0.
      &clk_n_val=0.
      &clk_2d_val=0.
      
      gosub Set_Clock_Freq
      return
    )
    else if ("&clk_desired_freq"=="r")
    (
      return
    )
    else
    (
      print "Invalid selection."
      goto Set_Clock_Freq_Enter
    )
  )

  if ("&clk"=="gcc_ce1_clk")
  (
    gosub PRINT_SET_CLOCK_FREQ_WARNING

    &clk_cmd_rcgr_addr=&HWIO_GCC_CE1_CMD_RCGR_ADDR
    &clk_cfg_rcgr_addr=&HWIO_GCC_CE1_CFG_RCGR_ADDR

    print "Choose frequency (MHz) from list below: " 

    print "42.86          85.71          171.43         " 

    print ""
    print "Enter desired frequency (r to return): "
    enter &clk_desired_freq
    print ""

    if ("&clk_desired_freq"=="42.86")
    (
      &clk_src_name="GPLL0"
      &clk_src_sel=SRC_SEL TODO.
      &clk_src_div=28.
      &clk_m_val=0.
      &clk_n_val=0.
      &clk_2d_val=0.
      
      gosub Set_Clock_Freq
      return
    )
    else if ("&clk_desired_freq"=="85.71")
    (
      &clk_src_name="GPLL0"
      &clk_src_sel=SRC_SEL TODO.
      &clk_src_div=14.
      &clk_m_val=0.
      &clk_n_val=0.
      &clk_2d_val=0.
      
      gosub Set_Clock_Freq
      return
    )
    else if ("&clk_desired_freq"=="171.43")
    (
      &clk_src_name="GPLL0"
      &clk_src_sel=SRC_SEL TODO.
      &clk_src_div=7.
      &clk_m_val=0.
      &clk_n_val=0.
      &clk_2d_val=0.
      
      gosub Set_Clock_Freq
      return
    )
    else if ("&clk_desired_freq"=="r")
    (
      return
    )
    else
    (
      print "Invalid selection."
      goto Set_Clock_Freq_Enter
    )
  )

  if ("&clk"=="gcc_ce2_clk")
  (
    gosub PRINT_SET_CLOCK_FREQ_WARNING

    &clk_cmd_rcgr_addr=&HWIO_GCC_CE2_CMD_RCGR_ADDR
    &clk_cfg_rcgr_addr=&HWIO_GCC_CE2_CFG_RCGR_ADDR

    print "Choose frequency (MHz) from list below: " 

    print "42.86          85.71          171.43         " 

    print ""
    print "Enter desired frequency (r to return): "
    enter &clk_desired_freq
    print ""

    if ("&clk_desired_freq"=="42.86")
    (
      &clk_src_name="GPLL0"
      &clk_src_sel=SRC_SEL TODO.
      &clk_src_div=28.
      &clk_m_val=0.
      &clk_n_val=0.
      &clk_2d_val=0.
      
      gosub Set_Clock_Freq
      return
    )
    else if ("&clk_desired_freq"=="85.71")
    (
      &clk_src_name="GPLL0"
      &clk_src_sel=SRC_SEL TODO.
      &clk_src_div=14.
      &clk_m_val=0.
      &clk_n_val=0.
      &clk_2d_val=0.
      
      gosub Set_Clock_Freq
      return
    )
    else if ("&clk_desired_freq"=="171.43")
    (
      &clk_src_name="GPLL0"
      &clk_src_sel=SRC_SEL TODO.
      &clk_src_div=7.
      &clk_m_val=0.
      &clk_n_val=0.
      &clk_2d_val=0.
      
      gosub Set_Clock_Freq
      return
    )
    else if ("&clk_desired_freq"=="r")
    (
      return
    )
    else
    (
      print "Invalid selection."
      goto Set_Clock_Freq_Enter
    )
  )

  if ("&clk"=="gcc_ce3_clk")
  (
    gosub PRINT_SET_CLOCK_FREQ_WARNING

    &clk_cmd_rcgr_addr=&HWIO_GCC_CE3_CMD_RCGR_ADDR
    &clk_cfg_rcgr_addr=&HWIO_GCC_CE3_CFG_RCGR_ADDR

    print "Choose frequency (MHz) from list below: " 

    print "42.86          85.71          171.43         " 

    print ""
    print "Enter desired frequency (r to return): "
    enter &clk_desired_freq
    print ""

    if ("&clk_desired_freq"=="42.86")
    (
      &clk_src_name="GPLL0"
      &clk_src_sel=SRC_SEL TODO.
      &clk_src_div=28.
      &clk_m_val=0.
      &clk_n_val=0.
      &clk_2d_val=0.
      
      gosub Set_Clock_Freq
      return
    )
    else if ("&clk_desired_freq"=="85.71")
    (
      &clk_src_name="GPLL0"
      &clk_src_sel=SRC_SEL TODO.
      &clk_src_div=14.
      &clk_m_val=0.
      &clk_n_val=0.
      &clk_2d_val=0.
      
      gosub Set_Clock_Freq
      return
    )
    else if ("&clk_desired_freq"=="171.43")
    (
      &clk_src_name="GPLL0"
      &clk_src_sel=SRC_SEL TODO.
      &clk_src_div=7.
      &clk_m_val=0.
      &clk_n_val=0.
      &clk_2d_val=0.
      
      gosub Set_Clock_Freq
      return
    )
    else if ("&clk_desired_freq"=="r")
    (
      return
    )
    else
    (
      print "Invalid selection."
      goto Set_Clock_Freq_Enter
    )
  )

  if ("&clk"=="gcc_ahb_clk")||("&clk"=="gcc_bimc_cfg_ahb_clk")||("&clk"=="gcc_boot_rom_ahb_clk")||("&clk"=="gcc_ce1_ahb_clk")||("&clk"=="gcc_ce2_ahb_clk")||("&clk"=="gcc_ce3_ahb_clk")||("&clk"=="gcc_cfg_noc_ahb_clk")||("&clk"=="gcc_cnoc_bus_timeout0_ahb_clk")||("&clk"=="gcc_cnoc_bus_timeout1_ahb_clk")||("&clk"=="gcc_cnoc_bus_timeout2_ahb_clk")||("&clk"=="gcc_cnoc_bus_timeout3_ahb_clk")||("&clk"=="gcc_cnoc_bus_timeout4_ahb_clk")||("&clk"=="gcc_cnoc_bus_timeout7_ahb_clk")||("&clk"=="gcc_dehr_clk")||("&clk"=="gcc_imem_cfg_ahb_clk")||("&clk"=="gcc_ipa_ahb_clk")||("&clk"=="gcc_mmss_noc_cfg_ahb_clk")||("&clk"=="gcc_mpm_ahb_clk")||("&clk"=="gcc_msg_ram_ahb_clk")||("&clk"=="gcc_mss_cfg_ahb_clk")||("&clk"=="gcc_noc_conf_xpu_ahb_clk")||("&clk"=="gcc_pcie_0_cfg_ahb_clk")||("&clk"=="gcc_pcie_1_cfg_ahb_clk")||("&clk"=="gcc_periph_noc_cfg_ahb_clk")||("&clk"=="gcc_qdss_cfg_ahb_clk")||("&clk"=="gcc_qdss_dap_ahb_clk")||("&clk"=="gcc_qdss_rbcpr_xpu_ahb_clk")||("&clk"=="gcc_rbcpr_cx_ahb_clk")||("&clk"=="gcc_rbcpr_mx_ahb_clk")||("&clk"=="gcc_sec_ctrl_ahb_clk")||("&clk"=="gcc_sec_ctrl_boot_rom_patch_clk")||("&clk"=="gcc_snoc_cnoc_ahb_clk")||("&clk"=="gcc_spdm_cfg_ahb_clk")||("&clk"=="gcc_spdm_mstr_ahb_clk")||("&clk"=="gcc_spmi_cnoc_ahb_clk")||("&clk"=="gcc_tcsr_ahb_clk")||("&clk"=="gcc_tlmm_ahb_clk")||("&clk"=="gcc_tlmm_clk")||("&clk"=="gcc_ufs_ahb_clk")
  (
    gosub PRINT_SET_CLOCK_FREQ_WARNING

    &clk_cmd_rcgr_addr=&HWIO_GCC_CONFIG_NOC_CMD_RCGR_ADDR
    &clk_cfg_rcgr_addr=&HWIO_GCC_CONFIG_NOC_CFG_RCGR_ADDR

    print "Choose frequency (MHz) from list below: " 

    print "19.2           37.5           75.0           " 

    print ""
    print "Enter desired frequency (r to return): "
    enter &clk_desired_freq
    print ""

    if ("&clk_desired_freq"=="19.2")
    (
      &clk_src_name="XO"
      &clk_src_sel=SRC_SEL TODO.
      &clk_src_div=2.
      &clk_m_val=0.
      &clk_n_val=0.
      &clk_2d_val=0.
      
      gosub Set_Clock_Freq
      return
    )
    else if ("&clk_desired_freq"=="37.5")
    (
      &clk_src_name="GPLL0"
      &clk_src_sel=SRC_SEL TODO.
      &clk_src_div=32.
      &clk_m_val=0.
      &clk_n_val=0.
      &clk_2d_val=0.
      
      gosub Set_Clock_Freq
      return
    )
    else if ("&clk_desired_freq"=="75.0")
    (
      &clk_src_name="GPLL0"
      &clk_src_sel=SRC_SEL TODO.
      &clk_src_div=16.
      &clk_m_val=0.
      &clk_n_val=0.
      &clk_2d_val=0.
      
      gosub Set_Clock_Freq
      return
    )
    else if ("&clk_desired_freq"=="r")
    (
      return
    )
    else
    (
      print "Invalid selection."
      goto Set_Clock_Freq_Enter
    )
  )

  if ("&clk"=="gcc_gp1_clk")
  (
    gosub PRINT_SET_CLOCK_FREQ_WARNING

    &clk_cmd_rcgr_addr=&HWIO_GCC_GP1_CMD_RCGR_ADDR
    &clk_cfg_rcgr_addr=&HWIO_GCC_GP1_CFG_RCGR_ADDR

    print "Choose frequency (MHz) from list below: " 

    print "19.2           100.0          200.0          " 

    print ""
    print "Enter desired frequency (r to return): "
    enter &clk_desired_freq
    print ""

    if ("&clk_desired_freq"=="19.2")
    (
      &clk_src_name="XO"
      &clk_src_sel=SRC_SEL TODO.
      &clk_src_div=2.
      &clk_m_val=0.
      &clk_n_val=0.
      &clk_2d_val=0.
      
      gosub Set_Clock_Freq
      return
    )
    else if ("&clk_desired_freq"=="100.0")
    (
      &clk_src_name="GPLL0"
      &clk_src_sel=SRC_SEL TODO.
      &clk_src_div=12.
      &clk_m_val=0.
      &clk_n_val=0.
      &clk_2d_val=0.
      
      gosub Set_Clock_Freq
      return
    )
    else if ("&clk_desired_freq"=="200.0")
    (
      &clk_src_name="GPLL0"
      &clk_src_sel=SRC_SEL TODO.
      &clk_src_div=6.
      &clk_m_val=0.
      &clk_n_val=0.
      &clk_2d_val=0.
      
      gosub Set_Clock_Freq
      return
    )
    else if ("&clk_desired_freq"=="r")
    (
      return
    )
    else
    (
      print "Invalid selection."
      goto Set_Clock_Freq_Enter
    )
  )

  if ("&clk"=="gcc_gp2_clk")
  (
    gosub PRINT_SET_CLOCK_FREQ_WARNING

    &clk_cmd_rcgr_addr=&HWIO_GCC_GP2_CMD_RCGR_ADDR
    &clk_cfg_rcgr_addr=&HWIO_GCC_GP2_CFG_RCGR_ADDR

    print "Choose frequency (MHz) from list below: " 

    print "19.2           100.0          200.0          " 

    print ""
    print "Enter desired frequency (r to return): "
    enter &clk_desired_freq
    print ""

    if ("&clk_desired_freq"=="19.2")
    (
      &clk_src_name="XO"
      &clk_src_sel=SRC_SEL TODO.
      &clk_src_div=2.
      &clk_m_val=0.
      &clk_n_val=0.
      &clk_2d_val=0.
      
      gosub Set_Clock_Freq
      return
    )
    else if ("&clk_desired_freq"=="100.0")
    (
      &clk_src_name="GPLL0"
      &clk_src_sel=SRC_SEL TODO.
      &clk_src_div=12.
      &clk_m_val=0.
      &clk_n_val=0.
      &clk_2d_val=0.
      
      gosub Set_Clock_Freq
      return
    )
    else if ("&clk_desired_freq"=="200.0")
    (
      &clk_src_name="GPLL0"
      &clk_src_sel=SRC_SEL TODO.
      &clk_src_div=6.
      &clk_m_val=0.
      &clk_n_val=0.
      &clk_2d_val=0.
      
      gosub Set_Clock_Freq
      return
    )
    else if ("&clk_desired_freq"=="r")
    (
      return
    )
    else
    (
      print "Invalid selection."
      goto Set_Clock_Freq_Enter
    )
  )

  if ("&clk"=="gcc_gp3_clk")
  (
    gosub PRINT_SET_CLOCK_FREQ_WARNING

    &clk_cmd_rcgr_addr=&HWIO_GCC_GP3_CMD_RCGR_ADDR
    &clk_cfg_rcgr_addr=&HWIO_GCC_GP3_CFG_RCGR_ADDR

    print "Choose frequency (MHz) from list below: " 

    print "19.2           100.0          200.0          " 

    print ""
    print "Enter desired frequency (r to return): "
    enter &clk_desired_freq
    print ""

    if ("&clk_desired_freq"=="19.2")
    (
      &clk_src_name="XO"
      &clk_src_sel=SRC_SEL TODO.
      &clk_src_div=2.
      &clk_m_val=0.
      &clk_n_val=0.
      &clk_2d_val=0.
      
      gosub Set_Clock_Freq
      return
    )
    else if ("&clk_desired_freq"=="100.0")
    (
      &clk_src_name="GPLL0"
      &clk_src_sel=SRC_SEL TODO.
      &clk_src_div=12.
      &clk_m_val=0.
      &clk_n_val=0.
      &clk_2d_val=0.
      
      gosub Set_Clock_Freq
      return
    )
    else if ("&clk_desired_freq"=="200.0")
    (
      &clk_src_name="GPLL0"
      &clk_src_sel=SRC_SEL TODO.
      &clk_src_div=6.
      &clk_m_val=0.
      &clk_n_val=0.
      &clk_2d_val=0.
      
      gosub Set_Clock_Freq
      return
    )
    else if ("&clk_desired_freq"=="r")
    (
      return
    )
    else
    (
      print "Invalid selection."
      goto Set_Clock_Freq_Enter
    )
  )

  if ("&clk"=="gcc_ipa_clk")||("&clk"=="gcc_sys_noc_ipa_axi_clk")
  (
    gosub PRINT_SET_CLOCK_FREQ_WARNING

    &clk_cmd_rcgr_addr=&HWIO_GCC_IPA_CMD_RCGR_ADDR
    &clk_cfg_rcgr_addr=&HWIO_GCC_IPA_CFG_RCGR_ADDR

    print "Choose frequency (MHz) from list below: " 

    print "37.5           75.0           150.0          " 

    print ""
    print "Enter desired frequency (r to return): "
    enter &clk_desired_freq
    print ""

    if ("&clk_desired_freq"=="37.5")
    (
      &clk_src_name="GPLL0"
      &clk_src_sel=SRC_SEL TODO.
      &clk_src_div=32.
      &clk_m_val=0.
      &clk_n_val=0.
      &clk_2d_val=0.
      
      gosub Set_Clock_Freq
      return
    )
    else if ("&clk_desired_freq"=="75.0")
    (
      &clk_src_name="GPLL0"
      &clk_src_sel=SRC_SEL TODO.
      &clk_src_div=16.
      &clk_m_val=0.
      &clk_n_val=0.
      &clk_2d_val=0.
      
      gosub Set_Clock_Freq
      return
    )
    else if ("&clk_desired_freq"=="150.0")
    (
      &clk_src_name="GPLL0"
      &clk_src_sel=SRC_SEL TODO.
      &clk_src_div=8.
      &clk_m_val=0.
      &clk_n_val=0.
      &clk_2d_val=0.
      
      gosub Set_Clock_Freq
      return
    )
    else if ("&clk_desired_freq"=="r")
    (
      return
    )
    else
    (
      print "Invalid selection."
      goto Set_Clock_Freq_Enter
    )
  )

  if ("&clk"=="gcc_kpss_ahb_clk")||("&clk"=="gcc_snoc_bus_timeout0_ahb_clk")||("&clk"=="gcc_sys_noc_kpss_ahb_clk")
  (
    gosub PRINT_SET_CLOCK_FREQ_WARNING

    &clk_cmd_rcgr_addr=&HWIO_GCC_KPSS_AHB_CMD_RCGR_ADDR
    &clk_cfg_rcgr_addr=&HWIO_GCC_KPSS_AHB_CFG_RCGR_ADDR

    print "Choose frequency (MHz) from list below: " 

    print "19.2           37.5           75.0           " 

    print ""
    print "Enter desired frequency (r to return): "
    enter &clk_desired_freq
    print ""

    if ("&clk_desired_freq"=="19.2")
    (
      &clk_src_name="XO"
      &clk_src_sel=SRC_SEL TODO.
      &clk_src_div=2.
      &clk_m_val=0.
      &clk_n_val=0.
      &clk_2d_val=0.
      
      gosub Set_Clock_Freq
      return
    )
    else if ("&clk_desired_freq"=="37.5")
    (
      &clk_src_name="GPLL0"
      &clk_src_sel=SRC_SEL TODO.
      &clk_src_div=32.
      &clk_m_val=0.
      &clk_n_val=0.
      &clk_2d_val=0.
      
      gosub Set_Clock_Freq
      return
    )
    else if ("&clk_desired_freq"=="75.0")
    (
      &clk_src_name="GPLL0"
      &clk_src_sel=SRC_SEL TODO.
      &clk_src_div=16.
      &clk_m_val=0.
      &clk_n_val=0.
      &clk_2d_val=0.
      
      gosub Set_Clock_Freq
      return
    )
    else if ("&clk_desired_freq"=="r")
    (
      return
    )
    else
    (
      print "Invalid selection."
      goto Set_Clock_Freq_Enter
    )
  )

  if ("&clk"=="gcc_pcie_0_aux_clk")
  (
    gosub PRINT_SET_CLOCK_FREQ_WARNING

    &clk_cmd_rcgr_addr=&HWIO_GCC_PCIE_0_AUX_CMD_RCGR_ADDR
    &clk_cfg_rcgr_addr=&HWIO_GCC_PCIE_0_AUX_CFG_RCGR_ADDR

    print "Choose frequency (MHz) from list below: " 

    print "1.010999       " 

    print ""
    print "Enter desired frequency (r to return): "
    enter &clk_desired_freq
    print ""

    if ("&clk_desired_freq"=="1.010999")
    (
      &clk_src_name="XO"
      &clk_src_sel=SRC_SEL TODO.
      &clk_src_div=2.
      &clk_m_val=1.
      &clk_n_val=19.
      &clk_2d_val=19.
      
      gosub Set_Clock_Freq
      return
    )
    else if ("&clk_desired_freq"=="r")
    (
      return
    )
    else
    (
      print "Invalid selection."
      goto Set_Clock_Freq_Enter
    )
  )

  if ("&clk"=="gcc_pcie_1_aux_clk")
  (
    gosub PRINT_SET_CLOCK_FREQ_WARNING

    &clk_cmd_rcgr_addr=&HWIO_GCC_PCIE_1_AUX_CMD_RCGR_ADDR
    &clk_cfg_rcgr_addr=&HWIO_GCC_PCIE_1_AUX_CFG_RCGR_ADDR

    print "Choose frequency (MHz) from list below: " 

    print "1.010999       " 

    print ""
    print "Enter desired frequency (r to return): "
    enter &clk_desired_freq
    print ""

    if ("&clk_desired_freq"=="1.010999")
    (
      &clk_src_name="XO"
      &clk_src_sel=SRC_SEL TODO.
      &clk_src_div=2.
      &clk_m_val=1.
      &clk_n_val=19.
      &clk_2d_val=19.
      
      gosub Set_Clock_Freq
      return
    )
    else if ("&clk_desired_freq"=="r")
    (
      return
    )
    else
    (
      print "Invalid selection."
      goto Set_Clock_Freq_Enter
    )
  )

  if ("&clk"=="gcc_pdm2_clk")
  (
    gosub PRINT_SET_CLOCK_FREQ_WARNING

    &clk_cmd_rcgr_addr=&HWIO_GCC_PDM2_CMD_RCGR_ADDR
    &clk_cfg_rcgr_addr=&HWIO_GCC_PDM2_CFG_RCGR_ADDR

    print "Choose frequency (MHz) from list below: " 

    print "60.0           " 

    print ""
    print "Enter desired frequency (r to return): "
    enter &clk_desired_freq
    print ""

    if ("&clk_desired_freq"=="60.0")
    (
      &clk_src_name="GPLL0"
      &clk_src_sel=SRC_SEL TODO.
      &clk_src_div=20.
      &clk_m_val=0.
      &clk_n_val=0.
      &clk_2d_val=0.
      
      gosub Set_Clock_Freq
      return
    )
    else if ("&clk_desired_freq"=="r")
    (
      return
    )
    else
    (
      print "Invalid selection."
      goto Set_Clock_Freq_Enter
    )
  )

  if ("&clk"=="gcc_bam_dma_ahb_clk")||("&clk"=="gcc_blsp1_ahb_clk")||("&clk"=="gcc_blsp2_ahb_clk")||("&clk"=="gcc_pdm_ahb_clk")||("&clk"=="gcc_periph_noc_ahb_clk")||("&clk"=="gcc_periph_noc_mpu_cfg_ahb_clk")||("&clk"=="gcc_periph_xpu_ahb_clk")||("&clk"=="gcc_pnoc_bus_timeout0_ahb_clk")||("&clk"=="gcc_pnoc_bus_timeout1_ahb_clk")||("&clk"=="gcc_pnoc_bus_timeout2_ahb_clk")||("&clk"=="gcc_pnoc_bus_timeout3_ahb_clk")||("&clk"=="gcc_pnoc_bus_timeout4_ahb_clk")||("&clk"=="gcc_prng_ahb_clk")||("&clk"=="gcc_sdcc1_ahb_clk")||("&clk"=="gcc_sdcc2_ahb_clk")||("&clk"=="gcc_sdcc3_ahb_clk")||("&clk"=="gcc_sdcc4_ahb_clk")||("&clk"=="gcc_snoc_pnoc_ahb_clk")||("&clk"=="gcc_tsif_ahb_clk")||("&clk"=="gcc_usb_hs_ahb_clk")||("&clk"=="gcc_usb_phy_cfg_ahb2phy_clk")
  (
    gosub PRINT_SET_CLOCK_FREQ_WARNING

    &clk_cmd_rcgr_addr=&HWIO_GCC_PERIPH_NOC_CMD_RCGR_ADDR
    &clk_cfg_rcgr_addr=&HWIO_GCC_PERIPH_NOC_CFG_RCGR_ADDR

    print "Choose frequency (MHz) from list below: " 

    print "19.2           37.5           50.0           " 
    print "75.0           100.0          " 

    print ""
    print "Enter desired frequency (r to return): "
    enter &clk_desired_freq
    print ""

    if ("&clk_desired_freq"=="19.2")
    (
      &clk_src_name="XO"
      &clk_src_sel=SRC_SEL TODO.
      &clk_src_div=2.
      &clk_m_val=0.
      &clk_n_val=0.
      &clk_2d_val=0.
      
      gosub Set_Clock_Freq
      return
    )
    else if ("&clk_desired_freq"=="37.5")
    (
      &clk_src_name="GPLL0"
      &clk_src_sel=SRC_SEL TODO.
      &clk_src_div=32.
      &clk_m_val=0.
      &clk_n_val=0.
      &clk_2d_val=0.
      
      gosub Set_Clock_Freq
      return
    )
    else if ("&clk_desired_freq"=="50.0")
    (
      &clk_src_name="GPLL0"
      &clk_src_sel=SRC_SEL TODO.
      &clk_src_div=24.
      &clk_m_val=0.
      &clk_n_val=0.
      &clk_2d_val=0.
      
      gosub Set_Clock_Freq
      return
    )
    else if ("&clk_desired_freq"=="75.0")
    (
      &clk_src_name="GPLL0"
      &clk_src_sel=SRC_SEL TODO.
      &clk_src_div=16.
      &clk_m_val=0.
      &clk_n_val=0.
      &clk_2d_val=0.
      
      gosub Set_Clock_Freq
      return
    )
    else if ("&clk_desired_freq"=="100.0")
    (
      &clk_src_name="GPLL0"
      &clk_src_sel=SRC_SEL TODO.
      &clk_src_div=12.
      &clk_m_val=0.
      &clk_n_val=0.
      &clk_2d_val=0.
      
      gosub Set_Clock_Freq
      return
    )
    else if ("&clk_desired_freq"=="r")
    (
      return
    )
    else
    (
      print "Invalid selection."
      goto Set_Clock_Freq_Enter
    )
  )

  if ("&clk"=="gcc_mmss_noc_at_clk")||("&clk"=="gcc_periph_noc_at_clk")||("&clk"=="gcc_qdss_at_clk")||("&clk"=="gcc_sys_noc_at_clk")
  (
    gosub PRINT_SET_CLOCK_FREQ_WARNING

    &clk_cmd_rcgr_addr=&HWIO_GCC_QDSS_AT_CMD_RCGR_ADDR
    &clk_cfg_rcgr_addr=&HWIO_GCC_QDSS_AT_CFG_RCGR_ADDR

    print "Choose frequency (MHz) from list below: " 

    print "60.0           120.0          240.0          " 

    print ""
    print "Enter desired frequency (r to return): "
    enter &clk_desired_freq
    print ""

    if ("&clk_desired_freq"=="60.0")
    (
      &clk_src_name="GPLL0"
      &clk_src_sel=SRC_SEL TODO.
      &clk_src_div=20.
      &clk_m_val=0.
      &clk_n_val=0.
      &clk_2d_val=0.
      
      gosub Set_Clock_Freq
      return
    )
    else if ("&clk_desired_freq"=="120.0")
    (
      &clk_src_name="GPLL0"
      &clk_src_sel=SRC_SEL TODO.
      &clk_src_div=10.
      &clk_m_val=0.
      &clk_n_val=0.
      &clk_2d_val=0.
      
      gosub Set_Clock_Freq
      return
    )
    else if ("&clk_desired_freq"=="240.0")
    (
      &clk_src_name="GPLL0"
      &clk_src_sel=SRC_SEL TODO.
      &clk_src_div=5.
      &clk_m_val=0.
      &clk_n_val=0.
      &clk_2d_val=0.
      
      gosub Set_Clock_Freq
      return
    )
    else if ("&clk_desired_freq"=="r")
    (
      return
    )
    else
    (
      print "Invalid selection."
      goto Set_Clock_Freq_Enter
    )
  )

  if ("&clk"=="gcc_qdss_stm_clk")||("&clk"=="gcc_sys_noc_qdss_stm_axi_clk")
  (
    gosub PRINT_SET_CLOCK_FREQ_WARNING

    &clk_cmd_rcgr_addr=&HWIO_GCC_QDSS_STM_CMD_RCGR_ADDR
    &clk_cfg_rcgr_addr=&HWIO_GCC_QDSS_STM_CFG_RCGR_ADDR

    print "Choose frequency (MHz) from list below: " 

    print "50.0           100.0          200.0          " 

    print ""
    print "Enter desired frequency (r to return): "
    enter &clk_desired_freq
    print ""

    if ("&clk_desired_freq"=="50.0")
    (
      &clk_src_name="GPLL0"
      &clk_src_sel=SRC_SEL TODO.
      &clk_src_div=24.
      &clk_m_val=0.
      &clk_n_val=0.
      &clk_2d_val=0.
      
      gosub Set_Clock_Freq
      return
    )
    else if ("&clk_desired_freq"=="100.0")
    (
      &clk_src_name="GPLL0"
      &clk_src_sel=SRC_SEL TODO.
      &clk_src_div=12.
      &clk_m_val=0.
      &clk_n_val=0.
      &clk_2d_val=0.
      
      gosub Set_Clock_Freq
      return
    )
    else if ("&clk_desired_freq"=="200.0")
    (
      &clk_src_name="GPLL0"
      &clk_src_sel=SRC_SEL TODO.
      &clk_src_div=6.
      &clk_m_val=0.
      &clk_n_val=0.
      &clk_2d_val=0.
      
      gosub Set_Clock_Freq
      return
    )
    else if ("&clk_desired_freq"=="r")
    (
      return
    )
    else
    (
      print "Invalid selection."
      goto Set_Clock_Freq_Enter
    )
  )

  if ("&clk"=="gcc_qdss_traceclkin_clk")
  (
    gosub PRINT_SET_CLOCK_FREQ_WARNING

    &clk_cmd_rcgr_addr=&HWIO_GCC_QDSS_TRACECLKIN_CMD_RCGR_ADDR
    &clk_cfg_rcgr_addr=&HWIO_GCC_QDSS_TRACECLKIN_CFG_RCGR_ADDR

    print "Choose frequency (MHz) from list below: " 

    print "75.0           150.0          300.0          " 

    print ""
    print "Enter desired frequency (r to return): "
    enter &clk_desired_freq
    print ""

    if ("&clk_desired_freq"=="75.0")
    (
      &clk_src_name="GPLL0"
      &clk_src_sel=SRC_SEL TODO.
      &clk_src_div=16.
      &clk_m_val=0.
      &clk_n_val=0.
      &clk_2d_val=0.
      
      gosub Set_Clock_Freq
      return
    )
    else if ("&clk_desired_freq"=="150.0")
    (
      &clk_src_name="GPLL0"
      &clk_src_sel=SRC_SEL TODO.
      &clk_src_div=8.
      &clk_m_val=0.
      &clk_n_val=0.
      &clk_2d_val=0.
      
      gosub Set_Clock_Freq
      return
    )
    else if ("&clk_desired_freq"=="300.0")
    (
      &clk_src_name="GPLL0"
      &clk_src_sel=SRC_SEL TODO.
      &clk_src_div=4.
      &clk_m_val=0.
      &clk_n_val=0.
      &clk_2d_val=0.
      
      gosub Set_Clock_Freq
      return
    )
    else if ("&clk_desired_freq"=="r")
    (
      return
    )
    else
    (
      print "Invalid selection."
      goto Set_Clock_Freq_Enter
    )
  )

  if ("&clk"=="gcc_qdss_tsctr_div2_clk")
  (
    gosub PRINT_SET_CLOCK_FREQ_WARNING

    &clk_cmd_rcgr_addr=&HWIO_GCC_QDSS_TSCTR_CMD_RCGR_ADDR
    &clk_cfg_rcgr_addr=&HWIO_GCC_QDSS_TSCTR_CFG_RCGR_ADDR

    print "Choose frequency (MHz) from list below: " 

    print "150.0          300.0          600.0          " 

    print ""
    print "Enter desired frequency (r to return): "
    enter &clk_desired_freq
    print ""

    if ("&clk_desired_freq"=="150.0")
    (
      &clk_src_name="GPLL0"
      &clk_src_sel=SRC_SEL TODO.
      &clk_src_div=8.
      &clk_m_val=0.
      &clk_n_val=0.
      &clk_2d_val=0.
      
      gosub Set_Clock_Freq
      return
    )
    else if ("&clk_desired_freq"=="300.0")
    (
      &clk_src_name="GPLL0"
      &clk_src_sel=SRC_SEL TODO.
      &clk_src_div=4.
      &clk_m_val=0.
      &clk_n_val=0.
      &clk_2d_val=0.
      
      gosub Set_Clock_Freq
      return
    )
    else if ("&clk_desired_freq"=="600.0")
    (
      &clk_src_name="GPLL0"
      &clk_src_sel=SRC_SEL TODO.
      &clk_src_div=2.
      &clk_m_val=0.
      &clk_n_val=0.
      &clk_2d_val=0.
      
      gosub Set_Clock_Freq
      return
    )
    else if ("&clk_desired_freq"=="r")
    (
      return
    )
    else
    (
      print "Invalid selection."
      goto Set_Clock_Freq_Enter
    )
  )

  if ("&clk"=="gcc_rbcpr_cx_clk")
  (
    gosub PRINT_SET_CLOCK_FREQ_WARNING

    &clk_cmd_rcgr_addr=&HWIO_GCC_RBCPR_CX_CMD_RCGR_ADDR
    &clk_cfg_rcgr_addr=&HWIO_GCC_RBCPR_CX_CFG_RCGR_ADDR

    print "Choose frequency (MHz) from list below: " 

    print "19.2           " 

    print ""
    print "Enter desired frequency (r to return): "
    enter &clk_desired_freq
    print ""

    if ("&clk_desired_freq"=="19.2")
    (
      &clk_src_name="XO"
      &clk_src_sel=SRC_SEL TODO.
      &clk_src_div=2.
      &clk_m_val=0.
      &clk_n_val=0.
      &clk_2d_val=0.
      
      gosub Set_Clock_Freq
      return
    )
    else if ("&clk_desired_freq"=="r")
    (
      return
    )
    else
    (
      print "Invalid selection."
      goto Set_Clock_Freq_Enter
    )
  )

  if ("&clk"=="gcc_rbcpr_mx_clk")
  (
    gosub PRINT_SET_CLOCK_FREQ_WARNING

    &clk_cmd_rcgr_addr=&HWIO_GCC_RBCPR_MX_CMD_RCGR_ADDR
    &clk_cfg_rcgr_addr=&HWIO_GCC_RBCPR_MX_CFG_RCGR_ADDR

    print "Choose frequency (MHz) from list below: " 

    print "19.2           " 

    print ""
    print "Enter desired frequency (r to return): "
    enter &clk_desired_freq
    print ""

    if ("&clk_desired_freq"=="19.2")
    (
      &clk_src_name="XO"
      &clk_src_sel=SRC_SEL TODO.
      &clk_src_div=2.
      &clk_m_val=0.
      &clk_n_val=0.
      &clk_2d_val=0.
      
      gosub Set_Clock_Freq
      return
    )
    else if ("&clk_desired_freq"=="r")
    (
      return
    )
    else
    (
      print "Invalid selection."
      goto Set_Clock_Freq_Enter
    )
  )

  if ("&clk"=="gcc_cfg_noc_rpm_ahb_clk")||("&clk"=="gcc_cnoc_bus_timeout6_ahb_clk")||("&clk"=="gcc_rpm_bus_ahb_clk")||("&clk"=="gcc_rpm_proc_fclk")||("&clk"=="gcc_rpm_proc_hclk")
  (
    gosub PRINT_SET_CLOCK_FREQ_WARNING

    &clk_cmd_rcgr_addr=&HWIO_GCC_RPM_CMD_RCGR_ADDR
    &clk_cfg_rcgr_addr=&HWIO_GCC_RPM_CFG_RCGR_ADDR

    print "Choose frequency (MHz) from list below: " 

    print "19.2           50.0           100.0          " 
    print "200.0          " 

    print ""
    print "Enter desired frequency (r to return): "
    enter &clk_desired_freq
    print ""

    if ("&clk_desired_freq"=="19.2")
    (
      &clk_src_name="XO"
      &clk_src_sel=SRC_SEL TODO.
      &clk_src_div=2.
      &clk_m_val=0.
      &clk_n_val=0.
      &clk_2d_val=0.
      
      gosub Set_Clock_Freq
      return
    )
    else if ("&clk_desired_freq"=="50.0")
    (
      &clk_src_name="GPLL0"
      &clk_src_sel=SRC_SEL TODO.
      &clk_src_div=24.
      &clk_m_val=0.
      &clk_n_val=0.
      &clk_2d_val=0.
      
      gosub Set_Clock_Freq
      return
    )
    else if ("&clk_desired_freq"=="100.0")
    (
      &clk_src_name="GPLL0"
      &clk_src_sel=SRC_SEL TODO.
      &clk_src_div=12.
      &clk_m_val=0.
      &clk_n_val=0.
      &clk_2d_val=0.
      
      gosub Set_Clock_Freq
      return
    )
    else if ("&clk_desired_freq"=="200.0")
    (
      &clk_src_name="GPLL0"
      &clk_src_sel=SRC_SEL TODO.
      &clk_src_div=6.
      &clk_m_val=0.
      &clk_n_val=0.
      &clk_2d_val=0.
      
      gosub Set_Clock_Freq
      return
    )
    else if ("&clk_desired_freq"=="r")
    (
      return
    )
    else
    (
      print "Invalid selection."
      goto Set_Clock_Freq_Enter
    )
  )

  if ("&clk"=="gcc_sdcc1_apps_clk")
  (
    gosub PRINT_SET_CLOCK_FREQ_WARNING

    &clk_cmd_rcgr_addr=&HWIO_GCC_SDCC1_APPS_CMD_RCGR_ADDR
    &clk_cfg_rcgr_addr=&HWIO_GCC_SDCC1_APPS_CFG_RCGR_ADDR

    print "Choose frequency (MHz) from list below: " 

    print "0.144          0.4            20.0           " 
    print "25.0           50.0           96.0           " 
    print "192.0          384.0          " 

    print ""
    print "Enter desired frequency (r to return): "
    enter &clk_desired_freq
    print ""

    if ("&clk_desired_freq"=="0.144")
    (
      &clk_src_name="XO"
      &clk_src_sel=SRC_SEL TODO.
      &clk_src_div=32.
      &clk_m_val=3.
      &clk_n_val=25.
      &clk_2d_val=25.
      
      gosub Set_Clock_Freq
      return
    )
    else if ("&clk_desired_freq"=="0.4")
    (
      &clk_src_name="XO"
      &clk_src_sel=SRC_SEL TODO.
      &clk_src_div=24.
      &clk_m_val=1.
      &clk_n_val=4.
      &clk_2d_val=4.
      
      gosub Set_Clock_Freq
      return
    )
    else if ("&clk_desired_freq"=="20.0")
    (
      &clk_src_name="GPLL0"
      &clk_src_sel=SRC_SEL TODO.
      &clk_src_div=30.
      &clk_m_val=1.
      &clk_n_val=2.
      &clk_2d_val=2.
      
      gosub Set_Clock_Freq
      return
    )
    else if ("&clk_desired_freq"=="25.0")
    (
      &clk_src_name="GPLL0"
      &clk_src_sel=SRC_SEL TODO.
      &clk_src_div=24.
      &clk_m_val=1.
      &clk_n_val=2.
      &clk_2d_val=2.
      
      gosub Set_Clock_Freq
      return
    )
    else if ("&clk_desired_freq"=="50.0")
    (
      &clk_src_name="GPLL0"
      &clk_src_sel=SRC_SEL TODO.
      &clk_src_div=24.
      &clk_m_val=0.
      &clk_n_val=0.
      &clk_2d_val=0.
      
      gosub Set_Clock_Freq
      return
    )
    else if ("&clk_desired_freq"=="96.0")
    (
      &clk_src_name="GPLL4"
      &clk_src_sel=SRC_SEL TODO.
      &clk_src_div=32.
      &clk_m_val=0.
      &clk_n_val=0.
      &clk_2d_val=0.
      
      gosub Set_Clock_Freq
      return
    )
    else if ("&clk_desired_freq"=="192.0")
    (
      &clk_src_name="GPLL4"
      &clk_src_sel=SRC_SEL TODO.
      &clk_src_div=16.
      &clk_m_val=0.
      &clk_n_val=0.
      &clk_2d_val=0.
      
      gosub Set_Clock_Freq
      return
    )
    else if ("&clk_desired_freq"=="384.0")
    (
      &clk_src_name="GPLL4"
      &clk_src_sel=SRC_SEL TODO.
      &clk_src_div=8.
      &clk_m_val=0.
      &clk_n_val=0.
      &clk_2d_val=0.
      
      gosub Set_Clock_Freq
      return
    )
    else if ("&clk_desired_freq"=="r")
    (
      return
    )
    else
    (
      print "Invalid selection."
      goto Set_Clock_Freq_Enter
    )
  )

  if ("&clk"=="gcc_sdcc2_apps_clk")
  (
    gosub PRINT_SET_CLOCK_FREQ_WARNING

    &clk_cmd_rcgr_addr=&HWIO_GCC_SDCC2_APPS_CMD_RCGR_ADDR
    &clk_cfg_rcgr_addr=&HWIO_GCC_SDCC2_APPS_CFG_RCGR_ADDR

    print "Choose frequency (MHz) from list below: " 

    print "0.144          0.4            20.0           " 
    print "25.0           50.0           100.0          " 
    print "200.0          " 

    print ""
    print "Enter desired frequency (r to return): "
    enter &clk_desired_freq
    print ""

    if ("&clk_desired_freq"=="0.144")
    (
      &clk_src_name="XO"
      &clk_src_sel=SRC_SEL TODO.
      &clk_src_div=32.
      &clk_m_val=3.
      &clk_n_val=25.
      &clk_2d_val=25.
      
      gosub Set_Clock_Freq
      return
    )
    else if ("&clk_desired_freq"=="0.4")
    (
      &clk_src_name="XO"
      &clk_src_sel=SRC_SEL TODO.
      &clk_src_div=24.
      &clk_m_val=1.
      &clk_n_val=4.
      &clk_2d_val=4.
      
      gosub Set_Clock_Freq
      return
    )
    else if ("&clk_desired_freq"=="20.0")
    (
      &clk_src_name="GPLL0"
      &clk_src_sel=SRC_SEL TODO.
      &clk_src_div=30.
      &clk_m_val=1.
      &clk_n_val=2.
      &clk_2d_val=2.
      
      gosub Set_Clock_Freq
      return
    )
    else if ("&clk_desired_freq"=="25.0")
    (
      &clk_src_name="GPLL0"
      &clk_src_sel=SRC_SEL TODO.
      &clk_src_div=24.
      &clk_m_val=1.
      &clk_n_val=2.
      &clk_2d_val=2.
      
      gosub Set_Clock_Freq
      return
    )
    else if ("&clk_desired_freq"=="50.0")
    (
      &clk_src_name="GPLL0"
      &clk_src_sel=SRC_SEL TODO.
      &clk_src_div=24.
      &clk_m_val=0.
      &clk_n_val=0.
      &clk_2d_val=0.
      
      gosub Set_Clock_Freq
      return
    )
    else if ("&clk_desired_freq"=="100.0")
    (
      &clk_src_name="GPLL0"
      &clk_src_sel=SRC_SEL TODO.
      &clk_src_div=12.
      &clk_m_val=0.
      &clk_n_val=0.
      &clk_2d_val=0.
      
      gosub Set_Clock_Freq
      return
    )
    else if ("&clk_desired_freq"=="200.0")
    (
      &clk_src_name="GPLL0"
      &clk_src_sel=SRC_SEL TODO.
      &clk_src_div=6.
      &clk_m_val=0.
      &clk_n_val=0.
      &clk_2d_val=0.
      
      gosub Set_Clock_Freq
      return
    )
    else if ("&clk_desired_freq"=="r")
    (
      return
    )
    else
    (
      print "Invalid selection."
      goto Set_Clock_Freq_Enter
    )
  )

  if ("&clk"=="gcc_sdcc3_apps_clk")
  (
    gosub PRINT_SET_CLOCK_FREQ_WARNING

    &clk_cmd_rcgr_addr=&HWIO_GCC_SDCC3_APPS_CMD_RCGR_ADDR
    &clk_cfg_rcgr_addr=&HWIO_GCC_SDCC3_APPS_CFG_RCGR_ADDR

    print "Choose frequency (MHz) from list below: " 

    print "0.144          0.4            20.0           " 
    print "25.0           50.0           100.0          " 
    print "200.0          " 

    print ""
    print "Enter desired frequency (r to return): "
    enter &clk_desired_freq
    print ""

    if ("&clk_desired_freq"=="0.144")
    (
      &clk_src_name="XO"
      &clk_src_sel=SRC_SEL TODO.
      &clk_src_div=32.
      &clk_m_val=3.
      &clk_n_val=25.
      &clk_2d_val=25.
      
      gosub Set_Clock_Freq
      return
    )
    else if ("&clk_desired_freq"=="0.4")
    (
      &clk_src_name="XO"
      &clk_src_sel=SRC_SEL TODO.
      &clk_src_div=24.
      &clk_m_val=1.
      &clk_n_val=4.
      &clk_2d_val=4.
      
      gosub Set_Clock_Freq
      return
    )
    else if ("&clk_desired_freq"=="20.0")
    (
      &clk_src_name="GPLL0"
      &clk_src_sel=SRC_SEL TODO.
      &clk_src_div=30.
      &clk_m_val=1.
      &clk_n_val=2.
      &clk_2d_val=2.
      
      gosub Set_Clock_Freq
      return
    )
    else if ("&clk_desired_freq"=="25.0")
    (
      &clk_src_name="GPLL0"
      &clk_src_sel=SRC_SEL TODO.
      &clk_src_div=24.
      &clk_m_val=1.
      &clk_n_val=2.
      &clk_2d_val=2.
      
      gosub Set_Clock_Freq
      return
    )
    else if ("&clk_desired_freq"=="50.0")
    (
      &clk_src_name="GPLL0"
      &clk_src_sel=SRC_SEL TODO.
      &clk_src_div=24.
      &clk_m_val=0.
      &clk_n_val=0.
      &clk_2d_val=0.
      
      gosub Set_Clock_Freq
      return
    )
    else if ("&clk_desired_freq"=="100.0")
    (
      &clk_src_name="GPLL0"
      &clk_src_sel=SRC_SEL TODO.
      &clk_src_div=12.
      &clk_m_val=0.
      &clk_n_val=0.
      &clk_2d_val=0.
      
      gosub Set_Clock_Freq
      return
    )
    else if ("&clk_desired_freq"=="200.0")
    (
      &clk_src_name="GPLL0"
      &clk_src_sel=SRC_SEL TODO.
      &clk_src_div=6.
      &clk_m_val=0.
      &clk_n_val=0.
      &clk_2d_val=0.
      
      gosub Set_Clock_Freq
      return
    )
    else if ("&clk_desired_freq"=="r")
    (
      return
    )
    else
    (
      print "Invalid selection."
      goto Set_Clock_Freq_Enter
    )
  )

  if ("&clk"=="gcc_sdcc4_apps_clk")
  (
    gosub PRINT_SET_CLOCK_FREQ_WARNING

    &clk_cmd_rcgr_addr=&HWIO_GCC_SDCC4_APPS_CMD_RCGR_ADDR
    &clk_cfg_rcgr_addr=&HWIO_GCC_SDCC4_APPS_CFG_RCGR_ADDR

    print "Choose frequency (MHz) from list below: " 

    print "0.144          0.4            20.0           " 
    print "25.0           50.0           100.0          " 

    print ""
    print "Enter desired frequency (r to return): "
    enter &clk_desired_freq
    print ""

    if ("&clk_desired_freq"=="0.144")
    (
      &clk_src_name="XO"
      &clk_src_sel=SRC_SEL TODO.
      &clk_src_div=32.
      &clk_m_val=3.
      &clk_n_val=25.
      &clk_2d_val=25.
      
      gosub Set_Clock_Freq
      return
    )
    else if ("&clk_desired_freq"=="0.4")
    (
      &clk_src_name="XO"
      &clk_src_sel=SRC_SEL TODO.
      &clk_src_div=24.
      &clk_m_val=1.
      &clk_n_val=4.
      &clk_2d_val=4.
      
      gosub Set_Clock_Freq
      return
    )
    else if ("&clk_desired_freq"=="20.0")
    (
      &clk_src_name="GPLL0"
      &clk_src_sel=SRC_SEL TODO.
      &clk_src_div=30.
      &clk_m_val=1.
      &clk_n_val=2.
      &clk_2d_val=2.
      
      gosub Set_Clock_Freq
      return
    )
    else if ("&clk_desired_freq"=="25.0")
    (
      &clk_src_name="GPLL0"
      &clk_src_sel=SRC_SEL TODO.
      &clk_src_div=24.
      &clk_m_val=1.
      &clk_n_val=2.
      &clk_2d_val=2.
      
      gosub Set_Clock_Freq
      return
    )
    else if ("&clk_desired_freq"=="50.0")
    (
      &clk_src_name="GPLL0"
      &clk_src_sel=SRC_SEL TODO.
      &clk_src_div=24.
      &clk_m_val=0.
      &clk_n_val=0.
      &clk_2d_val=0.
      
      gosub Set_Clock_Freq
      return
    )
    else if ("&clk_desired_freq"=="100.0")
    (
      &clk_src_name="GPLL0"
      &clk_src_sel=SRC_SEL TODO.
      &clk_src_div=12.
      &clk_m_val=0.
      &clk_n_val=0.
      &clk_2d_val=0.
      
      gosub Set_Clock_Freq
      return
    )
    else if ("&clk_desired_freq"=="r")
    (
      return
    )
    else
    (
      print "Invalid selection."
      goto Set_Clock_Freq_Enter
    )
  )

  if ("&clk"=="gcc_sec_ctrl_clk")||("&clk"=="gcc_sec_ctrl_sense_clk")
  (
    gosub PRINT_SET_CLOCK_FREQ_WARNING

    &clk_cmd_rcgr_addr=&HWIO_GCC_SEC_CTRL_CMD_RCGR_ADDR
    &clk_cfg_rcgr_addr=&HWIO_GCC_SEC_CTRL_CFG_RCGR_ADDR

    print "Choose frequency (MHz) from list below: " 

    print "2.4            19.2           " 

    print ""
    print "Enter desired frequency (r to return): "
    enter &clk_desired_freq
    print ""

    if ("&clk_desired_freq"=="2.4")
    (
      &clk_src_name="XO"
      &clk_src_sel=SRC_SEL TODO.
      &clk_src_div=16.
      &clk_m_val=0.
      &clk_n_val=0.
      &clk_2d_val=0.
      
      gosub Set_Clock_Freq
      return
    )
    else if ("&clk_desired_freq"=="19.2")
    (
      &clk_src_name="XO"
      &clk_src_sel=SRC_SEL TODO.
      &clk_src_div=2.
      &clk_m_val=0.
      &clk_n_val=0.
      &clk_2d_val=0.
      
      gosub Set_Clock_Freq
      return
    )
    else if ("&clk_desired_freq"=="r")
    (
      return
    )
    else
    (
      print "Invalid selection."
      goto Set_Clock_Freq_Enter
    )
  )

  if ("&clk"=="gcc_spmi_ahb_clk")
  (
    gosub PRINT_SET_CLOCK_FREQ_WARNING

    &clk_cmd_rcgr_addr=&HWIO_GCC_SPMI_AHB_CMD_RCGR_ADDR
    &clk_cfg_rcgr_addr=&HWIO_GCC_SPMI_AHB_CFG_RCGR_ADDR

    print "Choose frequency (MHz) from list below: " 

    print "37.5           " 

    print ""
    print "Enter desired frequency (r to return): "
    enter &clk_desired_freq
    print ""

    if ("&clk_desired_freq"=="37.5")
    (
      &clk_src_name="GPLL0"
      &clk_src_sel=SRC_SEL TODO.
      &clk_src_div=32.
      &clk_m_val=0.
      &clk_n_val=0.
      &clk_2d_val=0.
      
      gosub Set_Clock_Freq
      return
    )
    else if ("&clk_desired_freq"=="r")
    (
      return
    )
    else
    (
      print "Invalid selection."
      goto Set_Clock_Freq_Enter
    )
  )

  if ("&clk"=="gcc_spmi_ser_clk")
  (
    gosub PRINT_SET_CLOCK_FREQ_WARNING

    &clk_cmd_rcgr_addr=&HWIO_GCC_SPMI_SER_CMD_RCGR_ADDR
    &clk_cfg_rcgr_addr=&HWIO_GCC_SPMI_SER_CFG_RCGR_ADDR

    print "Choose frequency (MHz) from list below: " 

    print "19.2           " 

    print ""
    print "Enter desired frequency (r to return): "
    enter &clk_desired_freq
    print ""

    if ("&clk_desired_freq"=="19.2")
    (
      &clk_src_name="XO"
      &clk_src_sel=SRC_SEL TODO.
      &clk_src_div=2.
      &clk_m_val=0.
      &clk_n_val=0.
      &clk_2d_val=0.
      
      gosub Set_Clock_Freq
      return
    )
    else if ("&clk_desired_freq"=="r")
    (
      return
    )
    else
    (
      print "Invalid selection."
      goto Set_Clock_Freq_Enter
    )
  )

  if ("&clk"=="gcc_bimc_sysnoc_axi_clk")||("&clk"=="gcc_ce1_axi_clk")||("&clk"=="gcc_ce2_axi_clk")||("&clk"=="gcc_ce3_axi_clk")||("&clk"=="gcc_imem_axi_clk")||("&clk"=="gcc_lpass_mport_axi_clk")||("&clk"=="gcc_lpass_q6_axi_clk")||("&clk"=="gcc_lpass_sway_clk")||("&clk"=="gcc_ocmem_sys_noc_axi_clk")||("&clk"=="gcc_pcie_0_mstr_axi_clk")||("&clk"=="gcc_pcie_0_slv_axi_clk")||("&clk"=="gcc_pcie_1_mstr_axi_clk")||("&clk"=="gcc_pcie_1_slv_axi_clk")||("&clk"=="gcc_qdss_etr_usb_clk")||("&clk"=="gcc_snoc_bus_timeout1_ahb_clk")||("&clk"=="gcc_snoc_bus_timeout3_ahb_clk")||("&clk"=="gcc_sys_noc_axi_clk")
  (
    gosub PRINT_SET_CLOCK_FREQ_WARNING

    &clk_cmd_rcgr_addr=&HWIO_GCC_SYSTEM_NOC_CMD_RCGR_ADDR
    &clk_cfg_rcgr_addr=&HWIO_GCC_SYSTEM_NOC_CFG_RCGR_ADDR

    print "Choose frequency (MHz) from list below: " 

    print "19.2           50.0           100.0          " 
    print "150.0          171.43         200.0          " 

    print ""
    print "Enter desired frequency (r to return): "
    enter &clk_desired_freq
    print ""

    if ("&clk_desired_freq"=="19.2")
    (
      &clk_src_name="XO"
      &clk_src_sel=SRC_SEL TODO.
      &clk_src_div=2.
      &clk_m_val=0.
      &clk_n_val=0.
      &clk_2d_val=0.
      
      gosub Set_Clock_Freq
      return
    )
    else if ("&clk_desired_freq"=="50.0")
    (
      &clk_src_name="GPLL0"
      &clk_src_sel=SRC_SEL TODO.
      &clk_src_div=24.
      &clk_m_val=0.
      &clk_n_val=0.
      &clk_2d_val=0.
      
      gosub Set_Clock_Freq
      return
    )
    else if ("&clk_desired_freq"=="100.0")
    (
      &clk_src_name="GPLL0"
      &clk_src_sel=SRC_SEL TODO.
      &clk_src_div=12.
      &clk_m_val=0.
      &clk_n_val=0.
      &clk_2d_val=0.
      
      gosub Set_Clock_Freq
      return
    )
    else if ("&clk_desired_freq"=="150.0")
    (
      &clk_src_name="GPLL0"
      &clk_src_sel=SRC_SEL TODO.
      &clk_src_div=8.
      &clk_m_val=0.
      &clk_n_val=0.
      &clk_2d_val=0.
      
      gosub Set_Clock_Freq
      return
    )
    else if ("&clk_desired_freq"=="171.43")
    (
      &clk_src_name="GPLL0"
      &clk_src_sel=SRC_SEL TODO.
      &clk_src_div=7.
      &clk_m_val=0.
      &clk_n_val=0.
      &clk_2d_val=0.
      
      gosub Set_Clock_Freq
      return
    )
    else if ("&clk_desired_freq"=="200.0")
    (
      &clk_src_name="GPLL0"
      &clk_src_sel=SRC_SEL TODO.
      &clk_src_div=6.
      &clk_m_val=0.
      &clk_n_val=0.
      &clk_2d_val=0.
      
      gosub Set_Clock_Freq
      return
    )
    else if ("&clk_desired_freq"=="r")
    (
      return
    )
    else
    (
      print "Invalid selection."
      goto Set_Clock_Freq_Enter
    )
  )

  if ("&clk"=="gcc_tsif_ref_clk")
  (
    gosub PRINT_SET_CLOCK_FREQ_WARNING

    &clk_cmd_rcgr_addr=&HWIO_GCC_TSIF_REF_CMD_RCGR_ADDR
    &clk_cfg_rcgr_addr=&HWIO_GCC_TSIF_REF_CFG_RCGR_ADDR

    print "Choose frequency (MHz) from list below: " 

    print "0.1055         " 

    print ""
    print "Enter desired frequency (r to return): "
    enter &clk_desired_freq
    print ""

    if ("&clk_desired_freq"=="0.1055")
    (
      &clk_src_name="XO"
      &clk_src_sel=SRC_SEL TODO.
      &clk_src_div=2.
      &clk_m_val=1.
      &clk_n_val=182.
      &clk_2d_val=182.
      
      gosub Set_Clock_Freq
      return
    )
    else if ("&clk_desired_freq"=="r")
    (
      return
    )
    else
    (
      print "Invalid selection."
      goto Set_Clock_Freq_Enter
    )
  )

  if ("&clk"=="gcc_sys_noc_ufs_axi_clk")||("&clk"=="gcc_ufs_axi_clk")
  (
    gosub PRINT_SET_CLOCK_FREQ_WARNING

    &clk_cmd_rcgr_addr=&HWIO_GCC_UFS_AXI_CMD_RCGR_ADDR
    &clk_cfg_rcgr_addr=&HWIO_GCC_UFS_AXI_CFG_RCGR_ADDR

    print "Choose frequency (MHz) from list below: " 

    print "100.0          171.43         200.0          " 

    print ""
    print "Enter desired frequency (r to return): "
    enter &clk_desired_freq
    print ""

    if ("&clk_desired_freq"=="100.0")
    (
      &clk_src_name="GPLL0"
      &clk_src_sel=SRC_SEL TODO.
      &clk_src_div=12.
      &clk_m_val=0.
      &clk_n_val=0.
      &clk_2d_val=0.
      
      gosub Set_Clock_Freq
      return
    )
    else if ("&clk_desired_freq"=="171.43")
    (
      &clk_src_name="GPLL0"
      &clk_src_sel=SRC_SEL TODO.
      &clk_src_div=7.
      &clk_m_val=0.
      &clk_n_val=0.
      &clk_2d_val=0.
      
      gosub Set_Clock_Freq
      return
    )
    else if ("&clk_desired_freq"=="200.0")
    (
      &clk_src_name="GPLL0"
      &clk_src_sel=SRC_SEL TODO.
      &clk_src_div=6.
      &clk_m_val=0.
      &clk_n_val=0.
      &clk_2d_val=0.
      
      gosub Set_Clock_Freq
      return
    )
    else if ("&clk_desired_freq"=="r")
    (
      return
    )
    else
    (
      print "Invalid selection."
      goto Set_Clock_Freq_Enter
    )
  )

  if ("&clk"=="gcc_snoc_bus_timeout2_ahb_clk")||("&clk"=="gcc_sys_noc_usb3_axi_clk")||("&clk"=="gcc_usb30_master_clk")
  (
    gosub PRINT_SET_CLOCK_FREQ_WARNING

    &clk_cmd_rcgr_addr=&HWIO_GCC_USB30_MASTER_CMD_RCGR_ADDR
    &clk_cfg_rcgr_addr=&HWIO_GCC_USB30_MASTER_CFG_RCGR_ADDR

    print "Choose frequency (MHz) from list below: " 

    print "125.0          " 

    print ""
    print "Enter desired frequency (r to return): "
    enter &clk_desired_freq
    print ""

    if ("&clk_desired_freq"=="125.0")
    (
      &clk_src_name="GPLL0"
      &clk_src_sel=SRC_SEL TODO.
      &clk_src_div=2.
      &clk_m_val=5.
      &clk_n_val=24.
      &clk_2d_val=24.
      
      gosub Set_Clock_Freq
      return
    )
    else if ("&clk_desired_freq"=="r")
    (
      return
    )
    else
    (
      print "Invalid selection."
      goto Set_Clock_Freq_Enter
    )
  )

  if ("&clk"=="gcc_usb30_mock_utmi_clk")
  (
    gosub PRINT_SET_CLOCK_FREQ_WARNING

    &clk_cmd_rcgr_addr=&HWIO_GCC_USB30_MOCK_UTMI_CMD_RCGR_ADDR
    &clk_cfg_rcgr_addr=&HWIO_GCC_USB30_MOCK_UTMI_CFG_RCGR_ADDR

    print "Choose frequency (MHz) from list below: " 

    print "60.0           " 

    print ""
    print "Enter desired frequency (r to return): "
    enter &clk_desired_freq
    print ""

    if ("&clk_desired_freq"=="60.0")
    (
      &clk_src_name="GPLL0"
      &clk_src_sel=SRC_SEL TODO.
      &clk_src_div=20.
      &clk_m_val=0.
      &clk_n_val=0.
      &clk_2d_val=0.
      
      gosub Set_Clock_Freq
      return
    )
    else if ("&clk_desired_freq"=="r")
    (
      return
    )
    else
    (
      print "Invalid selection."
      goto Set_Clock_Freq_Enter
    )
  )

  if ("&clk"=="gcc_usb3_phy_aux_clk")
  (
    gosub PRINT_SET_CLOCK_FREQ_WARNING

    &clk_cmd_rcgr_addr=&HWIO_GCC_USB3_PHY_AUX_CMD_RCGR_ADDR
    &clk_cfg_rcgr_addr=&HWIO_GCC_USB3_PHY_AUX_CFG_RCGR_ADDR

    print "Choose frequency (MHz) from list below: " 

    print "1.2            " 

    print ""
    print "Enter desired frequency (r to return): "
    enter &clk_desired_freq
    print ""

    if ("&clk_desired_freq"=="1.2")
    (
      &clk_src_name="XO"
      &clk_src_sel=SRC_SEL TODO.
      &clk_src_div=32.
      &clk_m_val=0.
      &clk_n_val=0.
      &clk_2d_val=0.
      
      gosub Set_Clock_Freq
      return
    )
    else if ("&clk_desired_freq"=="r")
    (
      return
    )
    else
    (
      print "Invalid selection."
      goto Set_Clock_Freq_Enter
    )
  )

  if ("&clk"=="gcc_usb_hs_system_clk")
  (
    gosub PRINT_SET_CLOCK_FREQ_WARNING

    &clk_cmd_rcgr_addr=&HWIO_GCC_USB_HS_SYSTEM_CMD_RCGR_ADDR
    &clk_cfg_rcgr_addr=&HWIO_GCC_USB_HS_SYSTEM_CFG_RCGR_ADDR

    print "Choose frequency (MHz) from list below: " 

    print "75.0           " 

    print ""
    print "Enter desired frequency (r to return): "
    enter &clk_desired_freq
    print ""

    if ("&clk_desired_freq"=="75.0")
    (
      &clk_src_name="GPLL0"
      &clk_src_sel=SRC_SEL TODO.
      &clk_src_div=16.
      &clk_m_val=0.
      &clk_n_val=0.
      &clk_2d_val=0.
      
      gosub Set_Clock_Freq
      return
    )
    else if ("&clk_desired_freq"=="r")
    (
      return
    )
    else
    (
      print "Invalid selection."
      goto Set_Clock_Freq_Enter
    )
  )

  if ("&clk"=="gcc_vs_clk")
  (
    gosub PRINT_SET_CLOCK_FREQ_WARNING

    &clk_cmd_rcgr_addr=&HWIO_GCC_VS_CMD_RCGR_ADDR
    &clk_cfg_rcgr_addr=&HWIO_GCC_VS_CFG_RCGR_ADDR

    print "Choose frequency (MHz) from list below: " 

    print "150.0          300.0          600.0          " 

    print ""
    print "Enter desired frequency (r to return): "
    enter &clk_desired_freq
    print ""

    if ("&clk_desired_freq"=="150.0")
    (
      &clk_src_name="GPLL0"
      &clk_src_sel=SRC_SEL TODO.
      &clk_src_div=8.
      &clk_m_val=0.
      &clk_n_val=0.
      &clk_2d_val=0.
      
      gosub Set_Clock_Freq
      return
    )
    else if ("&clk_desired_freq"=="300.0")
    (
      &clk_src_name="GPLL0"
      &clk_src_sel=SRC_SEL TODO.
      &clk_src_div=4.
      &clk_m_val=0.
      &clk_n_val=0.
      &clk_2d_val=0.
      
      gosub Set_Clock_Freq
      return
    )
    else if ("&clk_desired_freq"=="600.0")
    (
      &clk_src_name="GPLL0"
      &clk_src_sel=SRC_SEL TODO.
      &clk_src_div=2.
      &clk_m_val=0.
      &clk_n_val=0.
      &clk_2d_val=0.
      
      gosub Set_Clock_Freq
      return
    )
    else if ("&clk_desired_freq"=="r")
    (
      return
    )
    else
    (
      print "Invalid selection."
      goto Set_Clock_Freq_Enter
    )
  )

  if ("&clk"=="ahbfabric_clk_src")||("&clk"=="ahb_spdmtm_clk")||("&clk"=="audio_core_aon_clk")||("&clk"=="audio_core_avsync_csr_clk")||("&clk"=="audio_core_csr_clk")||("&clk"=="audio_core_dml_clk")||("&clk"=="audio_core_ixfabric_clk")||("&clk"=="audio_core_ixfabric_spdmtm_csr_clk")||("&clk"=="audio_core_lpaif_csr_clk")||("&clk"=="audio_core_lpaif_dma_clk")||("&clk"=="audio_core_lpm_clk")||("&clk"=="audio_core_resampler_lfabif_clk")||("&clk"=="audio_core_security_clk")||("&clk"=="audio_core_slimbus2_lfabif_clk")||("&clk"=="audio_core_slimbus_lfabif_clk")||("&clk"=="audio_core_sysnoc_clk")||("&clk"=="audio_core_timeout_clk")||("&clk"=="audio_wrapper_aon_clk")||("&clk"=="audio_wrapper_br_clk")||("&clk"=="audio_wrapper_efabric_clk")||("&clk"=="audio_wrapper_efabric_spdmtm_csr_clk")||("&clk"=="audio_wrapper_lcc_csr_clk")||("&clk"=="audio_wrapper_security_clk")||("&clk"=="audio_wrapper_smem_clk")||("&clk"=="audio_wrapper_sysnoc_sway_clk")||("&clk"=="audio_wrapper_timeout_clk")||("&clk"=="q6ss_ahb_lfabif_clk")||("&clk"=="q6ss_ahbm_clk")||("&clk"=="q6ss_tcm_slave_clk")
  (
    gosub PRINT_SET_CLOCK_FREQ_WARNING

    &clk_cmd_rcgr_addr=&HWIO_LPASS_AHBFABRIC_CMD_RCGR_ADDR
    &clk_cfg_rcgr_addr=&HWIO_LPASS_AHBFABRIC_CFG_RCGR_ADDR

    print "Choose frequency (MHz) from list below: " 

    print "19.2           51.2           102.4          " 
    print "136.53         " 

    print ""
    print "Enter desired frequency (r to return): "
    enter &clk_desired_freq
    print ""

    if ("&clk_desired_freq"=="19.2")
    (
      &clk_src_name="XO"
      &clk_src_sel=SRC_SEL TODO.
      &clk_src_div=2.
      &clk_m_val=0.
      &clk_n_val=0.
      &clk_2d_val=0.
      
      gosub Set_Clock_Freq
      return
    )
    else if ("&clk_desired_freq"=="51.2")
    (
      &clk_src_name="LPASS_LPAAUDIO_PLL"
      &clk_src_sel=SRC_SEL TODO.
      &clk_src_div=8.
      &clk_m_val=0.
      &clk_n_val=0.
      &clk_2d_val=0.
      
      gosub Set_Clock_Freq
      return
    )
    else if ("&clk_desired_freq"=="102.4")
    (
      &clk_src_name="LPASS_LPAAUDIO_PLL"
      &clk_src_sel=SRC_SEL TODO.
      &clk_src_div=4.
      &clk_m_val=0.
      &clk_n_val=0.
      &clk_2d_val=0.
      
      gosub Set_Clock_Freq
      return
    )
    else if ("&clk_desired_freq"=="136.53")
    (
      &clk_src_name="LPASS_LPAAUDIO_PLL"
      &clk_src_sel=SRC_SEL TODO.
      &clk_src_div=3.
      &clk_m_val=0.
      &clk_n_val=0.
      &clk_2d_val=0.
      
      gosub Set_Clock_Freq
      return
    )
    else if ("&clk_desired_freq"=="r")
    (
      return
    )
    else
    (
      print "Invalid selection."
      goto Set_Clock_Freq_Enter
    )
  )

  if ("&clk"=="lpaif_pcm0_clk_src")||("&clk"=="audio_core_lpaif_pcm0_ibit_clk")
  (
    gosub PRINT_SET_CLOCK_FREQ_WARNING

    &clk_cmd_rcgr_addr=&HWIO_LPASS_LPAIF_PCM0_CMD_RCGR_ADDR
    &clk_cfg_rcgr_addr=&HWIO_LPASS_LPAIF_PCM0_CFG_RCGR_ADDR

    print "Choose frequency (MHz) from list below: " 

    print "0.512          0.768          1.024          " 
    print "1.536          2.048          3.072          " 
    print "4.096          6.144          8.192          " 
    print "12.288         " 

    print ""
    print "Enter desired frequency (r to return): "
    enter &clk_desired_freq
    print ""

    if ("&clk_desired_freq"=="0.512")
    (
      &clk_src_name="LPASS_LPAAUDIO_PLL"
      &clk_src_sel=SRC_SEL TODO.
      &clk_src_div=30.
      &clk_m_val=1.
      &clk_n_val=16.
      &clk_2d_val=16.
      
      gosub Set_Clock_Freq
      return
    )
    else if ("&clk_desired_freq"=="0.768")
    (
      &clk_src_name="LPASS_LPAAUDIO_PLL"
      &clk_src_sel=SRC_SEL TODO.
      &clk_src_div=20.
      &clk_m_val=1.
      &clk_n_val=16.
      &clk_2d_val=16.
      
      gosub Set_Clock_Freq
      return
    )
    else if ("&clk_desired_freq"=="1.024")
    (
      &clk_src_name="LPASS_LPAAUDIO_PLL"
      &clk_src_sel=SRC_SEL TODO.
      &clk_src_div=30.
      &clk_m_val=1.
      &clk_n_val=8.
      &clk_2d_val=8.
      
      gosub Set_Clock_Freq
      return
    )
    else if ("&clk_desired_freq"=="1.536")
    (
      &clk_src_name="LPASS_LPAAUDIO_PLL"
      &clk_src_sel=SRC_SEL TODO.
      &clk_src_div=20.
      &clk_m_val=1.
      &clk_n_val=8.
      &clk_2d_val=8.
      
      gosub Set_Clock_Freq
      return
    )
    else if ("&clk_desired_freq"=="2.048")
    (
      &clk_src_name="LPASS_LPAAUDIO_PLL"
      &clk_src_sel=SRC_SEL TODO.
      &clk_src_div=30.
      &clk_m_val=1.
      &clk_n_val=4.
      &clk_2d_val=4.
      
      gosub Set_Clock_Freq
      return
    )
    else if ("&clk_desired_freq"=="3.072")
    (
      &clk_src_name="LPASS_LPAAUDIO_PLL"
      &clk_src_sel=SRC_SEL TODO.
      &clk_src_div=20.
      &clk_m_val=1.
      &clk_n_val=4.
      &clk_2d_val=4.
      
      gosub Set_Clock_Freq
      return
    )
    else if ("&clk_desired_freq"=="4.096")
    (
      &clk_src_name="LPASS_LPAAUDIO_PLL"
      &clk_src_sel=SRC_SEL TODO.
      &clk_src_div=30.
      &clk_m_val=1.
      &clk_n_val=2.
      &clk_2d_val=2.
      
      gosub Set_Clock_Freq
      return
    )
    else if ("&clk_desired_freq"=="6.144")
    (
      &clk_src_name="LPASS_LPAAUDIO_PLL"
      &clk_src_sel=SRC_SEL TODO.
      &clk_src_div=20.
      &clk_m_val=1.
      &clk_n_val=2.
      &clk_2d_val=2.
      
      gosub Set_Clock_Freq
      return
    )
    else if ("&clk_desired_freq"=="8.192")
    (
      &clk_src_name="LPASS_LPAAUDIO_PLL"
      &clk_src_sel=SRC_SEL TODO.
      &clk_src_div=30.
      &clk_m_val=0.
      &clk_n_val=0.
      &clk_2d_val=0.
      
      gosub Set_Clock_Freq
      return
    )
    else if ("&clk_desired_freq"=="12.288")
    (
      &clk_src_name="LPASS_LPAAUDIO_PLL"
      &clk_src_sel=SRC_SEL TODO.
      &clk_src_div=20.
      &clk_m_val=0.
      &clk_n_val=0.
      &clk_2d_val=0.
      
      gosub Set_Clock_Freq
      return
    )
    else if ("&clk_desired_freq"=="r")
    (
      return
    )
    else
    (
      print "Invalid selection."
      goto Set_Clock_Freq_Enter
    )
  )

  if ("&clk"=="lpaif_pcm1_clk_src")||("&clk"=="audio_core_lpaif_pcm1_ibit_clk")
  (
    gosub PRINT_SET_CLOCK_FREQ_WARNING

    &clk_cmd_rcgr_addr=&HWIO_LPASS_LPAIF_PCM1_CMD_RCGR_ADDR
    &clk_cfg_rcgr_addr=&HWIO_LPASS_LPAIF_PCM1_CFG_RCGR_ADDR

    print "Choose frequency (MHz) from list below: " 

    print "0.512          0.768          1.024          " 
    print "1.536          2.048          3.072          " 
    print "4.096          6.144          8.192          " 
    print "12.288         " 

    print ""
    print "Enter desired frequency (r to return): "
    enter &clk_desired_freq
    print ""

    if ("&clk_desired_freq"=="0.512")
    (
      &clk_src_name="LPASS_LPAAUDIO_PLL"
      &clk_src_sel=SRC_SEL TODO.
      &clk_src_div=30.
      &clk_m_val=1.
      &clk_n_val=16.
      &clk_2d_val=16.
      
      gosub Set_Clock_Freq
      return
    )
    else if ("&clk_desired_freq"=="0.768")
    (
      &clk_src_name="LPASS_LPAAUDIO_PLL"
      &clk_src_sel=SRC_SEL TODO.
      &clk_src_div=20.
      &clk_m_val=1.
      &clk_n_val=16.
      &clk_2d_val=16.
      
      gosub Set_Clock_Freq
      return
    )
    else if ("&clk_desired_freq"=="1.024")
    (
      &clk_src_name="LPASS_LPAAUDIO_PLL"
      &clk_src_sel=SRC_SEL TODO.
      &clk_src_div=30.
      &clk_m_val=1.
      &clk_n_val=8.
      &clk_2d_val=8.
      
      gosub Set_Clock_Freq
      return
    )
    else if ("&clk_desired_freq"=="1.536")
    (
      &clk_src_name="LPASS_LPAAUDIO_PLL"
      &clk_src_sel=SRC_SEL TODO.
      &clk_src_div=20.
      &clk_m_val=1.
      &clk_n_val=8.
      &clk_2d_val=8.
      
      gosub Set_Clock_Freq
      return
    )
    else if ("&clk_desired_freq"=="2.048")
    (
      &clk_src_name="LPASS_LPAAUDIO_PLL"
      &clk_src_sel=SRC_SEL TODO.
      &clk_src_div=30.
      &clk_m_val=1.
      &clk_n_val=4.
      &clk_2d_val=4.
      
      gosub Set_Clock_Freq
      return
    )
    else if ("&clk_desired_freq"=="3.072")
    (
      &clk_src_name="LPASS_LPAAUDIO_PLL"
      &clk_src_sel=SRC_SEL TODO.
      &clk_src_div=20.
      &clk_m_val=1.
      &clk_n_val=4.
      &clk_2d_val=4.
      
      gosub Set_Clock_Freq
      return
    )
    else if ("&clk_desired_freq"=="4.096")
    (
      &clk_src_name="LPASS_LPAAUDIO_PLL"
      &clk_src_sel=SRC_SEL TODO.
      &clk_src_div=30.
      &clk_m_val=1.
      &clk_n_val=2.
      &clk_2d_val=2.
      
      gosub Set_Clock_Freq
      return
    )
    else if ("&clk_desired_freq"=="6.144")
    (
      &clk_src_name="LPASS_LPAAUDIO_PLL"
      &clk_src_sel=SRC_SEL TODO.
      &clk_src_div=20.
      &clk_m_val=1.
      &clk_n_val=2.
      &clk_2d_val=2.
      
      gosub Set_Clock_Freq
      return
    )
    else if ("&clk_desired_freq"=="8.192")
    (
      &clk_src_name="LPASS_LPAAUDIO_PLL"
      &clk_src_sel=SRC_SEL TODO.
      &clk_src_div=30.
      &clk_m_val=0.
      &clk_n_val=0.
      &clk_2d_val=0.
      
      gosub Set_Clock_Freq
      return
    )
    else if ("&clk_desired_freq"=="12.288")
    (
      &clk_src_name="LPASS_LPAAUDIO_PLL"
      &clk_src_sel=SRC_SEL TODO.
      &clk_src_div=20.
      &clk_m_val=0.
      &clk_n_val=0.
      &clk_2d_val=0.
      
      gosub Set_Clock_Freq
      return
    )
    else if ("&clk_desired_freq"=="r")
    (
      return
    )
    else
    (
      print "Invalid selection."
      goto Set_Clock_Freq_Enter
    )
  )

  if ("&clk"=="lpaif_pcmoe_clk_src")||("&clk"=="audio_core_lpaif_pcm_data_oe_clk")
  (
    gosub PRINT_SET_CLOCK_FREQ_WARNING

    &clk_cmd_rcgr_addr=&HWIO_LPASS_LPAIF_PCMOE_CMD_RCGR_ADDR
    &clk_cfg_rcgr_addr=&HWIO_LPASS_LPAIF_PCMOE_CFG_RCGR_ADDR

    print "Choose frequency (MHz) from list below: " 

    print "0.512          0.768          1.024          " 
    print "1.536          2.048          3.072          " 
    print "4.096          6.144          8.192          " 
    print "12.288         " 

    print ""
    print "Enter desired frequency (r to return): "
    enter &clk_desired_freq
    print ""

    if ("&clk_desired_freq"=="0.512")
    (
      &clk_src_name="LPASS_LPAAUDIO_PLL"
      &clk_src_sel=SRC_SEL TODO.
      &clk_src_div=30.
      &clk_m_val=1.
      &clk_n_val=16.
      &clk_2d_val=16.
      
      gosub Set_Clock_Freq
      return
    )
    else if ("&clk_desired_freq"=="0.768")
    (
      &clk_src_name="LPASS_LPAAUDIO_PLL"
      &clk_src_sel=SRC_SEL TODO.
      &clk_src_div=20.
      &clk_m_val=1.
      &clk_n_val=16.
      &clk_2d_val=16.
      
      gosub Set_Clock_Freq
      return
    )
    else if ("&clk_desired_freq"=="1.024")
    (
      &clk_src_name="LPASS_LPAAUDIO_PLL"
      &clk_src_sel=SRC_SEL TODO.
      &clk_src_div=30.
      &clk_m_val=1.
      &clk_n_val=8.
      &clk_2d_val=8.
      
      gosub Set_Clock_Freq
      return
    )
    else if ("&clk_desired_freq"=="1.536")
    (
      &clk_src_name="LPASS_LPAAUDIO_PLL"
      &clk_src_sel=SRC_SEL TODO.
      &clk_src_div=20.
      &clk_m_val=1.
      &clk_n_val=8.
      &clk_2d_val=8.
      
      gosub Set_Clock_Freq
      return
    )
    else if ("&clk_desired_freq"=="2.048")
    (
      &clk_src_name="LPASS_LPAAUDIO_PLL"
      &clk_src_sel=SRC_SEL TODO.
      &clk_src_div=30.
      &clk_m_val=1.
      &clk_n_val=4.
      &clk_2d_val=4.
      
      gosub Set_Clock_Freq
      return
    )
    else if ("&clk_desired_freq"=="3.072")
    (
      &clk_src_name="LPASS_LPAAUDIO_PLL"
      &clk_src_sel=SRC_SEL TODO.
      &clk_src_div=20.
      &clk_m_val=1.
      &clk_n_val=4.
      &clk_2d_val=4.
      
      gosub Set_Clock_Freq
      return
    )
    else if ("&clk_desired_freq"=="4.096")
    (
      &clk_src_name="LPASS_LPAAUDIO_PLL"
      &clk_src_sel=SRC_SEL TODO.
      &clk_src_div=30.
      &clk_m_val=1.
      &clk_n_val=2.
      &clk_2d_val=2.
      
      gosub Set_Clock_Freq
      return
    )
    else if ("&clk_desired_freq"=="6.144")
    (
      &clk_src_name="LPASS_LPAAUDIO_PLL"
      &clk_src_sel=SRC_SEL TODO.
      &clk_src_div=20.
      &clk_m_val=1.
      &clk_n_val=2.
      &clk_2d_val=2.
      
      gosub Set_Clock_Freq
      return
    )
    else if ("&clk_desired_freq"=="8.192")
    (
      &clk_src_name="LPASS_LPAAUDIO_PLL"
      &clk_src_sel=SRC_SEL TODO.
      &clk_src_div=30.
      &clk_m_val=0.
      &clk_n_val=0.
      &clk_2d_val=0.
      
      gosub Set_Clock_Freq
      return
    )
    else if ("&clk_desired_freq"=="12.288")
    (
      &clk_src_name="LPASS_LPAAUDIO_PLL"
      &clk_src_sel=SRC_SEL TODO.
      &clk_src_div=20.
      &clk_m_val=0.
      &clk_n_val=0.
      &clk_2d_val=0.
      
      gosub Set_Clock_Freq
      return
    )
    else if ("&clk_desired_freq"=="r")
    (
      return
    )
    else
    (
      print "Invalid selection."
      goto Set_Clock_Freq_Enter
    )
  )

  if ("&clk"=="lpaif_pri_clk_src")||("&clk"=="audio_core_lpaif_pri_ibit_clk")||("&clk"=="audio_core_lpaif_pri_osr_clk")
  (
    gosub PRINT_SET_CLOCK_FREQ_WARNING

    &clk_cmd_rcgr_addr=&HWIO_LPASS_LPAIF_PRI_CMD_RCGR_ADDR
    &clk_cfg_rcgr_addr=&HWIO_LPASS_LPAIF_PRI_CFG_RCGR_ADDR

    print "Choose frequency (MHz) from list below: " 

    print "0.512          0.768          1.024          " 
    print "1.536          2.048          3.072          " 
    print "4.096          6.144          8.192          " 
    print "12.288         " 

    print ""
    print "Enter desired frequency (r to return): "
    enter &clk_desired_freq
    print ""

    if ("&clk_desired_freq"=="0.512")
    (
      &clk_src_name="LPASS_LPAAUDIO_PLL"
      &clk_src_sel=SRC_SEL TODO.
      &clk_src_div=30.
      &clk_m_val=1.
      &clk_n_val=16.
      &clk_2d_val=16.
      
      gosub Set_Clock_Freq
      return
    )
    else if ("&clk_desired_freq"=="0.768")
    (
      &clk_src_name="LPASS_LPAAUDIO_PLL"
      &clk_src_sel=SRC_SEL TODO.
      &clk_src_div=20.
      &clk_m_val=1.
      &clk_n_val=16.
      &clk_2d_val=16.
      
      gosub Set_Clock_Freq
      return
    )
    else if ("&clk_desired_freq"=="1.024")
    (
      &clk_src_name="LPASS_LPAAUDIO_PLL"
      &clk_src_sel=SRC_SEL TODO.
      &clk_src_div=30.
      &clk_m_val=1.
      &clk_n_val=8.
      &clk_2d_val=8.
      
      gosub Set_Clock_Freq
      return
    )
    else if ("&clk_desired_freq"=="1.536")
    (
      &clk_src_name="LPASS_LPAAUDIO_PLL"
      &clk_src_sel=SRC_SEL TODO.
      &clk_src_div=20.
      &clk_m_val=1.
      &clk_n_val=8.
      &clk_2d_val=8.
      
      gosub Set_Clock_Freq
      return
    )
    else if ("&clk_desired_freq"=="2.048")
    (
      &clk_src_name="LPASS_LPAAUDIO_PLL"
      &clk_src_sel=SRC_SEL TODO.
      &clk_src_div=30.
      &clk_m_val=1.
      &clk_n_val=4.
      &clk_2d_val=4.
      
      gosub Set_Clock_Freq
      return
    )
    else if ("&clk_desired_freq"=="3.072")
    (
      &clk_src_name="LPASS_LPAAUDIO_PLL"
      &clk_src_sel=SRC_SEL TODO.
      &clk_src_div=20.
      &clk_m_val=1.
      &clk_n_val=4.
      &clk_2d_val=4.
      
      gosub Set_Clock_Freq
      return
    )
    else if ("&clk_desired_freq"=="4.096")
    (
      &clk_src_name="LPASS_LPAAUDIO_PLL"
      &clk_src_sel=SRC_SEL TODO.
      &clk_src_div=30.
      &clk_m_val=1.
      &clk_n_val=2.
      &clk_2d_val=2.
      
      gosub Set_Clock_Freq
      return
    )
    else if ("&clk_desired_freq"=="6.144")
    (
      &clk_src_name="LPASS_LPAAUDIO_PLL"
      &clk_src_sel=SRC_SEL TODO.
      &clk_src_div=20.
      &clk_m_val=1.
      &clk_n_val=2.
      &clk_2d_val=2.
      
      gosub Set_Clock_Freq
      return
    )
    else if ("&clk_desired_freq"=="8.192")
    (
      &clk_src_name="LPASS_LPAAUDIO_PLL"
      &clk_src_sel=SRC_SEL TODO.
      &clk_src_div=30.
      &clk_m_val=0.
      &clk_n_val=0.
      &clk_2d_val=0.
      
      gosub Set_Clock_Freq
      return
    )
    else if ("&clk_desired_freq"=="12.288")
    (
      &clk_src_name="LPASS_LPAAUDIO_PLL"
      &clk_src_sel=SRC_SEL TODO.
      &clk_src_div=20.
      &clk_m_val=0.
      &clk_n_val=0.
      &clk_2d_val=0.
      
      gosub Set_Clock_Freq
      return
    )
    else if ("&clk_desired_freq"=="r")
    (
      return
    )
    else
    (
      print "Invalid selection."
      goto Set_Clock_Freq_Enter
    )
  )

  if ("&clk"=="lpaif_quad_clk_src")||("&clk"=="audio_core_lpaif_quad_ibit_clk")||("&clk"=="audio_core_lpaif_quad_osr_clk")
  (
    gosub PRINT_SET_CLOCK_FREQ_WARNING

    &clk_cmd_rcgr_addr=&HWIO_LPASS_LPAIF_QUAD_CMD_RCGR_ADDR
    &clk_cfg_rcgr_addr=&HWIO_LPASS_LPAIF_QUAD_CFG_RCGR_ADDR

    print "Choose frequency (MHz) from list below: " 

    print "0.512          0.768          1.024          " 
    print "1.536          2.048          3.072          " 
    print "4.096          6.144          8.192          " 
    print "12.288         " 

    print ""
    print "Enter desired frequency (r to return): "
    enter &clk_desired_freq
    print ""

    if ("&clk_desired_freq"=="0.512")
    (
      &clk_src_name="LPASS_LPAAUDIO_PLL"
      &clk_src_sel=SRC_SEL TODO.
      &clk_src_div=30.
      &clk_m_val=1.
      &clk_n_val=16.
      &clk_2d_val=16.
      
      gosub Set_Clock_Freq
      return
    )
    else if ("&clk_desired_freq"=="0.768")
    (
      &clk_src_name="LPASS_LPAAUDIO_PLL"
      &clk_src_sel=SRC_SEL TODO.
      &clk_src_div=20.
      &clk_m_val=1.
      &clk_n_val=16.
      &clk_2d_val=16.
      
      gosub Set_Clock_Freq
      return
    )
    else if ("&clk_desired_freq"=="1.024")
    (
      &clk_src_name="LPASS_LPAAUDIO_PLL"
      &clk_src_sel=SRC_SEL TODO.
      &clk_src_div=30.
      &clk_m_val=1.
      &clk_n_val=8.
      &clk_2d_val=8.
      
      gosub Set_Clock_Freq
      return
    )
    else if ("&clk_desired_freq"=="1.536")
    (
      &clk_src_name="LPASS_LPAAUDIO_PLL"
      &clk_src_sel=SRC_SEL TODO.
      &clk_src_div=20.
      &clk_m_val=1.
      &clk_n_val=8.
      &clk_2d_val=8.
      
      gosub Set_Clock_Freq
      return
    )
    else if ("&clk_desired_freq"=="2.048")
    (
      &clk_src_name="LPASS_LPAAUDIO_PLL"
      &clk_src_sel=SRC_SEL TODO.
      &clk_src_div=30.
      &clk_m_val=1.
      &clk_n_val=4.
      &clk_2d_val=4.
      
      gosub Set_Clock_Freq
      return
    )
    else if ("&clk_desired_freq"=="3.072")
    (
      &clk_src_name="LPASS_LPAAUDIO_PLL"
      &clk_src_sel=SRC_SEL TODO.
      &clk_src_div=20.
      &clk_m_val=1.
      &clk_n_val=4.
      &clk_2d_val=4.
      
      gosub Set_Clock_Freq
      return
    )
    else if ("&clk_desired_freq"=="4.096")
    (
      &clk_src_name="LPASS_LPAAUDIO_PLL"
      &clk_src_sel=SRC_SEL TODO.
      &clk_src_div=30.
      &clk_m_val=1.
      &clk_n_val=2.
      &clk_2d_val=2.
      
      gosub Set_Clock_Freq
      return
    )
    else if ("&clk_desired_freq"=="6.144")
    (
      &clk_src_name="LPASS_LPAAUDIO_PLL"
      &clk_src_sel=SRC_SEL TODO.
      &clk_src_div=20.
      &clk_m_val=1.
      &clk_n_val=2.
      &clk_2d_val=2.
      
      gosub Set_Clock_Freq
      return
    )
    else if ("&clk_desired_freq"=="8.192")
    (
      &clk_src_name="LPASS_LPAAUDIO_PLL"
      &clk_src_sel=SRC_SEL TODO.
      &clk_src_div=30.
      &clk_m_val=0.
      &clk_n_val=0.
      &clk_2d_val=0.
      
      gosub Set_Clock_Freq
      return
    )
    else if ("&clk_desired_freq"=="12.288")
    (
      &clk_src_name="LPASS_LPAAUDIO_PLL"
      &clk_src_sel=SRC_SEL TODO.
      &clk_src_div=20.
      &clk_m_val=0.
      &clk_n_val=0.
      &clk_2d_val=0.
      
      gosub Set_Clock_Freq
      return
    )
    else if ("&clk_desired_freq"=="r")
    (
      return
    )
    else
    (
      print "Invalid selection."
      goto Set_Clock_Freq_Enter
    )
  )

  if ("&clk"=="lpaif_sec_clk_src")||("&clk"=="audio_core_lpaif_sec_ibit_clk")||("&clk"=="audio_core_lpaif_sec_osr_clk")
  (
    gosub PRINT_SET_CLOCK_FREQ_WARNING

    &clk_cmd_rcgr_addr=&HWIO_LPASS_LPAIF_SEC_CMD_RCGR_ADDR
    &clk_cfg_rcgr_addr=&HWIO_LPASS_LPAIF_SEC_CFG_RCGR_ADDR

    print "Choose frequency (MHz) from list below: " 

    print "0.512          0.768          1.024          " 
    print "1.536          2.048          3.072          " 
    print "4.096          6.144          8.192          " 
    print "12.288         " 

    print ""
    print "Enter desired frequency (r to return): "
    enter &clk_desired_freq
    print ""

    if ("&clk_desired_freq"=="0.512")
    (
      &clk_src_name="LPASS_LPAAUDIO_PLL"
      &clk_src_sel=SRC_SEL TODO.
      &clk_src_div=30.
      &clk_m_val=1.
      &clk_n_val=16.
      &clk_2d_val=16.
      
      gosub Set_Clock_Freq
      return
    )
    else if ("&clk_desired_freq"=="0.768")
    (
      &clk_src_name="LPASS_LPAAUDIO_PLL"
      &clk_src_sel=SRC_SEL TODO.
      &clk_src_div=20.
      &clk_m_val=1.
      &clk_n_val=16.
      &clk_2d_val=16.
      
      gosub Set_Clock_Freq
      return
    )
    else if ("&clk_desired_freq"=="1.024")
    (
      &clk_src_name="LPASS_LPAAUDIO_PLL"
      &clk_src_sel=SRC_SEL TODO.
      &clk_src_div=30.
      &clk_m_val=1.
      &clk_n_val=8.
      &clk_2d_val=8.
      
      gosub Set_Clock_Freq
      return
    )
    else if ("&clk_desired_freq"=="1.536")
    (
      &clk_src_name="LPASS_LPAAUDIO_PLL"
      &clk_src_sel=SRC_SEL TODO.
      &clk_src_div=20.
      &clk_m_val=1.
      &clk_n_val=8.
      &clk_2d_val=8.
      
      gosub Set_Clock_Freq
      return
    )
    else if ("&clk_desired_freq"=="2.048")
    (
      &clk_src_name="LPASS_LPAAUDIO_PLL"
      &clk_src_sel=SRC_SEL TODO.
      &clk_src_div=30.
      &clk_m_val=1.
      &clk_n_val=4.
      &clk_2d_val=4.
      
      gosub Set_Clock_Freq
      return
    )
    else if ("&clk_desired_freq"=="3.072")
    (
      &clk_src_name="LPASS_LPAAUDIO_PLL"
      &clk_src_sel=SRC_SEL TODO.
      &clk_src_div=20.
      &clk_m_val=1.
      &clk_n_val=4.
      &clk_2d_val=4.
      
      gosub Set_Clock_Freq
      return
    )
    else if ("&clk_desired_freq"=="4.096")
    (
      &clk_src_name="LPASS_LPAAUDIO_PLL"
      &clk_src_sel=SRC_SEL TODO.
      &clk_src_div=30.
      &clk_m_val=1.
      &clk_n_val=2.
      &clk_2d_val=2.
      
      gosub Set_Clock_Freq
      return
    )
    else if ("&clk_desired_freq"=="6.144")
    (
      &clk_src_name="LPASS_LPAAUDIO_PLL"
      &clk_src_sel=SRC_SEL TODO.
      &clk_src_div=20.
      &clk_m_val=1.
      &clk_n_val=2.
      &clk_2d_val=2.
      
      gosub Set_Clock_Freq
      return
    )
    else if ("&clk_desired_freq"=="8.192")
    (
      &clk_src_name="LPASS_LPAAUDIO_PLL"
      &clk_src_sel=SRC_SEL TODO.
      &clk_src_div=30.
      &clk_m_val=0.
      &clk_n_val=0.
      &clk_2d_val=0.
      
      gosub Set_Clock_Freq
      return
    )
    else if ("&clk_desired_freq"=="12.288")
    (
      &clk_src_name="LPASS_LPAAUDIO_PLL"
      &clk_src_sel=SRC_SEL TODO.
      &clk_src_div=20.
      &clk_m_val=0.
      &clk_n_val=0.
      &clk_2d_val=0.
      
      gosub Set_Clock_Freq
      return
    )
    else if ("&clk_desired_freq"=="r")
    (
      return
    )
    else
    (
      print "Invalid selection."
      goto Set_Clock_Freq_Enter
    )
  )

  if ("&clk"=="lpaif_spkr_clk_src")||("&clk"=="audio_core_lpaif_codec_spkr_ibit_clk")||("&clk"=="audio_core_lpaif_codec_spkr_osr_clk")
  (
    gosub PRINT_SET_CLOCK_FREQ_WARNING

    &clk_cmd_rcgr_addr=&HWIO_LPASS_LPAIF_SPKR_CMD_RCGR_ADDR
    &clk_cfg_rcgr_addr=&HWIO_LPASS_LPAIF_SPKR_CFG_RCGR_ADDR

    print "Choose frequency (MHz) from list below: " 

    print "0.512          0.768          1.024          " 
    print "1.536          2.048          3.072          " 
    print "4.096          6.144          8.192          " 
    print "12.288         " 

    print ""
    print "Enter desired frequency (r to return): "
    enter &clk_desired_freq
    print ""

    if ("&clk_desired_freq"=="0.512")
    (
      &clk_src_name="LPASS_LPAAUDIO_PLL"
      &clk_src_sel=SRC_SEL TODO.
      &clk_src_div=30.
      &clk_m_val=1.
      &clk_n_val=16.
      &clk_2d_val=16.
      
      gosub Set_Clock_Freq
      return
    )
    else if ("&clk_desired_freq"=="0.768")
    (
      &clk_src_name="LPASS_LPAAUDIO_PLL"
      &clk_src_sel=SRC_SEL TODO.
      &clk_src_div=20.
      &clk_m_val=1.
      &clk_n_val=16.
      &clk_2d_val=16.
      
      gosub Set_Clock_Freq
      return
    )
    else if ("&clk_desired_freq"=="1.024")
    (
      &clk_src_name="LPASS_LPAAUDIO_PLL"
      &clk_src_sel=SRC_SEL TODO.
      &clk_src_div=30.
      &clk_m_val=1.
      &clk_n_val=8.
      &clk_2d_val=8.
      
      gosub Set_Clock_Freq
      return
    )
    else if ("&clk_desired_freq"=="1.536")
    (
      &clk_src_name="LPASS_LPAAUDIO_PLL"
      &clk_src_sel=SRC_SEL TODO.
      &clk_src_div=20.
      &clk_m_val=1.
      &clk_n_val=8.
      &clk_2d_val=8.
      
      gosub Set_Clock_Freq
      return
    )
    else if ("&clk_desired_freq"=="2.048")
    (
      &clk_src_name="LPASS_LPAAUDIO_PLL"
      &clk_src_sel=SRC_SEL TODO.
      &clk_src_div=30.
      &clk_m_val=1.
      &clk_n_val=4.
      &clk_2d_val=4.
      
      gosub Set_Clock_Freq
      return
    )
    else if ("&clk_desired_freq"=="3.072")
    (
      &clk_src_name="LPASS_LPAAUDIO_PLL"
      &clk_src_sel=SRC_SEL TODO.
      &clk_src_div=20.
      &clk_m_val=1.
      &clk_n_val=4.
      &clk_2d_val=4.
      
      gosub Set_Clock_Freq
      return
    )
    else if ("&clk_desired_freq"=="4.096")
    (
      &clk_src_name="LPASS_LPAAUDIO_PLL"
      &clk_src_sel=SRC_SEL TODO.
      &clk_src_div=30.
      &clk_m_val=1.
      &clk_n_val=2.
      &clk_2d_val=2.
      
      gosub Set_Clock_Freq
      return
    )
    else if ("&clk_desired_freq"=="6.144")
    (
      &clk_src_name="LPASS_LPAAUDIO_PLL"
      &clk_src_sel=SRC_SEL TODO.
      &clk_src_div=20.
      &clk_m_val=1.
      &clk_n_val=2.
      &clk_2d_val=2.
      
      gosub Set_Clock_Freq
      return
    )
    else if ("&clk_desired_freq"=="8.192")
    (
      &clk_src_name="LPASS_LPAAUDIO_PLL"
      &clk_src_sel=SRC_SEL TODO.
      &clk_src_div=30.
      &clk_m_val=0.
      &clk_n_val=0.
      &clk_2d_val=0.
      
      gosub Set_Clock_Freq
      return
    )
    else if ("&clk_desired_freq"=="12.288")
    (
      &clk_src_name="LPASS_LPAAUDIO_PLL"
      &clk_src_sel=SRC_SEL TODO.
      &clk_src_div=20.
      &clk_m_val=0.
      &clk_n_val=0.
      &clk_2d_val=0.
      
      gosub Set_Clock_Freq
      return
    )
    else if ("&clk_desired_freq"=="r")
    (
      return
    )
    else
    (
      print "Invalid selection."
      goto Set_Clock_Freq_Enter
    )
  )

  if ("&clk"=="lpaif_ter_clk_src")||("&clk"=="audio_core_lpaif_ter_ibit_clk")||("&clk"=="audio_core_lpaif_ter_osr_clk")
  (
    gosub PRINT_SET_CLOCK_FREQ_WARNING

    &clk_cmd_rcgr_addr=&HWIO_LPASS_LPAIF_TER_CMD_RCGR_ADDR
    &clk_cfg_rcgr_addr=&HWIO_LPASS_LPAIF_TER_CFG_RCGR_ADDR

    print "Choose frequency (MHz) from list below: " 

    print "0.512          0.768          1.024          " 
    print "1.536          2.048          3.072          " 
    print "4.096          6.144          8.192          " 
    print "12.288         " 

    print ""
    print "Enter desired frequency (r to return): "
    enter &clk_desired_freq
    print ""

    if ("&clk_desired_freq"=="0.512")
    (
      &clk_src_name="LPASS_LPAAUDIO_PLL"
      &clk_src_sel=SRC_SEL TODO.
      &clk_src_div=30.
      &clk_m_val=1.
      &clk_n_val=16.
      &clk_2d_val=16.
      
      gosub Set_Clock_Freq
      return
    )
    else if ("&clk_desired_freq"=="0.768")
    (
      &clk_src_name="LPASS_LPAAUDIO_PLL"
      &clk_src_sel=SRC_SEL TODO.
      &clk_src_div=20.
      &clk_m_val=1.
      &clk_n_val=16.
      &clk_2d_val=16.
      
      gosub Set_Clock_Freq
      return
    )
    else if ("&clk_desired_freq"=="1.024")
    (
      &clk_src_name="LPASS_LPAAUDIO_PLL"
      &clk_src_sel=SRC_SEL TODO.
      &clk_src_div=30.
      &clk_m_val=1.
      &clk_n_val=8.
      &clk_2d_val=8.
      
      gosub Set_Clock_Freq
      return
    )
    else if ("&clk_desired_freq"=="1.536")
    (
      &clk_src_name="LPASS_LPAAUDIO_PLL"
      &clk_src_sel=SRC_SEL TODO.
      &clk_src_div=20.
      &clk_m_val=1.
      &clk_n_val=8.
      &clk_2d_val=8.
      
      gosub Set_Clock_Freq
      return
    )
    else if ("&clk_desired_freq"=="2.048")
    (
      &clk_src_name="LPASS_LPAAUDIO_PLL"
      &clk_src_sel=SRC_SEL TODO.
      &clk_src_div=30.
      &clk_m_val=1.
      &clk_n_val=4.
      &clk_2d_val=4.
      
      gosub Set_Clock_Freq
      return
    )
    else if ("&clk_desired_freq"=="3.072")
    (
      &clk_src_name="LPASS_LPAAUDIO_PLL"
      &clk_src_sel=SRC_SEL TODO.
      &clk_src_div=20.
      &clk_m_val=1.
      &clk_n_val=4.
      &clk_2d_val=4.
      
      gosub Set_Clock_Freq
      return
    )
    else if ("&clk_desired_freq"=="4.096")
    (
      &clk_src_name="LPASS_LPAAUDIO_PLL"
      &clk_src_sel=SRC_SEL TODO.
      &clk_src_div=30.
      &clk_m_val=1.
      &clk_n_val=2.
      &clk_2d_val=2.
      
      gosub Set_Clock_Freq
      return
    )
    else if ("&clk_desired_freq"=="6.144")
    (
      &clk_src_name="LPASS_LPAAUDIO_PLL"
      &clk_src_sel=SRC_SEL TODO.
      &clk_src_div=20.
      &clk_m_val=1.
      &clk_n_val=2.
      &clk_2d_val=2.
      
      gosub Set_Clock_Freq
      return
    )
    else if ("&clk_desired_freq"=="8.192")
    (
      &clk_src_name="LPASS_LPAAUDIO_PLL"
      &clk_src_sel=SRC_SEL TODO.
      &clk_src_div=30.
      &clk_m_val=0.
      &clk_n_val=0.
      &clk_2d_val=0.
      
      gosub Set_Clock_Freq
      return
    )
    else if ("&clk_desired_freq"=="12.288")
    (
      &clk_src_name="LPASS_LPAAUDIO_PLL"
      &clk_src_sel=SRC_SEL TODO.
      &clk_src_div=20.
      &clk_m_val=0.
      &clk_n_val=0.
      &clk_2d_val=0.
      
      gosub Set_Clock_Freq
      return
    )
    else if ("&clk_desired_freq"=="r")
    (
      return
    )
    else
    (
      print "Invalid selection."
      goto Set_Clock_Freq_Enter
    )
  )

  if ("&clk"=="pri_mclk_clk_src")||("&clk"=="audio_wrapper_pri_mclk_clk")
  (
    gosub PRINT_SET_CLOCK_FREQ_WARNING

    &clk_cmd_rcgr_addr=&HWIO_LPASS_PRI_MCLK_CMD_RCGR_ADDR
    &clk_cfg_rcgr_addr=&HWIO_LPASS_PRI_MCLK_CFG_RCGR_ADDR

    print "Choose frequency (MHz) from list below: " 

    print "0.512          0.768          1.024          " 
    print "1.536          2.048          3.072          " 
    print "4.096          6.144          8.192          " 
    print "12.288         " 

    print ""
    print "Enter desired frequency (r to return): "
    enter &clk_desired_freq
    print ""

    if ("&clk_desired_freq"=="0.512")
    (
      &clk_src_name="LPASS_LPAAUDIO_PLL"
      &clk_src_sel=SRC_SEL TODO.
      &clk_src_div=30.
      &clk_m_val=1.
      &clk_n_val=16.
      &clk_2d_val=16.
      
      gosub Set_Clock_Freq
      return
    )
    else if ("&clk_desired_freq"=="0.768")
    (
      &clk_src_name="LPASS_LPAAUDIO_PLL"
      &clk_src_sel=SRC_SEL TODO.
      &clk_src_div=20.
      &clk_m_val=1.
      &clk_n_val=16.
      &clk_2d_val=16.
      
      gosub Set_Clock_Freq
      return
    )
    else if ("&clk_desired_freq"=="1.024")
    (
      &clk_src_name="LPASS_LPAAUDIO_PLL"
      &clk_src_sel=SRC_SEL TODO.
      &clk_src_div=30.
      &clk_m_val=1.
      &clk_n_val=8.
      &clk_2d_val=8.
      
      gosub Set_Clock_Freq
      return
    )
    else if ("&clk_desired_freq"=="1.536")
    (
      &clk_src_name="LPASS_LPAAUDIO_PLL"
      &clk_src_sel=SRC_SEL TODO.
      &clk_src_div=20.
      &clk_m_val=1.
      &clk_n_val=8.
      &clk_2d_val=8.
      
      gosub Set_Clock_Freq
      return
    )
    else if ("&clk_desired_freq"=="2.048")
    (
      &clk_src_name="LPASS_LPAAUDIO_PLL"
      &clk_src_sel=SRC_SEL TODO.
      &clk_src_div=30.
      &clk_m_val=1.
      &clk_n_val=4.
      &clk_2d_val=4.
      
      gosub Set_Clock_Freq
      return
    )
    else if ("&clk_desired_freq"=="3.072")
    (
      &clk_src_name="LPASS_LPAAUDIO_PLL"
      &clk_src_sel=SRC_SEL TODO.
      &clk_src_div=20.
      &clk_m_val=1.
      &clk_n_val=4.
      &clk_2d_val=4.
      
      gosub Set_Clock_Freq
      return
    )
    else if ("&clk_desired_freq"=="4.096")
    (
      &clk_src_name="LPASS_LPAAUDIO_PLL"
      &clk_src_sel=SRC_SEL TODO.
      &clk_src_div=30.
      &clk_m_val=1.
      &clk_n_val=2.
      &clk_2d_val=2.
      
      gosub Set_Clock_Freq
      return
    )
    else if ("&clk_desired_freq"=="6.144")
    (
      &clk_src_name="LPASS_LPAAUDIO_PLL"
      &clk_src_sel=SRC_SEL TODO.
      &clk_src_div=20.
      &clk_m_val=1.
      &clk_n_val=2.
      &clk_2d_val=2.
      
      gosub Set_Clock_Freq
      return
    )
    else if ("&clk_desired_freq"=="8.192")
    (
      &clk_src_name="LPASS_LPAAUDIO_PLL"
      &clk_src_sel=SRC_SEL TODO.
      &clk_src_div=30.
      &clk_m_val=0.
      &clk_n_val=0.
      &clk_2d_val=0.
      
      gosub Set_Clock_Freq
      return
    )
    else if ("&clk_desired_freq"=="12.288")
    (
      &clk_src_name="LPASS_LPAAUDIO_PLL"
      &clk_src_sel=SRC_SEL TODO.
      &clk_src_div=20.
      &clk_m_val=0.
      &clk_n_val=0.
      &clk_2d_val=0.
      
      gosub Set_Clock_Freq
      return
    )
    else if ("&clk_desired_freq"=="r")
    (
      return
    )
    else
    (
      print "Invalid selection."
      goto Set_Clock_Freq_Enter
    )
  )

  if 
  (
    gosub PRINT_SET_CLOCK_FREQ_WARNING

    &clk_cmd_rcgr_addr=&HWIO_LPASS_Q6CORE_CMD_RCGR_ADDR
    &clk_cfg_rcgr_addr=&HWIO_LPASS_Q6CORE_CFG_RCGR_ADDR

    print "Choose frequency (MHz) from list below: " 

    print "19.2           403.2          595.2          " 
    print "748.8          " 

    print ""
    print "Enter desired frequency (r to return): "
    enter &clk_desired_freq
    print ""

    if ("&clk_desired_freq"=="19.2")
    (
      &clk_src_name="XO"
      &clk_src_sel=SRC_SEL TODO.
      &clk_src_div=2.
      &clk_m_val=0.
      &clk_n_val=0.
      &clk_2d_val=0.
      
      gosub Set_Clock_Freq
      return
    )
    else if ("&clk_desired_freq"=="403.2")
    (
      &clk_src_name="LPASS_QDSP6SS_PLL"
      &clk_src_sel=SRC_SEL TODO.
      &clk_src_div=2.
      &clk_m_val=0.
      &clk_n_val=0.
      &clk_2d_val=0.
      
      gosub Set_Clock_Freq
      return
    )
    else if ("&clk_desired_freq"=="595.2")
    (
      &clk_src_name="LPASS_QDSP6SS_PLL"
      &clk_src_sel=SRC_SEL TODO.
      &clk_src_div=2.
      &clk_m_val=0.
      &clk_n_val=0.
      &clk_2d_val=0.
      
      gosub Set_Clock_Freq
      return
    )
    else if ("&clk_desired_freq"=="748.8")
    (
      &clk_src_name="LPASS_QDSP6SS_PLL"
      &clk_src_sel=SRC_SEL TODO.
      &clk_src_div=2.
      &clk_m_val=0.
      &clk_n_val=0.
      &clk_2d_val=0.
      
      gosub Set_Clock_Freq
      return
    )
    else if ("&clk_desired_freq"=="r")
    (
      return
    )
    else
    (
      print "Invalid selection."
      goto Set_Clock_Freq_Enter
    )
  )

  if ("&clk"=="q6_spdm_clk_src")||("&clk"=="q6_spdm_clk")
  (
    gosub PRINT_SET_CLOCK_FREQ_WARNING

    &clk_cmd_rcgr_addr=&HWIO_LPASS_Q6_SPDM_CMD_RCGR_ADDR
    &clk_cfg_rcgr_addr=&HWIO_LPASS_Q6_SPDM_CFG_RCGR_ADDR

    print "Choose frequency (MHz) from list below: " 

    print "19.2           134.4          187.2          " 
    print "198.4          " 

    print ""
    print "Enter desired frequency (r to return): "
    enter &clk_desired_freq
    print ""

    if ("&clk_desired_freq"=="19.2")
    (
      &clk_src_name="XO"
      &clk_src_sel=SRC_SEL TODO.
      &clk_src_div=2.
      &clk_m_val=0.
      &clk_n_val=0.
      &clk_2d_val=0.
      
      gosub Set_Clock_Freq
      return
    )
    else if ("&clk_desired_freq"=="134.4")
    (
      &clk_src_name="LPASS_QDSP6SS_PLL"
      &clk_src_sel=SRC_SEL TODO.
      &clk_src_div=6.
      &clk_m_val=0.
      &clk_n_val=0.
      &clk_2d_val=0.
      
      gosub Set_Clock_Freq
      return
    )
    else if ("&clk_desired_freq"=="187.2")
    (
      &clk_src_name="LPASS_QDSP6SS_PLL"
      &clk_src_sel=SRC_SEL TODO.
      &clk_src_div=8.
      &clk_m_val=0.
      &clk_n_val=0.
      &clk_2d_val=0.
      
      gosub Set_Clock_Freq
      return
    )
    else if ("&clk_desired_freq"=="198.4")
    (
      &clk_src_name="LPASS_QDSP6SS_PLL"
      &clk_src_sel=SRC_SEL TODO.
      &clk_src_div=6.
      &clk_m_val=0.
      &clk_n_val=0.
      &clk_2d_val=0.
      
      gosub Set_Clock_Freq
      return
    )
    else if ("&clk_desired_freq"=="r")
    (
      return
    )
    else
    (
      print "Invalid selection."
      goto Set_Clock_Freq_Enter
    )
  )

  if ("&clk"=="quad_mclk_clk_src")||("&clk"=="audio_wrapper_quad_mclk_clk")
  (
    gosub PRINT_SET_CLOCK_FREQ_WARNING

    &clk_cmd_rcgr_addr=&HWIO_LPASS_QUAD_MCLK_CMD_RCGR_ADDR
    &clk_cfg_rcgr_addr=&HWIO_LPASS_QUAD_MCLK_CFG_RCGR_ADDR

    print "Choose frequency (MHz) from list below: " 

    print "0.512          0.768          1.024          " 
    print "1.536          2.048          3.072          " 
    print "4.096          6.144          8.192          " 
    print "12.288         " 

    print ""
    print "Enter desired frequency (r to return): "
    enter &clk_desired_freq
    print ""

    if ("&clk_desired_freq"=="0.512")
    (
      &clk_src_name="LPASS_LPAAUDIO_PLL"
      &clk_src_sel=SRC_SEL TODO.
      &clk_src_div=30.
      &clk_m_val=1.
      &clk_n_val=16.
      &clk_2d_val=16.
      
      gosub Set_Clock_Freq
      return
    )
    else if ("&clk_desired_freq"=="0.768")
    (
      &clk_src_name="LPASS_LPAAUDIO_PLL"
      &clk_src_sel=SRC_SEL TODO.
      &clk_src_div=20.
      &clk_m_val=1.
      &clk_n_val=16.
      &clk_2d_val=16.
      
      gosub Set_Clock_Freq
      return
    )
    else if ("&clk_desired_freq"=="1.024")
    (
      &clk_src_name="LPASS_LPAAUDIO_PLL"
      &clk_src_sel=SRC_SEL TODO.
      &clk_src_div=30.
      &clk_m_val=1.
      &clk_n_val=8.
      &clk_2d_val=8.
      
      gosub Set_Clock_Freq
      return
    )
    else if ("&clk_desired_freq"=="1.536")
    (
      &clk_src_name="LPASS_LPAAUDIO_PLL"
      &clk_src_sel=SRC_SEL TODO.
      &clk_src_div=20.
      &clk_m_val=1.
      &clk_n_val=8.
      &clk_2d_val=8.
      
      gosub Set_Clock_Freq
      return
    )
    else if ("&clk_desired_freq"=="2.048")
    (
      &clk_src_name="LPASS_LPAAUDIO_PLL"
      &clk_src_sel=SRC_SEL TODO.
      &clk_src_div=30.
      &clk_m_val=1.
      &clk_n_val=4.
      &clk_2d_val=4.
      
      gosub Set_Clock_Freq
      return
    )
    else if ("&clk_desired_freq"=="3.072")
    (
      &clk_src_name="LPASS_LPAAUDIO_PLL"
      &clk_src_sel=SRC_SEL TODO.
      &clk_src_div=20.
      &clk_m_val=1.
      &clk_n_val=4.
      &clk_2d_val=4.
      
      gosub Set_Clock_Freq
      return
    )
    else if ("&clk_desired_freq"=="4.096")
    (
      &clk_src_name="LPASS_LPAAUDIO_PLL"
      &clk_src_sel=SRC_SEL TODO.
      &clk_src_div=30.
      &clk_m_val=1.
      &clk_n_val=2.
      &clk_2d_val=2.
      
      gosub Set_Clock_Freq
      return
    )
    else if ("&clk_desired_freq"=="6.144")
    (
      &clk_src_name="LPASS_LPAAUDIO_PLL"
      &clk_src_sel=SRC_SEL TODO.
      &clk_src_div=20.
      &clk_m_val=1.
      &clk_n_val=2.
      &clk_2d_val=2.
      
      gosub Set_Clock_Freq
      return
    )
    else if ("&clk_desired_freq"=="8.192")
    (
      &clk_src_name="LPASS_LPAAUDIO_PLL"
      &clk_src_sel=SRC_SEL TODO.
      &clk_src_div=30.
      &clk_m_val=0.
      &clk_n_val=0.
      &clk_2d_val=0.
      
      gosub Set_Clock_Freq
      return
    )
    else if ("&clk_desired_freq"=="12.288")
    (
      &clk_src_name="LPASS_LPAAUDIO_PLL"
      &clk_src_sel=SRC_SEL TODO.
      &clk_src_div=20.
      &clk_m_val=0.
      &clk_n_val=0.
      &clk_2d_val=0.
      
      gosub Set_Clock_Freq
      return
    )
    else if ("&clk_desired_freq"=="r")
    (
      return
    )
    else
    (
      print "Invalid selection."
      goto Set_Clock_Freq_Enter
    )
  )

  if ("&clk"=="resampler_clk_src")||("&clk"=="audio_core_resampler_core_clk")
  (
    gosub PRINT_SET_CLOCK_FREQ_WARNING

    &clk_cmd_rcgr_addr=&HWIO_LPASS_RESAMPLER_CMD_RCGR_ADDR
    &clk_cfg_rcgr_addr=&HWIO_LPASS_RESAMPLER_CFG_RCGR_ADDR

    print "Choose frequency (MHz) from list below: " 

    print "19.2           68.27          136.53         " 

    print ""
    print "Enter desired frequency (r to return): "
    enter &clk_desired_freq
    print ""

    if ("&clk_desired_freq"=="19.2")
    (
      &clk_src_name="XO"
      &clk_src_sel=SRC_SEL TODO.
      &clk_src_div=2.
      &clk_m_val=0.
      &clk_n_val=0.
      &clk_2d_val=0.
      
      gosub Set_Clock_Freq
      return
    )
    else if ("&clk_desired_freq"=="68.27")
    (
      &clk_src_name="LPASS_LPAAUDIO_PLL"
      &clk_src_sel=SRC_SEL TODO.
      &clk_src_div=6.
      &clk_m_val=0.
      &clk_n_val=0.
      &clk_2d_val=0.
      
      gosub Set_Clock_Freq
      return
    )
    else if ("&clk_desired_freq"=="136.53")
    (
      &clk_src_name="LPASS_LPAAUDIO_PLL"
      &clk_src_sel=SRC_SEL TODO.
      &clk_src_div=3.
      &clk_m_val=0.
      &clk_n_val=0.
      &clk_2d_val=0.
      
      gosub Set_Clock_Freq
      return
    )
    else if ("&clk_desired_freq"=="r")
    (
      return
    )
    else
    (
      print "Invalid selection."
      goto Set_Clock_Freq_Enter
    )
  )

  if ("&clk"=="sec_mclk_clk_src")||("&clk"=="audio_wrapper_sec_mclk_clk")
  (
    gosub PRINT_SET_CLOCK_FREQ_WARNING

    &clk_cmd_rcgr_addr=&HWIO_LPASS_SEC_MCLK_CMD_RCGR_ADDR
    &clk_cfg_rcgr_addr=&HWIO_LPASS_SEC_MCLK_CFG_RCGR_ADDR

    print "Choose frequency (MHz) from list below: " 

    print "0.512          0.768          1.024          " 
    print "1.536          2.048          3.072          " 
    print "4.096          6.144          8.192          " 
    print "12.288         " 

    print ""
    print "Enter desired frequency (r to return): "
    enter &clk_desired_freq
    print ""

    if ("&clk_desired_freq"=="0.512")
    (
      &clk_src_name="LPASS_LPAAUDIO_PLL"
      &clk_src_sel=SRC_SEL TODO.
      &clk_src_div=30.
      &clk_m_val=1.
      &clk_n_val=16.
      &clk_2d_val=16.
      
      gosub Set_Clock_Freq
      return
    )
    else if ("&clk_desired_freq"=="0.768")
    (
      &clk_src_name="LPASS_LPAAUDIO_PLL"
      &clk_src_sel=SRC_SEL TODO.
      &clk_src_div=20.
      &clk_m_val=1.
      &clk_n_val=16.
      &clk_2d_val=16.
      
      gosub Set_Clock_Freq
      return
    )
    else if ("&clk_desired_freq"=="1.024")
    (
      &clk_src_name="LPASS_LPAAUDIO_PLL"
      &clk_src_sel=SRC_SEL TODO.
      &clk_src_div=30.
      &clk_m_val=1.
      &clk_n_val=8.
      &clk_2d_val=8.
      
      gosub Set_Clock_Freq
      return
    )
    else if ("&clk_desired_freq"=="1.536")
    (
      &clk_src_name="LPASS_LPAAUDIO_PLL"
      &clk_src_sel=SRC_SEL TODO.
      &clk_src_div=20.
      &clk_m_val=1.
      &clk_n_val=8.
      &clk_2d_val=8.
      
      gosub Set_Clock_Freq
      return
    )
    else if ("&clk_desired_freq"=="2.048")
    (
      &clk_src_name="LPASS_LPAAUDIO_PLL"
      &clk_src_sel=SRC_SEL TODO.
      &clk_src_div=30.
      &clk_m_val=1.
      &clk_n_val=4.
      &clk_2d_val=4.
      
      gosub Set_Clock_Freq
      return
    )
    else if ("&clk_desired_freq"=="3.072")
    (
      &clk_src_name="LPASS_LPAAUDIO_PLL"
      &clk_src_sel=SRC_SEL TODO.
      &clk_src_div=20.
      &clk_m_val=1.
      &clk_n_val=4.
      &clk_2d_val=4.
      
      gosub Set_Clock_Freq
      return
    )
    else if ("&clk_desired_freq"=="4.096")
    (
      &clk_src_name="LPASS_LPAAUDIO_PLL"
      &clk_src_sel=SRC_SEL TODO.
      &clk_src_div=30.
      &clk_m_val=1.
      &clk_n_val=2.
      &clk_2d_val=2.
      
      gosub Set_Clock_Freq
      return
    )
    else if ("&clk_desired_freq"=="6.144")
    (
      &clk_src_name="LPASS_LPAAUDIO_PLL"
      &clk_src_sel=SRC_SEL TODO.
      &clk_src_div=20.
      &clk_m_val=1.
      &clk_n_val=2.
      &clk_2d_val=2.
      
      gosub Set_Clock_Freq
      return
    )
    else if ("&clk_desired_freq"=="8.192")
    (
      &clk_src_name="LPASS_LPAAUDIO_PLL"
      &clk_src_sel=SRC_SEL TODO.
      &clk_src_div=30.
      &clk_m_val=0.
      &clk_n_val=0.
      &clk_2d_val=0.
      
      gosub Set_Clock_Freq
      return
    )
    else if ("&clk_desired_freq"=="12.288")
    (
      &clk_src_name="LPASS_LPAAUDIO_PLL"
      &clk_src_sel=SRC_SEL TODO.
      &clk_src_div=20.
      &clk_m_val=0.
      &clk_n_val=0.
      &clk_2d_val=0.
      
      gosub Set_Clock_Freq
      return
    )
    else if ("&clk_desired_freq"=="r")
    (
      return
    )
    else
    (
      print "Invalid selection."
      goto Set_Clock_Freq_Enter
    )
  )

  if ("&clk"=="ter_mclk_clk_src")||("&clk"=="audio_wrapper_ter_mclk_clk")
  (
    gosub PRINT_SET_CLOCK_FREQ_WARNING

    &clk_cmd_rcgr_addr=&HWIO_LPASS_TER_MCLK_CMD_RCGR_ADDR
    &clk_cfg_rcgr_addr=&HWIO_LPASS_TER_MCLK_CFG_RCGR_ADDR

    print "Choose frequency (MHz) from list below: " 

    print "0.512          0.768          1.024          " 
    print "1.536          2.048          3.072          " 
    print "4.096          6.144          8.192          " 
    print "12.288         " 

    print ""
    print "Enter desired frequency (r to return): "
    enter &clk_desired_freq
    print ""

    if ("&clk_desired_freq"=="0.512")
    (
      &clk_src_name="LPASS_LPAAUDIO_PLL"
      &clk_src_sel=SRC_SEL TODO.
      &clk_src_div=30.
      &clk_m_val=1.
      &clk_n_val=16.
      &clk_2d_val=16.
      
      gosub Set_Clock_Freq
      return
    )
    else if ("&clk_desired_freq"=="0.768")
    (
      &clk_src_name="LPASS_LPAAUDIO_PLL"
      &clk_src_sel=SRC_SEL TODO.
      &clk_src_div=20.
      &clk_m_val=1.
      &clk_n_val=16.
      &clk_2d_val=16.
      
      gosub Set_Clock_Freq
      return
    )
    else if ("&clk_desired_freq"=="1.024")
    (
      &clk_src_name="LPASS_LPAAUDIO_PLL"
      &clk_src_sel=SRC_SEL TODO.
      &clk_src_div=30.
      &clk_m_val=1.
      &clk_n_val=8.
      &clk_2d_val=8.
      
      gosub Set_Clock_Freq
      return
    )
    else if ("&clk_desired_freq"=="1.536")
    (
      &clk_src_name="LPASS_LPAAUDIO_PLL"
      &clk_src_sel=SRC_SEL TODO.
      &clk_src_div=20.
      &clk_m_val=1.
      &clk_n_val=8.
      &clk_2d_val=8.
      
      gosub Set_Clock_Freq
      return
    )
    else if ("&clk_desired_freq"=="2.048")
    (
      &clk_src_name="LPASS_LPAAUDIO_PLL"
      &clk_src_sel=SRC_SEL TODO.
      &clk_src_div=30.
      &clk_m_val=1.
      &clk_n_val=4.
      &clk_2d_val=4.
      
      gosub Set_Clock_Freq
      return
    )
    else if ("&clk_desired_freq"=="3.072")
    (
      &clk_src_name="LPASS_LPAAUDIO_PLL"
      &clk_src_sel=SRC_SEL TODO.
      &clk_src_div=20.
      &clk_m_val=1.
      &clk_n_val=4.
      &clk_2d_val=4.
      
      gosub Set_Clock_Freq
      return
    )
    else if ("&clk_desired_freq"=="4.096")
    (
      &clk_src_name="LPASS_LPAAUDIO_PLL"
      &clk_src_sel=SRC_SEL TODO.
      &clk_src_div=30.
      &clk_m_val=1.
      &clk_n_val=2.
      &clk_2d_val=2.
      
      gosub Set_Clock_Freq
      return
    )
    else if ("&clk_desired_freq"=="6.144")
    (
      &clk_src_name="LPASS_LPAAUDIO_PLL"
      &clk_src_sel=SRC_SEL TODO.
      &clk_src_div=20.
      &clk_m_val=1.
      &clk_n_val=2.
      &clk_2d_val=2.
      
      gosub Set_Clock_Freq
      return
    )
    else if ("&clk_desired_freq"=="8.192")
    (
      &clk_src_name="LPASS_LPAAUDIO_PLL"
      &clk_src_sel=SRC_SEL TODO.
      &clk_src_div=30.
      &clk_m_val=0.
      &clk_n_val=0.
      &clk_2d_val=0.
      
      gosub Set_Clock_Freq
      return
    )
    else if ("&clk_desired_freq"=="12.288")
    (
      &clk_src_name="LPASS_LPAAUDIO_PLL"
      &clk_src_sel=SRC_SEL TODO.
      &clk_src_div=20.
      &clk_m_val=0.
      &clk_n_val=0.
      &clk_2d_val=0.
      
      gosub Set_Clock_Freq
      return
    )
    else if ("&clk_desired_freq"=="r")
    (
      return
    )
    else
    (
      print "Invalid selection."
      goto Set_Clock_Freq_Enter
    )
  )


  return

