y.create.l HWIO_APCS_QTMR_AC_CNTFRQ_ADDR A:0xf9020000
y.create.l HWIO_APCS_QTMR_AC_CNTSR_ADDR A:0xf9020004
y.create.l HWIO_APCS_QTMR_AC_CNTTID_ADDR A:0xf9020008
y.create.l HWIO_APCS_QTMR_AC_CNTACR_0_ADDR A:0xf9020040
y.create.l HWIO_APCS_QTMR_AC_CNTACR_1_ADDR A:0xf9020044
y.create.l HWIO_APCS_QTMR_AC_CNTACR_2_ADDR A:0xf9020048
y.create.l HWIO_APCS_QTMR_AC_CNTACR_3_ADDR A:0xf902004c
y.create.l HWIO_APCS_QTMR_AC_CNTACR_4_ADDR A:0xf9020050
y.create.l HWIO_APCS_QTMR_AC_CNTACR_5_ADDR A:0xf9020054
y.create.l HWIO_APCS_QTMR_AC_CNTACR_6_ADDR A:0xf9020058
y.create.l HWIO_APCS_QTMR_AC_CNTVOFF_LO_0_ADDR A:0xf9020080
y.create.l HWIO_APCS_QTMR_AC_CNTVOFF_LO_1_ADDR A:0xf9020088
y.create.l HWIO_APCS_QTMR_AC_CNTVOFF_LO_2_ADDR A:0xf9020090
y.create.l HWIO_APCS_QTMR_AC_CNTVOFF_LO_3_ADDR A:0xf9020098
y.create.l HWIO_APCS_QTMR_AC_CNTVOFF_LO_4_ADDR A:0xf90200a0
y.create.l HWIO_APCS_QTMR_AC_CNTVOFF_LO_5_ADDR A:0xf90200a8
y.create.l HWIO_APCS_QTMR_AC_CNTVOFF_LO_6_ADDR A:0xf90200b0
y.create.l HWIO_APCS_QTMR_AC_CNTVOFF_HI_0_ADDR A:0xf9020084
y.create.l HWIO_APCS_QTMR_AC_CNTVOFF_HI_1_ADDR A:0xf902008c
y.create.l HWIO_APCS_QTMR_AC_CNTVOFF_HI_2_ADDR A:0xf9020094
y.create.l HWIO_APCS_QTMR_AC_CNTVOFF_HI_3_ADDR A:0xf902009c
y.create.l HWIO_APCS_QTMR_AC_CNTVOFF_HI_4_ADDR A:0xf90200a4
y.create.l HWIO_APCS_QTMR_AC_CNTVOFF_HI_5_ADDR A:0xf90200ac
y.create.l HWIO_APCS_QTMR_AC_CNTVOFF_HI_6_ADDR A:0xf90200b4
y.create.l HWIO_APCS_QTMR_AC_CFG_ADDR A:0xf9020fc0
y.create.l HWIO_APCS_QTMR_AC_VERSION_ADDR A:0xf9020fd0
y.create.l HWIO_APCS_F0_QTMR_V1_CNTPCT_LO_ADDR A:0xf9021000
y.create.l HWIO_APCS_F0_QTMR_V1_CNTPCT_HI_ADDR A:0xf9021004
y.create.l HWIO_APCS_F0_QTMR_V1_CNTVCT_LO_ADDR A:0xf9021008
y.create.l HWIO_APCS_F0_QTMR_V1_CNTVCT_HI_ADDR A:0xf902100c
y.create.l HWIO_APCS_F0_QTMR_V1_CNTFRQ_ADDR A:0xf9021010
y.create.l HWIO_APCS_F0_QTMR_V1_CNTPL0ACR_ADDR A:0xf9021014
y.create.l HWIO_APCS_F0_QTMR_V1_CNTVOFF_LO_ADDR A:0xf9021018
y.create.l HWIO_APCS_F0_QTMR_V1_CNTVOFF_HI_ADDR A:0xf902101c
y.create.l HWIO_APCS_F0_QTMR_V1_CNTP_CVAL_LO_ADDR A:0xf9021020
y.create.l HWIO_APCS_F0_QTMR_V1_CNTP_CVAL_HI_ADDR A:0xf9021024
y.create.l HWIO_APCS_F0_QTMR_V1_CNTP_TVAL_ADDR A:0xf9021028
y.create.l HWIO_APCS_F0_QTMR_V1_CNTP_CTL_ADDR A:0xf902102c
y.create.l HWIO_APCS_F0_QTMR_V1_CNTV_CVAL_LO_ADDR A:0xf9021030
y.create.l HWIO_APCS_F0_QTMR_V1_CNTV_CVAL_HI_ADDR A:0xf9021034
y.create.l HWIO_APCS_F0_QTMR_V1_CNTV_TVAL_ADDR A:0xf9021038
y.create.l HWIO_APCS_F0_QTMR_V1_CNTV_CTL_ADDR A:0xf902103c
y.create.l HWIO_APCS_F0_QTMR_V1_VERSION_ADDR A:0xf9021fd0
y.create.l HWIO_APCS_F0_QTMR_V2_CNTPCT_LO_ADDR A:0xf9022000
y.create.l HWIO_APCS_F0_QTMR_V2_CNTPCT_HI_ADDR A:0xf9022004
y.create.l HWIO_APCS_F0_QTMR_V2_CNTVCT_LO_ADDR A:0xf9022008
y.create.l HWIO_APCS_F0_QTMR_V2_CNTVCT_HI_ADDR A:0xf902200c
y.create.l HWIO_APCS_F0_QTMR_V2_CNTFRQ_ADDR A:0xf9022010
y.create.l HWIO_APCS_F0_QTMR_V2_CNTP_CVAL_LO_ADDR A:0xf9022020
y.create.l HWIO_APCS_F0_QTMR_V2_CNTP_CVAL_HI_ADDR A:0xf9022024
y.create.l HWIO_APCS_F0_QTMR_V2_CNTP_TVAL_ADDR A:0xf9022028
y.create.l HWIO_APCS_F0_QTMR_V2_CNTP_CTL_ADDR A:0xf902202c
y.create.l HWIO_APCS_F0_QTMR_V2_CNTV_CVAL_LO_ADDR A:0xf9022030
y.create.l HWIO_APCS_F0_QTMR_V2_CNTV_CVAL_HI_ADDR A:0xf9022034
y.create.l HWIO_APCS_F0_QTMR_V2_CNTV_TVAL_ADDR A:0xf9022038
y.create.l HWIO_APCS_F0_QTMR_V2_CNTV_CTL_ADDR A:0xf902203c
y.create.l HWIO_APCS_F0_QTMR_V2_VERSION_ADDR A:0xf9022fd0
y.create.l HWIO_APCS_F1_QTMR_V1_CNTPCT_LO_ADDR A:0xf9023000
y.create.l HWIO_APCS_F1_QTMR_V1_CNTPCT_HI_ADDR A:0xf9023004
y.create.l HWIO_APCS_F1_QTMR_V1_CNTVCT_LO_ADDR A:0xf9023008
y.create.l HWIO_APCS_F1_QTMR_V1_CNTVCT_HI_ADDR A:0xf902300c
y.create.l HWIO_APCS_F1_QTMR_V1_CNTFRQ_ADDR A:0xf9023010
y.create.l HWIO_APCS_F1_QTMR_V1_CNTPL0ACR_ADDR A:0xf9023014
y.create.l HWIO_APCS_F1_QTMR_V1_CNTVOFF_LO_ADDR A:0xf9023018
y.create.l HWIO_APCS_F1_QTMR_V1_CNTVOFF_HI_ADDR A:0xf902301c
y.create.l HWIO_APCS_F1_QTMR_V1_CNTP_CVAL_LO_ADDR A:0xf9023020
y.create.l HWIO_APCS_F1_QTMR_V1_CNTP_CVAL_HI_ADDR A:0xf9023024
y.create.l HWIO_APCS_F1_QTMR_V1_CNTP_TVAL_ADDR A:0xf9023028
y.create.l HWIO_APCS_F1_QTMR_V1_CNTP_CTL_ADDR A:0xf902302c
y.create.l HWIO_APCS_F1_QTMR_V1_CNTV_CVAL_LO_ADDR A:0xf9023030
y.create.l HWIO_APCS_F1_QTMR_V1_CNTV_CVAL_HI_ADDR A:0xf9023034
y.create.l HWIO_APCS_F1_QTMR_V1_CNTV_TVAL_ADDR A:0xf9023038
y.create.l HWIO_APCS_F1_QTMR_V1_CNTV_CTL_ADDR A:0xf902303c
y.create.l HWIO_APCS_F1_QTMR_V1_VERSION_ADDR A:0xf9023fd0
y.create.l HWIO_APCS_F2_QTMR_V1_CNTPCT_LO_ADDR A:0xf9024000
y.create.l HWIO_APCS_F2_QTMR_V1_CNTPCT_HI_ADDR A:0xf9024004
y.create.l HWIO_APCS_F2_QTMR_V1_CNTVCT_LO_ADDR A:0xf9024008
y.create.l HWIO_APCS_F2_QTMR_V1_CNTVCT_HI_ADDR A:0xf902400c
y.create.l HWIO_APCS_F2_QTMR_V1_CNTFRQ_ADDR A:0xf9024010
y.create.l HWIO_APCS_F2_QTMR_V1_CNTPL0ACR_ADDR A:0xf9024014
y.create.l HWIO_APCS_F2_QTMR_V1_CNTVOFF_LO_ADDR A:0xf9024018
y.create.l HWIO_APCS_F2_QTMR_V1_CNTVOFF_HI_ADDR A:0xf902401c
y.create.l HWIO_APCS_F2_QTMR_V1_CNTP_CVAL_LO_ADDR A:0xf9024020
y.create.l HWIO_APCS_F2_QTMR_V1_CNTP_CVAL_HI_ADDR A:0xf9024024
y.create.l HWIO_APCS_F2_QTMR_V1_CNTP_TVAL_ADDR A:0xf9024028
y.create.l HWIO_APCS_F2_QTMR_V1_CNTP_CTL_ADDR A:0xf902402c
y.create.l HWIO_APCS_F2_QTMR_V1_CNTV_CVAL_LO_ADDR A:0xf9024030
y.create.l HWIO_APCS_F2_QTMR_V1_CNTV_CVAL_HI_ADDR A:0xf9024034
y.create.l HWIO_APCS_F2_QTMR_V1_CNTV_TVAL_ADDR A:0xf9024038
y.create.l HWIO_APCS_F2_QTMR_V1_CNTV_CTL_ADDR A:0xf902403c
y.create.l HWIO_APCS_F2_QTMR_V1_VERSION_ADDR A:0xf9024fd0
y.create.l HWIO_APCS_F3_QTMR_V1_CNTPCT_LO_ADDR A:0xf9025000
y.create.l HWIO_APCS_F3_QTMR_V1_CNTPCT_HI_ADDR A:0xf9025004
y.create.l HWIO_APCS_F3_QTMR_V1_CNTVCT_LO_ADDR A:0xf9025008
y.create.l HWIO_APCS_F3_QTMR_V1_CNTVCT_HI_ADDR A:0xf902500c
y.create.l HWIO_APCS_F3_QTMR_V1_CNTFRQ_ADDR A:0xf9025010
y.create.l HWIO_APCS_F3_QTMR_V1_CNTPL0ACR_ADDR A:0xf9025014
y.create.l HWIO_APCS_F3_QTMR_V1_CNTVOFF_LO_ADDR A:0xf9025018
y.create.l HWIO_APCS_F3_QTMR_V1_CNTVOFF_HI_ADDR A:0xf902501c
y.create.l HWIO_APCS_F3_QTMR_V1_CNTP_CVAL_LO_ADDR A:0xf9025020
y.create.l HWIO_APCS_F3_QTMR_V1_CNTP_CVAL_HI_ADDR A:0xf9025024
y.create.l HWIO_APCS_F3_QTMR_V1_CNTP_TVAL_ADDR A:0xf9025028
y.create.l HWIO_APCS_F3_QTMR_V1_CNTP_CTL_ADDR A:0xf902502c
y.create.l HWIO_APCS_F3_QTMR_V1_CNTV_CVAL_LO_ADDR A:0xf9025030
y.create.l HWIO_APCS_F3_QTMR_V1_CNTV_CVAL_HI_ADDR A:0xf9025034
y.create.l HWIO_APCS_F3_QTMR_V1_CNTV_TVAL_ADDR A:0xf9025038
y.create.l HWIO_APCS_F3_QTMR_V1_CNTV_CTL_ADDR A:0xf902503c
y.create.l HWIO_APCS_F3_QTMR_V1_VERSION_ADDR A:0xf9025fd0
y.create.l HWIO_APCS_F4_QTMR_V1_CNTPCT_LO_ADDR A:0xf9026000
y.create.l HWIO_APCS_F4_QTMR_V1_CNTPCT_HI_ADDR A:0xf9026004
y.create.l HWIO_APCS_F4_QTMR_V1_CNTVCT_LO_ADDR A:0xf9026008
y.create.l HWIO_APCS_F4_QTMR_V1_CNTVCT_HI_ADDR A:0xf902600c
y.create.l HWIO_APCS_F4_QTMR_V1_CNTFRQ_ADDR A:0xf9026010
y.create.l HWIO_APCS_F4_QTMR_V1_CNTPL0ACR_ADDR A:0xf9026014
y.create.l HWIO_APCS_F4_QTMR_V1_CNTVOFF_LO_ADDR A:0xf9026018
y.create.l HWIO_APCS_F4_QTMR_V1_CNTVOFF_HI_ADDR A:0xf902601c
y.create.l HWIO_APCS_F4_QTMR_V1_CNTP_CVAL_LO_ADDR A:0xf9026020
y.create.l HWIO_APCS_F4_QTMR_V1_CNTP_CVAL_HI_ADDR A:0xf9026024
y.create.l HWIO_APCS_F4_QTMR_V1_CNTP_TVAL_ADDR A:0xf9026028
y.create.l HWIO_APCS_F4_QTMR_V1_CNTP_CTL_ADDR A:0xf902602c
y.create.l HWIO_APCS_F4_QTMR_V1_CNTV_CVAL_LO_ADDR A:0xf9026030
y.create.l HWIO_APCS_F4_QTMR_V1_CNTV_CVAL_HI_ADDR A:0xf9026034
y.create.l HWIO_APCS_F4_QTMR_V1_CNTV_TVAL_ADDR A:0xf9026038
y.create.l HWIO_APCS_F4_QTMR_V1_CNTV_CTL_ADDR A:0xf902603c
y.create.l HWIO_APCS_F4_QTMR_V1_VERSION_ADDR A:0xf9026fd0
y.create.l HWIO_APCS_F5_QTMR_V1_CNTPCT_LO_ADDR A:0xf9027000
y.create.l HWIO_APCS_F5_QTMR_V1_CNTPCT_HI_ADDR A:0xf9027004
y.create.l HWIO_APCS_F5_QTMR_V1_CNTVCT_LO_ADDR A:0xf9027008
y.create.l HWIO_APCS_F5_QTMR_V1_CNTVCT_HI_ADDR A:0xf902700c
y.create.l HWIO_APCS_F5_QTMR_V1_CNTFRQ_ADDR A:0xf9027010
y.create.l HWIO_APCS_F5_QTMR_V1_CNTPL0ACR_ADDR A:0xf9027014
y.create.l HWIO_APCS_F5_QTMR_V1_CNTVOFF_LO_ADDR A:0xf9027018
y.create.l HWIO_APCS_F5_QTMR_V1_CNTVOFF_HI_ADDR A:0xf902701c
y.create.l HWIO_APCS_F5_QTMR_V1_CNTP_CVAL_LO_ADDR A:0xf9027020
y.create.l HWIO_APCS_F5_QTMR_V1_CNTP_CVAL_HI_ADDR A:0xf9027024
y.create.l HWIO_APCS_F5_QTMR_V1_CNTP_TVAL_ADDR A:0xf9027028
y.create.l HWIO_APCS_F5_QTMR_V1_CNTP_CTL_ADDR A:0xf902702c
y.create.l HWIO_APCS_F5_QTMR_V1_CNTV_CVAL_LO_ADDR A:0xf9027030
y.create.l HWIO_APCS_F5_QTMR_V1_CNTV_CVAL_HI_ADDR A:0xf9027034
y.create.l HWIO_APCS_F5_QTMR_V1_CNTV_TVAL_ADDR A:0xf9027038
y.create.l HWIO_APCS_F5_QTMR_V1_CNTV_CTL_ADDR A:0xf902703c
y.create.l HWIO_APCS_F5_QTMR_V1_VERSION_ADDR A:0xf9027fd0
y.create.l HWIO_APCS_F6_QTMR_V1_CNTPCT_LO_ADDR A:0xf9028000
y.create.l HWIO_APCS_F6_QTMR_V1_CNTPCT_HI_ADDR A:0xf9028004
y.create.l HWIO_APCS_F6_QTMR_V1_CNTVCT_LO_ADDR A:0xf9028008
y.create.l HWIO_APCS_F6_QTMR_V1_CNTVCT_HI_ADDR A:0xf902800c
y.create.l HWIO_APCS_F6_QTMR_V1_CNTFRQ_ADDR A:0xf9028010
y.create.l HWIO_APCS_F6_QTMR_V1_CNTPL0ACR_ADDR A:0xf9028014
y.create.l HWIO_APCS_F6_QTMR_V1_CNTVOFF_LO_ADDR A:0xf9028018
y.create.l HWIO_APCS_F6_QTMR_V1_CNTVOFF_HI_ADDR A:0xf902801c
y.create.l HWIO_APCS_F6_QTMR_V1_CNTP_CVAL_LO_ADDR A:0xf9028020
y.create.l HWIO_APCS_F6_QTMR_V1_CNTP_CVAL_HI_ADDR A:0xf9028024
y.create.l HWIO_APCS_F6_QTMR_V1_CNTP_TVAL_ADDR A:0xf9028028
y.create.l HWIO_APCS_F6_QTMR_V1_CNTP_CTL_ADDR A:0xf902802c
y.create.l HWIO_APCS_F6_QTMR_V1_CNTV_CVAL_LO_ADDR A:0xf9028030
y.create.l HWIO_APCS_F6_QTMR_V1_CNTV_CVAL_HI_ADDR A:0xf9028034
y.create.l HWIO_APCS_F6_QTMR_V1_CNTV_TVAL_ADDR A:0xf9028038
y.create.l HWIO_APCS_F6_QTMR_V1_CNTV_CTL_ADDR A:0xf902803c
y.create.l HWIO_APCS_F6_QTMR_V1_VERSION_ADDR A:0xf9028fd0
y.create.l HWIO_APCS_VMM_IPC_INTERRUPT_ADDR A:0xf901a004
y.create.l HWIO_APCS_DEBUG_UI_SECURE_ADDR A:0xf9019000
y.create.l HWIO_APCS_DEBUG_UI_CTL_ADDR A:0xf9019004
y.create.l HWIO_APCS_DEBUG_UI_CTL_MASK_ADDR A:0xf9019008
y.create.l HWIO_APCS_DEBUG_UI_ADDR_0_ADDR A:0xf9019010
y.create.l HWIO_APCS_DEBUG_UI_ADDR_1_ADDR A:0xf9019014
y.create.l HWIO_APCS_DEBUG_UI_ADDR_2_ADDR A:0xf9019018
y.create.l HWIO_APCS_DEBUG_UI_ADDR_3_ADDR A:0xf901901c
y.create.l HWIO_APCS_DEBUG_UI_ADDR_4_ADDR A:0xf9019020
y.create.l HWIO_APCS_DEBUG_UI_ADDR_5_ADDR A:0xf9019024
y.create.l HWIO_APCS_DEBUG_UI_ADDR_6_ADDR A:0xf9019028
y.create.l HWIO_APCS_DEBUG_UI_ADDR_7_ADDR A:0xf901902c
y.create.l HWIO_APCS_DEBUG_UI_DATA_0_ADDR A:0xf9019090
y.create.l HWIO_APCS_DEBUG_UI_DATA_1_ADDR A:0xf9019094
y.create.l HWIO_APCS_DEBUG_UI_DATA_2_ADDR A:0xf9019098
y.create.l HWIO_APCS_DEBUG_UI_DATA_3_ADDR A:0xf901909c
y.create.l HWIO_APCS_DEBUG_UI_DATA_4_ADDR A:0xf90190a0
y.create.l HWIO_APCS_DEBUG_UI_DATA_5_ADDR A:0xf90190a4
y.create.l HWIO_APCS_DEBUG_UI_DATA_6_ADDR A:0xf90190a8
y.create.l HWIO_APCS_DEBUG_UI_DATA_7_ADDR A:0xf90190ac
y.create.l HWIO_APCS_RBCPR_VERSION_ADDR A:0xf9018000
y.create.l HWIO_APCS_RBCPR_SENSOR_MASK0_ADDR A:0xf9018020
y.create.l HWIO_APCS_RBCPR_SENSOR_MASK1_ADDR A:0xf9018024
y.create.l HWIO_APCS_RBCPR_SENSOR_MASK2_ADDR A:0xf9018028
y.create.l HWIO_APCS_RBCPR_SENSOR_MASK3_ADDR A:0xf901802c
y.create.l HWIO_APCS_RBCPR_SENSOR_BYPASS0_ADDR A:0xf9018030
y.create.l HWIO_APCS_RBCPR_SENSOR_BYPASS1_ADDR A:0xf9018034
y.create.l HWIO_APCS_RBCPR_SENSOR_BYPASS2_ADDR A:0xf9018038
y.create.l HWIO_APCS_RBCPR_SENSOR_BYPASS3_ADDR A:0xf901803c
y.create.l HWIO_APCS_RBIF_PMIC_ADDR_ADDR A:0xf9018040
y.create.l HWIO_APCS_RBCPR_TIMER_INTERVAL_ADDR A:0xf9018044
y.create.l HWIO_APCS_RBIF_LIMIT_ADDR A:0xf9018048
y.create.l HWIO_APCS_RBIF_TIMER_ADJUST_ADDR A:0xf901804c
y.create.l HWIO_APCS_RBCPR_GCNT_TARGET0_ADDR A:0xf9018060
y.create.l HWIO_APCS_RBCPR_GCNT_TARGET1_ADDR A:0xf9018064
y.create.l HWIO_APCS_RBCPR_GCNT_TARGET2_ADDR A:0xf9018068
y.create.l HWIO_APCS_RBCPR_GCNT_TARGET3_ADDR A:0xf901806c
y.create.l HWIO_APCS_RBCPR_GCNT_TARGET4_ADDR A:0xf9018070
y.create.l HWIO_APCS_RBCPR_GCNT_TARGET5_ADDR A:0xf9018074
y.create.l HWIO_APCS_RBCPR_GCNT_TARGET6_ADDR A:0xf9018078
y.create.l HWIO_APCS_RBCPR_GCNT_TARGET7_ADDR A:0xf901807c
y.create.l HWIO_APCS_RBCPR_STEP_QUOT_ADDR A:0xf9018080
y.create.l HWIO_APCS_RBCPR_CTL_ADDR A:0xf9018090
y.create.l HWIO_APCS_RBIF_SW_VLEVEL_ADDR A:0xf9018094
y.create.l HWIO_APCS_RBIF_CONT_ACK_CMD_ADDR A:0xf9018098
y.create.l HWIO_APCS_RBIF_CONT_NACK_CMD_ADDR A:0xf901809c
y.create.l HWIO_APCS_RBCPR_RESULT_0_ADDR A:0xf90180a0
y.create.l HWIO_APCS_RBCPR_RESULT_1_ADDR A:0xf90180a4
y.create.l HWIO_APCS_RBIF_IRQ_EN_0_ADDR A:0xf9018100
y.create.l HWIO_APCS_RBIF_IRQ_EN_1_ADDR A:0xf9018104
y.create.l HWIO_APCS_RBIF_IRQ_EN_2_ADDR A:0xf9018108
y.create.l HWIO_APCS_RBIF_IRQ_CLEAR_ADDR A:0xf9018110
y.create.l HWIO_APCS_RBIF_IRQ_STATUS_ADDR A:0xf9018114
y.create.l HWIO_APCS_RBCPR_QUOT_AVG_ADDR A:0xf9018118
y.create.l HWIO_APCS_RBCPR_DEBUG0_ADDR A:0xf901811c
y.create.l HWIO_APCS_RBCPR_DEBUG1_ADDR A:0xf9018120
y.create.l HWIO_APCS_RBCPR_DEBUG2_ADDR A:0xf9018124
y.create.l HWIO_APCS_RBCPR_BIST_MINMAX_ADDR A:0xf9018128
y.create.l HWIO_APCS_RBCPR_BIST_RESULT_ADDR A:0xf901812c
y.create.l HWIO_APCS_RBCPR_BIST_FAIL_MAP0_ADDR A:0xf9018130
y.create.l HWIO_APCS_RBCPR_BIST_FAIL_MAP1_ADDR A:0xf9018134
y.create.l HWIO_APCS_RBCPR_BIST_FAIL_MAP2_ADDR A:0xf9018138
y.create.l HWIO_APCS_RBCPR_BIST_FAIL_MAP3_ADDR A:0xf901813c
y.create.l HWIO_APCS_RBCPR_LOG_0_ADDR A:0xf9018140
y.create.l HWIO_APCS_RBCPR_LOG_1_ADDR A:0xf9018144
y.create.l HWIO_APCS_RBCPR_LOG_2_ADDR A:0xf9018148
y.create.l HWIO_APCS_RBCPR_LOG_3_ADDR A:0xf901814c
y.create.l HWIO_APCS_RBCPR_LOG_4_ADDR A:0xf9018150
y.create.l HWIO_APCS_RBCPR_LOG_5_ADDR A:0xf9018154
y.create.l HWIO_APCS_RBCPR_LOG_6_ADDR A:0xf9018158
y.create.l HWIO_APCS_RBCPR_LOG_7_ADDR A:0xf901815c
y.create.l HWIO_APCS_RBCPR_HTOL_AGE_ADDR A:0xf9018160
y.create.l HWIO_APCS_WDOG_SECURE_ADDR A:0xf9017000
y.create.l HWIO_APCS_WDOG_RESET_ADDR A:0xf9017004
y.create.l HWIO_APCS_WDOG_CTL_ADDR A:0xf9017008
y.create.l HWIO_APCS_WDOG_STATUS_ADDR A:0xf901700c
y.create.l HWIO_APCS_WDOG_BARK_TIME_ADDR A:0xf9017010
y.create.l HWIO_APCS_WDOG_BITE_TIME_ADDR A:0xf9017014
y.create.l HWIO_APCS_WDOG_TEST_LOAD_STATUS_ADDR A:0xf9017018
y.create.l HWIO_APCS_WDOG_TEST_LOAD_ADDR A:0xf901701c
y.create.l HWIO_APCS_WDOG_TEST_ADDR A:0xf9017020
y.create.l HWIO_APCS_SH_PLL_MODE_ADDR A:0xf9016000
y.create.l HWIO_APCS_SH_PLL_L_VAL_ADDR A:0xf9016004
y.create.l HWIO_APCS_SH_PLL_M_VAL_ADDR A:0xf9016008
y.create.l HWIO_APCS_SH_PLL_N_VAL_ADDR A:0xf901600c
y.create.l HWIO_APCS_SH_PLL_USER_CTL_ADDR A:0xf9016010
y.create.l HWIO_APCS_SH_PLL_CONFIG_CTL_ADDR A:0xf9016014
y.create.l HWIO_APCS_SH_PLL_TEST_CTL_ADDR A:0xf9016018
y.create.l HWIO_APCS_SH_PLL_STATUS_ADDR A:0xf901601c
y.create.l HWIO_APCS_SH_PLL_SECURE_ADDR A:0xf9016030
y.create.l HWIO_APCS_L2_SAW2_SECURE_ADDR A:0xf9012000
y.create.l HWIO_APCS_L2_SAW2_ID_ADDR A:0xf9012004
y.create.l HWIO_APCS_L2_SAW2_CFG_ADDR A:0xf9012008
y.create.l HWIO_APCS_L2_SAW2_SPM_STS_ADDR A:0xf901200c
y.create.l HWIO_APCS_L2_SAW2_AVS_STS_ADDR A:0xf9012010
y.create.l HWIO_APCS_L2_SAW2_PMIC_STS_ADDR A:0xf9012014
y.create.l HWIO_APCS_L2_SAW2_RST_ADDR A:0xf9012018
y.create.l HWIO_APCS_L2_SAW2_VCTL_ADDR A:0xf901201c
y.create.l HWIO_APCS_L2_SAW2_AVS_CTL_ADDR A:0xf9012020
y.create.l HWIO_APCS_L2_SAW2_AVS_LIMIT_ADDR A:0xf9012024
y.create.l HWIO_APCS_L2_SAW2_AVS_DLY_ADDR A:0xf9012028
y.create.l HWIO_APCS_L2_SAW2_AVS_HYSTERESIS_ADDR A:0xf901202c
y.create.l HWIO_APCS_L2_SAW2_SPM_CTL_ADDR A:0xf9012030
y.create.l HWIO_APCS_L2_SAW2_SPM_DLY_ADDR A:0xf9012034
y.create.l HWIO_APCS_L2_SAW2_SPM_SLP_SEQ_ENTRY_0_ADDR A:0xf9012080
y.create.l HWIO_APCS_L2_SAW2_SPM_SLP_SEQ_ENTRY_1_ADDR A:0xf9012084
y.create.l HWIO_APCS_L2_SAW2_SPM_SLP_SEQ_ENTRY_2_ADDR A:0xf9012088
y.create.l HWIO_APCS_L2_SAW2_SPM_SLP_SEQ_ENTRY_3_ADDR A:0xf901208c
y.create.l HWIO_APCS_L2_SAW2_SPM_SLP_SEQ_ENTRY_4_ADDR A:0xf9012090
y.create.l HWIO_APCS_L2_SAW2_SPM_SLP_SEQ_ENTRY_5_ADDR A:0xf9012094
y.create.l HWIO_APCS_L2_SAW2_SPM_SLP_SEQ_ENTRY_6_ADDR A:0xf9012098
y.create.l HWIO_APCS_L2_SAW2_SPM_SLP_SEQ_ENTRY_7_ADDR A:0xf901209c
y.create.l HWIO_APCS_L2_SAW2_SPM_SLP_SEQ_ENTRY_8_ADDR A:0xf90120a0
y.create.l HWIO_APCS_L2_SAW2_SPM_SLP_SEQ_ENTRY_9_ADDR A:0xf90120a4
y.create.l HWIO_APCS_L2_SAW2_SPM_PMIC_DATA_0_ADDR A:0xf9012040
y.create.l HWIO_APCS_L2_SAW2_SPM_PMIC_DATA_1_ADDR A:0xf9012044
y.create.l HWIO_APCS_L2_SAW2_SPM_PMIC_DATA_2_ADDR A:0xf9012048
y.create.l HWIO_APCS_L2_SAW2_SPM_PMIC_DATA_3_ADDR A:0xf901204c
y.create.l HWIO_APCS_L2_SAW2_SPM_PMIC_DATA_4_ADDR A:0xf9012050
y.create.l HWIO_APCS_L2_SAW2_SPM_PMIC_DATA_5_ADDR A:0xf9012054
y.create.l HWIO_APCS_L2_SAW2_VERSION_ADDR A:0xf9012fd0
y.create.l HWIO_APCS_BANKED_SAW2_SECURE_ADDR A:0xf9009000
y.create.l HWIO_APCS_BANKED_SAW2_ID_ADDR A:0xf9009004
y.create.l HWIO_APCS_BANKED_SAW2_CFG_ADDR A:0xf9009008
y.create.l HWIO_APCS_BANKED_SAW2_SPM_STS_ADDR A:0xf900900c
y.create.l HWIO_APCS_BANKED_SAW2_AVS_STS_ADDR A:0xf9009010
y.create.l HWIO_APCS_BANKED_SAW2_PMIC_STS_ADDR A:0xf9009014
y.create.l HWIO_APCS_BANKED_SAW2_RST_ADDR A:0xf9009018
y.create.l HWIO_APCS_BANKED_SAW2_SPM_CTL_ADDR A:0xf9009030
y.create.l HWIO_APCS_BANKED_SAW2_SPM_DLY_ADDR A:0xf9009034
y.create.l HWIO_APCS_BANKED_SAW2_SPM_SLP_SEQ_ENTRY_0_ADDR A:0xf9009080
y.create.l HWIO_APCS_BANKED_SAW2_SPM_SLP_SEQ_ENTRY_1_ADDR A:0xf9009084
y.create.l HWIO_APCS_BANKED_SAW2_SPM_SLP_SEQ_ENTRY_2_ADDR A:0xf9009088
y.create.l HWIO_APCS_BANKED_SAW2_SPM_SLP_SEQ_ENTRY_3_ADDR A:0xf900908c
y.create.l HWIO_APCS_BANKED_SAW2_SPM_SLP_SEQ_ENTRY_4_ADDR A:0xf9009090
y.create.l HWIO_APCS_BANKED_SAW2_SPM_SLP_SEQ_ENTRY_5_ADDR A:0xf9009094
y.create.l HWIO_APCS_BANKED_SAW2_SPM_SLP_SEQ_ENTRY_6_ADDR A:0xf9009098
y.create.l HWIO_APCS_BANKED_SAW2_SPM_SLP_SEQ_ENTRY_7_ADDR A:0xf900909c
y.create.l HWIO_APCS_BANKED_SAW2_SPM_SLP_SEQ_ENTRY_8_ADDR A:0xf90090a0
y.create.l HWIO_APCS_BANKED_SAW2_SPM_SLP_SEQ_ENTRY_9_ADDR A:0xf90090a4
y.create.l HWIO_APCS_BANKED_SAW2_VERSION_ADDR A:0xf9009fd0
y.create.l HWIO_APCS_ALIAS0_SAW2_SECURE_ADDR A:0xf9089000
y.create.l HWIO_APCS_ALIAS0_SAW2_ID_ADDR A:0xf9089004
y.create.l HWIO_APCS_ALIAS0_SAW2_CFG_ADDR A:0xf9089008
y.create.l HWIO_APCS_ALIAS0_SAW2_SPM_STS_ADDR A:0xf908900c
y.create.l HWIO_APCS_ALIAS0_SAW2_AVS_STS_ADDR A:0xf9089010
y.create.l HWIO_APCS_ALIAS0_SAW2_PMIC_STS_ADDR A:0xf9089014
y.create.l HWIO_APCS_ALIAS0_SAW2_RST_ADDR A:0xf9089018
y.create.l HWIO_APCS_ALIAS0_SAW2_SPM_CTL_ADDR A:0xf9089030
y.create.l HWIO_APCS_ALIAS0_SAW2_SPM_DLY_ADDR A:0xf9089034
y.create.l HWIO_APCS_ALIAS0_SAW2_SPM_SLP_SEQ_ENTRY_0_ADDR A:0xf9089080
y.create.l HWIO_APCS_ALIAS0_SAW2_SPM_SLP_SEQ_ENTRY_1_ADDR A:0xf9089084
y.create.l HWIO_APCS_ALIAS0_SAW2_SPM_SLP_SEQ_ENTRY_2_ADDR A:0xf9089088
y.create.l HWIO_APCS_ALIAS0_SAW2_SPM_SLP_SEQ_ENTRY_3_ADDR A:0xf908908c
y.create.l HWIO_APCS_ALIAS0_SAW2_SPM_SLP_SEQ_ENTRY_4_ADDR A:0xf9089090
y.create.l HWIO_APCS_ALIAS0_SAW2_SPM_SLP_SEQ_ENTRY_5_ADDR A:0xf9089094
y.create.l HWIO_APCS_ALIAS0_SAW2_SPM_SLP_SEQ_ENTRY_6_ADDR A:0xf9089098
y.create.l HWIO_APCS_ALIAS0_SAW2_SPM_SLP_SEQ_ENTRY_7_ADDR A:0xf908909c
y.create.l HWIO_APCS_ALIAS0_SAW2_SPM_SLP_SEQ_ENTRY_8_ADDR A:0xf90890a0
y.create.l HWIO_APCS_ALIAS0_SAW2_SPM_SLP_SEQ_ENTRY_9_ADDR A:0xf90890a4
y.create.l HWIO_APCS_ALIAS0_SAW2_VERSION_ADDR A:0xf9089fd0
y.create.l HWIO_APCS_ALIAS1_SAW2_SECURE_ADDR A:0xf9099000
y.create.l HWIO_APCS_ALIAS1_SAW2_ID_ADDR A:0xf9099004
y.create.l HWIO_APCS_ALIAS1_SAW2_CFG_ADDR A:0xf9099008
y.create.l HWIO_APCS_ALIAS1_SAW2_SPM_STS_ADDR A:0xf909900c
y.create.l HWIO_APCS_ALIAS1_SAW2_AVS_STS_ADDR A:0xf9099010
y.create.l HWIO_APCS_ALIAS1_SAW2_PMIC_STS_ADDR A:0xf9099014
y.create.l HWIO_APCS_ALIAS1_SAW2_RST_ADDR A:0xf9099018
y.create.l HWIO_APCS_ALIAS1_SAW2_SPM_CTL_ADDR A:0xf9099030
y.create.l HWIO_APCS_ALIAS1_SAW2_SPM_DLY_ADDR A:0xf9099034
y.create.l HWIO_APCS_ALIAS1_SAW2_SPM_SLP_SEQ_ENTRY_0_ADDR A:0xf9099080
y.create.l HWIO_APCS_ALIAS1_SAW2_SPM_SLP_SEQ_ENTRY_1_ADDR A:0xf9099084
y.create.l HWIO_APCS_ALIAS1_SAW2_SPM_SLP_SEQ_ENTRY_2_ADDR A:0xf9099088
y.create.l HWIO_APCS_ALIAS1_SAW2_SPM_SLP_SEQ_ENTRY_3_ADDR A:0xf909908c
y.create.l HWIO_APCS_ALIAS1_SAW2_SPM_SLP_SEQ_ENTRY_4_ADDR A:0xf9099090
y.create.l HWIO_APCS_ALIAS1_SAW2_SPM_SLP_SEQ_ENTRY_5_ADDR A:0xf9099094
y.create.l HWIO_APCS_ALIAS1_SAW2_SPM_SLP_SEQ_ENTRY_6_ADDR A:0xf9099098
y.create.l HWIO_APCS_ALIAS1_SAW2_SPM_SLP_SEQ_ENTRY_7_ADDR A:0xf909909c
y.create.l HWIO_APCS_ALIAS1_SAW2_SPM_SLP_SEQ_ENTRY_8_ADDR A:0xf90990a0
y.create.l HWIO_APCS_ALIAS1_SAW2_SPM_SLP_SEQ_ENTRY_9_ADDR A:0xf90990a4
y.create.l HWIO_APCS_ALIAS1_SAW2_VERSION_ADDR A:0xf9099fd0
y.create.l HWIO_APCS_ALIAS2_SAW2_SECURE_ADDR A:0xf90a9000
y.create.l HWIO_APCS_ALIAS2_SAW2_ID_ADDR A:0xf90a9004
y.create.l HWIO_APCS_ALIAS2_SAW2_CFG_ADDR A:0xf90a9008
y.create.l HWIO_APCS_ALIAS2_SAW2_SPM_STS_ADDR A:0xf90a900c
y.create.l HWIO_APCS_ALIAS2_SAW2_AVS_STS_ADDR A:0xf90a9010
y.create.l HWIO_APCS_ALIAS2_SAW2_PMIC_STS_ADDR A:0xf90a9014
y.create.l HWIO_APCS_ALIAS2_SAW2_RST_ADDR A:0xf90a9018
y.create.l HWIO_APCS_ALIAS2_SAW2_SPM_CTL_ADDR A:0xf90a9030
y.create.l HWIO_APCS_ALIAS2_SAW2_SPM_DLY_ADDR A:0xf90a9034
y.create.l HWIO_APCS_ALIAS2_SAW2_SPM_SLP_SEQ_ENTRY_0_ADDR A:0xf90a9080
y.create.l HWIO_APCS_ALIAS2_SAW2_SPM_SLP_SEQ_ENTRY_1_ADDR A:0xf90a9084
y.create.l HWIO_APCS_ALIAS2_SAW2_SPM_SLP_SEQ_ENTRY_2_ADDR A:0xf90a9088
y.create.l HWIO_APCS_ALIAS2_SAW2_SPM_SLP_SEQ_ENTRY_3_ADDR A:0xf90a908c
y.create.l HWIO_APCS_ALIAS2_SAW2_SPM_SLP_SEQ_ENTRY_4_ADDR A:0xf90a9090
y.create.l HWIO_APCS_ALIAS2_SAW2_SPM_SLP_SEQ_ENTRY_5_ADDR A:0xf90a9094
y.create.l HWIO_APCS_ALIAS2_SAW2_SPM_SLP_SEQ_ENTRY_6_ADDR A:0xf90a9098
y.create.l HWIO_APCS_ALIAS2_SAW2_SPM_SLP_SEQ_ENTRY_7_ADDR A:0xf90a909c
y.create.l HWIO_APCS_ALIAS2_SAW2_SPM_SLP_SEQ_ENTRY_8_ADDR A:0xf90a90a0
y.create.l HWIO_APCS_ALIAS2_SAW2_SPM_SLP_SEQ_ENTRY_9_ADDR A:0xf90a90a4
y.create.l HWIO_APCS_ALIAS2_SAW2_VERSION_ADDR A:0xf90a9fd0
y.create.l HWIO_APCS_ALIAS3_SAW2_SECURE_ADDR A:0xf90b9000
y.create.l HWIO_APCS_ALIAS3_SAW2_ID_ADDR A:0xf90b9004
y.create.l HWIO_APCS_ALIAS3_SAW2_CFG_ADDR A:0xf90b9008
y.create.l HWIO_APCS_ALIAS3_SAW2_SPM_STS_ADDR A:0xf90b900c
y.create.l HWIO_APCS_ALIAS3_SAW2_AVS_STS_ADDR A:0xf90b9010
y.create.l HWIO_APCS_ALIAS3_SAW2_PMIC_STS_ADDR A:0xf90b9014
y.create.l HWIO_APCS_ALIAS3_SAW2_RST_ADDR A:0xf90b9018
y.create.l HWIO_APCS_ALIAS3_SAW2_SPM_CTL_ADDR A:0xf90b9030
y.create.l HWIO_APCS_ALIAS3_SAW2_SPM_DLY_ADDR A:0xf90b9034
y.create.l HWIO_APCS_ALIAS3_SAW2_SPM_SLP_SEQ_ENTRY_0_ADDR A:0xf90b9080
y.create.l HWIO_APCS_ALIAS3_SAW2_SPM_SLP_SEQ_ENTRY_1_ADDR A:0xf90b9084
y.create.l HWIO_APCS_ALIAS3_SAW2_SPM_SLP_SEQ_ENTRY_2_ADDR A:0xf90b9088
y.create.l HWIO_APCS_ALIAS3_SAW2_SPM_SLP_SEQ_ENTRY_3_ADDR A:0xf90b908c
y.create.l HWIO_APCS_ALIAS3_SAW2_SPM_SLP_SEQ_ENTRY_4_ADDR A:0xf90b9090
y.create.l HWIO_APCS_ALIAS3_SAW2_SPM_SLP_SEQ_ENTRY_5_ADDR A:0xf90b9094
y.create.l HWIO_APCS_ALIAS3_SAW2_SPM_SLP_SEQ_ENTRY_6_ADDR A:0xf90b9098
y.create.l HWIO_APCS_ALIAS3_SAW2_SPM_SLP_SEQ_ENTRY_7_ADDR A:0xf90b909c
y.create.l HWIO_APCS_ALIAS3_SAW2_SPM_SLP_SEQ_ENTRY_8_ADDR A:0xf90b90a0
y.create.l HWIO_APCS_ALIAS3_SAW2_SPM_SLP_SEQ_ENTRY_9_ADDR A:0xf90b90a4
y.create.l HWIO_APCS_ALIAS3_SAW2_VERSION_ADDR A:0xf90b9fd0
y.create.l HWIO_APCS_GLB_SECURE_ADDR A:0xf9011000
y.create.l HWIO_APCS_TZ_IPC_INTERRUPT_ADDR A:0xf9011004
y.create.l HWIO_APCS_IPC_INTERRUPT_ADDR A:0xf9011008
y.create.l HWIO_APCS_PWR_CTL_OVERRIDE_ADDR A:0xf901100c
y.create.l HWIO_APCS_GLB_CLK_STATUS_ADDR A:0xf9011010
y.create.l HWIO_APCS_L2_PWR_CTL_ADDR A:0xf9011014
y.create.l HWIO_APCS_L2_PWR_STATUS_ADDR A:0xf9011018
y.create.l HWIO_APCS_GLB_CLK_DIAG_ADDR A:0xf901101c
y.create.l HWIO_APCS_GLB_TEST_BUS_SEL_ADDR A:0xf9011020
y.create.l HWIO_APCS_DBG_PWR_CTL_ADDR A:0xf9011024
y.create.l HWIO_APCS_GLB_SPARE_ADDR A:0xf9011028
y.create.l HWIO_APCS_SPARE_STATUS_ADDR A:0xf901102c
y.create.l HWIO_APCS_IDR_ADDR A:0xf9011030
y.create.l HWIO_APCS_XO_CBCR_ADDR A:0xf9011034
y.create.l HWIO_APCS_SLEEP_CBCR_ADDR A:0xf9011038
y.create.l HWIO_APCS_CMD_RCGR_ADDR A:0xf9011050
y.create.l HWIO_APCS_CFG_RCGR_ADDR A:0xf9011054
y.create.l HWIO_APCS_CORE_CBCR_ADDR A:0xf9011058
y.create.l HWIO_APCS_RBCPR_BCR_ADDR A:0xf9011060
y.create.l HWIO_APCS_RBCPR_CLK_SEL_ADDR A:0xf9011064
y.create.l HWIO_APCS_HW_EVENT_SEL_0_ADDR A:0xf9011080
y.create.l HWIO_APCS_HW_EVENT_SEL_1_ADDR A:0xf9011084
y.create.l HWIO_APCS_HW_EVENT_SEL_2_ADDR A:0xf9011088
y.create.l HWIO_APCS_HW_EVENT_SEL_3_ADDR A:0xf901108c
y.create.l HWIO_APCS_HW_EVENT_SEL_4_ADDR A:0xf9011090
y.create.l HWIO_APCS_HW_EVENT_SEL_5_ADDR A:0xf9011094
y.create.l HWIO_APCS_HW_EVENT_SEL_6_ADDR A:0xf9011098
y.create.l HWIO_APCS_HW_EVENT_SEL_7_ADDR A:0xf901109c
y.create.l HWIO_APCS_HW_EVENT_SEL_8_ADDR A:0xf90110a0
y.create.l HWIO_APCS_HW_EVENT_SEL_9_ADDR A:0xf90110a4
y.create.l HWIO_APCS_VERSION_ADDR A:0xf9011fd0
y.create.l HWIO_APCS_CFG_SECURE_ADDR A:0xf9010000
y.create.l HWIO_APCS_START_ADDR_ADDR A:0xf9010004
y.create.l HWIO_APCS_TCM_START_ADDR_ADDR A:0xf9010010
y.create.l HWIO_APCS_BANKED_APC_SECURE_ADDR A:0xf9008000
y.create.l HWIO_APCS_BANKED_CPU_PWR_CTL_ADDR A:0xf9008004
y.create.l HWIO_APCS_BANKED_APC_PWR_STATUS_ADDR A:0xf9008008
y.create.l HWIO_APCS_BANKED_APC_TEST_BUS_SEL_ADDR A:0xf900800c
y.create.l HWIO_APCS_BANKED_CPU_TRGTD_DBG_RST_ADDR A:0xf9008010
y.create.l HWIO_APCS_BANKED_APC_PWR_GATE_CTL_ADDR A:0xf9008014
y.create.l HWIO_APCS_BANKED_APC_PWR_GATE_STATUS_ADDR A:0xf9008030
y.create.l HWIO_APCS_ALIAS0_APC_SECURE_ADDR A:0xf9088000
y.create.l HWIO_APCS_ALIAS0_CPU_PWR_CTL_ADDR A:0xf9088004
y.create.l HWIO_APCS_ALIAS0_APC_PWR_STATUS_ADDR A:0xf9088008
y.create.l HWIO_APCS_ALIAS0_APC_TEST_BUS_SEL_ADDR A:0xf908800c
y.create.l HWIO_APCS_ALIAS0_CPU_TRGTD_DBG_RST_ADDR A:0xf9088010
y.create.l HWIO_APCS_ALIAS0_APC_PWR_GATE_CTL_ADDR A:0xf9088014
y.create.l HWIO_APCS_ALIAS0_APC_PWR_GATE_STATUS_ADDR A:0xf9088030
y.create.l HWIO_APCS_ALIAS1_APC_SECURE_ADDR A:0xf9098000
y.create.l HWIO_APCS_ALIAS1_CPU_PWR_CTL_ADDR A:0xf9098004
y.create.l HWIO_APCS_ALIAS1_APC_PWR_STATUS_ADDR A:0xf9098008
y.create.l HWIO_APCS_ALIAS1_APC_TEST_BUS_SEL_ADDR A:0xf909800c
y.create.l HWIO_APCS_ALIAS1_CPU_TRGTD_DBG_RST_ADDR A:0xf9098010
y.create.l HWIO_APCS_ALIAS1_APC_PWR_GATE_CTL_ADDR A:0xf9098014
y.create.l HWIO_APCS_ALIAS1_APC_PWR_GATE_STATUS_ADDR A:0xf9098030
y.create.l HWIO_APCS_ALIAS2_APC_SECURE_ADDR A:0xf90a8000
y.create.l HWIO_APCS_ALIAS2_CPU_PWR_CTL_ADDR A:0xf90a8004
y.create.l HWIO_APCS_ALIAS2_APC_PWR_STATUS_ADDR A:0xf90a8008
y.create.l HWIO_APCS_ALIAS2_APC_TEST_BUS_SEL_ADDR A:0xf90a800c
y.create.l HWIO_APCS_ALIAS2_CPU_TRGTD_DBG_RST_ADDR A:0xf90a8010
y.create.l HWIO_APCS_ALIAS2_APC_PWR_GATE_CTL_ADDR A:0xf90a8014
y.create.l HWIO_APCS_ALIAS2_APC_PWR_GATE_STATUS_ADDR A:0xf90a8030
y.create.l HWIO_APCS_ALIAS3_APC_SECURE_ADDR A:0xf90b8000
y.create.l HWIO_APCS_ALIAS3_CPU_PWR_CTL_ADDR A:0xf90b8004
y.create.l HWIO_APCS_ALIAS3_APC_PWR_STATUS_ADDR A:0xf90b8008
y.create.l HWIO_APCS_ALIAS3_APC_TEST_BUS_SEL_ADDR A:0xf90b800c
y.create.l HWIO_APCS_ALIAS3_CPU_TRGTD_DBG_RST_ADDR A:0xf90b8010
y.create.l HWIO_APCS_ALIAS3_APC_PWR_GATE_CTL_ADDR A:0xf90b8014
y.create.l HWIO_APCS_ALIAS3_APC_PWR_GATE_STATUS_ADDR A:0xf90b8030
y.create.l HWIO_APCS_GICD_CTLR_ADDR A:0xf9000000
y.create.l HWIO_APCS_GICD_TYPER_ADDR A:0xf9000004
y.create.l HWIO_APCS_GICD_IIDR_ADDR A:0xf9000008
y.create.l HWIO_APCS_GICD_ANSACR_ADDR A:0xf9000020
y.create.l HWIO_APCS_GICD_CGCR_ADDR A:0xf9000024
y.create.l HWIO_APCS_GICD_HW_VERSION_ADDR A:0xf9000030
y.create.l HWIO_APCS_GICD_ISR0_ADDR A:0xf9000080
y.create.l HWIO_APCS_GICD_ISR1_ADDR A:0xf9000084
y.create.l HWIO_APCS_GICD_ISR2_ADDR A:0xf9000088
y.create.l HWIO_APCS_GICD_ISR3_ADDR A:0xf900008c
y.create.l HWIO_APCS_GICD_ISR4_ADDR A:0xf9000090
y.create.l HWIO_APCS_GICD_ISR5_ADDR A:0xf9000094
y.create.l HWIO_APCS_GICD_ISR6_ADDR A:0xf9000098
y.create.l HWIO_APCS_GICD_ISR7_ADDR A:0xf900009c
y.create.l HWIO_APCS_GICD_ISR8_ADDR A:0xf90000a0
y.create.l HWIO_APCS_GICD_ISENABLER0_ADDR A:0xf9000100
y.create.l HWIO_APCS_GICD_ISENABLER1_ADDR A:0xf9000104
y.create.l HWIO_APCS_GICD_ISENABLER2_ADDR A:0xf9000108
y.create.l HWIO_APCS_GICD_ISENABLER3_ADDR A:0xf900010c
y.create.l HWIO_APCS_GICD_ISENABLER4_ADDR A:0xf9000110
y.create.l HWIO_APCS_GICD_ISENABLER5_ADDR A:0xf9000114
y.create.l HWIO_APCS_GICD_ISENABLER6_ADDR A:0xf9000118
y.create.l HWIO_APCS_GICD_ISENABLER7_ADDR A:0xf900011c
y.create.l HWIO_APCS_GICD_ISENABLER8_ADDR A:0xf9000120
y.create.l HWIO_APCS_GICD_ICENABLER0_ADDR A:0xf9000180
y.create.l HWIO_APCS_GICD_ICENABLER1_ADDR A:0xf9000184
y.create.l HWIO_APCS_GICD_ICENABLER2_ADDR A:0xf9000188
y.create.l HWIO_APCS_GICD_ICENABLER3_ADDR A:0xf900018c
y.create.l HWIO_APCS_GICD_ICENABLER4_ADDR A:0xf9000190
y.create.l HWIO_APCS_GICD_ICENABLER5_ADDR A:0xf9000194
y.create.l HWIO_APCS_GICD_ICENABLER6_ADDR A:0xf9000198
y.create.l HWIO_APCS_GICD_ICENABLER7_ADDR A:0xf900019c
y.create.l HWIO_APCS_GICD_ICENABLER8_ADDR A:0xf90001a0
y.create.l HWIO_APCS_GICD_ISPENDR0_ADDR A:0xf9000200
y.create.l HWIO_APCS_GICD_ISPENDR1_ADDR A:0xf9000204
y.create.l HWIO_APCS_GICD_ISPENDR2_ADDR A:0xf9000208
y.create.l HWIO_APCS_GICD_ISPENDR3_ADDR A:0xf900020c
y.create.l HWIO_APCS_GICD_ISPENDR4_ADDR A:0xf9000210
y.create.l HWIO_APCS_GICD_ISPENDR5_ADDR A:0xf9000214
y.create.l HWIO_APCS_GICD_ISPENDR6_ADDR A:0xf9000218
y.create.l HWIO_APCS_GICD_ISPENDR7_ADDR A:0xf900021c
y.create.l HWIO_APCS_GICD_ISPENDR8_ADDR A:0xf9000220
y.create.l HWIO_APCS_GICD_ICPENDR0_ADDR A:0xf9000280
y.create.l HWIO_APCS_GICD_ICPENDR1_ADDR A:0xf9000284
y.create.l HWIO_APCS_GICD_ICPENDR2_ADDR A:0xf9000288
y.create.l HWIO_APCS_GICD_ICPENDR3_ADDR A:0xf900028c
y.create.l HWIO_APCS_GICD_ICPENDR4_ADDR A:0xf9000290
y.create.l HWIO_APCS_GICD_ICPENDR5_ADDR A:0xf9000294
y.create.l HWIO_APCS_GICD_ICPENDR6_ADDR A:0xf9000298
y.create.l HWIO_APCS_GICD_ICPENDR7_ADDR A:0xf900029c
y.create.l HWIO_APCS_GICD_ICPENDR8_ADDR A:0xf90002a0
y.create.l HWIO_APCS_GICD_ISACTIVER0_ADDR A:0xf9000300
y.create.l HWIO_APCS_GICD_ISACTIVER1_ADDR A:0xf9000304
y.create.l HWIO_APCS_GICD_ISACTIVER2_ADDR A:0xf9000308
y.create.l HWIO_APCS_GICD_ISACTIVER3_ADDR A:0xf900030c
y.create.l HWIO_APCS_GICD_ISACTIVER4_ADDR A:0xf9000310
y.create.l HWIO_APCS_GICD_ISACTIVER5_ADDR A:0xf9000314
y.create.l HWIO_APCS_GICD_ISACTIVER6_ADDR A:0xf9000318
y.create.l HWIO_APCS_GICD_ISACTIVER7_ADDR A:0xf900031c
y.create.l HWIO_APCS_GICD_ISACTIVER8_ADDR A:0xf9000320
y.create.l HWIO_APCS_GICD_ICACTIVER0_ADDR A:0xf9000380
y.create.l HWIO_APCS_GICD_ICACTIVER1_ADDR A:0xf9000384
y.create.l HWIO_APCS_GICD_ICACTIVER2_ADDR A:0xf9000388
y.create.l HWIO_APCS_GICD_ICACTIVER3_ADDR A:0xf900038c
y.create.l HWIO_APCS_GICD_ICACTIVER4_ADDR A:0xf9000390
y.create.l HWIO_APCS_GICD_ICACTIVER5_ADDR A:0xf9000394
y.create.l HWIO_APCS_GICD_ICACTIVER6_ADDR A:0xf9000398
y.create.l HWIO_APCS_GICD_ICACTIVER7_ADDR A:0xf900039c
y.create.l HWIO_APCS_GICD_ICACTIVER8_ADDR A:0xf90003a0
y.create.l HWIO_APCS_GICD_IPRIORITYR0_ADDR A:0xf9000400
y.create.l HWIO_APCS_GICD_IPRIORITYR1_ADDR A:0xf9000404
y.create.l HWIO_APCS_GICD_IPRIORITYR2_ADDR A:0xf9000408
y.create.l HWIO_APCS_GICD_IPRIORITYR3_ADDR A:0xf900040c
y.create.l HWIO_APCS_GICD_IPRIORITYR4_ADDR A:0xf9000410
y.create.l HWIO_APCS_GICD_IPRIORITYR5_ADDR A:0xf9000414
y.create.l HWIO_APCS_GICD_IPRIORITYR6_ADDR A:0xf9000418
y.create.l HWIO_APCS_GICD_IPRIORITYR7_ADDR A:0xf900041c
y.create.l HWIO_APCS_GICD_IPRIORITYR8_ADDR A:0xf9000420
y.create.l HWIO_APCS_GICD_IPRIORITYR9_ADDR A:0xf9000424
y.create.l HWIO_APCS_GICD_ITARGETSR0_ADDR A:0xf9000800
y.create.l HWIO_APCS_GICD_ITARGETSR1_ADDR A:0xf9000804
y.create.l HWIO_APCS_GICD_ITARGETSR2_ADDR A:0xf9000808
y.create.l HWIO_APCS_GICD_ITARGETSR3_ADDR A:0xf900080c
y.create.l HWIO_APCS_GICD_ITARGETSR4_ADDR A:0xf9000810
y.create.l HWIO_APCS_GICD_ITARGETSR5_ADDR A:0xf9000814
y.create.l HWIO_APCS_GICD_ITARGETSR6_ADDR A:0xf9000818
y.create.l HWIO_APCS_GICD_ITARGETSR7_ADDR A:0xf900081c
y.create.l HWIO_APCS_GICD_ITARGETSR8_ADDR A:0xf9000820
y.create.l HWIO_APCS_GICD_ITARGETSR9_ADDR A:0xf9000824
y.create.l HWIO_APCS_GICD_ICFGR0_ADDR A:0xf9000c00
y.create.l HWIO_APCS_GICD_ICFGR1_ADDR A:0xf9000c04
y.create.l HWIO_APCS_GICD_ICFGR2_ADDR A:0xf9000c08
y.create.l HWIO_APCS_GICD_ICFGR3_ADDR A:0xf9000c0c
y.create.l HWIO_APCS_GICD_ICFGR4_ADDR A:0xf9000c10
y.create.l HWIO_APCS_GICD_ICFGR5_ADDR A:0xf9000c14
y.create.l HWIO_APCS_GICD_ICFGR6_ADDR A:0xf9000c18
y.create.l HWIO_APCS_GICD_ICFGR7_ADDR A:0xf9000c1c
y.create.l HWIO_APCS_GICD_ICFGR8_ADDR A:0xf9000c20
y.create.l HWIO_APCS_GICD_ICFGR9_ADDR A:0xf9000c24
y.create.l HWIO_APCS_GICD_SGIR_ADDR A:0xf9000f00
y.create.l HWIO_APCS_GICD_CPENDSGIR0_ADDR A:0xf9000f10
y.create.l HWIO_APCS_GICD_CPENDSGIR1_ADDR A:0xf9000f14
y.create.l HWIO_APCS_GICD_CPENDSGIR2_ADDR A:0xf9000f18
y.create.l HWIO_APCS_GICD_CPENDSGIR3_ADDR A:0xf9000f1c
y.create.l HWIO_APCS_GICD_SPENDSGIR0_ADDR A:0xf9000f20
y.create.l HWIO_APCS_GICD_SPENDSGIR1_ADDR A:0xf9000f24
y.create.l HWIO_APCS_GICD_SPENDSGIR2_ADDR A:0xf9000f28
y.create.l HWIO_APCS_GICD_SPENDSGIR3_ADDR A:0xf9000f2c
y.create.l HWIO_APCS_GICD_PIDR0_ADDR A:0xf9000fd0
y.create.l HWIO_APCS_GICD_PIDR1_ADDR A:0xf9000fd4
y.create.l HWIO_APCS_GICD_PIDR2_ADDR A:0xf9000fd8
y.create.l HWIO_APCS_GICD_PIDR3_ADDR A:0xf9000fdc
y.create.l HWIO_APCS_GICD_PIDR4_ADDR A:0xf9000fe0
y.create.l HWIO_APCS_GICD_PIDR5_ADDR A:0xf9000fe4
y.create.l HWIO_APCS_GICD_PIDR6_ADDR A:0xf9000fe8
y.create.l HWIO_APCS_GICD_PIDR7_ADDR A:0xf9000fec
y.create.l HWIO_APCS_GICD_CIDR0_ADDR A:0xf9000ff0
y.create.l HWIO_APCS_GICD_CIDR1_ADDR A:0xf9000ff4
y.create.l HWIO_APCS_GICD_CIDR2_ADDR A:0xf9000ff8
y.create.l HWIO_APCS_GICD_CIDR3_ADDR A:0xf9000ffc
y.create.l HWIO_APCS_GICH_HCR_ADDR A:0xf9001000
y.create.l HWIO_APCS_GICH_VTR_ADDR A:0xf9001004
y.create.l HWIO_APCS_GICH_VMCR_ADDR A:0xf9001008
y.create.l HWIO_APCS_GICH_MISR_ADDR A:0xf9001010
y.create.l HWIO_APCS_GICH_EISR_ADDR A:0xf9001020
y.create.l HWIO_APCS_GICH_ELRSR_ADDR A:0xf9001030
y.create.l HWIO_APCS_GICH_APR_ADDR A:0xf90010f0
y.create.l HWIO_APCS_GICH_LR0_ADDR A:0xf9001100
y.create.l HWIO_APCS_GICH_LR1_ADDR A:0xf9001104
y.create.l HWIO_APCS_GICH_LR2_ADDR A:0xf9001108
y.create.l HWIO_APCS_GICH_LR3_ADDR A:0xf900110c
y.create.l HWIO_APCS_GICH_SW_LR_ADDR A:0xf9001120
y.create.l HWIO_APCS_GICC_CTLR_ADDR A:0xf9002000
y.create.l HWIO_APCS_GICC_PMR_ADDR A:0xf9002004
y.create.l HWIO_APCS_GICC_BPR_ADDR A:0xf9002008
y.create.l HWIO_APCS_GICC_IAR_ADDR A:0xf900200c
y.create.l HWIO_APCS_GICC_EOIR_ADDR A:0xf9002010
y.create.l HWIO_APCS_GICC_RPR_ADDR A:0xf9002014
y.create.l HWIO_APCS_GICC_HPPIR_ADDR A:0xf9002018
y.create.l HWIO_APCS_GICC_ABPR_ADDR A:0xf900201c
y.create.l HWIO_APCS_GICC_AIAR_ADDR A:0xf9002020
y.create.l HWIO_APCS_GICC_AEOIR_ADDR A:0xf9002024
y.create.l HWIO_APCS_GICC_AHPPIR_ADDR A:0xf9002028
y.create.l HWIO_APCS_GICC_APR_ADDR A:0xf90020d0
y.create.l HWIO_APCS_GICC_NSAPR_ADDR A:0xf90020e0
y.create.l HWIO_APCS_GICC_IIDR_ADDR A:0xf90020fc
y.create.l HWIO_APCS_GICC_DIR_ADDR A:0xf9003000
y.create.l HWIO_APCS_GICV_CTLR_ADDR A:0xf9004000
y.create.l HWIO_APCS_GICV_PMR_ADDR A:0xf9004004
y.create.l HWIO_APCS_GICV_BPR_ADDR A:0xf9004008
y.create.l HWIO_APCS_GICV_IAR_ADDR A:0xf900400c
y.create.l HWIO_APCS_GICV_EOIR_ADDR A:0xf9004010
y.create.l HWIO_APCS_GICV_RPR_ADDR A:0xf9004014
y.create.l HWIO_APCS_GICV_HPPIR_ADDR A:0xf9004018
y.create.l HWIO_APCS_GICV_ABPR_ADDR A:0xf900401c
y.create.l HWIO_APCS_GICV_AIAR_ADDR A:0xf9004020
y.create.l HWIO_APCS_GICV_AEOIR_ADDR A:0xf9004024
y.create.l HWIO_APCS_GICV_AHPPIR_ADDR A:0xf9004028
y.create.l HWIO_APCS_GICV_APR_ADDR A:0xf90040d0
y.create.l HWIO_APCS_GICV_IIDR_ADDR A:0xf90040fc
y.create.l HWIO_APCS_GICV_DIR_ADDR A:0xf9005000
y.create.l HWIO_APCS_XPU_SCR_ADDR A:0xf9013000
y.create.l HWIO_APCS_XPU_SWDR_ADDR A:0xf9013004
y.create.l HWIO_APCS_XPU_PRTN_RACR_SSHADOW_ADDR A:0xf9013008
y.create.l HWIO_APCS_XPU_PRTN_WACR_SSHADOW_ADDR A:0xf901300c
y.create.l HWIO_APCS_XPU_PRTN_START_SSHADOW0_ADDR A:0xf9013010
y.create.l HWIO_APCS_XPU_PRTN_END_SSHADOW0_ADDR A:0xf9013018
y.create.l HWIO_APCS_XPU_SEAR0_ADDR A:0xf9013040
y.create.l HWIO_APCS_XPU_SESR_ADDR A:0xf9013048
y.create.l HWIO_APCS_XPU_SESRRESTORE_ADDR A:0xf901304c
y.create.l HWIO_APCS_XPU_SESYNR0_ADDR A:0xf9013050
y.create.l HWIO_APCS_XPU_SESYNR1_ADDR A:0xf9013054
y.create.l HWIO_APCS_XPU_SESYNR2_ADDR A:0xf9013058
y.create.l HWIO_APCS_XPU_MCR_ADDR A:0xf9013100
y.create.l HWIO_APCS_XPU_MEAR0_ADDR A:0xf9013140
y.create.l HWIO_APCS_XPU_MESR_ADDR A:0xf9013148
y.create.l HWIO_APCS_XPU_MESRRESTORE_ADDR A:0xf901314c
y.create.l HWIO_APCS_XPU_MESYNR0_ADDR A:0xf9013150
y.create.l HWIO_APCS_XPU_MESYNR1_ADDR A:0xf9013154
y.create.l HWIO_APCS_XPU_MESYNR2_ADDR A:0xf9013158
y.create.l HWIO_APCS_XPU_CR_ADDR A:0xf9013080
y.create.l HWIO_APCS_XPU_PRTN_RACR_SHADOW_ADDR A:0xf9013088
y.create.l HWIO_APCS_XPU_PRTN_WACR_SHADOW_ADDR A:0xf901308c
y.create.l HWIO_APCS_XPU_PRTN_START_SHADOW0_ADDR A:0xf9013090
y.create.l HWIO_APCS_XPU_PRTN_END_SHADOW0_ADDR A:0xf9013098
y.create.l HWIO_APCS_XPU_RPU_ACR0_ADDR A:0xf90130a0
y.create.l HWIO_APCS_XPU_EAR0_ADDR A:0xf90130c0
y.create.l HWIO_APCS_XPU_ESR_ADDR A:0xf90130c8
y.create.l HWIO_APCS_XPU_ESRRESTORE_ADDR A:0xf90130cc
y.create.l HWIO_APCS_XPU_ESYNR0_ADDR A:0xf90130d0
y.create.l HWIO_APCS_XPU_ESYNR1_ADDR A:0xf90130d4
y.create.l HWIO_APCS_XPU_ESYNR2_ADDR A:0xf90130d8
y.create.l HWIO_APCS_XPU_UMR_RACR_ADDR A:0xf90130e0
y.create.l HWIO_APCS_XPU_UMR_WACR_ADDR A:0xf90130e4
y.create.l HWIO_APCS_XPU_IDR0_ADDR A:0xf9013074
y.create.l HWIO_APCS_XPU_IDR1_ADDR A:0xf9013078
y.create.l HWIO_APCS_XPU_REV_ADDR A:0xf901307c
y.create.l HWIO_APCS_XPU_PRT0_RACR0_ADDR A:0xf9013200
y.create.l HWIO_APCS_XPU_PRT1_RACR0_ADDR A:0xf9013280
y.create.l HWIO_APCS_XPU_PRT2_RACR0_ADDR A:0xf9013300
y.create.l HWIO_APCS_XPU_PRT3_RACR0_ADDR A:0xf9013380
y.create.l HWIO_APCS_XPU_PRT4_RACR0_ADDR A:0xf9013400
y.create.l HWIO_APCS_XPU_PRT5_RACR0_ADDR A:0xf9013480
y.create.l HWIO_APCS_XPU_PRT6_RACR0_ADDR A:0xf9013500
y.create.l HWIO_APCS_XPU_PRT7_RACR0_ADDR A:0xf9013580
y.create.l HWIO_APCS_XPU_PRT8_RACR0_ADDR A:0xf9013600
y.create.l HWIO_APCS_XPU_PRT9_RACR0_ADDR A:0xf9013680
y.create.l HWIO_APCS_XPU_PRT0_WACR0_ADDR A:0xf9013220
y.create.l HWIO_APCS_XPU_PRT1_WACR0_ADDR A:0xf90132a0
y.create.l HWIO_APCS_XPU_PRT2_WACR0_ADDR A:0xf9013320
y.create.l HWIO_APCS_XPU_PRT3_WACR0_ADDR A:0xf90133a0
y.create.l HWIO_APCS_XPU_PRT4_WACR0_ADDR A:0xf9013420
y.create.l HWIO_APCS_XPU_PRT5_WACR0_ADDR A:0xf90134a0
y.create.l HWIO_APCS_XPU_PRT6_WACR0_ADDR A:0xf9013520
y.create.l HWIO_APCS_XPU_PRT7_WACR0_ADDR A:0xf90135a0
y.create.l HWIO_APCS_XPU_PRT8_WACR0_ADDR A:0xf9013620
y.create.l HWIO_APCS_XPU_PRT9_WACR0_ADDR A:0xf90136a0
y.create.l HWIO_APCS_XPU_PRT0_START0_ADDR A:0xf9013240
y.create.l HWIO_APCS_XPU_PRT1_START0_ADDR A:0xf90132c0
y.create.l HWIO_APCS_XPU_PRT2_START0_ADDR A:0xf9013340
y.create.l HWIO_APCS_XPU_PRT3_START0_ADDR A:0xf90133c0
y.create.l HWIO_APCS_XPU_PRT4_START0_ADDR A:0xf9013440
y.create.l HWIO_APCS_XPU_PRT5_START0_ADDR A:0xf90134c0
y.create.l HWIO_APCS_XPU_PRT6_START0_ADDR A:0xf9013540
y.create.l HWIO_APCS_XPU_PRT7_START0_ADDR A:0xf90135c0
y.create.l HWIO_APCS_XPU_PRT8_START0_ADDR A:0xf9013640
y.create.l HWIO_APCS_XPU_PRT9_START0_ADDR A:0xf90136c0
y.create.l HWIO_APCS_XPU_PRT0_END0_ADDR A:0xf9013248
y.create.l HWIO_APCS_XPU_PRT1_END0_ADDR A:0xf90132c8
y.create.l HWIO_APCS_XPU_PRT2_END0_ADDR A:0xf9013348
y.create.l HWIO_APCS_XPU_PRT3_END0_ADDR A:0xf90133c8
y.create.l HWIO_APCS_XPU_PRT4_END0_ADDR A:0xf9013448
y.create.l HWIO_APCS_XPU_PRT5_END0_ADDR A:0xf90134c8
y.create.l HWIO_APCS_XPU_PRT6_END0_ADDR A:0xf9013548
y.create.l HWIO_APCS_XPU_PRT7_END0_ADDR A:0xf90135c8
y.create.l HWIO_APCS_XPU_PRT8_END0_ADDR A:0xf9013648
y.create.l HWIO_APCS_XPU_PRT9_END0_ADDR A:0xf90136c8
y.create.l HWIO_APCS_XPU_PRT0_SCR_ADDR A:0xf9013250
y.create.l HWIO_APCS_XPU_PRT1_SCR_ADDR A:0xf90132d0
y.create.l HWIO_APCS_XPU_PRT2_SCR_ADDR A:0xf9013350
y.create.l HWIO_APCS_XPU_PRT3_SCR_ADDR A:0xf90133d0
y.create.l HWIO_APCS_XPU_PRT4_SCR_ADDR A:0xf9013450
y.create.l HWIO_APCS_XPU_PRT5_SCR_ADDR A:0xf90134d0
y.create.l HWIO_APCS_XPU_PRT6_SCR_ADDR A:0xf9013550
y.create.l HWIO_APCS_XPU_PRT7_SCR_ADDR A:0xf90135d0
y.create.l HWIO_APCS_XPU_PRT8_SCR_ADDR A:0xf9013650
y.create.l HWIO_APCS_XPU_PRT9_SCR_ADDR A:0xf90136d0
y.create.l HWIO_APCS_XPU_PRT0_MCR_ADDR A:0xf9013254
y.create.l HWIO_APCS_XPU_PRT1_MCR_ADDR A:0xf90132d4
y.create.l HWIO_APCS_XPU_PRT2_MCR_ADDR A:0xf9013354
y.create.l HWIO_APCS_XPU_PRT3_MCR_ADDR A:0xf90133d4
y.create.l HWIO_APCS_XPU_PRT4_MCR_ADDR A:0xf9013454
y.create.l HWIO_APCS_XPU_PRT5_MCR_ADDR A:0xf90134d4
y.create.l HWIO_APCS_XPU_PRT6_MCR_ADDR A:0xf9013554
y.create.l HWIO_APCS_XPU_PRT7_MCR_ADDR A:0xf90135d4
y.create.l HWIO_APCS_XPU_PRT8_MCR_ADDR A:0xf9013654
y.create.l HWIO_APCS_XPU_PRT9_MCR_ADDR A:0xf90136d4
y.create.l HWIO_APCS_XPU_PRT0_CNTL0_ADDR A:0xf9013258
y.create.l HWIO_APCS_XPU_PRT1_CNTL0_ADDR A:0xf90132d8
y.create.l HWIO_APCS_XPU_PRT2_CNTL0_ADDR A:0xf9013358
y.create.l HWIO_APCS_XPU_PRT3_CNTL0_ADDR A:0xf90133d8
y.create.l HWIO_APCS_XPU_PRT4_CNTL0_ADDR A:0xf9013458
y.create.l HWIO_APCS_XPU_PRT5_CNTL0_ADDR A:0xf90134d8
y.create.l HWIO_APCS_XPU_PRT6_CNTL0_ADDR A:0xf9013558
y.create.l HWIO_APCS_XPU_PRT7_CNTL0_ADDR A:0xf90135d8
y.create.l HWIO_APCS_XPU_PRT8_CNTL0_ADDR A:0xf9013658
y.create.l HWIO_APCS_XPU_PRT9_CNTL0_ADDR A:0xf90136d8
y.create.l HWIO_APCS_XPU_PRT0_CNTL1_ADDR A:0xf901325c
y.create.l HWIO_APCS_XPU_PRT1_CNTL1_ADDR A:0xf90132dc
y.create.l HWIO_APCS_XPU_PRT2_CNTL1_ADDR A:0xf901335c
y.create.l HWIO_APCS_XPU_PRT3_CNTL1_ADDR A:0xf90133dc
y.create.l HWIO_APCS_XPU_PRT4_CNTL1_ADDR A:0xf901345c
y.create.l HWIO_APCS_XPU_PRT5_CNTL1_ADDR A:0xf90134dc
y.create.l HWIO_APCS_XPU_PRT6_CNTL1_ADDR A:0xf901355c
y.create.l HWIO_APCS_XPU_PRT7_CNTL1_ADDR A:0xf90135dc
y.create.l HWIO_APCS_XPU_PRT8_CNTL1_ADDR A:0xf901365c
y.create.l HWIO_APCS_XPU_PRT9_CNTL1_ADDR A:0xf90136dc
y.create.l HWIO_APCS_VMIDMT_SCR0_ADDR A:0xf9014000
y.create.l HWIO_APCS_VMIDMT_SCR1_ADDR A:0xf9014004
y.create.l HWIO_APCS_VMIDMT_SCR2_ADDR A:0xf9014008
y.create.l HWIO_APCS_VMIDMT_SACR_ADDR A:0xf9014010
y.create.l HWIO_APCS_VMIDMT_SIDR0_ADDR A:0xf9014020
y.create.l HWIO_APCS_VMIDMT_SIDR1_ADDR A:0xf9014024
y.create.l HWIO_APCS_VMIDMT_SIDR2_ADDR A:0xf9014028
y.create.l HWIO_APCS_VMIDMT_SIDR4_ADDR A:0xf9014030
y.create.l HWIO_APCS_VMIDMT_SIDR5_ADDR A:0xf9014034
y.create.l HWIO_APCS_VMIDMT_SIDR7_ADDR A:0xf901403c
y.create.l HWIO_APCS_VMIDMT_SGFAR0_ADDR A:0xf9014040
y.create.l HWIO_APCS_VMIDMT_SGFSR_ADDR A:0xf9014048
y.create.l HWIO_APCS_VMIDMT_SGFSRRESTORE_ADDR A:0xf901404c
y.create.l HWIO_APCS_VMIDMT_SGFSYNDR0_ADDR A:0xf9014050
y.create.l HWIO_APCS_VMIDMT_SGFSYNDR1_ADDR A:0xf9014054
y.create.l HWIO_APCS_VMIDMT_SGFSYNDR2_ADDR A:0xf9014058
y.create.l HWIO_APCS_VMIDMT_VMIDMTSCR0_ADDR A:0xf9014090
y.create.l HWIO_APCS_VMIDMT_CR0_ADDR A:0xf9014000
y.create.l HWIO_APCS_VMIDMT_CR2_ADDR A:0xf9014008
y.create.l HWIO_APCS_VMIDMT_ACR_ADDR A:0xf9014010
y.create.l HWIO_APCS_VMIDMT_IDR0_ADDR A:0xf9014020
y.create.l HWIO_APCS_VMIDMT_IDR1_ADDR A:0xf9014024
y.create.l HWIO_APCS_VMIDMT_IDR2_ADDR A:0xf9014028
y.create.l HWIO_APCS_VMIDMT_IDR4_ADDR A:0xf9014030
y.create.l HWIO_APCS_VMIDMT_IDR5_ADDR A:0xf9014034
y.create.l HWIO_APCS_VMIDMT_IDR7_ADDR A:0xf901403c
y.create.l HWIO_APCS_VMIDMT_GFAR0_ADDR A:0xf9014040
y.create.l HWIO_APCS_VMIDMT_GFSR_ADDR A:0xf9014048
y.create.l HWIO_APCS_VMIDMT_GFSRRESTORE_ADDR A:0xf901404c
y.create.l HWIO_APCS_VMIDMT_GFSYNDR0_ADDR A:0xf9014050
y.create.l HWIO_APCS_VMIDMT_GFSYNDR1_ADDR A:0xf9014054
y.create.l HWIO_APCS_VMIDMT_GFSYNDR2_ADDR A:0xf9014058
y.create.l HWIO_APCS_VMIDMT_VMIDMTCR0_ADDR A:0xf9014090
y.create.l HWIO_APCS_VMIDMT_VMIDMTACR_ADDR A:0xf901409c
y.create.l HWIO_APCS_VMIDMT_NSCR0_ADDR A:0xf9014400
y.create.l HWIO_APCS_VMIDMT_NSCR2_ADDR A:0xf9014408
y.create.l HWIO_APCS_VMIDMT_NSACR_ADDR A:0xf9014410
y.create.l HWIO_APCS_VMIDMT_NSGFAR0_ADDR A:0xf9014440
y.create.l HWIO_APCS_VMIDMT_NSGFSR_ADDR A:0xf9014448
y.create.l HWIO_APCS_VMIDMT_NSGFSRRESTORE_ADDR A:0xf901444c
y.create.l HWIO_APCS_VMIDMT_NSGFSYNDR0_ADDR A:0xf9014450
y.create.l HWIO_APCS_VMIDMT_NSGFSYNDR1_ADDR A:0xf9014454
y.create.l HWIO_APCS_VMIDMT_NSGFSYNDR2_ADDR A:0xf9014458
y.create.l HWIO_APCS_VMIDMT_NSVMIDMTCR0_ADDR A:0xf9014490
y.create.l HWIO_APCS_VMIDMT_SSDR0_ADDR A:0xf9014080
y.create.l HWIO_APCS_VMIDMT_MCR_ADDR A:0xf9014494
y.create.l HWIO_APCS_VMIDMT_S2VR0_ADDR A:0xf9014c00
y.create.l HWIO_APCS_VMIDMT_S2VR1_ADDR A:0xf9014c04
y.create.l HWIO_APCS_VMIDMT_AS2VR0_ADDR A:0xf9014e00
y.create.l HWIO_APCS_VMIDMT_AS2VR1_ADDR A:0xf9014e04
y.create.l HWIO_BIMC_HW_VERSION_ADDR A:0xfc380000
y.create.l HWIO_BIMC_CORE_INFO_ADDR A:0xfc380004
y.create.l HWIO_BIMC_HW_INFO_ADDR A:0xfc380008
y.create.l HWIO_BIMC_CORE_CLK_SEL_ADDR A:0xfc380020
y.create.l HWIO_BIMC_CORE_CLK_PERIOD_ADDR A:0xfc380024
y.create.l HWIO_BIMC_SCMO0_LOCAL_CGC_THRESHOLD_ADDR A:0xfc380100
y.create.l HWIO_BIMC_DPE0_LOCAL_CGC_THRESHOLD_ADDR A:0xfc380140
y.create.l HWIO_BIMC_MPORT_CORE_DOMAIN_LOCAL_CGC_THRESHOLD_ADDR A:0xfc380180
y.create.l HWIO_BIMC_MPORT0_CLK_LOCAL_CGC_THRESHOLD_ADDR A:0xfc3801c0
y.create.l HWIO_BIMC_MPORT1_CLK_LOCAL_CGC_THRESHOLD_ADDR A:0xfc3801c4
y.create.l HWIO_BIMC_MPORT2_CLK_LOCAL_CGC_THRESHOLD_ADDR A:0xfc3801c8
y.create.l HWIO_BIMC_MPORT3_CLK_LOCAL_CGC_THRESHOLD_ADDR A:0xfc3801cc
y.create.l HWIO_BIMC_MPORT4_CLK_LOCAL_CGC_THRESHOLD_ADDR A:0xfc3801d0
y.create.l HWIO_BIMC_MPORT5_CLK_LOCAL_CGC_THRESHOLD_ADDR A:0xfc3801d4
y.create.l HWIO_BIMC_SWAY_LOCAL_CGC_THRESHOLD_ADDR A:0xfc380200
y.create.l HWIO_BIMC_SCMO0_CGC_CFG_ADDR A:0xfc380240
y.create.l HWIO_BIMC_DPE0_CGC_CFG_ADDR A:0xfc380280
y.create.l HWIO_BIMC_CALIBRATION_CFG_ADDR A:0xfc380400
y.create.l HWIO_BIMC_DFI0_LP_CFG_ADDR A:0xfc380600
y.create.l HWIO_BIMC_HFSC_CFG_ADDR A:0xfc380800
y.create.l HWIO_BIMC_HFSC_STATUS_ADDR A:0xfc38080c
y.create.l HWIO_BIMC_HFSC_STAGE1_CTRL_ADDR A:0xfc380840
y.create.l HWIO_BIMC_HFSC_STAGE2_CTRL_ADDR A:0xfc380860
y.create.l HWIO_BIMC_BRIC_GLOBAL1_COMPONENT_INFO_ADDR A:0xfc381000
y.create.l HWIO_BIMC_BRIC_HW_INFO_ADDR A:0xfc381010
y.create.l HWIO_BIMC_BRIC_CONFIGURATION_INFO_0_ADDR A:0xfc381020
y.create.l HWIO_BIMC_BRIC_CONFIGURATION_INFO_1_ADDR A:0xfc381030
y.create.l HWIO_BIMC_BRIC_INTERRUPT_STATUS_0_ADDR A:0xfc381100
y.create.l HWIO_BIMC_BRIC_INTERRUPT_CLEAR_0_ADDR A:0xfc381108
y.create.l HWIO_BIMC_BRIC_INTERRUPT_ENABLE_0_ADDR A:0xfc38110c
y.create.l HWIO_BIMC_BRIC_INTERRUPT_STATUS_1_ADDR A:0xfc381110
y.create.l HWIO_BIMC_BRIC_INTERRUPT_CLEAR_1_ADDR A:0xfc381118
y.create.l HWIO_BIMC_BRIC_INTERRUPT_ENABLE_1_ADDR A:0xfc38111c
y.create.l HWIO_BIMC_BRIC_INTERRUPT_STATUS_2_ADDR A:0xfc381120
y.create.l HWIO_BIMC_BRIC_INTERRUPT_CLEAR_2_ADDR A:0xfc381128
y.create.l HWIO_BIMC_BRIC_INTERRUPT_ENABLE_2_ADDR A:0xfc38112c
y.create.l HWIO_BIMC_BRIC_INTERRUPT_STATUS_3_ADDR A:0xfc381130
y.create.l HWIO_BIMC_BRIC_INTERRUPT_CLEAR_3_ADDR A:0xfc381138
y.create.l HWIO_BIMC_BRIC_INTERRUPT_ENABLE_3_ADDR A:0xfc38113c
y.create.l HWIO_BIMC_BRIC_REF_TIMER_INTERVAL_ADDR A:0xfc381200
y.create.l HWIO_BIMC_BRIC_DEBUG_SELECT_ADDR A:0xfc381210
y.create.l HWIO_BIMC_BRIC_GLOBAL2_COMPONENT_INFO_ADDR A:0xfc382000
y.create.l HWIO_BIMC_BRIC_DEFAULT_SEGMENT_ADDR A:0xfc3821f0
y.create.l HWIO_BIMC_BRIC_SEGMENT0_ADDR_BASE_A_LOWER_ADDR A:0xfc382200
y.create.l HWIO_BIMC_BRIC_SEGMENT1_ADDR_BASE_A_LOWER_ADDR A:0xfc382280
y.create.l HWIO_BIMC_BRIC_SEGMENT2_ADDR_BASE_A_LOWER_ADDR A:0xfc382300
y.create.l HWIO_BIMC_BRIC_SEGMENT0_ADDR_BASE_A_UPPER_ADDR A:0xfc382204
y.create.l HWIO_BIMC_BRIC_SEGMENT1_ADDR_BASE_A_UPPER_ADDR A:0xfc382284
y.create.l HWIO_BIMC_BRIC_SEGMENT2_ADDR_BASE_A_UPPER_ADDR A:0xfc382304
y.create.l HWIO_BIMC_BRIC_SEGMENT0_ADDR_MASK_A_LOWER_ADDR A:0xfc382208
y.create.l HWIO_BIMC_BRIC_SEGMENT1_ADDR_MASK_A_LOWER_ADDR A:0xfc382288
y.create.l HWIO_BIMC_BRIC_SEGMENT2_ADDR_MASK_A_LOWER_ADDR A:0xfc382308
y.create.l HWIO_BIMC_BRIC_SEGMENT0_ADDR_MASK_A_UPPER_ADDR A:0xfc38220c
y.create.l HWIO_BIMC_BRIC_SEGMENT1_ADDR_MASK_A_UPPER_ADDR A:0xfc38228c
y.create.l HWIO_BIMC_BRIC_SEGMENT2_ADDR_MASK_A_UPPER_ADDR A:0xfc38230c
y.create.l HWIO_BIMC_BRIC_SEGMENT0_ADDR_BASE_B_LOWER_ADDR A:0xfc382210
y.create.l HWIO_BIMC_BRIC_SEGMENT1_ADDR_BASE_B_LOWER_ADDR A:0xfc382290
y.create.l HWIO_BIMC_BRIC_SEGMENT2_ADDR_BASE_B_LOWER_ADDR A:0xfc382310
y.create.l HWIO_BIMC_BRIC_SEGMENT0_ADDR_BASE_B_UPPER_ADDR A:0xfc382214
y.create.l HWIO_BIMC_BRIC_SEGMENT1_ADDR_BASE_B_UPPER_ADDR A:0xfc382294
y.create.l HWIO_BIMC_BRIC_SEGMENT2_ADDR_BASE_B_UPPER_ADDR A:0xfc382314
y.create.l HWIO_BIMC_BRIC_SEGMENT0_ADDR_MASK_B_LOWER_ADDR A:0xfc382218
y.create.l HWIO_BIMC_BRIC_SEGMENT1_ADDR_MASK_B_LOWER_ADDR A:0xfc382298
y.create.l HWIO_BIMC_BRIC_SEGMENT2_ADDR_MASK_B_LOWER_ADDR A:0xfc382318
y.create.l HWIO_BIMC_BRIC_SEGMENT0_ADDR_MASK_B_UPPER_ADDR A:0xfc38221c
y.create.l HWIO_BIMC_BRIC_SEGMENT1_ADDR_MASK_B_UPPER_ADDR A:0xfc38229c
y.create.l HWIO_BIMC_BRIC_SEGMENT2_ADDR_MASK_B_UPPER_ADDR A:0xfc38231c
y.create.l HWIO_BIMC_BRIC_SEGMENT0_ADDR_BASE_C_LOWER_ADDR A:0xfc382220
y.create.l HWIO_BIMC_BRIC_SEGMENT1_ADDR_BASE_C_LOWER_ADDR A:0xfc3822a0
y.create.l HWIO_BIMC_BRIC_SEGMENT2_ADDR_BASE_C_LOWER_ADDR A:0xfc382320
y.create.l HWIO_BIMC_BRIC_SEGMENT0_ADDR_BASE_C_UPPER_ADDR A:0xfc382224
y.create.l HWIO_BIMC_BRIC_SEGMENT1_ADDR_BASE_C_UPPER_ADDR A:0xfc3822a4
y.create.l HWIO_BIMC_BRIC_SEGMENT2_ADDR_BASE_C_UPPER_ADDR A:0xfc382324
y.create.l HWIO_BIMC_BRIC_SEGMENT0_ADDR_MASK_C_LOWER_ADDR A:0xfc382228
y.create.l HWIO_BIMC_BRIC_SEGMENT1_ADDR_MASK_C_LOWER_ADDR A:0xfc3822a8
y.create.l HWIO_BIMC_BRIC_SEGMENT2_ADDR_MASK_C_LOWER_ADDR A:0xfc382328
y.create.l HWIO_BIMC_BRIC_SEGMENT0_ADDR_MASK_C_UPPER_ADDR A:0xfc38222c
y.create.l HWIO_BIMC_BRIC_SEGMENT1_ADDR_MASK_C_UPPER_ADDR A:0xfc3822ac
y.create.l HWIO_BIMC_BRIC_SEGMENT2_ADDR_MASK_C_UPPER_ADDR A:0xfc38232c
y.create.l HWIO_BIMC_CONFIG_APU_XPU_SCR_ADDR A:0xfc384000
y.create.l HWIO_BIMC_CONFIG_APU_XPU_SWDR_ADDR A:0xfc384004
y.create.l HWIO_BIMC_CONFIG_APU_XPU_SEAR0_ADDR A:0xfc384040
y.create.l HWIO_BIMC_CONFIG_APU_XPU_SESR_ADDR A:0xfc384048
y.create.l HWIO_BIMC_CONFIG_APU_XPU_SESRRESTORE_ADDR A:0xfc38404c
y.create.l HWIO_BIMC_CONFIG_APU_XPU_SESYNR0_ADDR A:0xfc384050
y.create.l HWIO_BIMC_CONFIG_APU_XPU_SESYNR1_ADDR A:0xfc384054
y.create.l HWIO_BIMC_CONFIG_APU_XPU_SESYNR2_ADDR A:0xfc384058
y.create.l HWIO_BIMC_CONFIG_APU_XPU_MCR_ADDR A:0xfc384100
y.create.l HWIO_BIMC_CONFIG_APU_XPU_MEAR0_ADDR A:0xfc384140
y.create.l HWIO_BIMC_CONFIG_APU_XPU_MESR_ADDR A:0xfc384148
y.create.l HWIO_BIMC_CONFIG_APU_XPU_MESRRESTORE_ADDR A:0xfc38414c
y.create.l HWIO_BIMC_CONFIG_APU_XPU_MESYNR0_ADDR A:0xfc384150
y.create.l HWIO_BIMC_CONFIG_APU_XPU_MESYNR1_ADDR A:0xfc384154
y.create.l HWIO_BIMC_CONFIG_APU_XPU_MESYNR2_ADDR A:0xfc384158
y.create.l HWIO_BIMC_CONFIG_APU_XPU_CR_ADDR A:0xfc384080
y.create.l HWIO_BIMC_CONFIG_APU_XPU_RPU_ACR0_ADDR A:0xfc3840a0
y.create.l HWIO_BIMC_CONFIG_APU_XPU_EAR0_ADDR A:0xfc3840c0
y.create.l HWIO_BIMC_CONFIG_APU_XPU_ESR_ADDR A:0xfc3840c8
y.create.l HWIO_BIMC_CONFIG_APU_XPU_ESRRESTORE_ADDR A:0xfc3840cc
y.create.l HWIO_BIMC_CONFIG_APU_XPU_ESYNR0_ADDR A:0xfc3840d0
y.create.l HWIO_BIMC_CONFIG_APU_XPU_ESYNR1_ADDR A:0xfc3840d4
y.create.l HWIO_BIMC_CONFIG_APU_XPU_ESYNR2_ADDR A:0xfc3840d8
y.create.l HWIO_BIMC_CONFIG_APU_XPU_IDR0_ADDR A:0xfc384074
y.create.l HWIO_BIMC_CONFIG_APU_XPU_IDR1_ADDR A:0xfc384078
y.create.l HWIO_BIMC_CONFIG_APU_XPU_REV_ADDR A:0xfc38407c
y.create.l HWIO_BIMC_CONFIG_APU_XPU_RG0_RACR0_ADDR A:0xfc384200
y.create.l HWIO_BIMC_CONFIG_APU_XPU_RG1_RACR0_ADDR A:0xfc384280
y.create.l HWIO_BIMC_CONFIG_APU_XPU_RG2_RACR0_ADDR A:0xfc384300
y.create.l HWIO_BIMC_CONFIG_APU_XPU_RG3_RACR0_ADDR A:0xfc384380
y.create.l HWIO_BIMC_CONFIG_APU_XPU_RG4_RACR0_ADDR A:0xfc384400
y.create.l HWIO_BIMC_CONFIG_APU_XPU_RG5_RACR0_ADDR A:0xfc384480
y.create.l HWIO_BIMC_CONFIG_APU_XPU_RG6_RACR0_ADDR A:0xfc384500
y.create.l HWIO_BIMC_CONFIG_APU_XPU_RG7_RACR0_ADDR A:0xfc384580
y.create.l HWIO_BIMC_CONFIG_APU_XPU_RG8_RACR0_ADDR A:0xfc384600
y.create.l HWIO_BIMC_CONFIG_APU_XPU_RG9_RACR0_ADDR A:0xfc384680
y.create.l HWIO_BIMC_CONFIG_APU_XPU_RG0_WACR0_ADDR A:0xfc384220
y.create.l HWIO_BIMC_CONFIG_APU_XPU_RG1_WACR0_ADDR A:0xfc3842a0
y.create.l HWIO_BIMC_CONFIG_APU_XPU_RG2_WACR0_ADDR A:0xfc384320
y.create.l HWIO_BIMC_CONFIG_APU_XPU_RG3_WACR0_ADDR A:0xfc3843a0
y.create.l HWIO_BIMC_CONFIG_APU_XPU_RG4_WACR0_ADDR A:0xfc384420
y.create.l HWIO_BIMC_CONFIG_APU_XPU_RG5_WACR0_ADDR A:0xfc3844a0
y.create.l HWIO_BIMC_CONFIG_APU_XPU_RG6_WACR0_ADDR A:0xfc384520
y.create.l HWIO_BIMC_CONFIG_APU_XPU_RG7_WACR0_ADDR A:0xfc3845a0
y.create.l HWIO_BIMC_CONFIG_APU_XPU_RG8_WACR0_ADDR A:0xfc384620
y.create.l HWIO_BIMC_CONFIG_APU_XPU_RG9_WACR0_ADDR A:0xfc3846a0
y.create.l HWIO_BIMC_CONFIG_APU_XPU_RG0_SCR_ADDR A:0xfc384250
y.create.l HWIO_BIMC_CONFIG_APU_XPU_RG1_SCR_ADDR A:0xfc3842d0
y.create.l HWIO_BIMC_CONFIG_APU_XPU_RG2_SCR_ADDR A:0xfc384350
y.create.l HWIO_BIMC_CONFIG_APU_XPU_RG3_SCR_ADDR A:0xfc3843d0
y.create.l HWIO_BIMC_CONFIG_APU_XPU_RG4_SCR_ADDR A:0xfc384450
y.create.l HWIO_BIMC_CONFIG_APU_XPU_RG5_SCR_ADDR A:0xfc3844d0
y.create.l HWIO_BIMC_CONFIG_APU_XPU_RG6_SCR_ADDR A:0xfc384550
y.create.l HWIO_BIMC_CONFIG_APU_XPU_RG7_SCR_ADDR A:0xfc3845d0
y.create.l HWIO_BIMC_CONFIG_APU_XPU_RG8_SCR_ADDR A:0xfc384650
y.create.l HWIO_BIMC_CONFIG_APU_XPU_RG9_SCR_ADDR A:0xfc3846d0
y.create.l HWIO_BIMC_CONFIG_APU_XPU_RG0_MCR_ADDR A:0xfc384254
y.create.l HWIO_BIMC_CONFIG_APU_XPU_RG1_MCR_ADDR A:0xfc3842d4
y.create.l HWIO_BIMC_CONFIG_APU_XPU_RG2_MCR_ADDR A:0xfc384354
y.create.l HWIO_BIMC_CONFIG_APU_XPU_RG3_MCR_ADDR A:0xfc3843d4
y.create.l HWIO_BIMC_CONFIG_APU_XPU_RG4_MCR_ADDR A:0xfc384454
y.create.l HWIO_BIMC_CONFIG_APU_XPU_RG5_MCR_ADDR A:0xfc3844d4
y.create.l HWIO_BIMC_CONFIG_APU_XPU_RG6_MCR_ADDR A:0xfc384554
y.create.l HWIO_BIMC_CONFIG_APU_XPU_RG7_MCR_ADDR A:0xfc3845d4
y.create.l HWIO_BIMC_CONFIG_APU_XPU_RG8_MCR_ADDR A:0xfc384654
y.create.l HWIO_BIMC_CONFIG_APU_XPU_RG9_MCR_ADDR A:0xfc3846d4
y.create.l HWIO_BIMC_PERFMON_COMPONENT_INFO_ADDR A:0xfc383000
y.create.l HWIO_BIMC_PERFMON_CONFIGURATION_INFO_ADDR A:0xfc383020
y.create.l HWIO_BIMC_PERFMON_CLOCK_CTRL_ADDR A:0xfc383200
y.create.l HWIO_BIMC_PERFMON_MODE_ADDR A:0xfc383210
y.create.l HWIO_BIMC_PERFMON_DUMP_ADDR A:0xfc383214
y.create.l HWIO_BIMC_PERFMON_TIMED_MODE_INTERVAL_ADDR A:0xfc383220
y.create.l HWIO_BIMC_PERFMON_TIMED_MODE_ITERATIONS_ADDR A:0xfc383230
y.create.l HWIO_BIMC_PERFMON_STATUS_ADDR A:0xfc3832f0
y.create.l HWIO_BIMC_PERFMON_COUNTER_0_CONFIG_ADDR A:0xfc383300
y.create.l HWIO_BIMC_PERFMON_COUNTER_1_CONFIG_ADDR A:0xfc383310
y.create.l HWIO_BIMC_PERFMON_COUNTER_2_CONFIG_ADDR A:0xfc383320
y.create.l HWIO_BIMC_PERFMON_COUNTER_3_CONFIG_ADDR A:0xfc383330
y.create.l HWIO_BIMC_PERFMON_COUNTER_4_CONFIG_ADDR A:0xfc383340
y.create.l HWIO_BIMC_PERFMON_COUNTER_5_CONFIG_ADDR A:0xfc383350
y.create.l HWIO_BIMC_PERFMON_COUNTER_6_CONFIG_ADDR A:0xfc383360
y.create.l HWIO_BIMC_PERFMON_COUNTER_7_CONFIG_ADDR A:0xfc383370
y.create.l HWIO_BIMC_PERFMON_COUNTER_8_CONFIG_ADDR A:0xfc383380
y.create.l HWIO_BIMC_PERFMON_COUNTER_9_CONFIG_ADDR A:0xfc383390
y.create.l HWIO_BIMC_PERFMON_COUNTER_0_ADDR A:0xfc383308
y.create.l HWIO_BIMC_PERFMON_COUNTER_1_ADDR A:0xfc383318
y.create.l HWIO_BIMC_PERFMON_COUNTER_2_ADDR A:0xfc383328
y.create.l HWIO_BIMC_PERFMON_COUNTER_3_ADDR A:0xfc383338
y.create.l HWIO_BIMC_PERFMON_COUNTER_4_ADDR A:0xfc383348
y.create.l HWIO_BIMC_PERFMON_COUNTER_5_ADDR A:0xfc383358
y.create.l HWIO_BIMC_PERFMON_COUNTER_6_ADDR A:0xfc383368
y.create.l HWIO_BIMC_PERFMON_COUNTER_7_ADDR A:0xfc383378
y.create.l HWIO_BIMC_PERFMON_COUNTER_8_ADDR A:0xfc383388
y.create.l HWIO_BIMC_PERFMON_COUNTER_9_ADDR A:0xfc383398
y.create.l HWIO_BIMC_PERFMON_COUNTER_0_OVERFLOW_ADDR A:0xfc38330c
y.create.l HWIO_BIMC_PERFMON_COUNTER_1_OVERFLOW_ADDR A:0xfc38331c
y.create.l HWIO_BIMC_PERFMON_COUNTER_2_OVERFLOW_ADDR A:0xfc38332c
y.create.l HWIO_BIMC_PERFMON_COUNTER_3_OVERFLOW_ADDR A:0xfc38333c
y.create.l HWIO_BIMC_PERFMON_COUNTER_4_OVERFLOW_ADDR A:0xfc38334c
y.create.l HWIO_BIMC_PERFMON_COUNTER_5_OVERFLOW_ADDR A:0xfc38335c
y.create.l HWIO_BIMC_PERFMON_COUNTER_6_OVERFLOW_ADDR A:0xfc38336c
y.create.l HWIO_BIMC_PERFMON_COUNTER_7_OVERFLOW_ADDR A:0xfc38337c
y.create.l HWIO_BIMC_PERFMON_COUNTER_8_OVERFLOW_ADDR A:0xfc38338c
y.create.l HWIO_BIMC_PERFMON_COUNTER_9_OVERFLOW_ADDR A:0xfc38339c
y.create.l HWIO_BIMC_DTE_HW_INFO_ADDR A:0xfc386000
y.create.l HWIO_BIMC_DTE_GLOBAL_CNTL_ADDR A:0xfc386004
y.create.l HWIO_BIMC_DTE_PROGRAM_CNTL_ADDR A:0xfc38600c
y.create.l HWIO_BIMC_DTE_REG_CNTL_ADDR A:0xfc386010
y.create.l HWIO_BIMC_DTE_REG_DATA_ADDR A:0xfc386014
y.create.l HWIO_BIMC_DTE_TEST_STATUS_DDR_ADDR A:0xfc386020
y.create.l HWIO_BIMC_DTE_TEST_STATUS_QSB_ADDR A:0xfc386024
y.create.l HWIO_BIMC_DTE_TEST_MEM_CNTL_ADDR A:0xfc386030
y.create.l HWIO_BIMC_DTE_TEST_MEM_DATA_0_ADDR A:0xfc386038
y.create.l HWIO_BIMC_DTE_TEST_MEM_DATA_1_ADDR A:0xfc38603c
y.create.l HWIO_BIMC_M_APP_MPORT_COMPONENT_INFO_ADDR A:0xfc388000
y.create.l HWIO_BIMC_M_APP_MPORT_CONFIGURATION_INFO_0_ADDR A:0xfc388020
y.create.l HWIO_BIMC_M_APP_MPORT_CONFIGURATION_INFO_1_ADDR A:0xfc388030
y.create.l HWIO_BIMC_M_APP_MPORT_CONFIGURATION_INFO_2_ADDR A:0xfc388040
y.create.l HWIO_BIMC_M_APP_MPORT_CONFIGURATION_INFO_3_ADDR A:0xfc388050
y.create.l HWIO_BIMC_M_APP_MPORT_CONFIGURATION_INFO_4_ADDR A:0xfc388060
y.create.l HWIO_BIMC_M_APP_MPORT_CONFIGURATION_INFO_5_ADDR A:0xfc388070
y.create.l HWIO_BIMC_M_APP_MPORT_INTERRUPT_STATUS_ADDR A:0xfc388100
y.create.l HWIO_BIMC_M_APP_MPORT_INTERRUPT_CLEAR_ADDR A:0xfc388108
y.create.l HWIO_BIMC_M_APP_MPORT_INTERRUPT_ENABLE_ADDR A:0xfc38810c
y.create.l HWIO_BIMC_M_APP_MPORT_CLOCK_CTRL_ADDR A:0xfc388200
y.create.l HWIO_BIMC_M_APP_MPORT_MODE_ADDR A:0xfc388210
y.create.l HWIO_BIMC_M_APP_MPORT_WR_WAY_CROSSING_ADDR A:0xfc388220
y.create.l HWIO_BIMC_M_APP_MPORT_PRIORITYLVL_OVERRIDE_ADDR A:0xfc388230
y.create.l HWIO_BIMC_M_APP_MPORT_READ_COMMAND_OVERRIDE_ADDR A:0xfc388240
y.create.l HWIO_BIMC_M_APP_MPORT_WRITE_COMMAND_OVERRIDE_ADDR A:0xfc388250
y.create.l HWIO_BIMC_M_APP_MPORT_BKE_ENABLE_ADDR A:0xfc388300
y.create.l HWIO_BIMC_M_APP_MPORT_BKE_GRANT_PERIOD_ADDR A:0xfc388304
y.create.l HWIO_BIMC_M_APP_MPORT_BKE_GRANT_COUNT_ADDR A:0xfc388308
y.create.l HWIO_BIMC_M_APP_MPORT_BKE_THRESHOLD_HIGH_ADDR A:0xfc388320
y.create.l HWIO_BIMC_M_APP_MPORT_BKE_THRESHOLD_MEDIUM_ADDR A:0xfc388324
y.create.l HWIO_BIMC_M_APP_MPORT_BKE_THRESHOLD_LOW_ADDR A:0xfc388328
y.create.l HWIO_BIMC_M_APP_MPORT_BKE_HEALTH_0_ADDR A:0xfc388340
y.create.l HWIO_BIMC_M_APP_MPORT_BKE_HEALTH_1_ADDR A:0xfc388344
y.create.l HWIO_BIMC_M_APP_MPORT_BKE_HEALTH_2_ADDR A:0xfc388348
y.create.l HWIO_BIMC_M_APP_MPORT_BKE_HEALTH_3_ADDR A:0xfc38834c
y.create.l HWIO_BIMC_M_APP_MPORT_BUFFER_STATUS_0_ADDR A:0xfc388400
y.create.l HWIO_BIMC_M_APP_MPORT_BUFFER_STATUS_1_ADDR A:0xfc388410
y.create.l HWIO_BIMC_M_MMSS_MPORT_COMPONENT_INFO_ADDR A:0xfc38c000
y.create.l HWIO_BIMC_M_MMSS_MPORT_CONFIGURATION_INFO_0_ADDR A:0xfc38c020
y.create.l HWIO_BIMC_M_MMSS_MPORT_CONFIGURATION_INFO_1_ADDR A:0xfc38c030
y.create.l HWIO_BIMC_M_MMSS_MPORT_CONFIGURATION_INFO_2_ADDR A:0xfc38c040
y.create.l HWIO_BIMC_M_MMSS_MPORT_CONFIGURATION_INFO_3_ADDR A:0xfc38c050
y.create.l HWIO_BIMC_M_MMSS_MPORT_CONFIGURATION_INFO_4_ADDR A:0xfc38c060
y.create.l HWIO_BIMC_M_MMSS_MPORT_CONFIGURATION_INFO_5_ADDR A:0xfc38c070
y.create.l HWIO_BIMC_M_MMSS_MPORT_INTERRUPT_STATUS_ADDR A:0xfc38c100
y.create.l HWIO_BIMC_M_MMSS_MPORT_INTERRUPT_CLEAR_ADDR A:0xfc38c108
y.create.l HWIO_BIMC_M_MMSS_MPORT_INTERRUPT_ENABLE_ADDR A:0xfc38c10c
y.create.l HWIO_BIMC_M_MMSS_MPORT_CLOCK_CTRL_ADDR A:0xfc38c200
y.create.l HWIO_BIMC_M_MMSS_MPORT_MODE_ADDR A:0xfc38c210
y.create.l HWIO_BIMC_M_MMSS_MPORT_WR_WAY_CROSSING_ADDR A:0xfc38c220
y.create.l HWIO_BIMC_M_MMSS_MPORT_PRIORITYLVL_OVERRIDE_ADDR A:0xfc38c230
y.create.l HWIO_BIMC_M_MMSS_MPORT_READ_COMMAND_OVERRIDE_ADDR A:0xfc38c240
y.create.l HWIO_BIMC_M_MMSS_MPORT_WRITE_COMMAND_OVERRIDE_ADDR A:0xfc38c250
y.create.l HWIO_BIMC_M_MMSS_MPORT_BKE_ENABLE_ADDR A:0xfc38c300
y.create.l HWIO_BIMC_M_MMSS_MPORT_BKE_GRANT_PERIOD_ADDR A:0xfc38c304
y.create.l HWIO_BIMC_M_MMSS_MPORT_BKE_GRANT_COUNT_ADDR A:0xfc38c308
y.create.l HWIO_BIMC_M_MMSS_MPORT_BKE_THRESHOLD_HIGH_ADDR A:0xfc38c320
y.create.l HWIO_BIMC_M_MMSS_MPORT_BKE_THRESHOLD_MEDIUM_ADDR A:0xfc38c324
y.create.l HWIO_BIMC_M_MMSS_MPORT_BKE_THRESHOLD_LOW_ADDR A:0xfc38c328
y.create.l HWIO_BIMC_M_MMSS_MPORT_BKE_HEALTH_0_ADDR A:0xfc38c340
y.create.l HWIO_BIMC_M_MMSS_MPORT_BKE_HEALTH_1_ADDR A:0xfc38c344
y.create.l HWIO_BIMC_M_MMSS_MPORT_BKE_HEALTH_2_ADDR A:0xfc38c348
y.create.l HWIO_BIMC_M_MMSS_MPORT_BKE_HEALTH_3_ADDR A:0xfc38c34c
y.create.l HWIO_BIMC_M_MMSS_MPORT_BUFFER_STATUS_0_ADDR A:0xfc38c400
y.create.l HWIO_BIMC_M_MMSS_MPORT_BUFFER_STATUS_1_ADDR A:0xfc38c410
y.create.l HWIO_BIMC_M_SYS_MPORT_COMPONENT_INFO_ADDR A:0xfc390000
y.create.l HWIO_BIMC_M_SYS_MPORT_CONFIGURATION_INFO_0_ADDR A:0xfc390020
y.create.l HWIO_BIMC_M_SYS_MPORT_CONFIGURATION_INFO_1_ADDR A:0xfc390030
y.create.l HWIO_BIMC_M_SYS_MPORT_CONFIGURATION_INFO_2_ADDR A:0xfc390040
y.create.l HWIO_BIMC_M_SYS_MPORT_CONFIGURATION_INFO_3_ADDR A:0xfc390050
y.create.l HWIO_BIMC_M_SYS_MPORT_CONFIGURATION_INFO_4_ADDR A:0xfc390060
y.create.l HWIO_BIMC_M_SYS_MPORT_CONFIGURATION_INFO_5_ADDR A:0xfc390070
y.create.l HWIO_BIMC_M_SYS_MPORT_INTERRUPT_STATUS_ADDR A:0xfc390100
y.create.l HWIO_BIMC_M_SYS_MPORT_INTERRUPT_CLEAR_ADDR A:0xfc390108
y.create.l HWIO_BIMC_M_SYS_MPORT_INTERRUPT_ENABLE_ADDR A:0xfc39010c
y.create.l HWIO_BIMC_M_SYS_MPORT_CLOCK_CTRL_ADDR A:0xfc390200
y.create.l HWIO_BIMC_M_SYS_MPORT_MODE_ADDR A:0xfc390210
y.create.l HWIO_BIMC_M_SYS_MPORT_WR_WAY_CROSSING_ADDR A:0xfc390220
y.create.l HWIO_BIMC_M_SYS_MPORT_PRIORITYLVL_OVERRIDE_ADDR A:0xfc390230
y.create.l HWIO_BIMC_M_SYS_MPORT_READ_COMMAND_OVERRIDE_ADDR A:0xfc390240
y.create.l HWIO_BIMC_M_SYS_MPORT_WRITE_COMMAND_OVERRIDE_ADDR A:0xfc390250
y.create.l HWIO_BIMC_M_SYS_MPORT_BKE_ENABLE_ADDR A:0xfc390300
y.create.l HWIO_BIMC_M_SYS_MPORT_BKE_GRANT_PERIOD_ADDR A:0xfc390304
y.create.l HWIO_BIMC_M_SYS_MPORT_BKE_GRANT_COUNT_ADDR A:0xfc390308
y.create.l HWIO_BIMC_M_SYS_MPORT_BKE_THRESHOLD_HIGH_ADDR A:0xfc390320
y.create.l HWIO_BIMC_M_SYS_MPORT_BKE_THRESHOLD_MEDIUM_ADDR A:0xfc390324
y.create.l HWIO_BIMC_M_SYS_MPORT_BKE_THRESHOLD_LOW_ADDR A:0xfc390328
y.create.l HWIO_BIMC_M_SYS_MPORT_BKE_HEALTH_0_ADDR A:0xfc390340
y.create.l HWIO_BIMC_M_SYS_MPORT_BKE_HEALTH_1_ADDR A:0xfc390344
y.create.l HWIO_BIMC_M_SYS_MPORT_BKE_HEALTH_2_ADDR A:0xfc390348
y.create.l HWIO_BIMC_M_SYS_MPORT_BKE_HEALTH_3_ADDR A:0xfc39034c
y.create.l HWIO_BIMC_M_SYS_MPORT_BUFFER_STATUS_0_ADDR A:0xfc390400
y.create.l HWIO_BIMC_M_SYS_MPORT_BUFFER_STATUS_1_ADDR A:0xfc390410
y.create.l HWIO_BIMC_M_MDSP_MPORT_COMPONENT_INFO_ADDR A:0xfc394000
y.create.l HWIO_BIMC_M_MDSP_MPORT_CONFIGURATION_INFO_0_ADDR A:0xfc394020
y.create.l HWIO_BIMC_M_MDSP_MPORT_CONFIGURATION_INFO_1_ADDR A:0xfc394030
y.create.l HWIO_BIMC_M_MDSP_MPORT_CONFIGURATION_INFO_2_ADDR A:0xfc394040
y.create.l HWIO_BIMC_M_MDSP_MPORT_CONFIGURATION_INFO_3_ADDR A:0xfc394050
y.create.l HWIO_BIMC_M_MDSP_MPORT_CONFIGURATION_INFO_4_ADDR A:0xfc394060
y.create.l HWIO_BIMC_M_MDSP_MPORT_CONFIGURATION_INFO_5_ADDR A:0xfc394070
y.create.l HWIO_BIMC_M_MDSP_MPORT_INTERRUPT_STATUS_ADDR A:0xfc394100
y.create.l HWIO_BIMC_M_MDSP_MPORT_INTERRUPT_CLEAR_ADDR A:0xfc394108
y.create.l HWIO_BIMC_M_MDSP_MPORT_INTERRUPT_ENABLE_ADDR A:0xfc39410c
y.create.l HWIO_BIMC_M_MDSP_MPORT_CLOCK_CTRL_ADDR A:0xfc394200
y.create.l HWIO_BIMC_M_MDSP_MPORT_MODE_ADDR A:0xfc394210
y.create.l HWIO_BIMC_M_MDSP_MPORT_WR_WAY_CROSSING_ADDR A:0xfc394220
y.create.l HWIO_BIMC_M_MDSP_MPORT_PRIORITYLVL_OVERRIDE_ADDR A:0xfc394230
y.create.l HWIO_BIMC_M_MDSP_MPORT_READ_COMMAND_OVERRIDE_ADDR A:0xfc394240
y.create.l HWIO_BIMC_M_MDSP_MPORT_WRITE_COMMAND_OVERRIDE_ADDR A:0xfc394250
y.create.l HWIO_BIMC_M_MDSP_MPORT_BKE_ENABLE_ADDR A:0xfc394300
y.create.l HWIO_BIMC_M_MDSP_MPORT_BKE_GRANT_PERIOD_ADDR A:0xfc394304
y.create.l HWIO_BIMC_M_MDSP_MPORT_BKE_GRANT_COUNT_ADDR A:0xfc394308
y.create.l HWIO_BIMC_M_MDSP_MPORT_BKE_THRESHOLD_HIGH_ADDR A:0xfc394320
y.create.l HWIO_BIMC_M_MDSP_MPORT_BKE_THRESHOLD_MEDIUM_ADDR A:0xfc394324
y.create.l HWIO_BIMC_M_MDSP_MPORT_BKE_THRESHOLD_LOW_ADDR A:0xfc394328
y.create.l HWIO_BIMC_M_MDSP_MPORT_BKE_HEALTH_0_ADDR A:0xfc394340
y.create.l HWIO_BIMC_M_MDSP_MPORT_BKE_HEALTH_1_ADDR A:0xfc394344
y.create.l HWIO_BIMC_M_MDSP_MPORT_BKE_HEALTH_2_ADDR A:0xfc394348
y.create.l HWIO_BIMC_M_MDSP_MPORT_BKE_HEALTH_3_ADDR A:0xfc39434c
y.create.l HWIO_BIMC_M_MDSP_MPORT_BUFFER_STATUS_0_ADDR A:0xfc394400
y.create.l HWIO_BIMC_M_MDSP_MPORT_BUFFER_STATUS_1_ADDR A:0xfc394410
y.create.l HWIO_BIMC_M_ADSP_MPORT_COMPONENT_INFO_ADDR A:0xfc398000
y.create.l HWIO_BIMC_M_ADSP_MPORT_CONFIGURATION_INFO_0_ADDR A:0xfc398020
y.create.l HWIO_BIMC_M_ADSP_MPORT_CONFIGURATION_INFO_1_ADDR A:0xfc398030
y.create.l HWIO_BIMC_M_ADSP_MPORT_CONFIGURATION_INFO_2_ADDR A:0xfc398040
y.create.l HWIO_BIMC_M_ADSP_MPORT_CONFIGURATION_INFO_3_ADDR A:0xfc398050
y.create.l HWIO_BIMC_M_ADSP_MPORT_CONFIGURATION_INFO_4_ADDR A:0xfc398060
y.create.l HWIO_BIMC_M_ADSP_MPORT_CONFIGURATION_INFO_5_ADDR A:0xfc398070
y.create.l HWIO_BIMC_M_ADSP_MPORT_INTERRUPT_STATUS_ADDR A:0xfc398100
y.create.l HWIO_BIMC_M_ADSP_MPORT_INTERRUPT_CLEAR_ADDR A:0xfc398108
y.create.l HWIO_BIMC_M_ADSP_MPORT_INTERRUPT_ENABLE_ADDR A:0xfc39810c
y.create.l HWIO_BIMC_M_ADSP_MPORT_CLOCK_CTRL_ADDR A:0xfc398200
y.create.l HWIO_BIMC_M_ADSP_MPORT_MODE_ADDR A:0xfc398210
y.create.l HWIO_BIMC_M_ADSP_MPORT_WR_WAY_CROSSING_ADDR A:0xfc398220
y.create.l HWIO_BIMC_M_ADSP_MPORT_PRIORITYLVL_OVERRIDE_ADDR A:0xfc398230
y.create.l HWIO_BIMC_M_ADSP_MPORT_READ_COMMAND_OVERRIDE_ADDR A:0xfc398240
y.create.l HWIO_BIMC_M_ADSP_MPORT_WRITE_COMMAND_OVERRIDE_ADDR A:0xfc398250
y.create.l HWIO_BIMC_M_ADSP_MPORT_BKE_ENABLE_ADDR A:0xfc398300
y.create.l HWIO_BIMC_M_ADSP_MPORT_BKE_GRANT_PERIOD_ADDR A:0xfc398304
y.create.l HWIO_BIMC_M_ADSP_MPORT_BKE_GRANT_COUNT_ADDR A:0xfc398308
y.create.l HWIO_BIMC_M_ADSP_MPORT_BKE_THRESHOLD_HIGH_ADDR A:0xfc398320
y.create.l HWIO_BIMC_M_ADSP_MPORT_BKE_THRESHOLD_MEDIUM_ADDR A:0xfc398324
y.create.l HWIO_BIMC_M_ADSP_MPORT_BKE_THRESHOLD_LOW_ADDR A:0xfc398328
y.create.l HWIO_BIMC_M_ADSP_MPORT_BKE_HEALTH_0_ADDR A:0xfc398340
y.create.l HWIO_BIMC_M_ADSP_MPORT_BKE_HEALTH_1_ADDR A:0xfc398344
y.create.l HWIO_BIMC_M_ADSP_MPORT_BKE_HEALTH_2_ADDR A:0xfc398348
y.create.l HWIO_BIMC_M_ADSP_MPORT_BKE_HEALTH_3_ADDR A:0xfc39834c
y.create.l HWIO_BIMC_M_ADSP_MPORT_BUFFER_STATUS_0_ADDR A:0xfc398400
y.create.l HWIO_BIMC_M_ADSP_MPORT_BUFFER_STATUS_1_ADDR A:0xfc398410
y.create.l HWIO_BIMC_M_GPU_MPORT_COMPONENT_INFO_ADDR A:0xfc39c000
y.create.l HWIO_BIMC_M_GPU_MPORT_CONFIGURATION_INFO_0_ADDR A:0xfc39c020
y.create.l HWIO_BIMC_M_GPU_MPORT_CONFIGURATION_INFO_1_ADDR A:0xfc39c030
y.create.l HWIO_BIMC_M_GPU_MPORT_CONFIGURATION_INFO_2_ADDR A:0xfc39c040
y.create.l HWIO_BIMC_M_GPU_MPORT_CONFIGURATION_INFO_3_ADDR A:0xfc39c050
y.create.l HWIO_BIMC_M_GPU_MPORT_CONFIGURATION_INFO_4_ADDR A:0xfc39c060
y.create.l HWIO_BIMC_M_GPU_MPORT_CONFIGURATION_INFO_5_ADDR A:0xfc39c070
y.create.l HWIO_BIMC_M_GPU_MPORT_INTERRUPT_STATUS_ADDR A:0xfc39c100
y.create.l HWIO_BIMC_M_GPU_MPORT_INTERRUPT_CLEAR_ADDR A:0xfc39c108
y.create.l HWIO_BIMC_M_GPU_MPORT_INTERRUPT_ENABLE_ADDR A:0xfc39c10c
y.create.l HWIO_BIMC_M_GPU_MPORT_CLOCK_CTRL_ADDR A:0xfc39c200
y.create.l HWIO_BIMC_M_GPU_MPORT_MODE_ADDR A:0xfc39c210
y.create.l HWIO_BIMC_M_GPU_MPORT_WR_WAY_CROSSING_ADDR A:0xfc39c220
y.create.l HWIO_BIMC_M_GPU_MPORT_PRIORITYLVL_OVERRIDE_ADDR A:0xfc39c230
y.create.l HWIO_BIMC_M_GPU_MPORT_READ_COMMAND_OVERRIDE_ADDR A:0xfc39c240
y.create.l HWIO_BIMC_M_GPU_MPORT_WRITE_COMMAND_OVERRIDE_ADDR A:0xfc39c250
y.create.l HWIO_BIMC_M_GPU_MPORT_BKE_ENABLE_ADDR A:0xfc39c300
y.create.l HWIO_BIMC_M_GPU_MPORT_BKE_GRANT_PERIOD_ADDR A:0xfc39c304
y.create.l HWIO_BIMC_M_GPU_MPORT_BKE_GRANT_COUNT_ADDR A:0xfc39c308
y.create.l HWIO_BIMC_M_GPU_MPORT_BKE_THRESHOLD_HIGH_ADDR A:0xfc39c320
y.create.l HWIO_BIMC_M_GPU_MPORT_BKE_THRESHOLD_MEDIUM_ADDR A:0xfc39c324
y.create.l HWIO_BIMC_M_GPU_MPORT_BKE_THRESHOLD_LOW_ADDR A:0xfc39c328
y.create.l HWIO_BIMC_M_GPU_MPORT_BKE_HEALTH_0_ADDR A:0xfc39c340
y.create.l HWIO_BIMC_M_GPU_MPORT_BKE_HEALTH_1_ADDR A:0xfc39c344
y.create.l HWIO_BIMC_M_GPU_MPORT_BKE_HEALTH_2_ADDR A:0xfc39c348
y.create.l HWIO_BIMC_M_GPU_MPORT_BKE_HEALTH_3_ADDR A:0xfc39c34c
y.create.l HWIO_BIMC_M_GPU_MPORT_BUFFER_STATUS_0_ADDR A:0xfc39c400
y.create.l HWIO_BIMC_M_GPU_MPORT_BUFFER_STATUS_1_ADDR A:0xfc39c410
y.create.l HWIO_BIMC_M_APP_PROF_COMPONENT_INFO_ADDR A:0xfc389000
y.create.l HWIO_BIMC_M_APP_PROF_CONFIGURATION_INFO_0_ADDR A:0xfc389020
y.create.l HWIO_BIMC_M_APP_PROF_CONFIGURATION_INFO_1_ADDR A:0xfc389030
y.create.l HWIO_BIMC_M_APP_PROF_CLOCK_CTRL_ADDR A:0xfc389200
y.create.l HWIO_BIMC_M_APP_PROF_MODE_ADDR A:0xfc389210
y.create.l HWIO_BIMC_M_APP_PROF_RD_TENURE_THRESHOLD_ADDR A:0xfc389214
y.create.l HWIO_BIMC_M_APP_PROF_WR_TENURE_THRESHOLD_ADDR A:0xfc389218
y.create.l HWIO_BIMC_M_APP_PROF_SWAY_SELECT_ADDR A:0xfc389220
y.create.l HWIO_BIMC_M_APP_PROF_MID_MASK_ADDR A:0xfc389230
y.create.l HWIO_BIMC_M_APP_PROF_MID_MATCH_ADDR A:0xfc389234
y.create.l HWIO_BIMC_M_APP_PROF_MID_INV_MATCH_ADDR A:0xfc389238
y.create.l HWIO_BIMC_M_APP_PROF_ADDR_MASK_LOWER_ADDR A:0xfc389240
y.create.l HWIO_BIMC_M_APP_PROF_ADDR_MASK_UPPER_ADDR A:0xfc389244
y.create.l HWIO_BIMC_M_APP_PROF_ADDR_MATCH_LOWER_ADDR A:0xfc389248
y.create.l HWIO_BIMC_M_APP_PROF_ADDR_MATCH_UPPER_ADDR A:0xfc38924c
y.create.l HWIO_BIMC_M_APP_PROF_ADDR_INV_MATCH_ADDR A:0xfc389250
y.create.l HWIO_BIMC_M_APP_PROF_ACH_MASK_0_ADDR A:0xfc389260
y.create.l HWIO_BIMC_M_APP_PROF_ACH_MATCH_0_ADDR A:0xfc389264
y.create.l HWIO_BIMC_M_APP_PROF_ACH_MASK_1_ADDR A:0xfc389270
y.create.l HWIO_BIMC_M_APP_PROF_ACH_MATCH_1_ADDR A:0xfc389274
y.create.l HWIO_BIMC_M_APP_PROF_ACH_INV_MATCH_1_ADDR A:0xfc389278
y.create.l HWIO_BIMC_M_APP_PROF_ACH_MASK_2_ADDR A:0xfc389280
y.create.l HWIO_BIMC_M_APP_PROF_ACH_MATCH_2_ADDR A:0xfc389284
y.create.l HWIO_BIMC_M_APP_PROF_ACH_MASK_3_ADDR A:0xfc389290
y.create.l HWIO_BIMC_M_APP_PROF_ACH_MATCH_3_ADDR A:0xfc389294
y.create.l HWIO_BIMC_M_APP_PROF_ACH_INV_MATCH_3_ADDR A:0xfc389298
y.create.l HWIO_BIMC_M_APP_PROF_ACH_MASK_4_ADDR A:0xfc3892a0
y.create.l HWIO_BIMC_M_APP_PROF_ACH_MATCH_4_ADDR A:0xfc3892a4
y.create.l HWIO_BIMC_M_APP_PROF_ACH_INV_MATCH_4_ADDR A:0xfc3892a8
y.create.l HWIO_BIMC_M_APP_PROF_BCH_MASK_ADDR A:0xfc389300
y.create.l HWIO_BIMC_M_APP_PROF_BCH_MATCH_ADDR A:0xfc389304
y.create.l HWIO_BIMC_M_APP_PROF_BCH_INV_MATCH_ADDR A:0xfc389308
y.create.l HWIO_BIMC_M_APP_PROF_RCH_MASK_ADDR A:0xfc389340
y.create.l HWIO_BIMC_M_APP_PROF_RCH_MATCH_ADDR A:0xfc389344
y.create.l HWIO_BIMC_M_APP_PROF_RCH_INV_MATCH_ADDR A:0xfc389348
y.create.l HWIO_BIMC_M_APP_PROF_RD_STATUS_ADDR A:0xfc389400
y.create.l HWIO_BIMC_M_APP_PROF_WR_STATUS_ADDR A:0xfc389410
y.create.l HWIO_BIMC_M_MMSS_PROF_COMPONENT_INFO_ADDR A:0xfc38d000
y.create.l HWIO_BIMC_M_MMSS_PROF_CONFIGURATION_INFO_0_ADDR A:0xfc38d020
y.create.l HWIO_BIMC_M_MMSS_PROF_CONFIGURATION_INFO_1_ADDR A:0xfc38d030
y.create.l HWIO_BIMC_M_MMSS_PROF_CLOCK_CTRL_ADDR A:0xfc38d200
y.create.l HWIO_BIMC_M_MMSS_PROF_MODE_ADDR A:0xfc38d210
y.create.l HWIO_BIMC_M_MMSS_PROF_RD_TENURE_THRESHOLD_ADDR A:0xfc38d214
y.create.l HWIO_BIMC_M_MMSS_PROF_WR_TENURE_THRESHOLD_ADDR A:0xfc38d218
y.create.l HWIO_BIMC_M_MMSS_PROF_SWAY_SELECT_ADDR A:0xfc38d220
y.create.l HWIO_BIMC_M_MMSS_PROF_MID_MASK_ADDR A:0xfc38d230
y.create.l HWIO_BIMC_M_MMSS_PROF_MID_MATCH_ADDR A:0xfc38d234
y.create.l HWIO_BIMC_M_MMSS_PROF_MID_INV_MATCH_ADDR A:0xfc38d238
y.create.l HWIO_BIMC_M_MMSS_PROF_ADDR_MASK_LOWER_ADDR A:0xfc38d240
y.create.l HWIO_BIMC_M_MMSS_PROF_ADDR_MASK_UPPER_ADDR A:0xfc38d244
y.create.l HWIO_BIMC_M_MMSS_PROF_ADDR_MATCH_LOWER_ADDR A:0xfc38d248
y.create.l HWIO_BIMC_M_MMSS_PROF_ADDR_MATCH_UPPER_ADDR A:0xfc38d24c
y.create.l HWIO_BIMC_M_MMSS_PROF_ADDR_INV_MATCH_ADDR A:0xfc38d250
y.create.l HWIO_BIMC_M_MMSS_PROF_ACH_MASK_0_ADDR A:0xfc38d260
y.create.l HWIO_BIMC_M_MMSS_PROF_ACH_MATCH_0_ADDR A:0xfc38d264
y.create.l HWIO_BIMC_M_MMSS_PROF_ACH_MASK_1_ADDR A:0xfc38d270
y.create.l HWIO_BIMC_M_MMSS_PROF_ACH_MATCH_1_ADDR A:0xfc38d274
y.create.l HWIO_BIMC_M_MMSS_PROF_ACH_INV_MATCH_1_ADDR A:0xfc38d278
y.create.l HWIO_BIMC_M_MMSS_PROF_ACH_MASK_2_ADDR A:0xfc38d280
y.create.l HWIO_BIMC_M_MMSS_PROF_ACH_MATCH_2_ADDR A:0xfc38d284
y.create.l HWIO_BIMC_M_MMSS_PROF_ACH_MASK_3_ADDR A:0xfc38d290
y.create.l HWIO_BIMC_M_MMSS_PROF_ACH_MATCH_3_ADDR A:0xfc38d294
y.create.l HWIO_BIMC_M_MMSS_PROF_ACH_INV_MATCH_3_ADDR A:0xfc38d298
y.create.l HWIO_BIMC_M_MMSS_PROF_ACH_MASK_4_ADDR A:0xfc38d2a0
y.create.l HWIO_BIMC_M_MMSS_PROF_ACH_MATCH_4_ADDR A:0xfc38d2a4
y.create.l HWIO_BIMC_M_MMSS_PROF_ACH_INV_MATCH_4_ADDR A:0xfc38d2a8
y.create.l HWIO_BIMC_M_MMSS_PROF_BCH_MASK_ADDR A:0xfc38d300
y.create.l HWIO_BIMC_M_MMSS_PROF_BCH_MATCH_ADDR A:0xfc38d304
y.create.l HWIO_BIMC_M_MMSS_PROF_BCH_INV_MATCH_ADDR A:0xfc38d308
y.create.l HWIO_BIMC_M_MMSS_PROF_RCH_MASK_ADDR A:0xfc38d340
y.create.l HWIO_BIMC_M_MMSS_PROF_RCH_MATCH_ADDR A:0xfc38d344
y.create.l HWIO_BIMC_M_MMSS_PROF_RCH_INV_MATCH_ADDR A:0xfc38d348
y.create.l HWIO_BIMC_M_MMSS_PROF_RD_STATUS_ADDR A:0xfc38d400
y.create.l HWIO_BIMC_M_MMSS_PROF_WR_STATUS_ADDR A:0xfc38d410
y.create.l HWIO_BIMC_M_SYS_PROF_COMPONENT_INFO_ADDR A:0xfc391000
y.create.l HWIO_BIMC_M_SYS_PROF_CONFIGURATION_INFO_0_ADDR A:0xfc391020
y.create.l HWIO_BIMC_M_SYS_PROF_CONFIGURATION_INFO_1_ADDR A:0xfc391030
y.create.l HWIO_BIMC_M_SYS_PROF_CLOCK_CTRL_ADDR A:0xfc391200
y.create.l HWIO_BIMC_M_SYS_PROF_MODE_ADDR A:0xfc391210
y.create.l HWIO_BIMC_M_SYS_PROF_RD_TENURE_THRESHOLD_ADDR A:0xfc391214
y.create.l HWIO_BIMC_M_SYS_PROF_WR_TENURE_THRESHOLD_ADDR A:0xfc391218
y.create.l HWIO_BIMC_M_SYS_PROF_SWAY_SELECT_ADDR A:0xfc391220
y.create.l HWIO_BIMC_M_SYS_PROF_MID_MASK_ADDR A:0xfc391230
y.create.l HWIO_BIMC_M_SYS_PROF_MID_MATCH_ADDR A:0xfc391234
y.create.l HWIO_BIMC_M_SYS_PROF_MID_INV_MATCH_ADDR A:0xfc391238
y.create.l HWIO_BIMC_M_SYS_PROF_ADDR_MASK_LOWER_ADDR A:0xfc391240
y.create.l HWIO_BIMC_M_SYS_PROF_ADDR_MASK_UPPER_ADDR A:0xfc391244
y.create.l HWIO_BIMC_M_SYS_PROF_ADDR_MATCH_LOWER_ADDR A:0xfc391248
y.create.l HWIO_BIMC_M_SYS_PROF_ADDR_MATCH_UPPER_ADDR A:0xfc39124c
y.create.l HWIO_BIMC_M_SYS_PROF_ADDR_INV_MATCH_ADDR A:0xfc391250
y.create.l HWIO_BIMC_M_SYS_PROF_ACH_MASK_0_ADDR A:0xfc391260
y.create.l HWIO_BIMC_M_SYS_PROF_ACH_MATCH_0_ADDR A:0xfc391264
y.create.l HWIO_BIMC_M_SYS_PROF_ACH_MASK_1_ADDR A:0xfc391270
y.create.l HWIO_BIMC_M_SYS_PROF_ACH_MATCH_1_ADDR A:0xfc391274
y.create.l HWIO_BIMC_M_SYS_PROF_ACH_INV_MATCH_1_ADDR A:0xfc391278
y.create.l HWIO_BIMC_M_SYS_PROF_ACH_MASK_2_ADDR A:0xfc391280
y.create.l HWIO_BIMC_M_SYS_PROF_ACH_MATCH_2_ADDR A:0xfc391284
y.create.l HWIO_BIMC_M_SYS_PROF_ACH_MASK_3_ADDR A:0xfc391290
y.create.l HWIO_BIMC_M_SYS_PROF_ACH_MATCH_3_ADDR A:0xfc391294
y.create.l HWIO_BIMC_M_SYS_PROF_ACH_INV_MATCH_3_ADDR A:0xfc391298
y.create.l HWIO_BIMC_M_SYS_PROF_ACH_MASK_4_ADDR A:0xfc3912a0
y.create.l HWIO_BIMC_M_SYS_PROF_ACH_MATCH_4_ADDR A:0xfc3912a4
y.create.l HWIO_BIMC_M_SYS_PROF_ACH_INV_MATCH_4_ADDR A:0xfc3912a8
y.create.l HWIO_BIMC_M_SYS_PROF_BCH_MASK_ADDR A:0xfc391300
y.create.l HWIO_BIMC_M_SYS_PROF_BCH_MATCH_ADDR A:0xfc391304
y.create.l HWIO_BIMC_M_SYS_PROF_BCH_INV_MATCH_ADDR A:0xfc391308
y.create.l HWIO_BIMC_M_SYS_PROF_RCH_MASK_ADDR A:0xfc391340
y.create.l HWIO_BIMC_M_SYS_PROF_RCH_MATCH_ADDR A:0xfc391344
y.create.l HWIO_BIMC_M_SYS_PROF_RCH_INV_MATCH_ADDR A:0xfc391348
y.create.l HWIO_BIMC_M_SYS_PROF_RD_STATUS_ADDR A:0xfc391400
y.create.l HWIO_BIMC_M_SYS_PROF_WR_STATUS_ADDR A:0xfc391410
y.create.l HWIO_BIMC_M_MDSP_PROF_COMPONENT_INFO_ADDR A:0xfc395000
y.create.l HWIO_BIMC_M_MDSP_PROF_CONFIGURATION_INFO_0_ADDR A:0xfc395020
y.create.l HWIO_BIMC_M_MDSP_PROF_CONFIGURATION_INFO_1_ADDR A:0xfc395030
y.create.l HWIO_BIMC_M_MDSP_PROF_CLOCK_CTRL_ADDR A:0xfc395200
y.create.l HWIO_BIMC_M_MDSP_PROF_MODE_ADDR A:0xfc395210
y.create.l HWIO_BIMC_M_MDSP_PROF_RD_TENURE_THRESHOLD_ADDR A:0xfc395214
y.create.l HWIO_BIMC_M_MDSP_PROF_WR_TENURE_THRESHOLD_ADDR A:0xfc395218
y.create.l HWIO_BIMC_M_MDSP_PROF_SWAY_SELECT_ADDR A:0xfc395220
y.create.l HWIO_BIMC_M_MDSP_PROF_MID_MASK_ADDR A:0xfc395230
y.create.l HWIO_BIMC_M_MDSP_PROF_MID_MATCH_ADDR A:0xfc395234
y.create.l HWIO_BIMC_M_MDSP_PROF_MID_INV_MATCH_ADDR A:0xfc395238
y.create.l HWIO_BIMC_M_MDSP_PROF_ADDR_MASK_LOWER_ADDR A:0xfc395240
y.create.l HWIO_BIMC_M_MDSP_PROF_ADDR_MASK_UPPER_ADDR A:0xfc395244
y.create.l HWIO_BIMC_M_MDSP_PROF_ADDR_MATCH_LOWER_ADDR A:0xfc395248
y.create.l HWIO_BIMC_M_MDSP_PROF_ADDR_MATCH_UPPER_ADDR A:0xfc39524c
y.create.l HWIO_BIMC_M_MDSP_PROF_ADDR_INV_MATCH_ADDR A:0xfc395250
y.create.l HWIO_BIMC_M_MDSP_PROF_ACH_MASK_0_ADDR A:0xfc395260
y.create.l HWIO_BIMC_M_MDSP_PROF_ACH_MATCH_0_ADDR A:0xfc395264
y.create.l HWIO_BIMC_M_MDSP_PROF_ACH_MASK_1_ADDR A:0xfc395270
y.create.l HWIO_BIMC_M_MDSP_PROF_ACH_MATCH_1_ADDR A:0xfc395274
y.create.l HWIO_BIMC_M_MDSP_PROF_ACH_INV_MATCH_1_ADDR A:0xfc395278
y.create.l HWIO_BIMC_M_MDSP_PROF_ACH_MASK_2_ADDR A:0xfc395280
y.create.l HWIO_BIMC_M_MDSP_PROF_ACH_MATCH_2_ADDR A:0xfc395284
y.create.l HWIO_BIMC_M_MDSP_PROF_ACH_MASK_3_ADDR A:0xfc395290
y.create.l HWIO_BIMC_M_MDSP_PROF_ACH_MATCH_3_ADDR A:0xfc395294
y.create.l HWIO_BIMC_M_MDSP_PROF_ACH_INV_MATCH_3_ADDR A:0xfc395298
y.create.l HWIO_BIMC_M_MDSP_PROF_ACH_MASK_4_ADDR A:0xfc3952a0
y.create.l HWIO_BIMC_M_MDSP_PROF_ACH_MATCH_4_ADDR A:0xfc3952a4
y.create.l HWIO_BIMC_M_MDSP_PROF_ACH_INV_MATCH_4_ADDR A:0xfc3952a8
y.create.l HWIO_BIMC_M_MDSP_PROF_BCH_MASK_ADDR A:0xfc395300
y.create.l HWIO_BIMC_M_MDSP_PROF_BCH_MATCH_ADDR A:0xfc395304
y.create.l HWIO_BIMC_M_MDSP_PROF_BCH_INV_MATCH_ADDR A:0xfc395308
y.create.l HWIO_BIMC_M_MDSP_PROF_RCH_MASK_ADDR A:0xfc395340
y.create.l HWIO_BIMC_M_MDSP_PROF_RCH_MATCH_ADDR A:0xfc395344
y.create.l HWIO_BIMC_M_MDSP_PROF_RCH_INV_MATCH_ADDR A:0xfc395348
y.create.l HWIO_BIMC_M_MDSP_PROF_RD_STATUS_ADDR A:0xfc395400
y.create.l HWIO_BIMC_M_MDSP_PROF_WR_STATUS_ADDR A:0xfc395410
y.create.l HWIO_BIMC_M_ADSP_PROF_COMPONENT_INFO_ADDR A:0xfc399000
y.create.l HWIO_BIMC_M_ADSP_PROF_CONFIGURATION_INFO_0_ADDR A:0xfc399020
y.create.l HWIO_BIMC_M_ADSP_PROF_CONFIGURATION_INFO_1_ADDR A:0xfc399030
y.create.l HWIO_BIMC_M_ADSP_PROF_CLOCK_CTRL_ADDR A:0xfc399200
y.create.l HWIO_BIMC_M_ADSP_PROF_MODE_ADDR A:0xfc399210
y.create.l HWIO_BIMC_M_ADSP_PROF_RD_TENURE_THRESHOLD_ADDR A:0xfc399214
y.create.l HWIO_BIMC_M_ADSP_PROF_WR_TENURE_THRESHOLD_ADDR A:0xfc399218
y.create.l HWIO_BIMC_M_ADSP_PROF_SWAY_SELECT_ADDR A:0xfc399220
y.create.l HWIO_BIMC_M_ADSP_PROF_MID_MASK_ADDR A:0xfc399230
y.create.l HWIO_BIMC_M_ADSP_PROF_MID_MATCH_ADDR A:0xfc399234
y.create.l HWIO_BIMC_M_ADSP_PROF_MID_INV_MATCH_ADDR A:0xfc399238
y.create.l HWIO_BIMC_M_ADSP_PROF_ADDR_MASK_LOWER_ADDR A:0xfc399240
y.create.l HWIO_BIMC_M_ADSP_PROF_ADDR_MASK_UPPER_ADDR A:0xfc399244
y.create.l HWIO_BIMC_M_ADSP_PROF_ADDR_MATCH_LOWER_ADDR A:0xfc399248
y.create.l HWIO_BIMC_M_ADSP_PROF_ADDR_MATCH_UPPER_ADDR A:0xfc39924c
y.create.l HWIO_BIMC_M_ADSP_PROF_ADDR_INV_MATCH_ADDR A:0xfc399250
y.create.l HWIO_BIMC_M_ADSP_PROF_ACH_MASK_0_ADDR A:0xfc399260
y.create.l HWIO_BIMC_M_ADSP_PROF_ACH_MATCH_0_ADDR A:0xfc399264
y.create.l HWIO_BIMC_M_ADSP_PROF_ACH_MASK_1_ADDR A:0xfc399270
y.create.l HWIO_BIMC_M_ADSP_PROF_ACH_MATCH_1_ADDR A:0xfc399274
y.create.l HWIO_BIMC_M_ADSP_PROF_ACH_INV_MATCH_1_ADDR A:0xfc399278
y.create.l HWIO_BIMC_M_ADSP_PROF_ACH_MASK_2_ADDR A:0xfc399280
y.create.l HWIO_BIMC_M_ADSP_PROF_ACH_MATCH_2_ADDR A:0xfc399284
y.create.l HWIO_BIMC_M_ADSP_PROF_ACH_MASK_3_ADDR A:0xfc399290
y.create.l HWIO_BIMC_M_ADSP_PROF_ACH_MATCH_3_ADDR A:0xfc399294
y.create.l HWIO_BIMC_M_ADSP_PROF_ACH_INV_MATCH_3_ADDR A:0xfc399298
y.create.l HWIO_BIMC_M_ADSP_PROF_ACH_MASK_4_ADDR A:0xfc3992a0
y.create.l HWIO_BIMC_M_ADSP_PROF_ACH_MATCH_4_ADDR A:0xfc3992a4
y.create.l HWIO_BIMC_M_ADSP_PROF_ACH_INV_MATCH_4_ADDR A:0xfc3992a8
y.create.l HWIO_BIMC_M_ADSP_PROF_BCH_MASK_ADDR A:0xfc399300
y.create.l HWIO_BIMC_M_ADSP_PROF_BCH_MATCH_ADDR A:0xfc399304
y.create.l HWIO_BIMC_M_ADSP_PROF_BCH_INV_MATCH_ADDR A:0xfc399308
y.create.l HWIO_BIMC_M_ADSP_PROF_RCH_MASK_ADDR A:0xfc399340
y.create.l HWIO_BIMC_M_ADSP_PROF_RCH_MATCH_ADDR A:0xfc399344
y.create.l HWIO_BIMC_M_ADSP_PROF_RCH_INV_MATCH_ADDR A:0xfc399348
y.create.l HWIO_BIMC_M_ADSP_PROF_RD_STATUS_ADDR A:0xfc399400
y.create.l HWIO_BIMC_M_ADSP_PROF_WR_STATUS_ADDR A:0xfc399410
y.create.l HWIO_BIMC_M_GPU_PROF_COMPONENT_INFO_ADDR A:0xfc39d000
y.create.l HWIO_BIMC_M_GPU_PROF_CONFIGURATION_INFO_0_ADDR A:0xfc39d020
y.create.l HWIO_BIMC_M_GPU_PROF_CONFIGURATION_INFO_1_ADDR A:0xfc39d030
y.create.l HWIO_BIMC_M_GPU_PROF_CLOCK_CTRL_ADDR A:0xfc39d200
y.create.l HWIO_BIMC_M_GPU_PROF_MODE_ADDR A:0xfc39d210
y.create.l HWIO_BIMC_M_GPU_PROF_RD_TENURE_THRESHOLD_ADDR A:0xfc39d214
y.create.l HWIO_BIMC_M_GPU_PROF_WR_TENURE_THRESHOLD_ADDR A:0xfc39d218
y.create.l HWIO_BIMC_M_GPU_PROF_SWAY_SELECT_ADDR A:0xfc39d220
y.create.l HWIO_BIMC_M_GPU_PROF_MID_MASK_ADDR A:0xfc39d230
y.create.l HWIO_BIMC_M_GPU_PROF_MID_MATCH_ADDR A:0xfc39d234
y.create.l HWIO_BIMC_M_GPU_PROF_MID_INV_MATCH_ADDR A:0xfc39d238
y.create.l HWIO_BIMC_M_GPU_PROF_ADDR_MASK_LOWER_ADDR A:0xfc39d240
y.create.l HWIO_BIMC_M_GPU_PROF_ADDR_MASK_UPPER_ADDR A:0xfc39d244
y.create.l HWIO_BIMC_M_GPU_PROF_ADDR_MATCH_LOWER_ADDR A:0xfc39d248
y.create.l HWIO_BIMC_M_GPU_PROF_ADDR_MATCH_UPPER_ADDR A:0xfc39d24c
y.create.l HWIO_BIMC_M_GPU_PROF_ADDR_INV_MATCH_ADDR A:0xfc39d250
y.create.l HWIO_BIMC_M_GPU_PROF_ACH_MASK_0_ADDR A:0xfc39d260
y.create.l HWIO_BIMC_M_GPU_PROF_ACH_MATCH_0_ADDR A:0xfc39d264
y.create.l HWIO_BIMC_M_GPU_PROF_ACH_MASK_1_ADDR A:0xfc39d270
y.create.l HWIO_BIMC_M_GPU_PROF_ACH_MATCH_1_ADDR A:0xfc39d274
y.create.l HWIO_BIMC_M_GPU_PROF_ACH_INV_MATCH_1_ADDR A:0xfc39d278
y.create.l HWIO_BIMC_M_GPU_PROF_ACH_MASK_2_ADDR A:0xfc39d280
y.create.l HWIO_BIMC_M_GPU_PROF_ACH_MATCH_2_ADDR A:0xfc39d284
y.create.l HWIO_BIMC_M_GPU_PROF_ACH_MASK_3_ADDR A:0xfc39d290
y.create.l HWIO_BIMC_M_GPU_PROF_ACH_MATCH_3_ADDR A:0xfc39d294
y.create.l HWIO_BIMC_M_GPU_PROF_ACH_INV_MATCH_3_ADDR A:0xfc39d298
y.create.l HWIO_BIMC_M_GPU_PROF_ACH_MASK_4_ADDR A:0xfc39d2a0
y.create.l HWIO_BIMC_M_GPU_PROF_ACH_MATCH_4_ADDR A:0xfc39d2a4
y.create.l HWIO_BIMC_M_GPU_PROF_ACH_INV_MATCH_4_ADDR A:0xfc39d2a8
y.create.l HWIO_BIMC_M_GPU_PROF_BCH_MASK_ADDR A:0xfc39d300
y.create.l HWIO_BIMC_M_GPU_PROF_BCH_MATCH_ADDR A:0xfc39d304
y.create.l HWIO_BIMC_M_GPU_PROF_BCH_INV_MATCH_ADDR A:0xfc39d308
y.create.l HWIO_BIMC_M_GPU_PROF_RCH_MASK_ADDR A:0xfc39d340
y.create.l HWIO_BIMC_M_GPU_PROF_RCH_MATCH_ADDR A:0xfc39d344
y.create.l HWIO_BIMC_M_GPU_PROF_RCH_INV_MATCH_ADDR A:0xfc39d348
y.create.l HWIO_BIMC_M_GPU_PROF_RD_STATUS_ADDR A:0xfc39d400
y.create.l HWIO_BIMC_M_GPU_PROF_WR_STATUS_ADDR A:0xfc39d410
y.create.l HWIO_BIMC_S_SYS_SWAY_COMPONENT_INFO_ADDR A:0xfc3d0000
y.create.l HWIO_BIMC_S_SYS_SWAY_CONFIGURATION_INFO_0_ADDR A:0xfc3d0020
y.create.l HWIO_BIMC_S_SYS_SWAY_CONFIGURATION_INFO_1_ADDR A:0xfc3d0030
y.create.l HWIO_BIMC_S_SYS_SWAY_CONFIGURATION_INFO_2_ADDR A:0xfc3d0040
y.create.l HWIO_BIMC_S_SYS_SWAY_CONFIGURATION_INFO_3_ADDR A:0xfc3d0050
y.create.l HWIO_BIMC_S_SYS_SWAY_CONFIGURATION_INFO_4_ADDR A:0xfc3d0060
y.create.l HWIO_BIMC_S_SYS_SWAY_CONFIGURATION_INFO_5_ADDR A:0xfc3d0070
y.create.l HWIO_BIMC_S_SYS_SWAY_CONFIGURATION_INFO_6_ADDR A:0xfc3d0080
y.create.l HWIO_BIMC_S_SYS_SWAY_INTERRUPT_STATUS_ADDR A:0xfc3d0100
y.create.l HWIO_BIMC_S_SYS_SWAY_INTERRUPT_CLEAR_ADDR A:0xfc3d0108
y.create.l HWIO_BIMC_S_SYS_SWAY_INTERRUPT_ENABLE_ADDR A:0xfc3d010c
y.create.l HWIO_BIMC_S_SYS_SWAY_CLOCK_CTRL_ADDR A:0xfc3d0200
y.create.l HWIO_BIMC_S_SYS_SWAY_RCH_SELECT_ADDR A:0xfc3d0210
y.create.l HWIO_BIMC_S_SYS_SWAY_MAX_OUTSTANDING_REQUESTS_ADDR A:0xfc3d0220
y.create.l HWIO_BIMC_S_SYS_SWAY_BUFFER_STATUS_0_ADDR A:0xfc3d0400
y.create.l HWIO_BIMC_S_SYS_SWAY_BUFFER_STATUS_1_ADDR A:0xfc3d0410
y.create.l HWIO_BIMC_S_SYS_SWAY_BUFFER_STATUS_2_ADDR A:0xfc3d0420
y.create.l HWIO_BIMC_S_DEFAULT_SWAY_COMPONENT_INFO_ADDR A:0xfc3d8000
y.create.l HWIO_BIMC_S_DEFAULT_SWAY_CONFIGURATION_INFO_0_ADDR A:0xfc3d8020
y.create.l HWIO_BIMC_S_DEFAULT_SWAY_CONFIGURATION_INFO_1_ADDR A:0xfc3d8030
y.create.l HWIO_BIMC_S_DEFAULT_SWAY_INTERRUPT_STATUS_ADDR A:0xfc3d8100
y.create.l HWIO_BIMC_S_DEFAULT_SWAY_INTERRUPT_CLEAR_ADDR A:0xfc3d8108
y.create.l HWIO_BIMC_S_DEFAULT_SWAY_INTERRUPT_ENABLE_ADDR A:0xfc3d810c
y.create.l HWIO_BIMC_S_DEFAULT_SWAY_DEFAULT_SLAVE_STATUS_0_ADDR A:0xfc3d8400
y.create.l HWIO_BIMC_S_DEFAULT_SWAY_DEFAULT_SLAVE_STATUS_1_ADDR A:0xfc3d8410
y.create.l HWIO_BIMC_S_DEFAULT_SWAY_DEFAULT_SLAVE_STATUS_2_ADDR A:0xfc3d8420
y.create.l HWIO_BIMC_S_DDR0_ARB_COMPONENT_INFO_ADDR A:0xfc3c9000
y.create.l HWIO_BIMC_S_DDR0_ARB_CONFIGURATION_INFO_0_ADDR A:0xfc3c9020
y.create.l HWIO_BIMC_S_DDR0_ARB_CONFIGURATION_INFO_1_ADDR A:0xfc3c9030
y.create.l HWIO_BIMC_S_DDR0_ARB_CLOCK_CTRL_ADDR A:0xfc3c9200
y.create.l HWIO_BIMC_S_DDR0_ARB_MODE_ADDR A:0xfc3c9210
y.create.l HWIO_BIMC_S_SYS_ARB_COMPONENT_INFO_ADDR A:0xfc3d1000
y.create.l HWIO_BIMC_S_SYS_ARB_CONFIGURATION_INFO_0_ADDR A:0xfc3d1020
y.create.l HWIO_BIMC_S_SYS_ARB_CONFIGURATION_INFO_1_ADDR A:0xfc3d1030
y.create.l HWIO_BIMC_S_SYS_ARB_CLOCK_CTRL_ADDR A:0xfc3d1200
y.create.l HWIO_BIMC_S_SYS_ARB_MODE_ADDR A:0xfc3d1210
y.create.l HWIO_BIMC_S_DEFAULT_ARB_COMPONENT_INFO_ADDR A:0xfc3d9000
y.create.l HWIO_BIMC_S_DEFAULT_ARB_CONFIGURATION_INFO_0_ADDR A:0xfc3d9020
y.create.l HWIO_BIMC_S_DEFAULT_ARB_CONFIGURATION_INFO_1_ADDR A:0xfc3d9030
y.create.l HWIO_BIMC_S_DEFAULT_ARB_CLOCK_CTRL_ADDR A:0xfc3d9200
y.create.l HWIO_BIMC_S_DEFAULT_ARB_MODE_ADDR A:0xfc3d9210
y.create.l HWIO_BIMC_S_DDR0_SCMO_COMPONENT_INFO_ADDR A:0xfc3c8000
y.create.l HWIO_BIMC_S_DDR0_SCMO_HW_INFO_ADDR A:0xfc3c8010
y.create.l HWIO_BIMC_S_DDR0_SCMO_CONFIGURATION_INFO_0_ADDR A:0xfc3c8020
y.create.l HWIO_BIMC_S_DDR0_SCMO_CONFIGURATION_INFO_1_ADDR A:0xfc3c8030
y.create.l HWIO_BIMC_S_DDR0_SCMO_CONFIGURATION_INFO_2_ADDR A:0xfc3c8040
y.create.l HWIO_BIMC_S_DDR0_SCMO_CONFIGURATION_INFO_3_ADDR A:0xfc3c8050
y.create.l HWIO_BIMC_S_DDR0_SCMO_CONFIGURATION_INFO_4_ADDR A:0xfc3c8060
y.create.l HWIO_BIMC_S_DDR0_SCMO_CONFIGURATION_INFO_5_ADDR A:0xfc3c8070
y.create.l HWIO_BIMC_S_DDR0_SCMO_CONFIGURATION_INFO_6_ADDR A:0xfc3c8080
y.create.l HWIO_BIMC_S_DDR0_SCMO_INTERRUPT_STATUS_ADDR A:0xfc3c8100
y.create.l HWIO_BIMC_S_DDR0_SCMO_INTERRUPT_CLEAR_ADDR A:0xfc3c8108
y.create.l HWIO_BIMC_S_DDR0_SCMO_INTERRUPT_ENABLE_ADDR A:0xfc3c810c
y.create.l HWIO_BIMC_S_DDR0_SCMO_ESYN_ADDR_ADDR A:0xfc3c8120
y.create.l HWIO_BIMC_S_DDR0_SCMO_ESYN_APACKET_0_ADDR A:0xfc3c8128
y.create.l HWIO_BIMC_S_DDR0_SCMO_ESYN_APACKET_1_ADDR A:0xfc3c812c
y.create.l HWIO_BIMC_S_DDR0_SCMO_CLOCK_CTRL_ADDR A:0xfc3c8200
y.create.l HWIO_BIMC_S_DDR0_SCMO_SLV_INTERLEAVE_CFG_ADDR A:0xfc3c8400
y.create.l HWIO_BIMC_S_DDR0_SCMO_ADDR_BASE_CS0_ADDR A:0xfc3c8410
y.create.l HWIO_BIMC_S_DDR0_SCMO_ADDR_BASE_CS1_ADDR A:0xfc3c8414
y.create.l HWIO_BIMC_S_DDR0_SCMO_ADDR_MAP_CS0_ADDR A:0xfc3c8420
y.create.l HWIO_BIMC_S_DDR0_SCMO_ADDR_MAP_CS1_ADDR A:0xfc3c8424
y.create.l HWIO_BIMC_S_DDR0_SCMO_ADDR_MASK_CS0_ADDR A:0xfc3c8430
y.create.l HWIO_BIMC_S_DDR0_SCMO_ADDR_MASK_CS1_ADDR A:0xfc3c8434
y.create.l HWIO_BIMC_S_DDR0_SCMO_SLV_STATUS_ADDR A:0xfc3c8450
y.create.l HWIO_BIMC_S_DDR0_SCMO_CMD_BUF_CFG_ADDR A:0xfc3c8500
y.create.l HWIO_BIMC_S_DDR0_SCMO_CMD_BUF_STATUS_ADDR A:0xfc3c8520
y.create.l HWIO_BIMC_S_DDR0_SCMO_RCH_SELECT_ADDR A:0xfc3c8540
y.create.l HWIO_BIMC_S_DDR0_SCMO_RCH_BKPR_CFG_ADDR A:0xfc3c8544
y.create.l HWIO_BIMC_S_DDR0_SCMO_RCH_STATUS_ADDR A:0xfc3c8560
y.create.l HWIO_BIMC_S_DDR0_SCMO_WCH_BUF_CFG_ADDR A:0xfc3c8580
y.create.l HWIO_BIMC_S_DDR0_SCMO_WCH_STATUS_ADDR A:0xfc3c85a0
y.create.l HWIO_BIMC_S_DDR0_SCMO_FLUSH_CFG_ADDR A:0xfc3c85c0
y.create.l HWIO_BIMC_S_DDR0_SCMO_FLUSH_CMD_ADDR A:0xfc3c85c4
y.create.l HWIO_BIMC_S_DDR0_SCMO_CMD_OPT_CFG0_ADDR A:0xfc3c8700
y.create.l HWIO_BIMC_S_DDR0_SCMO_CMD_OPT_CFG1_ADDR A:0xfc3c8704
y.create.l HWIO_BIMC_S_DDR0_SCMO_CMD_OPT_CFG2_ADDR A:0xfc3c8708
y.create.l HWIO_BIMC_S_DDR0_SCMO_CMD_OPT_CFG3_ADDR A:0xfc3c870c
y.create.l HWIO_BIMC_S_DDR0_XPU_SCR_ADDR A:0xfc3ca000
y.create.l HWIO_BIMC_S_DDR0_XPU_SWDR_ADDR A:0xfc3ca004
y.create.l HWIO_BIMC_S_DDR0_XPU_PRTN_RACR_SSHADOW_ADDR A:0xfc3ca008
y.create.l HWIO_BIMC_S_DDR0_XPU_PRTN_WACR_SSHADOW_ADDR A:0xfc3ca00c
y.create.l HWIO_BIMC_S_DDR0_XPU_PRTN_START_SSHADOW0_ADDR A:0xfc3ca010
y.create.l HWIO_BIMC_S_DDR0_XPU_PRTN_END_SSHADOW0_ADDR A:0xfc3ca018
y.create.l HWIO_BIMC_S_DDR0_XPU_SEAR0_ADDR A:0xfc3ca040
y.create.l HWIO_BIMC_S_DDR0_XPU_SESR_ADDR A:0xfc3ca048
y.create.l HWIO_BIMC_S_DDR0_XPU_SESRRESTORE_ADDR A:0xfc3ca04c
y.create.l HWIO_BIMC_S_DDR0_XPU_SESYNR0_ADDR A:0xfc3ca050
y.create.l HWIO_BIMC_S_DDR0_XPU_SESYNR1_ADDR A:0xfc3ca054
y.create.l HWIO_BIMC_S_DDR0_XPU_SESYNR2_ADDR A:0xfc3ca058
y.create.l HWIO_BIMC_S_DDR0_XPU_MCR_ADDR A:0xfc3ca100
y.create.l HWIO_BIMC_S_DDR0_XPU_MEAR0_ADDR A:0xfc3ca140
y.create.l HWIO_BIMC_S_DDR0_XPU_MESR_ADDR A:0xfc3ca148
y.create.l HWIO_BIMC_S_DDR0_XPU_MESRRESTORE_ADDR A:0xfc3ca14c
y.create.l HWIO_BIMC_S_DDR0_XPU_MESYNR0_ADDR A:0xfc3ca150
y.create.l HWIO_BIMC_S_DDR0_XPU_MESYNR1_ADDR A:0xfc3ca154
y.create.l HWIO_BIMC_S_DDR0_XPU_MESYNR2_ADDR A:0xfc3ca158
y.create.l HWIO_BIMC_S_DDR0_XPU_CR_ADDR A:0xfc3ca080
y.create.l HWIO_BIMC_S_DDR0_XPU_PRTN_RACR_SHADOW_ADDR A:0xfc3ca088
y.create.l HWIO_BIMC_S_DDR0_XPU_PRTN_WACR_SHADOW_ADDR A:0xfc3ca08c
y.create.l HWIO_BIMC_S_DDR0_XPU_PRTN_START_SHADOW0_ADDR A:0xfc3ca090
y.create.l HWIO_BIMC_S_DDR0_XPU_PRTN_END_SHADOW0_ADDR A:0xfc3ca098
y.create.l HWIO_BIMC_S_DDR0_XPU_RPU_ACR0_ADDR A:0xfc3ca0a0
y.create.l HWIO_BIMC_S_DDR0_XPU_EAR0_ADDR A:0xfc3ca0c0
y.create.l HWIO_BIMC_S_DDR0_XPU_ESR_ADDR A:0xfc3ca0c8
y.create.l HWIO_BIMC_S_DDR0_XPU_ESRRESTORE_ADDR A:0xfc3ca0cc
y.create.l HWIO_BIMC_S_DDR0_XPU_ESYNR0_ADDR A:0xfc3ca0d0
y.create.l HWIO_BIMC_S_DDR0_XPU_ESYNR1_ADDR A:0xfc3ca0d4
y.create.l HWIO_BIMC_S_DDR0_XPU_ESYNR2_ADDR A:0xfc3ca0d8
y.create.l HWIO_BIMC_S_DDR0_XPU_UMR_RACR_ADDR A:0xfc3ca0e0
y.create.l HWIO_BIMC_S_DDR0_XPU_UMR_WACR_ADDR A:0xfc3ca0e4
y.create.l HWIO_BIMC_S_DDR0_XPU_IDR0_ADDR A:0xfc3ca074
y.create.l HWIO_BIMC_S_DDR0_XPU_IDR1_ADDR A:0xfc3ca078
y.create.l HWIO_BIMC_S_DDR0_XPU_REV_ADDR A:0xfc3ca07c
y.create.l HWIO_BIMC_S_DDR0_XPU_PRT0_RACR0_ADDR A:0xfc3ca200
y.create.l HWIO_BIMC_S_DDR0_XPU_PRT1_RACR0_ADDR A:0xfc3ca280
y.create.l HWIO_BIMC_S_DDR0_XPU_PRT2_RACR0_ADDR A:0xfc3ca300
y.create.l HWIO_BIMC_S_DDR0_XPU_PRT3_RACR0_ADDR A:0xfc3ca380
y.create.l HWIO_BIMC_S_DDR0_XPU_PRT4_RACR0_ADDR A:0xfc3ca400
y.create.l HWIO_BIMC_S_DDR0_XPU_PRT5_RACR0_ADDR A:0xfc3ca480
y.create.l HWIO_BIMC_S_DDR0_XPU_PRT6_RACR0_ADDR A:0xfc3ca500
y.create.l HWIO_BIMC_S_DDR0_XPU_PRT7_RACR0_ADDR A:0xfc3ca580
y.create.l HWIO_BIMC_S_DDR0_XPU_PRT8_RACR0_ADDR A:0xfc3ca600
y.create.l HWIO_BIMC_S_DDR0_XPU_PRT9_RACR0_ADDR A:0xfc3ca680
y.create.l HWIO_BIMC_S_DDR0_XPU_PRT0_WACR0_ADDR A:0xfc3ca220
y.create.l HWIO_BIMC_S_DDR0_XPU_PRT1_WACR0_ADDR A:0xfc3ca2a0
y.create.l HWIO_BIMC_S_DDR0_XPU_PRT2_WACR0_ADDR A:0xfc3ca320
y.create.l HWIO_BIMC_S_DDR0_XPU_PRT3_WACR0_ADDR A:0xfc3ca3a0
y.create.l HWIO_BIMC_S_DDR0_XPU_PRT4_WACR0_ADDR A:0xfc3ca420
y.create.l HWIO_BIMC_S_DDR0_XPU_PRT5_WACR0_ADDR A:0xfc3ca4a0
y.create.l HWIO_BIMC_S_DDR0_XPU_PRT6_WACR0_ADDR A:0xfc3ca520
y.create.l HWIO_BIMC_S_DDR0_XPU_PRT7_WACR0_ADDR A:0xfc3ca5a0
y.create.l HWIO_BIMC_S_DDR0_XPU_PRT8_WACR0_ADDR A:0xfc3ca620
y.create.l HWIO_BIMC_S_DDR0_XPU_PRT9_WACR0_ADDR A:0xfc3ca6a0
y.create.l HWIO_BIMC_S_DDR0_XPU_PRT0_START0_ADDR A:0xfc3ca240
y.create.l HWIO_BIMC_S_DDR0_XPU_PRT1_START0_ADDR A:0xfc3ca2c0
y.create.l HWIO_BIMC_S_DDR0_XPU_PRT2_START0_ADDR A:0xfc3ca340
y.create.l HWIO_BIMC_S_DDR0_XPU_PRT3_START0_ADDR A:0xfc3ca3c0
y.create.l HWIO_BIMC_S_DDR0_XPU_PRT4_START0_ADDR A:0xfc3ca440
y.create.l HWIO_BIMC_S_DDR0_XPU_PRT5_START0_ADDR A:0xfc3ca4c0
y.create.l HWIO_BIMC_S_DDR0_XPU_PRT6_START0_ADDR A:0xfc3ca540
y.create.l HWIO_BIMC_S_DDR0_XPU_PRT7_START0_ADDR A:0xfc3ca5c0
y.create.l HWIO_BIMC_S_DDR0_XPU_PRT8_START0_ADDR A:0xfc3ca640
y.create.l HWIO_BIMC_S_DDR0_XPU_PRT9_START0_ADDR A:0xfc3ca6c0
y.create.l HWIO_BIMC_S_DDR0_XPU_PRT0_END0_ADDR A:0xfc3ca248
y.create.l HWIO_BIMC_S_DDR0_XPU_PRT1_END0_ADDR A:0xfc3ca2c8
y.create.l HWIO_BIMC_S_DDR0_XPU_PRT2_END0_ADDR A:0xfc3ca348
y.create.l HWIO_BIMC_S_DDR0_XPU_PRT3_END0_ADDR A:0xfc3ca3c8
y.create.l HWIO_BIMC_S_DDR0_XPU_PRT4_END0_ADDR A:0xfc3ca448
y.create.l HWIO_BIMC_S_DDR0_XPU_PRT5_END0_ADDR A:0xfc3ca4c8
y.create.l HWIO_BIMC_S_DDR0_XPU_PRT6_END0_ADDR A:0xfc3ca548
y.create.l HWIO_BIMC_S_DDR0_XPU_PRT7_END0_ADDR A:0xfc3ca5c8
y.create.l HWIO_BIMC_S_DDR0_XPU_PRT8_END0_ADDR A:0xfc3ca648
y.create.l HWIO_BIMC_S_DDR0_XPU_PRT9_END0_ADDR A:0xfc3ca6c8
y.create.l HWIO_BIMC_S_DDR0_XPU_PRT0_SCR_ADDR A:0xfc3ca250
y.create.l HWIO_BIMC_S_DDR0_XPU_PRT1_SCR_ADDR A:0xfc3ca2d0
y.create.l HWIO_BIMC_S_DDR0_XPU_PRT2_SCR_ADDR A:0xfc3ca350
y.create.l HWIO_BIMC_S_DDR0_XPU_PRT3_SCR_ADDR A:0xfc3ca3d0
y.create.l HWIO_BIMC_S_DDR0_XPU_PRT4_SCR_ADDR A:0xfc3ca450
y.create.l HWIO_BIMC_S_DDR0_XPU_PRT5_SCR_ADDR A:0xfc3ca4d0
y.create.l HWIO_BIMC_S_DDR0_XPU_PRT6_SCR_ADDR A:0xfc3ca550
y.create.l HWIO_BIMC_S_DDR0_XPU_PRT7_SCR_ADDR A:0xfc3ca5d0
y.create.l HWIO_BIMC_S_DDR0_XPU_PRT8_SCR_ADDR A:0xfc3ca650
y.create.l HWIO_BIMC_S_DDR0_XPU_PRT9_SCR_ADDR A:0xfc3ca6d0
y.create.l HWIO_BIMC_S_DDR0_XPU_PRT0_MCR_ADDR A:0xfc3ca254
y.create.l HWIO_BIMC_S_DDR0_XPU_PRT1_MCR_ADDR A:0xfc3ca2d4
y.create.l HWIO_BIMC_S_DDR0_XPU_PRT2_MCR_ADDR A:0xfc3ca354
y.create.l HWIO_BIMC_S_DDR0_XPU_PRT3_MCR_ADDR A:0xfc3ca3d4
y.create.l HWIO_BIMC_S_DDR0_XPU_PRT4_MCR_ADDR A:0xfc3ca454
y.create.l HWIO_BIMC_S_DDR0_XPU_PRT5_MCR_ADDR A:0xfc3ca4d4
y.create.l HWIO_BIMC_S_DDR0_XPU_PRT6_MCR_ADDR A:0xfc3ca554
y.create.l HWIO_BIMC_S_DDR0_XPU_PRT7_MCR_ADDR A:0xfc3ca5d4
y.create.l HWIO_BIMC_S_DDR0_XPU_PRT8_MCR_ADDR A:0xfc3ca654
y.create.l HWIO_BIMC_S_DDR0_XPU_PRT9_MCR_ADDR A:0xfc3ca6d4
y.create.l HWIO_BIMC_S_DDR0_XPU_PRT0_CNTL0_ADDR A:0xfc3ca258
y.create.l HWIO_BIMC_S_DDR0_XPU_PRT1_CNTL0_ADDR A:0xfc3ca2d8
y.create.l HWIO_BIMC_S_DDR0_XPU_PRT2_CNTL0_ADDR A:0xfc3ca358
y.create.l HWIO_BIMC_S_DDR0_XPU_PRT3_CNTL0_ADDR A:0xfc3ca3d8
y.create.l HWIO_BIMC_S_DDR0_XPU_PRT4_CNTL0_ADDR A:0xfc3ca458
y.create.l HWIO_BIMC_S_DDR0_XPU_PRT5_CNTL0_ADDR A:0xfc3ca4d8
y.create.l HWIO_BIMC_S_DDR0_XPU_PRT6_CNTL0_ADDR A:0xfc3ca558
y.create.l HWIO_BIMC_S_DDR0_XPU_PRT7_CNTL0_ADDR A:0xfc3ca5d8
y.create.l HWIO_BIMC_S_DDR0_XPU_PRT8_CNTL0_ADDR A:0xfc3ca658
y.create.l HWIO_BIMC_S_DDR0_XPU_PRT9_CNTL0_ADDR A:0xfc3ca6d8
y.create.l HWIO_BIMC_S_DDR0_XPU_PRT0_CNTL1_ADDR A:0xfc3ca25c
y.create.l HWIO_BIMC_S_DDR0_XPU_PRT1_CNTL1_ADDR A:0xfc3ca2dc
y.create.l HWIO_BIMC_S_DDR0_XPU_PRT2_CNTL1_ADDR A:0xfc3ca35c
y.create.l HWIO_BIMC_S_DDR0_XPU_PRT3_CNTL1_ADDR A:0xfc3ca3dc
y.create.l HWIO_BIMC_S_DDR0_XPU_PRT4_CNTL1_ADDR A:0xfc3ca45c
y.create.l HWIO_BIMC_S_DDR0_XPU_PRT5_CNTL1_ADDR A:0xfc3ca4dc
y.create.l HWIO_BIMC_S_DDR0_XPU_PRT6_CNTL1_ADDR A:0xfc3ca55c
y.create.l HWIO_BIMC_S_DDR0_XPU_PRT7_CNTL1_ADDR A:0xfc3ca5dc
y.create.l HWIO_BIMC_S_DDR0_XPU_PRT8_CNTL1_ADDR A:0xfc3ca65c
y.create.l HWIO_BIMC_S_DDR0_XPU_PRT9_CNTL1_ADDR A:0xfc3ca6dc
y.create.l HWIO_BIMC_S_DDR0_XPU_AMT_RACR_ADDR A:0xfc3ca0e8
y.create.l HWIO_BIMC_S_DDR0_XPU_AMT_WACR_ADDR A:0xfc3ca0ec
y.create.l HWIO_BIMC_S_DDR0_XPU_AMTR0_ADDR A:0xfc3cae80
y.create.l HWIO_BIMC_S_DDR0_XPU_AMTR1_ADDR A:0xfc3cae84
y.create.l HWIO_BIMC_S_DDR0_XPU_AMTR2_ADDR A:0xfc3cae88
y.create.l HWIO_BIMC_S_DDR0_XPU_AMTR3_ADDR A:0xfc3cae8c
y.create.l HWIO_BIMC_S_DDR0_XPU_AMTR4_ADDR A:0xfc3cae90
y.create.l HWIO_BIMC_S_DDR0_XPU_AMTR5_ADDR A:0xfc3cae94
y.create.l HWIO_BIMC_S_DDR0_XPU_AMTR6_ADDR A:0xfc3cae98
y.create.l HWIO_BIMC_S_DDR0_XPU_AMTR7_ADDR A:0xfc3cae9c
y.create.l HWIO_BIMC_S_DDR0_XPU_AMTR8_ADDR A:0xfc3caea0
y.create.l HWIO_BIMC_S_DDR0_XPU_AMTR9_ADDR A:0xfc3caea4
y.create.l HWIO_BIMC_S_DDR0_DPE_HW_INFO_ADDR A:0xfc3cc000
y.create.l HWIO_BIMC_S_DDR0_DPE_CONFIG_0_ADDR A:0xfc3cc010
y.create.l HWIO_BIMC_S_DDR0_DPE_CONFIG_1_ADDR A:0xfc3cc014
y.create.l HWIO_BIMC_S_DDR0_DPE_CONFIG_2_ADDR A:0xfc3cc018
y.create.l HWIO_BIMC_S_DDR0_DPE_CONFIG_3_ADDR A:0xfc3cc01c
y.create.l HWIO_BIMC_S_DDR0_DPE_CONFIG_4_ADDR A:0xfc3cc020
y.create.l HWIO_BIMC_S_DDR0_DPE_CONFIG_5_ADDR A:0xfc3cc024
y.create.l HWIO_BIMC_S_DDR0_DPE_CONFIG_6_ADDR A:0xfc3cc028
y.create.l HWIO_BIMC_S_DDR0_DPE_CONFIG_7_ADDR A:0xfc3cc02c
y.create.l HWIO_BIMC_S_DDR0_DPE_CA_TRAIN_PRE_CS_ADDR A:0xfc3cc050
y.create.l HWIO_BIMC_S_DDR0_DPE_CA_TRAIN_CS_ADDR A:0xfc3cc054
y.create.l HWIO_BIMC_S_DDR0_DPE_CA_TRAIN_POST_CS_ADDR A:0xfc3cc058
y.create.l HWIO_BIMC_S_DDR0_DPE_PWR_CTRL_0_ADDR A:0xfc3cc068
y.create.l HWIO_BIMC_S_DDR0_DPE_OPT_CTRL_0_ADDR A:0xfc3cc078
y.create.l HWIO_BIMC_S_DDR0_DPE_OPT_CTRL_1_ADDR A:0xfc3cc07c
y.create.l HWIO_BIMC_S_DDR0_DPE_DRAM_STATUS_0_ADDR A:0xfc3cc08c
y.create.l HWIO_BIMC_S_DDR0_DPE_MEMC_STATUS_0_ADDR A:0xfc3cc09c
y.create.l HWIO_BIMC_S_DDR0_DPE_MEMC_STATUS_1_ADDR A:0xfc3cc0a0
y.create.l HWIO_BIMC_S_DDR0_DPE_MEMC_STATUS_2_ADDR A:0xfc3cc0a4
y.create.l HWIO_BIMC_S_DDR0_DPE_INTERRUPT_ENABLE_ADDR A:0xfc3cc0b4
y.create.l HWIO_BIMC_S_DDR0_DPE_INTERRUPT_STATUS_ADDR A:0xfc3cc0b8
y.create.l HWIO_BIMC_S_DDR0_DPE_INTERRUPT_CLR_ADDR A:0xfc3cc0bc
y.create.l HWIO_BIMC_S_DDR0_DPE_INTERRUPT_SET_ADDR A:0xfc3cc0c0
y.create.l HWIO_BIMC_S_DDR0_DPE_ELEVATE_PRI_RD_ADDR A:0xfc3cc0d0
y.create.l HWIO_BIMC_S_DDR0_DPE_ELEVATE_PRI_WR_ADDR A:0xfc3cc0d4
y.create.l HWIO_BIMC_S_DDR0_DPE_TIMER_0_ADDR A:0xfc3cc0e4
y.create.l HWIO_BIMC_S_DDR0_DPE_TIMER_1_ADDR A:0xfc3cc0e8
y.create.l HWIO_BIMC_S_DDR0_DPE_TIMER_2_ADDR A:0xfc3cc0ec
y.create.l HWIO_BIMC_S_DDR0_DPE_TIMER_3_ADDR A:0xfc3cc0f0
y.create.l HWIO_BIMC_S_DDR0_DPE_MRW_BEFORE_FREQ_SWITCH_0_ADDR A:0xfc3cc114
y.create.l HWIO_BIMC_S_DDR0_DPE_MRW_BEFORE_FREQ_SWITCH_1_ADDR A:0xfc3cc118
y.create.l HWIO_BIMC_S_DDR0_DPE_MRW_BEFORE_FREQ_SWITCH_2_ADDR A:0xfc3cc11c
y.create.l HWIO_BIMC_S_DDR0_DPE_MRW_BEFORE_FREQ_SWITCH_3_ADDR A:0xfc3cc120
y.create.l HWIO_BIMC_S_DDR0_DPE_MRW_AFTER_FREQ_SWITCH_0_ADDR A:0xfc3cc124
y.create.l HWIO_BIMC_S_DDR0_DPE_MRW_AFTER_FREQ_SWITCH_1_ADDR A:0xfc3cc128
y.create.l HWIO_BIMC_S_DDR0_DPE_MRW_AFTER_FREQ_SWITCH_2_ADDR A:0xfc3cc12c
y.create.l HWIO_BIMC_S_DDR0_DPE_MRW_AFTER_FREQ_SWITCH_3_ADDR A:0xfc3cc130
y.create.l HWIO_BIMC_S_DDR0_DPE_MRW_FREQ_SWITCH_ADDR A:0xfc3cc134
y.create.l HWIO_BIMC_S_DDR0_DPE_DRAM_TIMING_0_ADDR A:0xfc3cc144
y.create.l HWIO_BIMC_S_DDR0_DPE_DRAM_TIMING_1_ADDR A:0xfc3cc148
y.create.l HWIO_BIMC_S_DDR0_DPE_DRAM_TIMING_2_ADDR A:0xfc3cc14c
y.create.l HWIO_BIMC_S_DDR0_DPE_DRAM_TIMING_3_ADDR A:0xfc3cc150
y.create.l HWIO_BIMC_S_DDR0_DPE_DRAM_TIMING_4_ADDR A:0xfc3cc154
y.create.l HWIO_BIMC_S_DDR0_DPE_DRAM_TIMING_5_ADDR A:0xfc3cc158
y.create.l HWIO_BIMC_S_DDR0_DPE_DRAM_TIMING_6_ADDR A:0xfc3cc15c
y.create.l HWIO_BIMC_S_DDR0_DPE_DRAM_TIMING_7_ADDR A:0xfc3cc160
y.create.l HWIO_BIMC_S_DDR0_DPE_DRAM_TIMING_8_ADDR A:0xfc3cc164
y.create.l HWIO_BIMC_S_DDR0_DPE_DRAM_TIMING_9_ADDR A:0xfc3cc168
y.create.l HWIO_BIMC_S_DDR0_DPE_DRAM_TIMING_10_ADDR A:0xfc3cc16c
y.create.l HWIO_BIMC_S_DDR0_DPE_DRAM_TIMING_11_ADDR A:0xfc3cc170
y.create.l HWIO_BIMC_S_DDR0_DPE_DRAM_TIMING_12_ADDR A:0xfc3cc174
y.create.l HWIO_BIMC_S_DDR0_DPE_DRAM_TIMING_13_ADDR A:0xfc3cc178
y.create.l HWIO_BIMC_S_DDR0_DPE_DRAM_TIMING_14_ADDR A:0xfc3cc17c
y.create.l HWIO_BIMC_S_DDR0_DPE_DRAM_TIMING_15_ADDR A:0xfc3cc180
y.create.l HWIO_BIMC_S_DDR0_DPE_DRAM_TIMING_16_ADDR A:0xfc3cc184
y.create.l HWIO_BIMC_S_DDR0_DPE_DRAM_TIMING_17_ADDR A:0xfc3cc188
y.create.l HWIO_BIMC_S_DDR0_DPE_DRAM_TIMING_0_ACT_ADDR A:0xfc3cc1a4
y.create.l HWIO_BIMC_S_DDR0_DPE_DRAM_TIMING_1_ACT_ADDR A:0xfc3cc1a8
y.create.l HWIO_BIMC_S_DDR0_DPE_DRAM_TIMING_2_ACT_ADDR A:0xfc3cc1ac
y.create.l HWIO_BIMC_S_DDR0_DPE_DRAM_TIMING_3_ACT_ADDR A:0xfc3cc1b0
y.create.l HWIO_BIMC_S_DDR0_DPE_DRAM_TIMING_4_ACT_ADDR A:0xfc3cc1b4
y.create.l HWIO_BIMC_S_DDR0_DPE_DRAM_TIMING_5_ACT_ADDR A:0xfc3cc1b8
y.create.l HWIO_BIMC_S_DDR0_DPE_DRAM_TIMING_6_ACT_ADDR A:0xfc3cc1bc
y.create.l HWIO_BIMC_S_DDR0_DPE_DRAM_TIMING_7_ACT_ADDR A:0xfc3cc1c0
y.create.l HWIO_BIMC_S_DDR0_DPE_DRAM_TIMING_8_ACT_ADDR A:0xfc3cc1c4
y.create.l HWIO_BIMC_S_DDR0_DPE_DRAM_TIMING_9_ACT_ADDR A:0xfc3cc1c8
y.create.l HWIO_BIMC_S_DDR0_DPE_DRAM_TIMING_10_ACT_ADDR A:0xfc3cc1cc
y.create.l HWIO_BIMC_S_DDR0_DPE_DRAM_TIMING_11_ACT_ADDR A:0xfc3cc1d0
y.create.l HWIO_BIMC_S_DDR0_DPE_DRAM_TIMING_12_ACT_ADDR A:0xfc3cc1d4
y.create.l HWIO_BIMC_S_DDR0_DPE_DRAM_TIMING_13_ACT_ADDR A:0xfc3cc1d8
y.create.l HWIO_BIMC_S_DDR0_DPE_DRAM_TIMING_14_ACT_ADDR A:0xfc3cc1dc
y.create.l HWIO_BIMC_S_DDR0_DPE_DRAM_TIMING_15_ACT_ADDR A:0xfc3cc1e0
y.create.l HWIO_BIMC_S_DDR0_DPE_DRAM_TIMING_16_ACT_ADDR A:0xfc3cc1e4
y.create.l HWIO_BIMC_S_DDR0_DPE_DRAM_TIMING_17_ACT_ADDR A:0xfc3cc1e8
y.create.l HWIO_BIMC_S_DDR0_DPE_TESTBUS_CTRL_ADDR A:0xfc3cc204
y.create.l HWIO_BIMC_S_DDR0_DPE_SPARE_REG_ADDR A:0xfc3cc214
y.create.l HWIO_BIMC_S_DDR0_DPE_SPARE_REG_ACT_ADDR A:0xfc3cc224
y.create.l HWIO_BIMC_S_DDR0_DPE_CGC_CTRL_ADDR A:0xfc3cc2fc
y.create.l HWIO_BIMC_S_DDR0_DPE_PMON_EN_ADDR A:0xfc3cc300
y.create.l HWIO_BIMC_S_DDR0_DPE_PMON_CFG_ADDR A:0xfc3cc304
y.create.l HWIO_BIMC_S_DDR0_DPE_PMON_CMD_QUEUED_0_ADDR A:0xfc3cc310
y.create.l HWIO_BIMC_S_DDR0_DPE_PMON_CMD_QUEUED_1_ADDR A:0xfc3cc314
y.create.l HWIO_BIMC_S_DDR0_DPE_PMON_CMD_QUEUED_2_ADDR A:0xfc3cc318
y.create.l HWIO_BIMC_S_DDR0_DPE_PMON_CMD_QUEUED_3_ADDR A:0xfc3cc31c
y.create.l HWIO_BIMC_S_DDR0_DPE_PMON_CMD_EXEC_0_ADDR A:0xfc3cc320
y.create.l HWIO_BIMC_S_DDR0_DPE_PMON_CMD_EXEC_1_ADDR A:0xfc3cc324
y.create.l HWIO_BIMC_S_DDR0_DPE_PMON_CMD_EXEC_2_ADDR A:0xfc3cc328
y.create.l HWIO_BIMC_S_DDR0_DPE_PMON_CMD_EXEC_3_ADDR A:0xfc3cc32c
y.create.l HWIO_BIMC_S_DDR0_DPE_PMON_CMD_FLTR_0_ADDR A:0xfc3cc330
y.create.l HWIO_BIMC_S_DDR0_DPE_PMON_CMD_FLTR_1_ADDR A:0xfc3cc334
y.create.l HWIO_BIMC_S_DDR0_DPE_PMON_CMD_FLTR_2_ADDR A:0xfc3cc338
y.create.l HWIO_BIMC_S_DDR0_DPE_PMON_CMD_FLTR_3_ADDR A:0xfc3cc33c
y.create.l HWIO_BIMC_S_DDR0_DPE_PMON_ADDR_FLTR_0_ADDR A:0xfc3cc340
y.create.l HWIO_BIMC_S_DDR0_DPE_PMON_ADDR_FLTR_1_ADDR A:0xfc3cc344
y.create.l HWIO_BIMC_S_DDR0_DPE_PMON_ADDR_FLTR_2_ADDR A:0xfc3cc348
y.create.l HWIO_BIMC_S_DDR0_DPE_PMON_ADDR_FLTR_3_ADDR A:0xfc3cc34c
y.create.l HWIO_BIMC_S_DDR0_DPE_PMON_MID_FLTR_0_ADDR A:0xfc3cc350
y.create.l HWIO_BIMC_S_DDR0_DPE_PMON_MID_FLTR_1_ADDR A:0xfc3cc354
y.create.l HWIO_BIMC_S_DDR0_DPE_PMON_LAT_LIM_0_ADDR A:0xfc3cc360
y.create.l HWIO_BIMC_S_DDR0_DPE_PMON_LAT_LIM_1_ADDR A:0xfc3cc364
y.create.l HWIO_BIMC_S_DDR0_DPE_PMON_LAT_LIM_2_ADDR A:0xfc3cc368
y.create.l HWIO_BIMC_S_DDR0_DPE_PMON_LAT_LIM_3_ADDR A:0xfc3cc36c
y.create.l HWIO_BIMC_S_DDR0_DPE_PMON_PRI_FLTR_0_ADDR A:0xfc3cc370
y.create.l HWIO_BIMC_S_DDR0_DPE_PMON_PRI_FLTR_1_ADDR A:0xfc3cc374
y.create.l HWIO_BIMC_S_DDR0_DPE_PMON_PRI_FLTR_2_ADDR A:0xfc3cc378
y.create.l HWIO_BIMC_S_DDR0_DPE_PMON_PRI_FLTR_3_ADDR A:0xfc3cc37c
y.create.l HWIO_BIMC_S_DDR0_DPE_PMON_CMDQ_0_ADDR A:0xfc3cc380
y.create.l HWIO_BIMC_S_DDR0_DPE_PMON_CMDQ_1_ADDR A:0xfc3cc384
y.create.l HWIO_BIMC_S_DDR0_DPE_PMON_WRBUF_0_ADDR A:0xfc3cc388
y.create.l HWIO_BIMC_S_DDR0_DPE_PMON_WRBUF_1_ADDR A:0xfc3cc38c
y.create.l HWIO_BIMC_S_DDR0_DPE_PMON_DDR_CMD_0_ADDR A:0xfc3cc390
y.create.l HWIO_BIMC_S_DDR0_DPE_PMON_DDR_CMD_1_ADDR A:0xfc3cc394
y.create.l HWIO_BIMC_S_DDR0_DPE_PMON_DDR_CMD_2_ADDR A:0xfc3cc398
y.create.l HWIO_BIMC_S_DDR0_DPE_PMON_DDR_CMD_3_ADDR A:0xfc3cc39c
y.create.l HWIO_BIMC_S_DDR0_DPE_PMON_DDR_DATA_0_ADDR A:0xfc3cc3a0
y.create.l HWIO_BIMC_S_DDR0_DPE_PMON_DDR_DATA_1_ADDR A:0xfc3cc3a4
y.create.l HWIO_BIMC_S_DDR0_DPE_PMON_RANK_STATE_0_ADDR A:0xfc3cc3b0
y.create.l HWIO_BIMC_S_DDR0_DPE_PMON_RANK_STATE_1_ADDR A:0xfc3cc3b4
y.create.l HWIO_BIMC_S_DDR0_DPE_PMON_RANK_STATE_2_ADDR A:0xfc3cc3b8
y.create.l HWIO_BIMC_S_DDR0_DPE_PMON_RANK_STATE_3_ADDR A:0xfc3cc3bc
y.create.l HWIO_BIMC_S_DDR0_DPE_PMON_SHKE_0_ADDR A:0xfc3cc3c0
y.create.l HWIO_BIMC_S_DDR0_DPE_PMON_SHKE_1_ADDR A:0xfc3cc3c4
y.create.l HWIO_BIMC_S_DDR0_DPE_PMON_SHKE_2_ADDR A:0xfc3cc3c8
y.create.l HWIO_BIMC_S_DDR0_DPE_PMON_SHKE_3_ADDR A:0xfc3cc3cc
y.create.l HWIO_BIMC_S_DDR0_DPE_PMON_SHKE_4_ADDR A:0xfc3cc3d0
y.create.l HWIO_BIMC_S_DDR0_DPE_PMON_SHKE_5_ADDR A:0xfc3cc3d4
y.create.l HWIO_BIMC_S_DDR0_DPE_PMON_SHKE_6_ADDR A:0xfc3cc3d8
y.create.l HWIO_BIMC_S_DDR0_DPE_PMON_SHKE_7_ADDR A:0xfc3cc3dc
y.create.l HWIO_BIMC_S_DDR0_SHKE_HW_INFO_ADDR A:0xfc3cd000
y.create.l HWIO_BIMC_S_DDR0_SHKE_CONFIG_ADDR A:0xfc3cd004
y.create.l HWIO_BIMC_S_DDR0_SHKE_CGC_CNTL_ADDR A:0xfc3cd010
y.create.l HWIO_BIMC_S_DDR0_SHKE_DRAM_MANUAL_0_ADDR A:0xfc3cd020
y.create.l HWIO_BIMC_S_DDR0_SHKE_DRAM_MANUAL_1_ADDR A:0xfc3cd024
y.create.l HWIO_BIMC_S_DDR0_SHKE_MREG_ADDR_WDATA_CNTL_ADDR A:0xfc3cd030
y.create.l HWIO_BIMC_S_DDR0_SHKE_MREG_RDATA_RANK1_U_ADDR A:0xfc3cd050
y.create.l HWIO_BIMC_S_DDR0_SHKE_MREG_RDATA_RANK1_L_ADDR A:0xfc3cd054
y.create.l HWIO_BIMC_S_DDR0_SHKE_MREG_RDATA_RANK0_U_ADDR A:0xfc3cd060
y.create.l HWIO_BIMC_S_DDR0_SHKE_MREG_RDATA_RANK0_L_ADDR A:0xfc3cd064
y.create.l HWIO_BIMC_S_DDR0_SHKE_MREG_RDATA_STATUS_ADDR A:0xfc3cd070
y.create.l HWIO_BIMC_S_DDR0_SHKE_DRAM_STATUS_ADDR A:0xfc3cd074
y.create.l HWIO_BIMC_S_DDR0_SHKE_DRAM_DEBUG_CMD_0_ADDR A:0xfc3cd080
y.create.l HWIO_BIMC_S_DDR0_SHKE_DRAM_DEBUG_CMD_1_ADDR A:0xfc3cd084
y.create.l HWIO_BIMC_S_DDR0_SHKE_DRAM_DEBUG_CMD_2_ADDR A:0xfc3cd088
y.create.l HWIO_BIMC_S_DDR0_SHKE_PERIODIC_MRR_ADDR A:0xfc3cd0a0
y.create.l HWIO_BIMC_S_DDR0_SHKE_PERIODIC_MRR_RDATA_RANK1_U_ADDR A:0xfc3cd0b0
y.create.l HWIO_BIMC_S_DDR0_SHKE_PERIODIC_MRR_RDATA_RANK1_L_ADDR A:0xfc3cd0b4
y.create.l HWIO_BIMC_S_DDR0_SHKE_PERIODIC_MRR_RDATA_RANK0_U_ADDR A:0xfc3cd0b8
y.create.l HWIO_BIMC_S_DDR0_SHKE_PERIODIC_MRR_RDATA_RANK0_L_ADDR A:0xfc3cd0bc
y.create.l HWIO_BIMC_S_DDR0_SHKE_PERIODIC_ZQCAL_ADDR A:0xfc3cd0d0
y.create.l HWIO_BIMC_S_DDR0_SHKE_AUTO_REFRESH_CNTL_ADDR A:0xfc3cd0f0
y.create.l HWIO_BIMC_S_DDR0_SHKE_SELF_REFRESH_CNTL_ADDR A:0xfc3cd0f4
y.create.l HWIO_BIMC_S_DDR0_SHKE_AUTO_REFRESH_CNTL_1_ADDR A:0xfc3cd100
y.create.l HWIO_BIMC_S_DDR0_SHKE_AUTO_REFRESH_CNTL_2_ADDR A:0xfc3cd104
y.create.l HWIO_BIMC_S_DDR0_SHKE_TESTBUS_CNTL_ADDR A:0xfc3cd114
y.create.l HWIO_BIMC_S_DDR0_SHKE_SPARE_REG_ADDR A:0xfc3cd130
y.create.l HWIO_BOOT_ROM_XPU_SCR_ADDR A:0xfc0ff000
y.create.l HWIO_BOOT_ROM_XPU_SWDR_ADDR A:0xfc0ff004
y.create.l HWIO_BOOT_ROM_XPU_PRTN_RACR_SSHADOW_ADDR A:0xfc0ff008
y.create.l HWIO_BOOT_ROM_XPU_PRTN_START_SSHADOW0_ADDR A:0xfc0ff010
y.create.l HWIO_BOOT_ROM_XPU_PRTN_END_SSHADOW0_ADDR A:0xfc0ff018
y.create.l HWIO_BOOT_ROM_XPU_SEAR0_ADDR A:0xfc0ff040
y.create.l HWIO_BOOT_ROM_XPU_SESR_ADDR A:0xfc0ff048
y.create.l HWIO_BOOT_ROM_XPU_SESRRESTORE_ADDR A:0xfc0ff04c
y.create.l HWIO_BOOT_ROM_XPU_SESYNR0_ADDR A:0xfc0ff050
y.create.l HWIO_BOOT_ROM_XPU_SESYNR1_ADDR A:0xfc0ff054
y.create.l HWIO_BOOT_ROM_XPU_SESYNR2_ADDR A:0xfc0ff058
y.create.l HWIO_BOOT_ROM_XPU_MCR_ADDR A:0xfc0ff100
y.create.l HWIO_BOOT_ROM_XPU_MEAR0_ADDR A:0xfc0ff140
y.create.l HWIO_BOOT_ROM_XPU_MESR_ADDR A:0xfc0ff148
y.create.l HWIO_BOOT_ROM_XPU_MESRRESTORE_ADDR A:0xfc0ff14c
y.create.l HWIO_BOOT_ROM_XPU_MESYNR0_ADDR A:0xfc0ff150
y.create.l HWIO_BOOT_ROM_XPU_MESYNR1_ADDR A:0xfc0ff154
y.create.l HWIO_BOOT_ROM_XPU_MESYNR2_ADDR A:0xfc0ff158
y.create.l HWIO_BOOT_ROM_XPU_CR_ADDR A:0xfc0ff080
y.create.l HWIO_BOOT_ROM_XPU_PRTN_RACR_SHADOW_ADDR A:0xfc0ff088
y.create.l HWIO_BOOT_ROM_XPU_PRTN_START_SHADOW0_ADDR A:0xfc0ff090
y.create.l HWIO_BOOT_ROM_XPU_PRTN_END_SHADOW0_ADDR A:0xfc0ff098
y.create.l HWIO_BOOT_ROM_XPU_RPU_ACR0_ADDR A:0xfc0ff0a0
y.create.l HWIO_BOOT_ROM_XPU_EAR0_ADDR A:0xfc0ff0c0
y.create.l HWIO_BOOT_ROM_XPU_ESR_ADDR A:0xfc0ff0c8
y.create.l HWIO_BOOT_ROM_XPU_ESRRESTORE_ADDR A:0xfc0ff0cc
y.create.l HWIO_BOOT_ROM_XPU_ESYNR0_ADDR A:0xfc0ff0d0
y.create.l HWIO_BOOT_ROM_XPU_ESYNR1_ADDR A:0xfc0ff0d4
y.create.l HWIO_BOOT_ROM_XPU_ESYNR2_ADDR A:0xfc0ff0d8
y.create.l HWIO_BOOT_ROM_XPU_UMR_RACR_ADDR A:0xfc0ff0e0
y.create.l HWIO_BOOT_ROM_XPU_UMR_WACR_ADDR A:0xfc0ff0e4
y.create.l HWIO_BOOT_ROM_XPU_IDR0_ADDR A:0xfc0ff074
y.create.l HWIO_BOOT_ROM_XPU_IDR1_ADDR A:0xfc0ff078
y.create.l HWIO_BOOT_ROM_XPU_REV_ADDR A:0xfc0ff07c
y.create.l HWIO_BOOT_ROM_XPU_PRT0_RACR0_ADDR A:0xfc0ff200
y.create.l HWIO_BOOT_ROM_XPU_PRT1_RACR0_ADDR A:0xfc0ff280
y.create.l HWIO_BOOT_ROM_XPU_PRT2_RACR0_ADDR A:0xfc0ff300
y.create.l HWIO_BOOT_ROM_XPU_PRT3_RACR0_ADDR A:0xfc0ff380
y.create.l HWIO_BOOT_ROM_XPU_PRT0_START0_ADDR A:0xfc0ff240
y.create.l HWIO_BOOT_ROM_XPU_PRT1_START0_ADDR A:0xfc0ff2c0
y.create.l HWIO_BOOT_ROM_XPU_PRT2_START0_ADDR A:0xfc0ff340
y.create.l HWIO_BOOT_ROM_XPU_PRT3_START0_ADDR A:0xfc0ff3c0
y.create.l HWIO_BOOT_ROM_XPU_PRT0_END0_ADDR A:0xfc0ff248
y.create.l HWIO_BOOT_ROM_XPU_PRT1_END0_ADDR A:0xfc0ff2c8
y.create.l HWIO_BOOT_ROM_XPU_PRT2_END0_ADDR A:0xfc0ff348
y.create.l HWIO_BOOT_ROM_XPU_PRT3_END0_ADDR A:0xfc0ff3c8
y.create.l HWIO_BOOT_ROM_XPU_PRT0_SCR_ADDR A:0xfc0ff250
y.create.l HWIO_BOOT_ROM_XPU_PRT1_SCR_ADDR A:0xfc0ff2d0
y.create.l HWIO_BOOT_ROM_XPU_PRT2_SCR_ADDR A:0xfc0ff350
y.create.l HWIO_BOOT_ROM_XPU_PRT3_SCR_ADDR A:0xfc0ff3d0
y.create.l HWIO_BOOT_ROM_XPU_PRT0_MCR_ADDR A:0xfc0ff254
y.create.l HWIO_BOOT_ROM_XPU_PRT1_MCR_ADDR A:0xfc0ff2d4
y.create.l HWIO_BOOT_ROM_XPU_PRT2_MCR_ADDR A:0xfc0ff354
y.create.l HWIO_BOOT_ROM_XPU_PRT3_MCR_ADDR A:0xfc0ff3d4
y.create.l HWIO_BOOT_ROM_XPU_PRT0_CNTL0_ADDR A:0xfc0ff258
y.create.l HWIO_BOOT_ROM_XPU_PRT1_CNTL0_ADDR A:0xfc0ff2d8
y.create.l HWIO_BOOT_ROM_XPU_PRT2_CNTL0_ADDR A:0xfc0ff358
y.create.l HWIO_BOOT_ROM_XPU_PRT3_CNTL0_ADDR A:0xfc0ff3d8
y.create.l HWIO_BOOT_ROM_XPU_PRT0_CNTL1_ADDR A:0xfc0ff25c
y.create.l HWIO_BOOT_ROM_XPU_PRT1_CNTL1_ADDR A:0xfc0ff2dc
y.create.l HWIO_BOOT_ROM_XPU_PRT2_CNTL1_ADDR A:0xfc0ff35c
y.create.l HWIO_BOOT_ROM_XPU_PRT3_CNTL1_ADDR A:0xfc0ff3dc
y.create.l HWIO_GCC_GPLL0_MODE_ADDR A:0xfc400000
y.create.l HWIO_GCC_GPLL0_L_VAL_ADDR A:0xfc400004
y.create.l HWIO_GCC_GPLL0_M_VAL_ADDR A:0xfc400008
y.create.l HWIO_GCC_GPLL0_N_VAL_ADDR A:0xfc40000c
y.create.l HWIO_GCC_GPLL0_USER_CTL_ADDR A:0xfc400010
y.create.l HWIO_GCC_GPLL0_CONFIG_CTL_ADDR A:0xfc400014
y.create.l HWIO_GCC_GPLL0_TEST_CTL_ADDR A:0xfc400018
y.create.l HWIO_GCC_GPLL0_STATUS_ADDR A:0xfc40001c
y.create.l HWIO_GCC_GPLL2_MODE_ADDR A:0xfc400080
y.create.l HWIO_GCC_GPLL2_L_VAL_ADDR A:0xfc400084
y.create.l HWIO_GCC_GPLL2_M_VAL_ADDR A:0xfc400088
y.create.l HWIO_GCC_GPLL2_N_VAL_ADDR A:0xfc40008c
y.create.l HWIO_GCC_GPLL2_USER_CTL_ADDR A:0xfc400090
y.create.l HWIO_GCC_GPLL2_CONFIG_CTL_ADDR A:0xfc400094
y.create.l HWIO_GCC_GPLL2_TEST_CTL_ADDR A:0xfc400098
y.create.l HWIO_GCC_GPLL2_STATUS_ADDR A:0xfc40009c
y.create.l HWIO_GCC_GPLL3_MODE_ADDR A:0xfc4000c0
y.create.l HWIO_GCC_GPLL3_L_VAL_ADDR A:0xfc4000c4
y.create.l HWIO_GCC_GPLL3_M_VAL_ADDR A:0xfc4000c8
y.create.l HWIO_GCC_GPLL3_N_VAL_ADDR A:0xfc4000cc
y.create.l HWIO_GCC_GPLL3_USER_CTL_ADDR A:0xfc4000d0
y.create.l HWIO_GCC_GPLL3_CONFIG_CTL_ADDR A:0xfc4000d4
y.create.l HWIO_GCC_GPLL3_TEST_CTL_ADDR A:0xfc4000d8
y.create.l HWIO_GCC_GPLL3_STATUS_ADDR A:0xfc4000dc
y.create.l HWIO_GCC_SYSTEM_NOC_BCR_ADDR A:0xfc400100
y.create.l HWIO_GCC_SYSTEM_NOC_CMD_RCGR_ADDR A:0xfc400120
y.create.l HWIO_GCC_SYSTEM_NOC_CFG_RCGR_ADDR A:0xfc400124
y.create.l HWIO_GCC_SNOC_QOSGEN_EXTREF_CTL_ADDR A:0xfc400138
y.create.l HWIO_GCC_CONFIG_NOC_CMD_RCGR_ADDR A:0xfc400150
y.create.l HWIO_GCC_CONFIG_NOC_CFG_RCGR_ADDR A:0xfc400154
y.create.l HWIO_GCC_PERIPH_NOC_CMD_RCGR_ADDR A:0xfc400190
y.create.l HWIO_GCC_PERIPH_NOC_CFG_RCGR_ADDR A:0xfc400194
y.create.l HWIO_GCC_SYS_NOC_AXI_CBCR_ADDR A:0xfc400104
y.create.l HWIO_GCC_SYS_NOC_QDSS_STM_AXI_CBCR_ADDR A:0xfc40010c
y.create.l HWIO_GCC_SYS_NOC_APCS_AHB_CBCR_ADDR A:0xfc400110
y.create.l HWIO_GCC_SNOC_CNOC_AHB_CBCR_ADDR A:0xfc400114
y.create.l HWIO_GCC_SNOC_PNOC_AHB_CBCR_ADDR A:0xfc400118
y.create.l HWIO_GCC_SYS_NOC_AT_CBCR_ADDR A:0xfc40011c
y.create.l HWIO_GCC_CONFIG_NOC_BCR_ADDR A:0xfc400140
y.create.l HWIO_GCC_CFG_NOC_AHB_CBCR_ADDR A:0xfc400144
y.create.l HWIO_GCC_CFG_NOC_DDR_CFG_CBCR_ADDR A:0xfc400148
y.create.l HWIO_GCC_CFG_NOC_RPM_AHB_CBCR_ADDR A:0xfc40014c
y.create.l HWIO_GCC_LPSS_SMMU_AHB_CBCR_ADDR A:0xfc400158
y.create.l HWIO_GCC_COPSS_SMMU_AHB_CBCR_ADDR A:0xfc40015c
y.create.l HWIO_GCC_PERIPH_NOC_BCR_ADDR A:0xfc400180
y.create.l HWIO_GCC_PERIPH_NOC_AHB_CBCR_ADDR A:0xfc400184
y.create.l HWIO_GCC_PERIPH_NOC_CFG_AHB_CBCR_ADDR A:0xfc400188
y.create.l HWIO_GCC_PERIPH_NOC_AT_CBCR_ADDR A:0xfc40018c
y.create.l HWIO_GCC_NOC_CONF_XPU_AHB_CBCR_ADDR A:0xfc4001c0
y.create.l HWIO_GCC_IMEM_BCR_ADDR A:0xfc400200
y.create.l HWIO_GCC_IMEM_AXI_CBCR_ADDR A:0xfc400204
y.create.l HWIO_GCC_IMEM_CFG_AHB_CBCR_ADDR A:0xfc400208
y.create.l HWIO_GCC_MMSS_BCR_ADDR A:0xfc400240
y.create.l HWIO_GCC_GMEM_SYS_NOC_AXI_CBCR_ADDR A:0xfc400244
y.create.l HWIO_GCC_MMSS_NOC_CFG_AHB_CBCR_ADDR A:0xfc40024c
y.create.l HWIO_GCC_MMSS_NOC_AT_CBCR_ADDR A:0xfc400250
y.create.l HWIO_GCC_MSS_CFG_AHB_CBCR_ADDR A:0xfc400280
y.create.l HWIO_GCC_MSS_Q6_BIMC_AXI_CBCR_ADDR A:0xfc400284
y.create.l HWIO_GCC_QDSS_RBCPR_XPU_AHB_CBCR_ADDR A:0xfc4002c0
y.create.l HWIO_GCC_QDSS_BCR_ADDR A:0xfc400300
y.create.l HWIO_GCC_QDSS_DAP_AHB_CBCR_ADDR A:0xfc400304
y.create.l HWIO_GCC_QDSS_CFG_AHB_CBCR_ADDR A:0xfc400308
y.create.l HWIO_GCC_QDSS_AT_CMD_RCGR_ADDR A:0xfc400340
y.create.l HWIO_GCC_QDSS_AT_CFG_RCGR_ADDR A:0xfc400344
y.create.l HWIO_GCC_QDSS_AT_CBCR_ADDR A:0xfc40030c
y.create.l HWIO_GCC_QDSS_ETR_USB_CBCR_ADDR A:0xfc400310
y.create.l HWIO_GCC_QDSS_STM_CMD_RCGR_ADDR A:0xfc400358
y.create.l HWIO_GCC_QDSS_STM_CFG_RCGR_ADDR A:0xfc40035c
y.create.l HWIO_GCC_QDSS_STM_CBCR_ADDR A:0xfc400314
y.create.l HWIO_GCC_QDSS_TRACECLKIN_CMD_RCGR_ADDR A:0xfc400380
y.create.l HWIO_GCC_QDSS_TRACECLKIN_CFG_RCGR_ADDR A:0xfc400384
y.create.l HWIO_GCC_QDSS_TRACECLKIN_CBCR_ADDR A:0xfc400318
y.create.l HWIO_GCC_QDSS_TSCTR_CMD_RCGR_ADDR A:0xfc400398
y.create.l HWIO_GCC_QDSS_TSCTR_CFG_RCGR_ADDR A:0xfc40039c
y.create.l HWIO_GCC_QDSS_TSCTR_DIV2_CBCR_ADDR A:0xfc40031c
y.create.l HWIO_GCC_QDSS_TSCTR_DIV3_CBCR_ADDR A:0xfc400320
y.create.l HWIO_GCC_QDSS_DAP_CBCR_ADDR A:0xfc400324
y.create.l HWIO_GCC_QDSS_TSCTR_DIV4_CBCR_ADDR A:0xfc400328
y.create.l HWIO_GCC_QDSS_TSCTR_DIV8_CBCR_ADDR A:0xfc40032c
y.create.l HWIO_GCC_QDSS_TSCTR_DIV16_CBCR_ADDR A:0xfc400330
y.create.l HWIO_GCC_GCC_SLEEP_CMD_RCGR_ADDR A:0xfc4010d0
y.create.l HWIO_GCC_USB_HS_BCR_ADDR A:0xfc400480
y.create.l HWIO_GCC_USB_HS_SYSTEM_CBCR_ADDR A:0xfc400484
y.create.l HWIO_GCC_USB_HS_AHB_CBCR_ADDR A:0xfc400488
y.create.l HWIO_GCC_USB_HS_INACTIVITY_TIMERS_CBCR_ADDR A:0xfc40048c
y.create.l HWIO_GCC_USB_HS_SYSTEM_CMD_RCGR_ADDR A:0xfc400490
y.create.l HWIO_GCC_USB_HS_SYSTEM_CFG_RCGR_ADDR A:0xfc400494
y.create.l HWIO_GCC_USB2A_PHY_BCR_ADDR A:0xfc4004a8
y.create.l HWIO_GCC_USB2A_PHY_SLEEP_CBCR_ADDR A:0xfc4004ac
y.create.l HWIO_GCC_SDCC1_BCR_ADDR A:0xfc4004c0
y.create.l HWIO_GCC_SDCC1_APPS_CMD_RCGR_ADDR A:0xfc4004d0
y.create.l HWIO_GCC_SDCC1_APPS_CFG_RCGR_ADDR A:0xfc4004d4
y.create.l HWIO_GCC_SDCC1_APPS_M_ADDR A:0xfc4004d8
y.create.l HWIO_GCC_SDCC1_APPS_N_ADDR A:0xfc4004dc
y.create.l HWIO_GCC_SDCC1_APPS_D_ADDR A:0xfc4004e0
y.create.l HWIO_GCC_SDCC1_APPS_CBCR_ADDR A:0xfc4004c4
y.create.l HWIO_GCC_SDCC1_AHB_CBCR_ADDR A:0xfc4004c8
y.create.l HWIO_GCC_SDCC1_INACTIVITY_TIMERS_CBCR_ADDR A:0xfc4004cc
y.create.l HWIO_GCC_SDCC2_BCR_ADDR A:0xfc400500
y.create.l HWIO_GCC_SDCC2_APPS_CMD_RCGR_ADDR A:0xfc400510
y.create.l HWIO_GCC_SDCC2_APPS_CFG_RCGR_ADDR A:0xfc400514
y.create.l HWIO_GCC_SDCC2_APPS_M_ADDR A:0xfc400518
y.create.l HWIO_GCC_SDCC2_APPS_N_ADDR A:0xfc40051c
y.create.l HWIO_GCC_SDCC2_APPS_D_ADDR A:0xfc400520
y.create.l HWIO_GCC_SDCC2_APPS_CBCR_ADDR A:0xfc400504
y.create.l HWIO_GCC_SDCC2_AHB_CBCR_ADDR A:0xfc400508
y.create.l HWIO_GCC_SDCC2_INACTIVITY_TIMERS_CBCR_ADDR A:0xfc40050c
y.create.l HWIO_GCC_BLSP1_BCR_ADDR A:0xfc4005c0
y.create.l HWIO_GCC_BLSP1_SLEEP_CBCR_ADDR A:0xfc4005c8
y.create.l HWIO_GCC_BLSP1_AHB_CBCR_ADDR A:0xfc4005c4
y.create.l HWIO_GCC_BLSP1_QUP1_BCR_ADDR A:0xfc400640
y.create.l HWIO_GCC_BLSP1_QUP1_SPI_APPS_CBCR_ADDR A:0xfc400644
y.create.l HWIO_GCC_BLSP1_QUP1_I2C_APPS_CBCR_ADDR A:0xfc400648
y.create.l HWIO_GCC_BLSP1_QUP1_SPI_APPS_CMD_RCGR_ADDR A:0xfc40064c
y.create.l HWIO_GCC_BLSP1_QUP1_SPI_APPS_CFG_RCGR_ADDR A:0xfc400650
y.create.l HWIO_GCC_BLSP1_QUP1_SPI_APPS_M_ADDR A:0xfc400654
y.create.l HWIO_GCC_BLSP1_QUP1_SPI_APPS_N_ADDR A:0xfc400658
y.create.l HWIO_GCC_BLSP1_QUP1_SPI_APPS_D_ADDR A:0xfc40065c
y.create.l HWIO_GCC_BLSP1_UART1_BCR_ADDR A:0xfc400680
y.create.l HWIO_GCC_BLSP1_UART1_APPS_CBCR_ADDR A:0xfc400684
y.create.l HWIO_GCC_BLSP1_UART1_SIM_CBCR_ADDR A:0xfc400688
y.create.l HWIO_GCC_BLSP1_UART1_APPS_CMD_RCGR_ADDR A:0xfc40068c
y.create.l HWIO_GCC_BLSP1_UART1_APPS_CFG_RCGR_ADDR A:0xfc400690
y.create.l HWIO_GCC_BLSP1_UART1_APPS_M_ADDR A:0xfc400694
y.create.l HWIO_GCC_BLSP1_UART1_APPS_N_ADDR A:0xfc400698
y.create.l HWIO_GCC_BLSP1_UART1_APPS_D_ADDR A:0xfc40069c
y.create.l HWIO_GCC_BLSP1_QUP2_BCR_ADDR A:0xfc4006c0
y.create.l HWIO_GCC_BLSP1_QUP2_SPI_APPS_CBCR_ADDR A:0xfc4006c4
y.create.l HWIO_GCC_BLSP1_QUP2_I2C_APPS_CBCR_ADDR A:0xfc4006c8
y.create.l HWIO_GCC_BLSP1_QUP2_SPI_APPS_CMD_RCGR_ADDR A:0xfc4006cc
y.create.l HWIO_GCC_BLSP1_QUP2_SPI_APPS_CFG_RCGR_ADDR A:0xfc4006d0
y.create.l HWIO_GCC_BLSP1_QUP2_SPI_APPS_M_ADDR A:0xfc4006d4
y.create.l HWIO_GCC_BLSP1_QUP2_SPI_APPS_N_ADDR A:0xfc4006d8
y.create.l HWIO_GCC_BLSP1_QUP2_SPI_APPS_D_ADDR A:0xfc4006dc
y.create.l HWIO_GCC_BLSP1_UART2_BCR_ADDR A:0xfc400700
y.create.l HWIO_GCC_BLSP1_UART2_APPS_CBCR_ADDR A:0xfc400704
y.create.l HWIO_GCC_BLSP1_UART2_SIM_CBCR_ADDR A:0xfc400708
y.create.l HWIO_GCC_BLSP1_UART2_APPS_CMD_RCGR_ADDR A:0xfc40070c
y.create.l HWIO_GCC_BLSP1_UART2_APPS_CFG_RCGR_ADDR A:0xfc400710
y.create.l HWIO_GCC_BLSP1_UART2_APPS_M_ADDR A:0xfc400714
y.create.l HWIO_GCC_BLSP1_UART2_APPS_N_ADDR A:0xfc400718
y.create.l HWIO_GCC_BLSP1_UART2_APPS_D_ADDR A:0xfc40071c
y.create.l HWIO_GCC_BLSP1_QUP3_BCR_ADDR A:0xfc400740
y.create.l HWIO_GCC_BLSP1_QUP3_SPI_APPS_CBCR_ADDR A:0xfc400744
y.create.l HWIO_GCC_BLSP1_QUP3_I2C_APPS_CBCR_ADDR A:0xfc400748
y.create.l HWIO_GCC_BLSP1_QUP3_SPI_APPS_CMD_RCGR_ADDR A:0xfc40074c
y.create.l HWIO_GCC_BLSP1_QUP3_SPI_APPS_CFG_RCGR_ADDR A:0xfc400750
y.create.l HWIO_GCC_BLSP1_QUP3_SPI_APPS_M_ADDR A:0xfc400754
y.create.l HWIO_GCC_BLSP1_QUP3_SPI_APPS_N_ADDR A:0xfc400758
y.create.l HWIO_GCC_BLSP1_QUP3_SPI_APPS_D_ADDR A:0xfc40075c
y.create.l HWIO_GCC_BLSP1_UART3_BCR_ADDR A:0xfc400780
y.create.l HWIO_GCC_BLSP1_UART3_APPS_CBCR_ADDR A:0xfc400784
y.create.l HWIO_GCC_BLSP1_UART3_SIM_CBCR_ADDR A:0xfc400788
y.create.l HWIO_GCC_BLSP1_UART3_APPS_CMD_RCGR_ADDR A:0xfc40078c
y.create.l HWIO_GCC_BLSP1_UART3_APPS_CFG_RCGR_ADDR A:0xfc400790
y.create.l HWIO_GCC_BLSP1_UART3_APPS_M_ADDR A:0xfc400794
y.create.l HWIO_GCC_BLSP1_UART3_APPS_N_ADDR A:0xfc400798
y.create.l HWIO_GCC_BLSP1_UART3_APPS_D_ADDR A:0xfc40079c
y.create.l HWIO_GCC_BLSP1_QUP4_BCR_ADDR A:0xfc4007c0
y.create.l HWIO_GCC_BLSP1_QUP4_SPI_APPS_CBCR_ADDR A:0xfc4007c4
y.create.l HWIO_GCC_BLSP1_QUP4_I2C_APPS_CBCR_ADDR A:0xfc4007c8
y.create.l HWIO_GCC_BLSP1_QUP4_SPI_APPS_CMD_RCGR_ADDR A:0xfc4007cc
y.create.l HWIO_GCC_BLSP1_QUP4_SPI_APPS_CFG_RCGR_ADDR A:0xfc4007d0
y.create.l HWIO_GCC_BLSP1_QUP4_SPI_APPS_M_ADDR A:0xfc4007d4
y.create.l HWIO_GCC_BLSP1_QUP4_SPI_APPS_N_ADDR A:0xfc4007d8
y.create.l HWIO_GCC_BLSP1_QUP4_SPI_APPS_D_ADDR A:0xfc4007dc
y.create.l HWIO_GCC_BLSP1_UART4_BCR_ADDR A:0xfc400800
y.create.l HWIO_GCC_BLSP1_UART4_APPS_CBCR_ADDR A:0xfc400804
y.create.l HWIO_GCC_BLSP1_UART4_SIM_CBCR_ADDR A:0xfc400808
y.create.l HWIO_GCC_BLSP1_UART4_APPS_CMD_RCGR_ADDR A:0xfc40080c
y.create.l HWIO_GCC_BLSP1_UART4_APPS_CFG_RCGR_ADDR A:0xfc400810
y.create.l HWIO_GCC_BLSP1_UART4_APPS_M_ADDR A:0xfc400814
y.create.l HWIO_GCC_BLSP1_UART4_APPS_N_ADDR A:0xfc400818
y.create.l HWIO_GCC_BLSP1_UART4_APPS_D_ADDR A:0xfc40081c
y.create.l HWIO_GCC_BLSP1_QUP5_BCR_ADDR A:0xfc400840
y.create.l HWIO_GCC_BLSP1_QUP5_SPI_APPS_CBCR_ADDR A:0xfc400844
y.create.l HWIO_GCC_BLSP1_QUP5_I2C_APPS_CBCR_ADDR A:0xfc400848
y.create.l HWIO_GCC_BLSP1_QUP5_SPI_APPS_CMD_RCGR_ADDR A:0xfc40084c
y.create.l HWIO_GCC_BLSP1_QUP5_SPI_APPS_CFG_RCGR_ADDR A:0xfc400850
y.create.l HWIO_GCC_BLSP1_QUP5_SPI_APPS_M_ADDR A:0xfc400854
y.create.l HWIO_GCC_BLSP1_QUP5_SPI_APPS_N_ADDR A:0xfc400858
y.create.l HWIO_GCC_BLSP1_QUP5_SPI_APPS_D_ADDR A:0xfc40085c
y.create.l HWIO_GCC_BLSP1_UART5_BCR_ADDR A:0xfc400880
y.create.l HWIO_GCC_BLSP1_UART5_APPS_CBCR_ADDR A:0xfc400884
y.create.l HWIO_GCC_BLSP1_UART5_SIM_CBCR_ADDR A:0xfc400888
y.create.l HWIO_GCC_BLSP1_UART5_APPS_CMD_RCGR_ADDR A:0xfc40088c
y.create.l HWIO_GCC_BLSP1_UART5_APPS_CFG_RCGR_ADDR A:0xfc400890
y.create.l HWIO_GCC_BLSP1_UART5_APPS_M_ADDR A:0xfc400894
y.create.l HWIO_GCC_BLSP1_UART5_APPS_N_ADDR A:0xfc400898
y.create.l HWIO_GCC_BLSP1_UART5_APPS_D_ADDR A:0xfc40089c
y.create.l HWIO_GCC_BLSP1_QUP6_BCR_ADDR A:0xfc4008c0
y.create.l HWIO_GCC_BLSP1_QUP6_SPI_APPS_CBCR_ADDR A:0xfc4008c4
y.create.l HWIO_GCC_BLSP1_QUP6_I2C_APPS_CBCR_ADDR A:0xfc4008c8
y.create.l HWIO_GCC_BLSP1_QUP6_SPI_APPS_CMD_RCGR_ADDR A:0xfc4008cc
y.create.l HWIO_GCC_BLSP1_QUP6_SPI_APPS_CFG_RCGR_ADDR A:0xfc4008d0
y.create.l HWIO_GCC_BLSP1_QUP6_SPI_APPS_M_ADDR A:0xfc4008d4
y.create.l HWIO_GCC_BLSP1_QUP6_SPI_APPS_N_ADDR A:0xfc4008d8
y.create.l HWIO_GCC_BLSP1_QUP6_SPI_APPS_D_ADDR A:0xfc4008dc
y.create.l HWIO_GCC_BLSP1_UART6_BCR_ADDR A:0xfc400900
y.create.l HWIO_GCC_BLSP1_UART6_APPS_CBCR_ADDR A:0xfc400904
y.create.l HWIO_GCC_BLSP1_UART6_SIM_CBCR_ADDR A:0xfc400908
y.create.l HWIO_GCC_BLSP1_UART6_APPS_CMD_RCGR_ADDR A:0xfc40090c
y.create.l HWIO_GCC_BLSP1_UART6_APPS_CFG_RCGR_ADDR A:0xfc400910
y.create.l HWIO_GCC_BLSP1_UART6_APPS_M_ADDR A:0xfc400914
y.create.l HWIO_GCC_BLSP1_UART6_APPS_N_ADDR A:0xfc400918
y.create.l HWIO_GCC_BLSP1_UART6_APPS_D_ADDR A:0xfc40091c
y.create.l HWIO_GCC_BLSP_UART_SIM_CMD_RCGR_ADDR A:0xfc400600
y.create.l HWIO_GCC_BLSP_UART_SIM_CFG_RCGR_ADDR A:0xfc400604
y.create.l HWIO_GCC_PERIPH_XPU_AHB_CBCR_ADDR A:0xfc400c80
y.create.l HWIO_GCC_PDM_BCR_ADDR A:0xfc400cc0
y.create.l HWIO_GCC_PDM_AHB_CBCR_ADDR A:0xfc400cc4
y.create.l HWIO_GCC_PDM_XO4_CBCR_ADDR A:0xfc400cc8
y.create.l HWIO_GCC_PDM2_CBCR_ADDR A:0xfc400ccc
y.create.l HWIO_GCC_PDM2_CMD_RCGR_ADDR A:0xfc400cd0
y.create.l HWIO_GCC_PDM2_CFG_RCGR_ADDR A:0xfc400cd4
y.create.l HWIO_GCC_PRNG_BCR_ADDR A:0xfc400d00
y.create.l HWIO_GCC_PRNG_AHB_CBCR_ADDR A:0xfc400d04
y.create.l HWIO_GCC_TCSR_BCR_ADDR A:0xfc400dc0
y.create.l HWIO_GCC_TCSR_AHB_CBCR_ADDR A:0xfc400dc4
y.create.l HWIO_GCC_BOOT_ROM_BCR_ADDR A:0xfc400e00
y.create.l HWIO_GCC_BOOT_ROM_AHB_CBCR_ADDR A:0xfc400e04
y.create.l HWIO_GCC_MSG_RAM_BCR_ADDR A:0xfc400e40
y.create.l HWIO_GCC_MSG_RAM_AHB_CBCR_ADDR A:0xfc400e44
y.create.l HWIO_GCC_TLMM_BCR_ADDR A:0xfc400e80
y.create.l HWIO_GCC_TLMM_AHB_CBCR_ADDR A:0xfc400e84
y.create.l HWIO_GCC_TLMM_CBCR_ADDR A:0xfc400e88
y.create.l HWIO_GCC_MPM_BCR_ADDR A:0xfc400ec0
y.create.l HWIO_GCC_MPM_MISC_ADDR A:0xfc400ec4
y.create.l HWIO_GCC_MPM_AHB_CBCR_ADDR A:0xfc400ec8
y.create.l HWIO_GCC_RPM_PROC_HCLK_CBCR_ADDR A:0xfc400f00
y.create.l HWIO_GCC_RPM_BUS_AHB_CBCR_ADDR A:0xfc400f04
y.create.l HWIO_GCC_RPM_SLEEP_CBCR_ADDR A:0xfc400f08
y.create.l HWIO_GCC_RPM_TIMER_CBCR_ADDR A:0xfc400f0c
y.create.l HWIO_GCC_RPM_CMD_RCGR_ADDR A:0xfc400f10
y.create.l HWIO_GCC_RPM_CFG_RCGR_ADDR A:0xfc400f14
y.create.l HWIO_GCC_RPM_MISC_ADDR A:0xfc400f24
y.create.l HWIO_GCC_SEC_CTRL_BCR_ADDR A:0xfc400f40
y.create.l HWIO_GCC_ACC_CMD_RCGR_ADDR A:0xfc400f80
y.create.l HWIO_GCC_ACC_CFG_RCGR_ADDR A:0xfc400f84
y.create.l HWIO_GCC_ACC_MISC_ADDR A:0xfc400f94
y.create.l HWIO_GCC_SEC_CTRL_ACC_CBCR_ADDR A:0xfc400f44
y.create.l HWIO_GCC_SEC_CTRL_AHB_CBCR_ADDR A:0xfc400f48
y.create.l HWIO_GCC_SEC_CTRL_CBCR_ADDR A:0xfc400f4c
y.create.l HWIO_GCC_SEC_CTRL_SENSE_CBCR_ADDR A:0xfc400f50
y.create.l HWIO_GCC_SEC_CTRL_BOOT_ROM_PATCH_CBCR_ADDR A:0xfc400f54
y.create.l HWIO_GCC_SEC_CTRL_CMD_RCGR_ADDR A:0xfc400f98
y.create.l HWIO_GCC_SEC_CTRL_CFG_RCGR_ADDR A:0xfc400f9c
y.create.l HWIO_GCC_SPMI_BCR_ADDR A:0xfc400fc0
y.create.l HWIO_GCC_SPMI_SER_CMD_RCGR_ADDR A:0xfc400fd0
y.create.l HWIO_GCC_SPMI_SER_CFG_RCGR_ADDR A:0xfc400fd4
y.create.l HWIO_GCC_SPMI_SER_CBCR_ADDR A:0xfc400fc4
y.create.l HWIO_GCC_SPMI_CNOC_AHB_CBCR_ADDR A:0xfc400fc8
y.create.l HWIO_GCC_SPMI_AHB_CMD_RCGR_ADDR A:0xfc400fe8
y.create.l HWIO_GCC_SPMI_AHB_CFG_RCGR_ADDR A:0xfc400fec
y.create.l HWIO_GCC_SPMI_AHB_CBCR_ADDR A:0xfc400fcc
y.create.l HWIO_GCC_SPDM_BCR_ADDR A:0xfc401000
y.create.l HWIO_GCC_SPDM_CFG_AHB_CBCR_ADDR A:0xfc401004
y.create.l HWIO_GCC_SPDM_MSTR_AHB_CBCR_ADDR A:0xfc401008
y.create.l HWIO_GCC_SPDM_FF_CBCR_ADDR A:0xfc40100c
y.create.l HWIO_GCC_SPDM_BIMC_CY_CBCR_ADDR A:0xfc401010
y.create.l HWIO_GCC_SPDM_SNOC_CY_CBCR_ADDR A:0xfc401014
y.create.l HWIO_GCC_SPDM_DEBUG_CY_CBCR_ADDR A:0xfc401018
y.create.l HWIO_GCC_SPDM_PNOC_CY_CBCR_ADDR A:0xfc40101c
y.create.l HWIO_GCC_SPDM_RPM_CY_CBCR_ADDR A:0xfc401020
y.create.l HWIO_GCC_CE1_BCR_ADDR A:0xfc401040
y.create.l HWIO_GCC_CE1_CMD_RCGR_ADDR A:0xfc401050
y.create.l HWIO_GCC_CE1_CFG_RCGR_ADDR A:0xfc401054
y.create.l HWIO_GCC_CE1_CBCR_ADDR A:0xfc401044
y.create.l HWIO_GCC_CE1_AXI_CBCR_ADDR A:0xfc401048
y.create.l HWIO_GCC_CE1_AHB_CBCR_ADDR A:0xfc40104c
y.create.l HWIO_GCC_GCC_AHB_CBCR_ADDR A:0xfc4010c0
y.create.l HWIO_GCC_GCC_XO_CMD_RCGR_ADDR A:0xfc4010e8
y.create.l HWIO_GCC_GCC_XO_CBCR_ADDR A:0xfc4010c4
y.create.l HWIO_GCC_GCC_XO_DIV4_CBCR_ADDR A:0xfc4010c8
y.create.l HWIO_GCC_GCC_IM_SLEEP_CBCR_ADDR A:0xfc4010cc
y.create.l HWIO_GCC_BIMC_BCR_ADDR A:0xfc401100
y.create.l HWIO_GCC_BIMC_GDSCR_ADDR A:0xfc401104
y.create.l HWIO_GCC_BIMC_DDR_XO_CMD_RCGR_ADDR A:0xfc401140
y.create.l HWIO_GCC_BIMC_XO_CBCR_ADDR A:0xfc401108
y.create.l HWIO_GCC_BIMC_CFG_AHB_CBCR_ADDR A:0xfc40110c
y.create.l HWIO_GCC_BIMC_SLEEP_CBCR_ADDR A:0xfc401110
y.create.l HWIO_GCC_BIMC_SYSNOC_AXI_CBCR_ADDR A:0xfc401114
y.create.l HWIO_GCC_BIMC_DDR_CMD_RCGR_ADDR A:0xfc401158
y.create.l HWIO_GCC_BIMC_DDR_CFG_RCGR_ADDR A:0xfc40115c
y.create.l HWIO_GCC_BIMC_MISC_ADDR A:0xfc40116c
y.create.l HWIO_GCC_BIMC_CBCR_ADDR A:0xfc401118
y.create.l HWIO_GCC_BIMC_APCS_AXI_CBCR_ADDR A:0xfc40111c
y.create.l HWIO_GCC_BIMC_SMMU_CBCR_ADDR A:0xfc401120
y.create.l HWIO_GCC_DDR_DIM_CFG_CBCR_ADDR A:0xfc401180
y.create.l HWIO_GCC_DDR_DIM_SLEEP_CBCR_ADDR A:0xfc40118c
y.create.l HWIO_GCC_LPASS_Q6_AXI_CBCR_ADDR A:0xfc4011c0
y.create.l HWIO_GCC_APCS_AHB_CMD_RCGR_ADDR A:0xfc40120c
y.create.l HWIO_GCC_APCS_AHB_CFG_RCGR_ADDR A:0xfc401210
y.create.l HWIO_GCC_APCS_AHB_MISC_ADDR A:0xfc401220
y.create.l HWIO_GCC_APCS_AHB_CBCR_ADDR A:0xfc401204
y.create.l HWIO_GCC_APCS_AXI_CBCR_ADDR A:0xfc401208
y.create.l HWIO_GCC_SNOC_BUS_TIMEOUT0_BCR_ADDR A:0xfc401240
y.create.l HWIO_GCC_SNOC_BUS_TIMEOUT0_AHB_CBCR_ADDR A:0xfc401244
y.create.l HWIO_GCC_PNOC_BUS_TIMEOUT0_BCR_ADDR A:0xfc401280
y.create.l HWIO_GCC_PNOC_BUS_TIMEOUT0_AHB_CBCR_ADDR A:0xfc401284
y.create.l HWIO_GCC_PNOC_BUS_TIMEOUT1_BCR_ADDR A:0xfc401288
y.create.l HWIO_GCC_PNOC_BUS_TIMEOUT1_AHB_CBCR_ADDR A:0xfc40128c
y.create.l HWIO_GCC_PNOC_BUS_TIMEOUT2_BCR_ADDR A:0xfc401290
y.create.l HWIO_GCC_PNOC_BUS_TIMEOUT2_AHB_CBCR_ADDR A:0xfc401294
y.create.l HWIO_GCC_PNOC_BUS_TIMEOUT3_BCR_ADDR A:0xfc401298
y.create.l HWIO_GCC_PNOC_BUS_TIMEOUT3_AHB_CBCR_ADDR A:0xfc40129c
y.create.l HWIO_GCC_PNOC_BUS_TIMEOUT4_BCR_ADDR A:0xfc4012a0
y.create.l HWIO_GCC_PNOC_BUS_TIMEOUT4_AHB_CBCR_ADDR A:0xfc4012a4
y.create.l HWIO_GCC_CNOC_BUS_TIMEOUT0_BCR_ADDR A:0xfc4012c0
y.create.l HWIO_GCC_CNOC_BUS_TIMEOUT0_AHB_CBCR_ADDR A:0xfc4012c4
y.create.l HWIO_GCC_CNOC_BUS_TIMEOUT1_BCR_ADDR A:0xfc4012c8
y.create.l HWIO_GCC_CNOC_BUS_TIMEOUT1_AHB_CBCR_ADDR A:0xfc4012cc
y.create.l HWIO_GCC_CNOC_BUS_TIMEOUT2_BCR_ADDR A:0xfc4012d0
y.create.l HWIO_GCC_CNOC_BUS_TIMEOUT2_AHB_CBCR_ADDR A:0xfc4012d4
y.create.l HWIO_GCC_CNOC_BUS_TIMEOUT3_BCR_ADDR A:0xfc4012d8
y.create.l HWIO_GCC_CNOC_BUS_TIMEOUT3_AHB_CBCR_ADDR A:0xfc4012dc
y.create.l HWIO_GCC_CNOC_BUS_TIMEOUT4_BCR_ADDR A:0xfc4012e0
y.create.l HWIO_GCC_CNOC_BUS_TIMEOUT4_AHB_CBCR_ADDR A:0xfc4012e4
y.create.l HWIO_GCC_CNOC_BUS_TIMEOUT5_BCR_ADDR A:0xfc4012e8
y.create.l HWIO_GCC_CNOC_BUS_TIMEOUT5_AHB_CBCR_ADDR A:0xfc4012ec
y.create.l HWIO_GCC_CNOC_BUS_TIMEOUT6_BCR_ADDR A:0xfc4012f0
y.create.l HWIO_GCC_CNOC_BUS_TIMEOUT6_AHB_CBCR_ADDR A:0xfc4012f4
y.create.l HWIO_GCC_DEHR_BCR_ADDR A:0xfc401300
y.create.l HWIO_GCC_DEHR_CBCR_ADDR A:0xfc401304
y.create.l HWIO_GCC_PERIPH_NOC_MPU_CFG_AHB_CBCR_ADDR A:0xfc401340
y.create.l HWIO_GCC_RBCPR_BCR_ADDR A:0xfc401380
y.create.l HWIO_GCC_RBCPR_CBCR_ADDR A:0xfc401384
y.create.l HWIO_GCC_RBCPR_AHB_CBCR_ADDR A:0xfc401388
y.create.l HWIO_GCC_RBCPR_CMD_RCGR_ADDR A:0xfc40138c
y.create.l HWIO_GCC_RBCPR_CFG_RCGR_ADDR A:0xfc401390
y.create.l HWIO_GCC_RPM_GPLL_ENA_VOTE_ADDR A:0xfc401440
y.create.l HWIO_GCC_RPM_CLOCK_BRANCH_ENA_VOTE_ADDR A:0xfc401444
y.create.l HWIO_GCC_RPM_CLOCK_SLEEP_ENA_VOTE_ADDR A:0xfc401448
y.create.l HWIO_GCC_APCS_GPLL_ENA_VOTE_ADDR A:0xfc401480
y.create.l HWIO_GCC_APCS_CLOCK_BRANCH_ENA_VOTE_ADDR A:0xfc401484
y.create.l HWIO_GCC_APCS_CLOCK_SLEEP_ENA_VOTE_ADDR A:0xfc401488
y.create.l HWIO_GCC_APCS_TZ_GPLL_ENA_VOTE_ADDR A:0xfc4014c0
y.create.l HWIO_GCC_APCS_TZ_CLOCK_BRANCH_ENA_VOTE_ADDR A:0xfc4014c4
y.create.l HWIO_GCC_APCS_TZ_CLOCK_SLEEP_ENA_VOTE_ADDR A:0xfc4014c8
y.create.l HWIO_GCC_MSS_Q6_GPLL_ENA_VOTE_ADDR A:0xfc401500
y.create.l HWIO_GCC_MSS_Q6_CLOCK_BRANCH_ENA_VOTE_ADDR A:0xfc401504
y.create.l HWIO_GCC_MSS_Q6_CLOCK_SLEEP_ENA_VOTE_ADDR A:0xfc401508
y.create.l HWIO_GCC_LPASS_DSP_GPLL_ENA_VOTE_ADDR A:0xfc401540
y.create.l HWIO_GCC_LPASS_DSP_CLOCK_BRANCH_ENA_VOTE_ADDR A:0xfc401544
y.create.l HWIO_GCC_LPASS_DSP_CLOCK_SLEEP_ENA_VOTE_ADDR A:0xfc401548
y.create.l HWIO_GCC_WCSS_GPLL_ENA_VOTE_ADDR A:0xfc401580
y.create.l HWIO_GCC_WCSS_CLOCK_BRANCH_ENA_VOTE_ADDR A:0xfc401584
y.create.l HWIO_GCC_WCSS_CLOCK_SLEEP_ENA_VOTE_ADDR A:0xfc401588
y.create.l HWIO_GCC_SPARE_GPLL_ENA_VOTE_ADDR A:0xfc4015c0
y.create.l HWIO_GCC_SPARE_CLOCK_BRANCH_ENA_VOTE_ADDR A:0xfc4015c4
y.create.l HWIO_GCC_QDSS_STM_EVENT0_CTL_REG_ADDR A:0xfc401600
y.create.l HWIO_GCC_QDSS_STM_EVENT1_CTL_REG_ADDR A:0xfc401604
y.create.l HWIO_GCC_QDSS_STM_EVENT2_CTL_REG_ADDR A:0xfc401608
y.create.l HWIO_GCC_QDSS_STM_EVENT3_CTL_REG_ADDR A:0xfc40160c
y.create.l HWIO_GCC_QDSS_STM_EVENT4_CTL_REG_ADDR A:0xfc401610
y.create.l HWIO_GCC_QDSS_STM_EVENT5_CTL_REG_ADDR A:0xfc401614
y.create.l HWIO_GCC_QDSS_STM_EVENT6_CTL_REG_ADDR A:0xfc401618
y.create.l HWIO_GCC_QDSS_STM_EVENT7_CTL_REG_ADDR A:0xfc40161c
y.create.l HWIO_GCC_QDSS_STM_EVENT8_CTL_REG_ADDR A:0xfc401620
y.create.l HWIO_GCC_QDSS_STM_EVENT9_CTL_REG_ADDR A:0xfc401624
y.create.l HWIO_GCC_QDSS_STM_EVENT10_CTL_REG_ADDR A:0xfc401628
y.create.l HWIO_GCC_QDSS_STM_EVENT11_CTL_REG_ADDR A:0xfc40162c
y.create.l HWIO_GCC_QDSS_STM_EVENT12_CTL_REG_ADDR A:0xfc401630
y.create.l HWIO_GCC_QDSS_STM_EVENT13_CTL_REG_ADDR A:0xfc401634
y.create.l HWIO_GCC_QDSS_STM_EVENT14_CTL_REG_ADDR A:0xfc401638
y.create.l HWIO_GCC_QDSS_STM_EVENT15_CTL_REG_ADDR A:0xfc40163c
y.create.l HWIO_GCC_QDSS_STM_EVENT16_CTL_REG_ADDR A:0xfc401640
y.create.l HWIO_GCC_QDSS_STM_EVENT17_CTL_REG_ADDR A:0xfc401644
y.create.l HWIO_GCC_QDSS_STM_EVENT18_CTL_REG_ADDR A:0xfc401648
y.create.l HWIO_GCC_QDSS_STM_EVENT19_CTL_REG_ADDR A:0xfc40164c
y.create.l HWIO_GCC_QDSS_STM_EVENT20_CTL_REG_ADDR A:0xfc401650
y.create.l HWIO_GCC_QDSS_STM_EVENT21_CTL_REG_ADDR A:0xfc401654
y.create.l HWIO_GCC_QDSS_STM_EVENT22_CTL_REG_ADDR A:0xfc401658
y.create.l HWIO_GCC_QDSS_STM_EVENT23_CTL_REG_ADDR A:0xfc40165c
y.create.l HWIO_GCC_QDSS_STM_EVENT24_CTL_REG_ADDR A:0xfc401660
y.create.l HWIO_GCC_QDSS_STM_EVENT25_CTL_REG_ADDR A:0xfc401664
y.create.l HWIO_GCC_QDSS_STM_EVENT26_CTL_REG_ADDR A:0xfc401668
y.create.l HWIO_GCC_QDSS_STM_EVENT27_CTL_REG_ADDR A:0xfc40166c
y.create.l HWIO_GCC_QDSS_STM_EVENT28_CTL_REG_ADDR A:0xfc401670
y.create.l HWIO_GCC_QDSS_STM_EVENT29_CTL_REG_ADDR A:0xfc401674
y.create.l HWIO_GCC_QDSS_STM_EVENT30_CTL_REG_ADDR A:0xfc401678
y.create.l HWIO_GCC_QDSS_STM_EVENT31_CTL_REG_ADDR A:0xfc40167c
y.create.l HWIO_GCC_MSS_RESTART_ADDR A:0xfc401680
y.create.l HWIO_GCC_LPASS_RESTART_ADDR A:0xfc4016c0
y.create.l HWIO_GCC_WCSS_RESTART_ADDR A:0xfc401700
y.create.l HWIO_GCC_VENUS_RESTART_ADDR A:0xfc401740
y.create.l HWIO_GCC_FLUSH_ETR_DEBUG_TIMER_ADDR A:0xfc401784
y.create.l HWIO_GCC_WDOG_DEBUG_ADDR A:0xfc401780
y.create.l HWIO_GCC_RESET_STATUS_ADDR A:0xfc4017c0
y.create.l HWIO_GCC_SW_SRST_ADDR A:0xfc401800
y.create.l HWIO_GCC_PROC_HALT_ADDR A:0xfc401840
y.create.l HWIO_GCC_GCC_DEBUG_CLK_CTL_ADDR A:0xfc401880
y.create.l HWIO_GCC_CLOCK_FRQ_MEASURE_CTL_ADDR A:0xfc401884
y.create.l HWIO_GCC_CLOCK_FRQ_MEASURE_STATUS_ADDR A:0xfc401888
y.create.l HWIO_GCC_PLLTEST_PAD_CFG_ADDR A:0xfc40188c
y.create.l HWIO_GCC_JITTER_PROBE_CFG_ADDR A:0xfc401890
y.create.l HWIO_GCC_JITTER_PROBE_VAL_ADDR A:0xfc401894
y.create.l HWIO_GCC_GP1_CBCR_ADDR A:0xfc401900
y.create.l HWIO_GCC_GP1_CMD_RCGR_ADDR A:0xfc401904
y.create.l HWIO_GCC_GP1_CFG_RCGR_ADDR A:0xfc401908
y.create.l HWIO_GCC_GP1_M_ADDR A:0xfc40190c
y.create.l HWIO_GCC_GP1_N_ADDR A:0xfc401910
y.create.l HWIO_GCC_GP1_D_ADDR A:0xfc401914
y.create.l HWIO_GCC_GP2_CBCR_ADDR A:0xfc401940
y.create.l HWIO_GCC_GP2_CMD_RCGR_ADDR A:0xfc401944
y.create.l HWIO_GCC_GP2_CFG_RCGR_ADDR A:0xfc401948
y.create.l HWIO_GCC_GP2_M_ADDR A:0xfc40194c
y.create.l HWIO_GCC_GP2_N_ADDR A:0xfc401950
y.create.l HWIO_GCC_GP2_D_ADDR A:0xfc401954
y.create.l HWIO_GCC_GP3_CBCR_ADDR A:0xfc401980
y.create.l HWIO_GCC_GP3_CMD_RCGR_ADDR A:0xfc401984
y.create.l HWIO_GCC_GP3_CFG_RCGR_ADDR A:0xfc401988
y.create.l HWIO_GCC_GP3_M_ADDR A:0xfc40198c
y.create.l HWIO_GCC_GP3_N_ADDR A:0xfc401990
y.create.l HWIO_GCC_GP3_D_ADDR A:0xfc401994
y.create.l HWIO_GCC_APCS_BOOT_CLOCK_CTL_ADDR A:0xfc4019c0
y.create.l HWIO_GCC_USB_BOOT_CLOCK_CTL_ADDR A:0xfc401a00
y.create.l HWIO_GCC_RAW_SLEEP_CLK_CTRL_ADDR A:0xfc401fc0
y.create.l HWIO_GCC_RPU_XPU_SCR_ADDR A:0xfc410000
y.create.l HWIO_GCC_RPU_XPU_SWDR_ADDR A:0xfc410004
y.create.l HWIO_GCC_RPU_XPU_SEAR0_ADDR A:0xfc410040
y.create.l HWIO_GCC_RPU_XPU_SESR_ADDR A:0xfc410048
y.create.l HWIO_GCC_RPU_XPU_SESRRESTORE_ADDR A:0xfc41004c
y.create.l HWIO_GCC_RPU_XPU_SESYNR0_ADDR A:0xfc410050
y.create.l HWIO_GCC_RPU_XPU_SESYNR1_ADDR A:0xfc410054
y.create.l HWIO_GCC_RPU_XPU_SESYNR2_ADDR A:0xfc410058
y.create.l HWIO_GCC_RPU_XPU_MCR_ADDR A:0xfc410100
y.create.l HWIO_GCC_RPU_XPU_MEAR0_ADDR A:0xfc410140
y.create.l HWIO_GCC_RPU_XPU_MESR_ADDR A:0xfc410148
y.create.l HWIO_GCC_RPU_XPU_MESRRESTORE_ADDR A:0xfc41014c
y.create.l HWIO_GCC_RPU_XPU_MESYNR0_ADDR A:0xfc410150
y.create.l HWIO_GCC_RPU_XPU_MESYNR1_ADDR A:0xfc410154
y.create.l HWIO_GCC_RPU_XPU_MESYNR2_ADDR A:0xfc410158
y.create.l HWIO_GCC_RPU_XPU_CR_ADDR A:0xfc410080
y.create.l HWIO_GCC_RPU_XPU_RPU_ACR0_ADDR A:0xfc4100a0
y.create.l HWIO_GCC_RPU_XPU_EAR0_ADDR A:0xfc4100c0
y.create.l HWIO_GCC_RPU_XPU_ESR_ADDR A:0xfc4100c8
y.create.l HWIO_GCC_RPU_XPU_ESRRESTORE_ADDR A:0xfc4100cc
y.create.l HWIO_GCC_RPU_XPU_ESYNR0_ADDR A:0xfc4100d0
y.create.l HWIO_GCC_RPU_XPU_ESYNR1_ADDR A:0xfc4100d4
y.create.l HWIO_GCC_RPU_XPU_ESYNR2_ADDR A:0xfc4100d8
y.create.l HWIO_GCC_RPU_XPU_IDR0_ADDR A:0xfc410074
y.create.l HWIO_GCC_RPU_XPU_IDR1_ADDR A:0xfc410078
y.create.l HWIO_GCC_RPU_XPU_REV_ADDR A:0xfc41007c
y.create.l HWIO_GCC_RPU_XPU_RG0_RACR0_ADDR A:0xfc410200
y.create.l HWIO_GCC_RPU_XPU_RG1_RACR0_ADDR A:0xfc410280
y.create.l HWIO_GCC_RPU_XPU_RG2_RACR0_ADDR A:0xfc410300
y.create.l HWIO_GCC_RPU_XPU_RG3_RACR0_ADDR A:0xfc410380
y.create.l HWIO_GCC_RPU_XPU_RG4_RACR0_ADDR A:0xfc410400
y.create.l HWIO_GCC_RPU_XPU_RG5_RACR0_ADDR A:0xfc410480
y.create.l HWIO_GCC_RPU_XPU_RG6_RACR0_ADDR A:0xfc410500
y.create.l HWIO_GCC_RPU_XPU_RG7_RACR0_ADDR A:0xfc410580
y.create.l HWIO_GCC_RPU_XPU_RG8_RACR0_ADDR A:0xfc410600
y.create.l HWIO_GCC_RPU_XPU_RG9_RACR0_ADDR A:0xfc410680
y.create.l HWIO_GCC_RPU_XPU_RG0_SCR_ADDR A:0xfc410250
y.create.l HWIO_GCC_RPU_XPU_RG1_SCR_ADDR A:0xfc4102d0
y.create.l HWIO_GCC_RPU_XPU_RG2_SCR_ADDR A:0xfc410350
y.create.l HWIO_GCC_RPU_XPU_RG3_SCR_ADDR A:0xfc4103d0
y.create.l HWIO_GCC_RPU_XPU_RG4_SCR_ADDR A:0xfc410450
y.create.l HWIO_GCC_RPU_XPU_RG5_SCR_ADDR A:0xfc4104d0
y.create.l HWIO_GCC_RPU_XPU_RG6_SCR_ADDR A:0xfc410550
y.create.l HWIO_GCC_RPU_XPU_RG7_SCR_ADDR A:0xfc4105d0
y.create.l HWIO_GCC_RPU_XPU_RG8_SCR_ADDR A:0xfc410650
y.create.l HWIO_GCC_RPU_XPU_RG9_SCR_ADDR A:0xfc4106d0
y.create.l HWIO_GCC_RPU_XPU_RG0_MCR_ADDR A:0xfc410254
y.create.l HWIO_GCC_RPU_XPU_RG1_MCR_ADDR A:0xfc4102d4
y.create.l HWIO_GCC_RPU_XPU_RG2_MCR_ADDR A:0xfc410354
y.create.l HWIO_GCC_RPU_XPU_RG3_MCR_ADDR A:0xfc4103d4
y.create.l HWIO_GCC_RPU_XPU_RG4_MCR_ADDR A:0xfc410454
y.create.l HWIO_GCC_RPU_XPU_RG5_MCR_ADDR A:0xfc4104d4
y.create.l HWIO_GCC_RPU_XPU_RG6_MCR_ADDR A:0xfc410554
y.create.l HWIO_GCC_RPU_XPU_RG7_MCR_ADDR A:0xfc4105d4
y.create.l HWIO_GCC_RPU_XPU_RG8_MCR_ADDR A:0xfc410654
y.create.l HWIO_GCC_RPU_XPU_RG9_MCR_ADDR A:0xfc4106d4
y.create.l HWIO_CNOC_0_ABT_HW_VERSION_ADDR A:0xfc448000
y.create.l HWIO_CNOC_0_ABT_INST_ID_ADDR A:0xfc448004
y.create.l HWIO_CNOC_0_ABT_NUM_SLAVES_ADDR A:0xfc448008
y.create.l HWIO_CNOC_0_ABT_TIMER_LOADVAL_ADDR A:0xfc44800c
y.create.l HWIO_CNOC_0_ABT_TIMER_MODE_ADDR A:0xfc448010
y.create.l HWIO_CNOC_0_ABT_INTR_STATUS_ADDR A:0xfc448014
y.create.l HWIO_CNOC_0_ABT_INTR_CLEAR_ADDR A:0xfc448018
y.create.l HWIO_CNOC_0_ABT_INTR_ENABLE_ADDR A:0xfc44801c
y.create.l HWIO_CNOC_0_ABT_SYND_VALID_ADDR A:0xfc448020
y.create.l HWIO_CNOC_0_ABT_SYND_CLEAR_ADDR A:0xfc448024
y.create.l HWIO_CNOC_0_ABT_SYND_ID_ADDR A:0xfc448028
y.create.l HWIO_CNOC_0_ABT_SYND_ADDR0_ADDR A:0xfc44802c
y.create.l HWIO_CNOC_0_ABT_SYND_ADDR1_ADDR A:0xfc448030
y.create.l HWIO_CNOC_0_ABT_SYND_HREADY_ADDR A:0xfc448034
y.create.l HWIO_CNOC_1_ABT_HW_VERSION_ADDR A:0xfc449000
y.create.l HWIO_CNOC_1_ABT_INST_ID_ADDR A:0xfc449004
y.create.l HWIO_CNOC_1_ABT_NUM_SLAVES_ADDR A:0xfc449008
y.create.l HWIO_CNOC_1_ABT_TIMER_LOADVAL_ADDR A:0xfc44900c
y.create.l HWIO_CNOC_1_ABT_TIMER_MODE_ADDR A:0xfc449010
y.create.l HWIO_CNOC_1_ABT_INTR_STATUS_ADDR A:0xfc449014
y.create.l HWIO_CNOC_1_ABT_INTR_CLEAR_ADDR A:0xfc449018
y.create.l HWIO_CNOC_1_ABT_INTR_ENABLE_ADDR A:0xfc44901c
y.create.l HWIO_CNOC_1_ABT_SYND_VALID_ADDR A:0xfc449020
y.create.l HWIO_CNOC_1_ABT_SYND_CLEAR_ADDR A:0xfc449024
y.create.l HWIO_CNOC_1_ABT_SYND_ID_ADDR A:0xfc449028
y.create.l HWIO_CNOC_1_ABT_SYND_ADDR0_ADDR A:0xfc44902c
y.create.l HWIO_CNOC_1_ABT_SYND_ADDR1_ADDR A:0xfc449030
y.create.l HWIO_CNOC_1_ABT_SYND_HREADY_ADDR A:0xfc449034
y.create.l HWIO_CNOC_2_ABT_HW_VERSION_ADDR A:0xfc44a000
y.create.l HWIO_CNOC_2_ABT_INST_ID_ADDR A:0xfc44a004
y.create.l HWIO_CNOC_2_ABT_NUM_SLAVES_ADDR A:0xfc44a008
y.create.l HWIO_CNOC_2_ABT_TIMER_LOADVAL_ADDR A:0xfc44a00c
y.create.l HWIO_CNOC_2_ABT_TIMER_MODE_ADDR A:0xfc44a010
y.create.l HWIO_CNOC_2_ABT_INTR_STATUS_ADDR A:0xfc44a014
y.create.l HWIO_CNOC_2_ABT_INTR_CLEAR_ADDR A:0xfc44a018
y.create.l HWIO_CNOC_2_ABT_INTR_ENABLE_ADDR A:0xfc44a01c
y.create.l HWIO_CNOC_2_ABT_SYND_VALID_ADDR A:0xfc44a020
y.create.l HWIO_CNOC_2_ABT_SYND_CLEAR_ADDR A:0xfc44a024
y.create.l HWIO_CNOC_2_ABT_SYND_ID_ADDR A:0xfc44a028
y.create.l HWIO_CNOC_2_ABT_SYND_ADDR0_ADDR A:0xfc44a02c
y.create.l HWIO_CNOC_2_ABT_SYND_ADDR1_ADDR A:0xfc44a030
y.create.l HWIO_CNOC_2_ABT_SYND_HREADY_ADDR A:0xfc44a034
y.create.l HWIO_CNOC_3_ABT_HW_VERSION_ADDR A:0xfc44b000
y.create.l HWIO_CNOC_3_ABT_INST_ID_ADDR A:0xfc44b004
y.create.l HWIO_CNOC_3_ABT_NUM_SLAVES_ADDR A:0xfc44b008
y.create.l HWIO_CNOC_3_ABT_TIMER_LOADVAL_ADDR A:0xfc44b00c
y.create.l HWIO_CNOC_3_ABT_TIMER_MODE_ADDR A:0xfc44b010
y.create.l HWIO_CNOC_3_ABT_INTR_STATUS_ADDR A:0xfc44b014
y.create.l HWIO_CNOC_3_ABT_INTR_CLEAR_ADDR A:0xfc44b018
y.create.l HWIO_CNOC_3_ABT_INTR_ENABLE_ADDR A:0xfc44b01c
y.create.l HWIO_CNOC_3_ABT_SYND_VALID_ADDR A:0xfc44b020
y.create.l HWIO_CNOC_3_ABT_SYND_CLEAR_ADDR A:0xfc44b024
y.create.l HWIO_CNOC_3_ABT_SYND_ID_ADDR A:0xfc44b028
y.create.l HWIO_CNOC_3_ABT_SYND_ADDR0_ADDR A:0xfc44b02c
y.create.l HWIO_CNOC_3_ABT_SYND_ADDR1_ADDR A:0xfc44b030
y.create.l HWIO_CNOC_3_ABT_SYND_HREADY_ADDR A:0xfc44b034
y.create.l HWIO_CNOC_4_ABT_HW_VERSION_ADDR A:0xfc44c000
y.create.l HWIO_CNOC_4_ABT_INST_ID_ADDR A:0xfc44c004
y.create.l HWIO_CNOC_4_ABT_NUM_SLAVES_ADDR A:0xfc44c008
y.create.l HWIO_CNOC_4_ABT_TIMER_LOADVAL_ADDR A:0xfc44c00c
y.create.l HWIO_CNOC_4_ABT_TIMER_MODE_ADDR A:0xfc44c010
y.create.l HWIO_CNOC_4_ABT_INTR_STATUS_ADDR A:0xfc44c014
y.create.l HWIO_CNOC_4_ABT_INTR_CLEAR_ADDR A:0xfc44c018
y.create.l HWIO_CNOC_4_ABT_INTR_ENABLE_ADDR A:0xfc44c01c
y.create.l HWIO_CNOC_4_ABT_SYND_VALID_ADDR A:0xfc44c020
y.create.l HWIO_CNOC_4_ABT_SYND_CLEAR_ADDR A:0xfc44c024
y.create.l HWIO_CNOC_4_ABT_SYND_ID_ADDR A:0xfc44c028
y.create.l HWIO_CNOC_4_ABT_SYND_ADDR0_ADDR A:0xfc44c02c
y.create.l HWIO_CNOC_4_ABT_SYND_ADDR1_ADDR A:0xfc44c030
y.create.l HWIO_CNOC_4_ABT_SYND_HREADY_ADDR A:0xfc44c034
y.create.l HWIO_CNOC_5_ABT_HW_VERSION_ADDR A:0xfc44d000
y.create.l HWIO_CNOC_5_ABT_INST_ID_ADDR A:0xfc44d004
y.create.l HWIO_CNOC_5_ABT_NUM_SLAVES_ADDR A:0xfc44d008
y.create.l HWIO_CNOC_5_ABT_TIMER_LOADVAL_ADDR A:0xfc44d00c
y.create.l HWIO_CNOC_5_ABT_TIMER_MODE_ADDR A:0xfc44d010
y.create.l HWIO_CNOC_5_ABT_INTR_STATUS_ADDR A:0xfc44d014
y.create.l HWIO_CNOC_5_ABT_INTR_CLEAR_ADDR A:0xfc44d018
y.create.l HWIO_CNOC_5_ABT_INTR_ENABLE_ADDR A:0xfc44d01c
y.create.l HWIO_CNOC_5_ABT_SYND_VALID_ADDR A:0xfc44d020
y.create.l HWIO_CNOC_5_ABT_SYND_CLEAR_ADDR A:0xfc44d024
y.create.l HWIO_CNOC_5_ABT_SYND_ID_ADDR A:0xfc44d028
y.create.l HWIO_CNOC_5_ABT_SYND_ADDR0_ADDR A:0xfc44d02c
y.create.l HWIO_CNOC_5_ABT_SYND_ADDR1_ADDR A:0xfc44d030
y.create.l HWIO_CNOC_5_ABT_SYND_HREADY_ADDR A:0xfc44d034
y.create.l HWIO_CNOC_6_ABT_HW_VERSION_ADDR A:0xfc44e000
y.create.l HWIO_CNOC_6_ABT_INST_ID_ADDR A:0xfc44e004
y.create.l HWIO_CNOC_6_ABT_NUM_SLAVES_ADDR A:0xfc44e008
y.create.l HWIO_CNOC_6_ABT_TIMER_LOADVAL_ADDR A:0xfc44e00c
y.create.l HWIO_CNOC_6_ABT_TIMER_MODE_ADDR A:0xfc44e010
y.create.l HWIO_CNOC_6_ABT_INTR_STATUS_ADDR A:0xfc44e014
y.create.l HWIO_CNOC_6_ABT_INTR_CLEAR_ADDR A:0xfc44e018
y.create.l HWIO_CNOC_6_ABT_INTR_ENABLE_ADDR A:0xfc44e01c
y.create.l HWIO_CNOC_6_ABT_SYND_VALID_ADDR A:0xfc44e020
y.create.l HWIO_CNOC_6_ABT_SYND_CLEAR_ADDR A:0xfc44e024
y.create.l HWIO_CNOC_6_ABT_SYND_ID_ADDR A:0xfc44e028
y.create.l HWIO_CNOC_6_ABT_SYND_ADDR0_ADDR A:0xfc44e02c
y.create.l HWIO_CNOC_6_ABT_SYND_ADDR1_ADDR A:0xfc44e030
y.create.l HWIO_CNOC_6_ABT_SYND_HREADY_ADDR A:0xfc44e034
y.create.l HWIO_CNOC_OBS_ID_COREID_ADDR A:0xfc480000
y.create.l HWIO_CNOC_OBS_ID_REVISIONID_ADDR A:0xfc480004
y.create.l HWIO_CNOC_OBS_ERRCTL_ADDR A:0xfc480008
y.create.l HWIO_CNOC_OBS_ERRSTATUS_ADDR A:0xfc48000c
y.create.l HWIO_CNOC_OBS_ERRLOG0_ADDR A:0xfc480010
y.create.l HWIO_CNOC_OBS_ERRLOG1_ADDR A:0xfc480014
y.create.l HWIO_CNOC_OBS_ERRLOG2_ADDR A:0xfc480018
y.create.l HWIO_CNOC_OBS_ERRLOG5_ADDR A:0xfc480024
y.create.l HWIO_TCSR_MUTEX_XPU_SCR_ADDR A:0xfd480000
y.create.l HWIO_TCSR_MUTEX_XPU_SWDR_ADDR A:0xfd480004
y.create.l HWIO_TCSR_MUTEX_XPU_SEAR0_ADDR A:0xfd480040
y.create.l HWIO_TCSR_MUTEX_XPU_SESR_ADDR A:0xfd480048
y.create.l HWIO_TCSR_MUTEX_XPU_SESRRESTORE_ADDR A:0xfd48004c
y.create.l HWIO_TCSR_MUTEX_XPU_SESYNR0_ADDR A:0xfd480050
y.create.l HWIO_TCSR_MUTEX_XPU_SESYNR1_ADDR A:0xfd480054
y.create.l HWIO_TCSR_MUTEX_XPU_SESYNR2_ADDR A:0xfd480058
y.create.l HWIO_TCSR_MUTEX_XPU_MCR_ADDR A:0xfd480100
y.create.l HWIO_TCSR_MUTEX_XPU_MEAR0_ADDR A:0xfd480140
y.create.l HWIO_TCSR_MUTEX_XPU_MESR_ADDR A:0xfd480148
y.create.l HWIO_TCSR_MUTEX_XPU_MESRRESTORE_ADDR A:0xfd48014c
y.create.l HWIO_TCSR_MUTEX_XPU_MESYNR0_ADDR A:0xfd480150
y.create.l HWIO_TCSR_MUTEX_XPU_MESYNR1_ADDR A:0xfd480154
y.create.l HWIO_TCSR_MUTEX_XPU_MESYNR2_ADDR A:0xfd480158
y.create.l HWIO_TCSR_MUTEX_XPU_CR_ADDR A:0xfd480080
y.create.l HWIO_TCSR_MUTEX_XPU_RPU_ACR0_ADDR A:0xfd4800a0
y.create.l HWIO_TCSR_MUTEX_XPU_EAR0_ADDR A:0xfd4800c0
y.create.l HWIO_TCSR_MUTEX_XPU_ESR_ADDR A:0xfd4800c8
y.create.l HWIO_TCSR_MUTEX_XPU_ESRRESTORE_ADDR A:0xfd4800cc
y.create.l HWIO_TCSR_MUTEX_XPU_ESYNR0_ADDR A:0xfd4800d0
y.create.l HWIO_TCSR_MUTEX_XPU_ESYNR1_ADDR A:0xfd4800d4
y.create.l HWIO_TCSR_MUTEX_XPU_ESYNR2_ADDR A:0xfd4800d8
y.create.l HWIO_TCSR_MUTEX_XPU_IDR0_ADDR A:0xfd480074
y.create.l HWIO_TCSR_MUTEX_XPU_IDR1_ADDR A:0xfd480078
y.create.l HWIO_TCSR_MUTEX_XPU_REV_ADDR A:0xfd48007c
y.create.l HWIO_TCSR_MUTEX_XPU_RG0_RACR0_ADDR A:0xfd480200
y.create.l HWIO_TCSR_MUTEX_XPU_RG1_RACR0_ADDR A:0xfd480280
y.create.l HWIO_TCSR_MUTEX_XPU_RG2_RACR0_ADDR A:0xfd480300
y.create.l HWIO_TCSR_MUTEX_XPU_RG3_RACR0_ADDR A:0xfd480380
y.create.l HWIO_TCSR_MUTEX_XPU_RG4_RACR0_ADDR A:0xfd480400
y.create.l HWIO_TCSR_MUTEX_XPU_RG5_RACR0_ADDR A:0xfd480480
y.create.l HWIO_TCSR_MUTEX_XPU_RG6_RACR0_ADDR A:0xfd480500
y.create.l HWIO_TCSR_MUTEX_XPU_RG7_RACR0_ADDR A:0xfd480580
y.create.l HWIO_TCSR_MUTEX_XPU_RG8_RACR0_ADDR A:0xfd480600
y.create.l HWIO_TCSR_MUTEX_XPU_RG9_RACR0_ADDR A:0xfd480680
y.create.l HWIO_TCSR_MUTEX_XPU_RG0_WACR0_ADDR A:0xfd480220
y.create.l HWIO_TCSR_MUTEX_XPU_RG1_WACR0_ADDR A:0xfd4802a0
y.create.l HWIO_TCSR_MUTEX_XPU_RG2_WACR0_ADDR A:0xfd480320
y.create.l HWIO_TCSR_MUTEX_XPU_RG3_WACR0_ADDR A:0xfd4803a0
y.create.l HWIO_TCSR_MUTEX_XPU_RG4_WACR0_ADDR A:0xfd480420
y.create.l HWIO_TCSR_MUTEX_XPU_RG5_WACR0_ADDR A:0xfd4804a0
y.create.l HWIO_TCSR_MUTEX_XPU_RG6_WACR0_ADDR A:0xfd480520
y.create.l HWIO_TCSR_MUTEX_XPU_RG7_WACR0_ADDR A:0xfd4805a0
y.create.l HWIO_TCSR_MUTEX_XPU_RG8_WACR0_ADDR A:0xfd480620
y.create.l HWIO_TCSR_MUTEX_XPU_RG9_WACR0_ADDR A:0xfd4806a0
y.create.l HWIO_TCSR_MUTEX_XPU_RG0_SCR_ADDR A:0xfd480250
y.create.l HWIO_TCSR_MUTEX_XPU_RG1_SCR_ADDR A:0xfd4802d0
y.create.l HWIO_TCSR_MUTEX_XPU_RG2_SCR_ADDR A:0xfd480350
y.create.l HWIO_TCSR_MUTEX_XPU_RG3_SCR_ADDR A:0xfd4803d0
y.create.l HWIO_TCSR_MUTEX_XPU_RG4_SCR_ADDR A:0xfd480450
y.create.l HWIO_TCSR_MUTEX_XPU_RG5_SCR_ADDR A:0xfd4804d0
y.create.l HWIO_TCSR_MUTEX_XPU_RG6_SCR_ADDR A:0xfd480550
y.create.l HWIO_TCSR_MUTEX_XPU_RG7_SCR_ADDR A:0xfd4805d0
y.create.l HWIO_TCSR_MUTEX_XPU_RG8_SCR_ADDR A:0xfd480650
y.create.l HWIO_TCSR_MUTEX_XPU_RG9_SCR_ADDR A:0xfd4806d0
y.create.l HWIO_TCSR_MUTEX_XPU_RG0_MCR_ADDR A:0xfd480254
y.create.l HWIO_TCSR_MUTEX_XPU_RG1_MCR_ADDR A:0xfd4802d4
y.create.l HWIO_TCSR_MUTEX_XPU_RG2_MCR_ADDR A:0xfd480354
y.create.l HWIO_TCSR_MUTEX_XPU_RG3_MCR_ADDR A:0xfd4803d4
y.create.l HWIO_TCSR_MUTEX_XPU_RG4_MCR_ADDR A:0xfd480454
y.create.l HWIO_TCSR_MUTEX_XPU_RG5_MCR_ADDR A:0xfd4804d4
y.create.l HWIO_TCSR_MUTEX_XPU_RG6_MCR_ADDR A:0xfd480554
y.create.l HWIO_TCSR_MUTEX_XPU_RG7_MCR_ADDR A:0xfd4805d4
y.create.l HWIO_TCSR_MUTEX_XPU_RG8_MCR_ADDR A:0xfd480654
y.create.l HWIO_TCSR_MUTEX_XPU_RG9_MCR_ADDR A:0xfd4806d4
y.create.l HWIO_TCSR_MUTEX_REG_0_ADDR A:0xfd484000
y.create.l HWIO_TCSR_MUTEX_REG_1_ADDR A:0xfd484080
y.create.l HWIO_TCSR_MUTEX_REG_2_ADDR A:0xfd484100
y.create.l HWIO_TCSR_MUTEX_REG_3_ADDR A:0xfd484180
y.create.l HWIO_TCSR_MUTEX_REG_4_ADDR A:0xfd484200
y.create.l HWIO_TCSR_MUTEX_REG_5_ADDR A:0xfd484280
y.create.l HWIO_TCSR_MUTEX_REG_6_ADDR A:0xfd484300
y.create.l HWIO_TCSR_MUTEX_REG_7_ADDR A:0xfd484380
y.create.l HWIO_TCSR_MUTEX_REG_8_ADDR A:0xfd484400
y.create.l HWIO_TCSR_MUTEX_REG_9_ADDR A:0xfd484480
y.create.l HWIO_TCSR_CRYPTO0_HALTREQ_ADDR A:0xfd485000
y.create.l HWIO_TCSR_CRYPTO0_HALTACK_ADDR A:0xfd485004
y.create.l HWIO_TCSR_CRYPTO0_MASTER_IDLE_ADDR A:0xfd485008
y.create.l HWIO_TCSR_CRYPTO1_HALTREQ_ADDR A:0xfd485080
y.create.l HWIO_TCSR_CRYPTO1_HALTACK_ADDR A:0xfd485084
y.create.l HWIO_TCSR_CRYPTO1_MASTER_IDLE_ADDR A:0xfd485088
y.create.l HWIO_TCSR_LPASS_HALTREQ_ADDR A:0xfd485100
y.create.l HWIO_TCSR_LPASS_HALTACK_ADDR A:0xfd485104
y.create.l HWIO_TCSR_LPASS_MASTER_IDLE_ADDR A:0xfd485108
y.create.l HWIO_TCSR_LPASSQ6_POWER_STATE_ADDR A:0xfd485110
y.create.l HWIO_TCSR_MSSQ6_HALTREQ_ADDR A:0xfd485180
y.create.l HWIO_TCSR_MSSQ6_HALTACK_ADDR A:0xfd485184
y.create.l HWIO_TCSR_MSSQ6_MASTER_IDLE_ADDR A:0xfd485188
y.create.l HWIO_TCSR_MSSQ6_POWER_STATE_ADDR A:0xfd485190
y.create.l HWIO_TCSR_MSS_BHS_ADDR A:0xfd485194
y.create.l HWIO_TCSR_MSS_MODEM_HALTREQ_ADDR A:0xfd485200
y.create.l HWIO_TCSR_MSS_MODEM_HALTACK_ADDR A:0xfd485204
y.create.l HWIO_TCSR_MSS_MODEM_MASTER_IDLE_ADDR A:0xfd485208
y.create.l HWIO_TCSR_MSS_NC_HALTREQ_ADDR A:0xfd485280
y.create.l HWIO_TCSR_MSS_NC_HALTACK_ADDR A:0xfd485284
y.create.l HWIO_TCSR_MSS_NC_MASTER_IDLE_ADDR A:0xfd485288
y.create.l HWIO_TCSR_WCSS_HALTREQ_ADDR A:0xfd485300
y.create.l HWIO_TCSR_WCSS_HALTACK_ADDR A:0xfd485304
y.create.l HWIO_TCSR_WCSS_MASTER_IDLE_ADDR A:0xfd485308
y.create.l HWIO_TCSR_MUTEX_REG_RESET_ADDR A:0xfd485380
y.create.l HWIO_TCSR_REGS_XPU_SCR_ADDR A:0xfd498000
y.create.l HWIO_TCSR_REGS_XPU_SWDR_ADDR A:0xfd498004
y.create.l HWIO_TCSR_REGS_XPU_SEAR0_ADDR A:0xfd498040
y.create.l HWIO_TCSR_REGS_XPU_SESR_ADDR A:0xfd498048
y.create.l HWIO_TCSR_REGS_XPU_SESRRESTORE_ADDR A:0xfd49804c
y.create.l HWIO_TCSR_REGS_XPU_SESYNR0_ADDR A:0xfd498050
y.create.l HWIO_TCSR_REGS_XPU_SESYNR1_ADDR A:0xfd498054
y.create.l HWIO_TCSR_REGS_XPU_SESYNR2_ADDR A:0xfd498058
y.create.l HWIO_TCSR_REGS_XPU_MCR_ADDR A:0xfd498100
y.create.l HWIO_TCSR_REGS_XPU_MEAR0_ADDR A:0xfd498140
y.create.l HWIO_TCSR_REGS_XPU_MESR_ADDR A:0xfd498148
y.create.l HWIO_TCSR_REGS_XPU_MESRRESTORE_ADDR A:0xfd49814c
y.create.l HWIO_TCSR_REGS_XPU_MESYNR0_ADDR A:0xfd498150
y.create.l HWIO_TCSR_REGS_XPU_MESYNR1_ADDR A:0xfd498154
y.create.l HWIO_TCSR_REGS_XPU_MESYNR2_ADDR A:0xfd498158
y.create.l HWIO_TCSR_REGS_XPU_CR_ADDR A:0xfd498080
y.create.l HWIO_TCSR_REGS_XPU_RPU_ACR0_ADDR A:0xfd4980a0
y.create.l HWIO_TCSR_REGS_XPU_EAR0_ADDR A:0xfd4980c0
y.create.l HWIO_TCSR_REGS_XPU_ESR_ADDR A:0xfd4980c8
y.create.l HWIO_TCSR_REGS_XPU_ESRRESTORE_ADDR A:0xfd4980cc
y.create.l HWIO_TCSR_REGS_XPU_ESYNR0_ADDR A:0xfd4980d0
y.create.l HWIO_TCSR_REGS_XPU_ESYNR1_ADDR A:0xfd4980d4
y.create.l HWIO_TCSR_REGS_XPU_ESYNR2_ADDR A:0xfd4980d8
y.create.l HWIO_TCSR_REGS_XPU_IDR0_ADDR A:0xfd498074
y.create.l HWIO_TCSR_REGS_XPU_IDR1_ADDR A:0xfd498078
y.create.l HWIO_TCSR_REGS_XPU_REV_ADDR A:0xfd49807c
y.create.l HWIO_TCSR_REGS_XPU_RG0_RACR0_ADDR A:0xfd498200
y.create.l HWIO_TCSR_REGS_XPU_RG1_RACR0_ADDR A:0xfd498280
y.create.l HWIO_TCSR_REGS_XPU_RG2_RACR0_ADDR A:0xfd498300
y.create.l HWIO_TCSR_REGS_XPU_RG3_RACR0_ADDR A:0xfd498380
y.create.l HWIO_TCSR_REGS_XPU_RG4_RACR0_ADDR A:0xfd498400
y.create.l HWIO_TCSR_REGS_XPU_RG5_RACR0_ADDR A:0xfd498480
y.create.l HWIO_TCSR_REGS_XPU_RG6_RACR0_ADDR A:0xfd498500
y.create.l HWIO_TCSR_REGS_XPU_RG7_RACR0_ADDR A:0xfd498580
y.create.l HWIO_TCSR_REGS_XPU_RG8_RACR0_ADDR A:0xfd498600
y.create.l HWIO_TCSR_REGS_XPU_RG9_RACR0_ADDR A:0xfd498680
y.create.l HWIO_TCSR_REGS_XPU_RG0_WACR0_ADDR A:0xfd498220
y.create.l HWIO_TCSR_REGS_XPU_RG1_WACR0_ADDR A:0xfd4982a0
y.create.l HWIO_TCSR_REGS_XPU_RG2_WACR0_ADDR A:0xfd498320
y.create.l HWIO_TCSR_REGS_XPU_RG3_WACR0_ADDR A:0xfd4983a0
y.create.l HWIO_TCSR_REGS_XPU_RG4_WACR0_ADDR A:0xfd498420
y.create.l HWIO_TCSR_REGS_XPU_RG5_WACR0_ADDR A:0xfd4984a0
y.create.l HWIO_TCSR_REGS_XPU_RG6_WACR0_ADDR A:0xfd498520
y.create.l HWIO_TCSR_REGS_XPU_RG7_WACR0_ADDR A:0xfd4985a0
y.create.l HWIO_TCSR_REGS_XPU_RG8_WACR0_ADDR A:0xfd498620
y.create.l HWIO_TCSR_REGS_XPU_RG9_WACR0_ADDR A:0xfd4986a0
y.create.l HWIO_TCSR_REGS_XPU_RG0_SCR_ADDR A:0xfd498250
y.create.l HWIO_TCSR_REGS_XPU_RG1_SCR_ADDR A:0xfd4982d0
y.create.l HWIO_TCSR_REGS_XPU_RG2_SCR_ADDR A:0xfd498350
y.create.l HWIO_TCSR_REGS_XPU_RG3_SCR_ADDR A:0xfd4983d0
y.create.l HWIO_TCSR_REGS_XPU_RG4_SCR_ADDR A:0xfd498450
y.create.l HWIO_TCSR_REGS_XPU_RG5_SCR_ADDR A:0xfd4984d0
y.create.l HWIO_TCSR_REGS_XPU_RG6_SCR_ADDR A:0xfd498550
y.create.l HWIO_TCSR_REGS_XPU_RG7_SCR_ADDR A:0xfd4985d0
y.create.l HWIO_TCSR_REGS_XPU_RG8_SCR_ADDR A:0xfd498650
y.create.l HWIO_TCSR_REGS_XPU_RG9_SCR_ADDR A:0xfd4986d0
y.create.l HWIO_TCSR_REGS_XPU_RG0_MCR_ADDR A:0xfd498254
y.create.l HWIO_TCSR_REGS_XPU_RG1_MCR_ADDR A:0xfd4982d4
y.create.l HWIO_TCSR_REGS_XPU_RG2_MCR_ADDR A:0xfd498354
y.create.l HWIO_TCSR_REGS_XPU_RG3_MCR_ADDR A:0xfd4983d4
y.create.l HWIO_TCSR_REGS_XPU_RG4_MCR_ADDR A:0xfd498454
y.create.l HWIO_TCSR_REGS_XPU_RG5_MCR_ADDR A:0xfd4984d4
y.create.l HWIO_TCSR_REGS_XPU_RG6_MCR_ADDR A:0xfd498554
y.create.l HWIO_TCSR_REGS_XPU_RG7_MCR_ADDR A:0xfd4985d4
y.create.l HWIO_TCSR_REGS_XPU_RG8_MCR_ADDR A:0xfd498654
y.create.l HWIO_TCSR_REGS_XPU_RG9_MCR_ADDR A:0xfd4986d4
y.create.l HWIO_TCSR_KPSS_QRIB_VMIDMT_INIT_ADDR A:0xfd4a1300
y.create.l HWIO_TCSR_BIMC_CFG_QRIB_XPU2_INIT_ADDR A:0xfd4a0100
y.create.l HWIO_TCSR_BIMC_QXS0_QRIB_XPU2_INIT_ADDR A:0xfd4a0104
y.create.l HWIO_TCSR_BIMC_QXS1_QRIB_XPU2_INIT_ADDR A:0xfd4a0108
y.create.l HWIO_TCSR_LPASS_LPM_QRIB_XPU2_INIT_ADDR A:0xfd4a0180
y.create.l HWIO_TCSR_LPASS_LPC_CSR_QRIB_XPU2_INIT_ADDR A:0xfd4a0184
y.create.l HWIO_TCSR_LPASS_LPAIF_QRIB_XPU2_INIT_ADDR A:0xfd4a0188
y.create.l HWIO_TCSR_LPASS_RSMP_QRIB_XPU2_INIT_ADDR A:0xfd4a018c
y.create.l HWIO_TCSR_LPASS_LPC_COM_QRIB_XPU2_INIT_ADDR A:0xfd4a0190
y.create.l HWIO_TCSR_LPASS_SB_QRIB_XPU2_INIT_ADDR A:0xfd4a0194
y.create.l HWIO_TCSR_MPM_QDSS_QRIB_XPU2_INIT_ADDR A:0xfd4a0200
y.create.l HWIO_TCSR_DDR_PHY_CFG_QRIB_XPU2_INIT_ADDR A:0xfd4a0280
y.create.l HWIO_TCSR_NOC_MEM_TYPE_ADDR A:0xfd4a0300
y.create.l HWIO_TCSR_MMSS_VENUS0_VBIF_QRIB_XPU2_INIT_ADDR A:0xfd4a0380
y.create.l HWIO_TCSR_MMSS_VENUS0_WRAPPER_QRIB_XPU2_INIT_ADDR A:0xfd4a0384
y.create.l HWIO_TCSR_MMSS_VFE_QRIB_XPU2_INIT_ADDR A:0xfd4a038c
y.create.l HWIO_TCSR_MMSS_JPEG_QRIB_XPU2_INIT_ADDR A:0xfd4a0390
y.create.l HWIO_TCSR_MMSS_MDP_QRIB_XPU2_INIT_ADDR A:0xfd4a0394
y.create.l HWIO_TCSR_MMSS_VENUS0_MMU_QRIB_NS_ADDR A:0xfd4a0400
y.create.l HWIO_TCSR_MMSS_VENUS0_MMU_QRIB_NS_EN_ADDR A:0xfd4a0404
y.create.l HWIO_TCSR_MMSS_VFE_MMU_QRIB_NS_ADDR A:0xfd4a0410
y.create.l HWIO_TCSR_MMSS_VFE_MMU_QRIB_NS_EN_ADDR A:0xfd4a0414
y.create.l HWIO_TCSR_MMSS_JPEG_MMU_QRIB_NS_ADDR A:0xfd4a0418
y.create.l HWIO_TCSR_MMSS_JPEG_MMU_QRIB_NS_EN_ADDR A:0xfd4a041c
y.create.l HWIO_TCSR_MMSS_MDP_MMU_QRIB_NS_ADDR A:0xfd4a0420
y.create.l HWIO_TCSR_MMSS_MDP_MMU_QRIB_NS_EN_ADDR A:0xfd4a0424
y.create.l HWIO_TCSR_MMSS_OXILI_MMU_QRIB_NS_ADDR A:0xfd4a0428
y.create.l HWIO_TCSR_MMSS_OXILI_MMU_QRIB_NS_EN_ADDR A:0xfd4a042c
y.create.l HWIO_TCSR_MMSS_OXILICX_QRIB_XPU2_INIT_ADDR A:0xfd4a0500
y.create.l HWIO_TCSR_MMSS_OXILI_VBIF_QRIB_XPU2_INIT_ADDR A:0xfd4a0504
y.create.l HWIO_TCSR_MMSS_OCMEM_DM_QRIB_XPU2_INIT_ADDR A:0xfd4a0600
y.create.l HWIO_TCSR_MMSS_OCMEM_QRIB_XPU2_INIT_ADDR A:0xfd4a0604
y.create.l HWIO_TCSR_MMSS_OCMEM_OSW0_QRIB_XPU2_INIT_ADDR A:0xfd4a0608
y.create.l HWIO_TCSR_MMSS_OCMEM_OSW1_QRIB_XPU2_INIT_ADDR A:0xfd4a060c
y.create.l HWIO_TCSR_MMSS_OCMEM_OSWDM_QRIB_XPU2_INIT_ADDR A:0xfd4a0610
y.create.l HWIO_TCSR_MMSS_OCMEM_OSWSYS_QRIB_XPU2_INIT_ADDR A:0xfd4a0614
y.create.l HWIO_TCSR_PHSS_USB1_HS_QRIB_XPU2_INIT_ADDR A:0xfd4a0700
y.create.l HWIO_TCSR_PHSS_USB2_HSIC_QRIB_XPU2_INIT_ADDR A:0xfd4a0704
y.create.l HWIO_TCSR_PHSS_BLSP1_QRIB_XPU2_INIT_ADDR A:0xfd4a0708
y.create.l HWIO_TCSR_PHSS_BLSP2_QRIB_XPU2_INIT_ADDR A:0xfd4a070c
y.create.l HWIO_TCSR_PHSS_TSIF_BAM_QRIB_XPU2_INIT_ADDR A:0xfd4a0710
y.create.l HWIO_TCSR_PHSS_BAM_DMA_QRIB_XPU2_INIT_ADDR A:0xfd4a0714
y.create.l HWIO_TCSR_TIMEOUT_SLAVE_GLB_EN_ADDR A:0xfd4a0800
y.create.l HWIO_TCSR_XPU_NSEN_STATUS_ADDR A:0xfd4a0820
y.create.l HWIO_TCSR_XPU_VMIDEN_STATUS_ADDR A:0xfd4a0824
y.create.l HWIO_TCSR_XPU_MSAEN_STATUS_ADDR A:0xfd4a0828
y.create.l HWIO_TCSR_BIMC_CFG_QRIB_XPU2_ACR_ADDR A:0xfd4a1000
y.create.l HWIO_TCSR_BIMC_CFG_QRIB_XPU2_VMIDEN_INIT_ADDR A:0xfd4a1004
y.create.l HWIO_TCSR_BIMC_QXS0_QRIB_XPU2_ACR_ADDR A:0xfd4a1008
y.create.l HWIO_TCSR_BIMC_QXS0_QRIB_XPU2_VMIDEN_INIT_ADDR A:0xfd4a100c
y.create.l HWIO_TCSR_BIMC_QXS1_QRIB_XPU2_ACR_ADDR A:0xfd4a1010
y.create.l HWIO_TCSR_BIMC_QXS1_QRIB_XPU2_VMIDEN_INIT_ADDR A:0xfd4a1014
y.create.l HWIO_TCSR_LPASS_LPM_QRIB_XPU2_ACR_ADDR A:0xfd4a1180
y.create.l HWIO_TCSR_LPASS_LPM_QRIB_XPU2_VMIDEN_INIT_ADDR A:0xfd4a1184
y.create.l HWIO_TCSR_LPASS_LPC_CSR_QRIB_XPU2_ACR_ADDR A:0xfd4a1188
y.create.l HWIO_TCSR_LPASS_LPC_CSR_QRIB_XPU2_VMIDEN_INIT_ADDR A:0xfd4a118c
y.create.l HWIO_TCSR_LPASS_LPAIF_QRIB_XPU2_ACR_ADDR A:0xfd4a1190
y.create.l HWIO_TCSR_LPASS_LPAIF_QRIB_XPU2_VMIDEN_INIT_ADDR A:0xfd4a1194
y.create.l HWIO_TCSR_LPASS_RSMP_QRIB_XPU2_ACR_ADDR A:0xfd4a1198
y.create.l HWIO_TCSR_LPASS_RSMP_QRIB_XPU2_VMIDEN_INIT_ADDR A:0xfd4a119c
y.create.l HWIO_TCSR_LPASS_LPC_COM_QRIB_XPU2_ACR_ADDR A:0xfd4a1280
y.create.l HWIO_TCSR_LPASS_LPC_COM_QRIB_XPU2_VMIDEN_INIT_ADDR A:0xfd4a11a4
y.create.l HWIO_TCSR_LPASS_SB_QRIB_XPU2_ACR_ADDR A:0xfd4a11b8
y.create.l HWIO_TCSR_LPASS_SB_QRIB_XPU2_VMIDEN_INIT_ADDR A:0xfd4a11bc
y.create.l HWIO_TCSR_LPASS_SB_QRIB_VMIDMT_INIT_ACR_INIT_ADDR A:0xfd4a11c0
y.create.l HWIO_TCSR_LPASS_SB_QRIB_VMIDMT_EN_ADDR A:0xfd4a11c4
y.create.l HWIO_TCSR_LPASS_AIF_QRIB_VMIDMT_INIT_ACR_INIT_ADDR A:0xfd4a11c8
y.create.l HWIO_TCSR_LPASS_AIF_QRIB_VMIDMT_EN_ADDR A:0xfd4a11cc
y.create.l HWIO_TCSR_LPASS_DML_QRIB_VMIDMT_INIT_ACR_INIT_ADDR A:0xfd4a11d0
y.create.l HWIO_TCSR_LPASS_DML_QRIB_VMIDMT_EN_ADDR A:0xfd4a11d4
y.create.l HWIO_TCSR_LPASS_MIDI_QRIB_VMIDMT_INIT_ACR_INIT_ADDR A:0xfd4a11d8
y.create.l HWIO_TCSR_LPASS_MIDI_QRIB_VMIDMT_EN_ADDR A:0xfd4a11dc
y.create.l HWIO_TCSR_LPASS_RSMPLR_QRIB_VMIDMT_INIT_ACR_INIT_ADDR A:0xfd4a11e0
y.create.l HWIO_TCSR_LPASS_RSMPLR_QRIB_VMIDMT_EN_ADDR A:0xfd4a11e4
y.create.l HWIO_TCSR_MPM_QDSS_QRIB_XPU2_ACR_ADDR A:0xfd4a1200
y.create.l HWIO_TCSR_MPM_QDSS_QRIB_XPU2_VMIDEN_INIT_ADDR A:0xfd4a1204
y.create.l HWIO_TCSR_DDR_PHY_CFG_QRIB_XPU2_VMIDEN_INIT_ADDR A:0xfd4a1284
y.create.l HWIO_TCSR_NOC_CFG_QRIB_XPU2_VMIDEN_INIT_ADDR A:0xfd4a1304
y.create.l HWIO_TCSR_MMSS_VENUS0_VBIF_QRIB_XPU2_ACR_ADDR A:0xfd4a1380
y.create.l HWIO_TCSR_MMSS_VENUS0_VBIF_QRIB_XPU2_VMIDEN_INIT_ADDR A:0xfd4a1384
y.create.l HWIO_TCSR_MMSS_VENUS0_CPU_QRIB_VMIDMT_INIT_ACR_INIT_ADDR A:0xfd4a1388
y.create.l HWIO_TCSR_MMSS_VENUS0_CPU_QRIB_VMIDMT_EN_ADDR A:0xfd4a138c
y.create.l HWIO_TCSR_MMSS_VENUS0_WRAPPER_QRIB_XPU2_ACR_ADDR A:0xfd4a1390
y.create.l HWIO_TCSR_MMSS_VENUS0_WRAPPER_QRIB_XPU2_VMIDEN_INIT_ADDR A:0xfd4a1394
y.create.l HWIO_TCSR_MMSS_VENUS0_VBIF_QRIB_VMIDMT_INIT_ACR_INIT_ADDR A:0xfd4a1398
y.create.l HWIO_TCSR_MMSS_VENUS0_VBIF_QRIB_VMIDMT_EN_ADDR A:0xfd4a139c
y.create.l HWIO_TCSR_MMSS_VFE_QRIB_XPU2_ACR_ADDR A:0xfd4a13b0
y.create.l HWIO_TCSR_MMSS_VFE_QRIB_XPU2_VMIDEN_INIT_ADDR A:0xfd4a13b4
y.create.l HWIO_TCSR_MMSS_VFE_QRIB_VMIDMT_INIT_ACR_INIT_ADDR A:0xfd4a13b8
y.create.l HWIO_TCSR_MMSS_VFE_QRIB_VMIDMT_EN_ADDR A:0xfd4a13bc
y.create.l HWIO_TCSR_MMSS_JPEG_QRIB_XPU2_ACR_ADDR A:0xfd4a13c0
y.create.l HWIO_TCSR_MMSS_JPEG_QRIB_XPU2_VMIDEN_INIT_ADDR A:0xfd4a13c4
y.create.l HWIO_TCSR_MMSS_JPEG_QRIB_VMIDMT_INIT_ACR_INIT_ADDR A:0xfd4a13c8
y.create.l HWIO_TCSR_MMSS_JPEG_QRIB_VMIDMT_EN_ADDR A:0xfd4a13cc
y.create.l HWIO_TCSR_MMSS_MDP_QRIB_XPU2_ACR_ADDR A:0xfd4a13d0
y.create.l HWIO_TCSR_MMSS_MDP_QRIB_XPU2_VMIDEN_INIT_ADDR A:0xfd4a13d4
y.create.l HWIO_TCSR_MMSS_MDP_QRIB_VMIDMT_INIT_ACR_INIT_ADDR A:0xfd4a13d8
y.create.l HWIO_TCSR_MMSS_MDP_QRIB_VMIDMT_EN_ADDR A:0xfd4a13dc
y.create.l HWIO_TCSR_MMSS_VENUS0_MMU_QRIB_VMID_INIT_EN_ADDR A:0xfd4a1480
y.create.l HWIO_TCSR_MMSS_VENUS0_MMU_QRIB_VMID_INIT_ADDR A:0xfd4a1484
y.create.l HWIO_TCSR_MMSS_VENUS0_MMU_QRIB_VMID_EN_ADDR A:0xfd4a1488
y.create.l HWIO_TCSR_MMSS_VENUS0_MMU_QRIB_VMID_ADDR A:0xfd4a148c
y.create.l HWIO_TCSR_MMSS_VFE_MMU_QRIB_VMID_INIT_EN_ADDR A:0xfd4a14a0
y.create.l HWIO_TCSR_MMSS_VFE_MMU_QRIB_VMID_INIT_ADDR A:0xfd4a14a4
y.create.l HWIO_TCSR_MMSS_VFE_MMU_QRIB_VMID_EN_ADDR A:0xfd4a14a8
y.create.l HWIO_TCSR_MMSS_VFE_MMU_QRIB_VMID_ADDR A:0xfd4a14ac
y.create.l HWIO_TCSR_MMSS_JPEG_MMU_QRIB_VMID_INIT_EN_ADDR A:0xfd4a14b0
y.create.l HWIO_TCSR_MMSS_JPEG_MMU_QRIB_VMID_INIT_ADDR A:0xfd4a14b4
y.create.l HWIO_TCSR_MMSS_JPEG_MMU_QRIB_VMID_EN_ADDR A:0xfd4a14b8
y.create.l HWIO_TCSR_MMSS_JPEG_MMU_QRIB_VMID_ADDR A:0xfd4a14bc
y.create.l HWIO_TCSR_MMSS_MDP_MMU_QRIB_VMID_INIT_EN_ADDR A:0xfd4a14c0
y.create.l HWIO_TCSR_MMSS_MDP_MMU_QRIB_VMID_INIT_ADDR A:0xfd4a14c4
y.create.l HWIO_TCSR_MMSS_MDP_MMU_QRIB_VMID_EN_ADDR A:0xfd4a14c8
y.create.l HWIO_TCSR_MMSS_MDP_MMU_QRIB_VMID_ADDR A:0xfd4a14cc
y.create.l HWIO_TCSR_MMSS_OXILI_MMU_QRIB_VMID_INIT_EN_ADDR A:0xfd4a14d0
y.create.l HWIO_TCSR_MMSS_OXILI_MMU_QRIB_VMID_INIT_ADDR A:0xfd4a14d4
y.create.l HWIO_TCSR_MMSS_OXILI_MMU_QRIB_VMID_EN_ADDR A:0xfd4a14d8
y.create.l HWIO_TCSR_MMSS_OXILI_MMU_QRIB_VMID_ADDR A:0xfd4a14dc
y.create.l HWIO_TCSR_MMSS_OXILICX_QRIB_XPU2_ACR_ADDR A:0xfd4a1500
y.create.l HWIO_TCSR_MMSS_OXILICX_QRIB_XPU2_VMIDEN_INIT_ADDR A:0xfd4a1504
y.create.l HWIO_TCSR_MMSS_OXILI_RBBM_QRIB_VMIDMT_INIT_ACR_INIT_ADDR A:0xfd4a1508
y.create.l HWIO_TCSR_MMSS_OXILI_RBBM_QRIB_VMIDMT_EN_ADDR A:0xfd4a150c
y.create.l HWIO_TCSR_MMSS_OXILI_VBIF_QRIB_XPU2_ACR_ADDR A:0xfd4a1510
y.create.l HWIO_TCSR_MMSS_OXILI_VBIF_QRIB_XPU2_VMIDEN_INIT_ADDR A:0xfd4a1514
y.create.l HWIO_TCSR_MMSS_OCMEM_DM_QRIB_XPU2_ACR_ADDR A:0xfd4a1600
y.create.l HWIO_TCSR_MMSS_OCMEM_DM_QRIB_XPU2_VMIDEN_INIT_ADDR A:0xfd4a1604
y.create.l HWIO_TCSR_MMSS_OCMEM_DMOCMEM_QRIB_VMIDMT_INIT_ACR_INIT_ADDR A:0xfd4a1608
y.create.l HWIO_TCSR_MMSS_OCMEM_DMOCMEM_QRIB_VMIDMT_EN_ADDR A:0xfd4a160c
y.create.l HWIO_TCSR_MMSS_OCMEM_DMSYS_QRIB_VMIDMT_INIT_ACR_INIT_ADDR A:0xfd4a1610
y.create.l HWIO_TCSR_MMSS_OCMEM_DMSYS_QRIB_VMIDMT_EN_ADDR A:0xfd4a1614
y.create.l HWIO_TCSR_MMSS_OCMEM_QRIB_XPU2_ACR_ADDR A:0xfd4a1618
y.create.l HWIO_TCSR_MMSS_OCMEM_QRIB_XPU2_VMIDEN_INIT_ADDR A:0xfd4a161c
y.create.l HWIO_TCSR_MMSS_OCMEM_OSW0_QRIB_XPU2_ACR_ADDR A:0xfd4a1620
y.create.l HWIO_TCSR_MMSS_OCMEM_OSW0_QRIB_XPU2_VMIDEN_INIT_ADDR A:0xfd4a1624
y.create.l HWIO_TCSR_MMSS_OCMEM_OSW1_QRIB_XPU2_ACR_ADDR A:0xfd4a1628
y.create.l HWIO_TCSR_MMSS_OCMEM_OSW1_QRIB_XPU2_VMIDEN_INIT_ADDR A:0xfd4a162c
y.create.l HWIO_TCSR_MMSS_OCMEM_OSWDM_QRIB_XPU2_ACR_ADDR A:0xfd4a1630
y.create.l HWIO_TCSR_MMSS_OCMEM_OSWSYS_QRIB_XPU2_ACR_ADDR A:0xfd4a1638
y.create.l HWIO_TCSR_PHSS_USB1_HS_QRIB_XPU2_ACR_ADDR A:0xfd4a1700
y.create.l HWIO_TCSR_PHSS_USB1_HS_QRIB_XPU2_VMIDEN_INIT_ADDR A:0xfd4a1704
y.create.l HWIO_TCSR_PHSS_USB2_HSIC_QRIB_XPU2_ACR_ADDR A:0xfd4a1708
y.create.l HWIO_TCSR_PHSS_USB2_HSIC_QRIB_XPU2_VMIDEN_INIT_ADDR A:0xfd4a170c
y.create.l HWIO_TCSR_PHSS_BLSP1_QRIB_XPU2_ACR_ADDR A:0xfd4a1710
y.create.l HWIO_TCSR_PHSS_BLSP1_QRIB_XPU2_VMIDEN_INIT_ADDR A:0xfd4a1714
y.create.l HWIO_TCSR_PHSS_BLSP2_QRIB_XPU2_ACR_ADDR A:0xfd4a1718
y.create.l HWIO_TCSR_PHSS_BLSP2_QRIB_XPU2_VMIDEN_INIT_ADDR A:0xfd4a171c
y.create.l HWIO_TCSR_PHSS_TSIF_BAM_QRIB_XPU2_ACR_ADDR A:0xfd4a1720
y.create.l HWIO_TCSR_PHSS_TSIF_BAM_QRIB_XPU2_VMIDEN_INIT_ADDR A:0xfd4a1724
y.create.l HWIO_TCSR_PHSS_BAM_DMA_QRIB_XPU2_ACR_ADDR A:0xfd4a1728
y.create.l HWIO_TCSR_PHSS_BAM_DMA_QRIB_XPU2_VMIDEN_INIT_ADDR A:0xfd4a172c
y.create.l HWIO_TCSR_PHSS_USB1_HS_QRIB_VMIDMT_INIT_ACR_INIT_ADDR A:0xfd4a1730
y.create.l HWIO_TCSR_PHSS_USB1_HS_QRIB_VMIDMT_EN_ADDR A:0xfd4a1734
y.create.l HWIO_TCSR_PHSS_USB2_HSIC_QRIB_VMIDMT_INIT_ACR_INIT_ADDR A:0xfd4a1738
y.create.l HWIO_TCSR_PHSS_USB2_HSIC_QRIB_VMIDMT_EN_ADDR A:0xfd4a173c
y.create.l HWIO_TCSR_PHSS_BLSP1_QRIB_VMIDMT_INIT_ACR_INIT_ADDR A:0xfd4a1740
y.create.l HWIO_TCSR_PHSS_BLSP1_QRIB_VMIDMT_EN_ADDR A:0xfd4a1744
y.create.l HWIO_TCSR_PHSS_BLSP2_QRIB_VMIDMT_INIT_ACR_INIT_ADDR A:0xfd4a1748
y.create.l HWIO_TCSR_PHSS_BLSP2_QRIB_VMIDMT_EN_ADDR A:0xfd4a174c
y.create.l HWIO_TCSR_PHSS_TSIF_BAM_QRIB_VMIDMT_INIT_ACR_INIT_ADDR A:0xfd4a1750
y.create.l HWIO_TCSR_PHSS_TSIF_BAM_QRIB_VMIDMT_EN_ADDR A:0xfd4a1754
y.create.l HWIO_TCSR_PHSS_BAM_DMA_QRIB_VMIDMT_INIT_ACR_INIT_ADDR A:0xfd4a1758
y.create.l HWIO_TCSR_PHSS_BAM_DMA_QRIB_VMIDMT_EN_ADDR A:0xfd4a175c
y.create.l HWIO_TCSR_SS_XPU2_NON_SEC_INTR0_ADDR A:0xfd4a2000
y.create.l HWIO_TCSR_SS_XPU2_NON_SEC_INTR1_ADDR A:0xfd4a2004
y.create.l HWIO_TCSR_SS_XPU2_NON_SEC_INTR0_ENABLE_ADDR A:0xfd4a2040
y.create.l HWIO_TCSR_SS_XPU2_NON_SEC_INTR1_ENABLE_ADDR A:0xfd4a2044
y.create.l HWIO_TCSR_SS_VMIDMT_CLIENT_NON_SEC_INTR_ADDR A:0xfd4a2010
y.create.l HWIO_TCSR_SS_MMU_CLIENT_NON_SEC_INTR_ADDR A:0xfd4a2014
y.create.l HWIO_TCSR_SS_VMIDMT_CLIENT_NON_SEC_INTR_ENABLE_ADDR A:0xfd4a2050
y.create.l HWIO_TCSR_SS_MMU_CLIENT_NON_SEC_INTR_ENABLE_ADDR A:0xfd4a2054
y.create.l HWIO_TCSR_SS_VMIDMT_CFG_NON_SEC_INTR_ADDR A:0xfd4a3000
y.create.l HWIO_TCSR_SS_MMU_CFG_NON_SEC_INTR_ADDR A:0xfd4a3004
y.create.l HWIO_TCSR_SS_VMIDMT_CFG_NON_SEC_INTR_ENABLE_ADDR A:0xfd4a3040
y.create.l HWIO_TCSR_SS_MMU_CFG_NON_SEC_INTR_ENABLE_ADDR A:0xfd4a3044
y.create.l HWIO_TCSR_SS_XPU2_SEC_INTR0_ADDR A:0xfd4a4000
y.create.l HWIO_TCSR_SS_XPU2_SEC_INTR1_ADDR A:0xfd4a4004
y.create.l HWIO_TCSR_SS_XPU2_SEC_INTR0_ENABLE_ADDR A:0xfd4a4040
y.create.l HWIO_TCSR_SS_XPU2_SEC_INTR1_ENABLE_ADDR A:0xfd4a4044
y.create.l HWIO_TCSR_SS_VMIDMT_CLIENT_SEC_INTR_ADDR A:0xfd4a4010
y.create.l HWIO_TCSR_SS_MMU_CLIENT_SEC_INTR_ADDR A:0xfd4a4014
y.create.l HWIO_TCSR_SS_VMIDMT_CLIENT_SEC_INTR_ENABLE_ADDR A:0xfd4a4050
y.create.l HWIO_TCSR_SS_MMU_CLIENT_SEC_INTR_ENABLE_ADDR A:0xfd4a4054
y.create.l HWIO_TCSR_SS_VMIDMT_CFG_SEC_INTR_ADDR A:0xfd4a5000
y.create.l HWIO_TCSR_SS_MMU_CFG_SEC_INTR_ADDR A:0xfd4a5004
y.create.l HWIO_TCSR_SS_VMIDMT_CFG_SEC_INTR_ENABLE_ADDR A:0xfd4a5040
y.create.l HWIO_TCSR_SS_MMU_CFG_SEC_INTR_ENABLE_ADDR A:0xfd4a5044
y.create.l HWIO_TCSR_SS_XPU2_MSA_INTR0_ADDR A:0xfd4a6000
y.create.l HWIO_TCSR_SS_XPU2_MSA_INTR1_ADDR A:0xfd4a6004
y.create.l HWIO_TCSR_SS_XPU2_MSA_INTR0_ENABLE_ADDR A:0xfd4a6040
y.create.l HWIO_TCSR_SS_XPU2_MSA_INTR1_ENABLE_ADDR A:0xfd4a6044
y.create.l HWIO_TCSR_SPDM_CNT_CLK_CTRL_ADDR A:0xfd4a7000
y.create.l HWIO_TCSR_SPDM_DLY_FIFO_EN_ADDR A:0xfd4a7004
y.create.l HWIO_TCSR_SPDM_STG1_MUX_SEL_ADDR A:0xfd4a7008
y.create.l HWIO_TCSR_SPDM_STG2_A_MUX_SEL_ADDR A:0xfd4a700c
y.create.l HWIO_TCSR_SPDM_STG2_B_MUX_SEL_ADDR A:0xfd4a7010
y.create.l HWIO_TCSR_SPDM_STG3_A_MUX_SEL_ADDR A:0xfd4a7014
y.create.l HWIO_TCSR_SPDM_STG3_B_MUX_SEL_ADDR A:0xfd4a7018
y.create.l HWIO_TCSR_SOC_HW_VERSION_ADDR A:0xfd4a8000
y.create.l HWIO_TCSR_TIMEOUT_INTR_STATUS_ADDR A:0xfd4a8020
y.create.l HWIO_TCSR_TIMEOUT_INTR_RPM_ENABLE_ADDR A:0xfd4a8030
y.create.l HWIO_TCSR_TIMEOUT_INTR_KPSS_ENABLE_ADDR A:0xfd4a8040
y.create.l HWIO_TCSR_TIMEOUT_INTR_LPASS_ENABLE_ADDR A:0xfd4a8050
y.create.l HWIO_TCSR_TIMEOUT_INTR_MSS_ENABLE_ADDR A:0xfd4a8060
y.create.l HWIO_TCSR_TIMEOUT_WCSS_SW_RESET_ADDR A:0xfd4a8070
y.create.l HWIO_TCSR_TCSR_CLK_EN_ADDR A:0xfd4a907c
y.create.l HWIO_TCSR_SYS_POWER_CTRL_ADDR A:0xfd4aa000
y.create.l HWIO_TCSR_USB_CORE_ID_ADDR A:0xfd4aa004
y.create.l HWIO_TCSR_SPARE_REG0_ADDR A:0xfd4aa044
y.create.l HWIO_TCSR_SPARE_REG1_ADDR A:0xfd4aa048
y.create.l HWIO_TCSR_PHSS_USB2_PHY_SEL_ADDR A:0xfd4ab000
y.create.l HWIO_TCSR_PHSS_ATEST_USB2_PHY_SEL_ADDR A:0xfd4ab004
y.create.l HWIO_TCSR_PHSS_TEST_BUS_SEL_ADDR A:0xfd4ab008
y.create.l HWIO_TCSR_PHSS_QDSS_HW_EVENTS_CTRL_ADDR A:0xfd4ab00c
y.create.l HWIO_TCSR_PHSS_UART_LPASS_INT_SEL_0_ADDR A:0xfd4ab040
y.create.l HWIO_TCSR_PHSS_UART_LPASS_INT_SEL_1_ADDR A:0xfd4ab050
y.create.l HWIO_TCSR_PHSS_UART_PRONTO_INT_SEL_0_ADDR A:0xfd4ab080
y.create.l HWIO_TCSR_PHSS_UART_PRONTO_INT_SEL_1_ADDR A:0xfd4ab090
y.create.l HWIO_TCSR_PHSS_UART_MSS_INT_SEL_0_ADDR A:0xfd4ab0c0
y.create.l HWIO_TCSR_PHSS_UART_MSS_INT_SEL_1_ADDR A:0xfd4ab0d0
y.create.l HWIO_TCSR_PHSS_QUP_PRONTO_INT_SEL_0_ADDR A:0xfd4ab100
y.create.l HWIO_TCSR_PHSS_QUP_PRONTO_INT_SEL_1_ADDR A:0xfd4ab110
y.create.l HWIO_TCSR_PHSS_QUP_MSS_INT_SEL_0_ADDR A:0xfd4ab140
y.create.l HWIO_TCSR_PHSS_QUP_MSS_INT_SEL_1_ADDR A:0xfd4ab150
y.create.l HWIO_TCSR_PHSS_QDSS_HW_EVENTS_CTRL_0_ADDR A:0xfd4ab160
y.create.l HWIO_TCSR_PHSS_QDSS_HW_EVENTS_CTRL_1_ADDR A:0xfd4ab164
y.create.l HWIO_TCSR_PHSS_QDSS_HW_EVENTS_CTRL_2_ADDR A:0xfd4ab168
y.create.l HWIO_TCSR_PHSS_QDSS_HW_EVENTS_CTRL_3_ADDR A:0xfd4ab16c
y.create.l HWIO_TCSR_PHSS_QDSS_HW_EVENTS_CTRL_4_ADDR A:0xfd4ab170
y.create.l HWIO_TCSR_PHSS_QDSS_HW_EVENTS_CTRL_5_ADDR A:0xfd4ab174
y.create.l HWIO_TCSR_PHSS_QDSS_HW_EVENTS_CTRL_6_ADDR A:0xfd4ab178
y.create.l HWIO_TCSR_PHSS_QDSS_HW_EVENTS_CTRL_7_ADDR A:0xfd4ab17c
y.create.l HWIO_TCSR_PHSS_QDSS_HW_EVENTS_CTRL_8_ADDR A:0xfd4ab180
y.create.l HWIO_TCSR_PHSS_QDSS_HW_EVENTS_CTRL_9_ADDR A:0xfd4ab184
y.create.l HWIO_TCSR_LDO_SLEEP_CTRL_ADDR A:0xfd4ac000
y.create.l HWIO_TCSR_LDO_UPDATE_STATE_CTRL_ADDR A:0xfd4ac004
y.create.l HWIO_TCSR_LDO_OBIAS_CTRL_ADDR A:0xfd4ac008
y.create.l HWIO_TCSR_LDO_VREF_CONFIG_ADDR A:0xfd4ac00c
y.create.l HWIO_TCSR_LDO_IB_CONFIG_ADDR A:0xfd4ac010
y.create.l HWIO_TCSR_LDO_BGC_CONFIG_ADDR A:0xfd4ac014
y.create.l HWIO_TCSR_LDO_VREF_CTRL_ADDR A:0xfd4ac018
y.create.l HWIO_TCSR_LDO_LD_EN_ADDR A:0xfd4ac01c
y.create.l HWIO_TCSR_LDO_LD_CTRL_ADDR A:0xfd4ac020
y.create.l HWIO_TCSR_LDO_OSC_RESETB_ADDR A:0xfd4ac024
y.create.l HWIO_TCSR_LDO_OSC_CTRL_ADDR A:0xfd4ac028
y.create.l HWIO_TCSR_LDO_DFT_EN_CTRL_ADDR A:0xfd4ac02c
y.create.l HWIO_TCSR_LDO_DFT_CTRL_ADDR A:0xfd4ac030
y.create.l HWIO_TCSR_COMPILER_VDDMSS_ACC_0_ADDR A:0xfd4ad000
y.create.l HWIO_TCSR_COMPILER_VDDMSS_ACC_1_ADDR A:0xfd4ad004
y.create.l HWIO_TCSR_CUSTOM_ACC_MHPLRRFWITHBYPASS_VDDMSS_ADDR A:0xfd4ad010
y.create.l HWIO_TCSR_CUSTOM_ACC_6PRF_VDDMSS_ADDR A:0xfd4ad014
y.create.l HWIO_TCSR_CUSTOM_ACC_8PRF_VDDMSS_ADDR A:0xfd4ad018
y.create.l HWIO_TCSR_CUSTOM_ACC_MHPLLSP127VPESP_VDDMSS_ADDR A:0xfd4ad01c
y.create.l HWIO_TCSR_CUSTOM_ACC_MHPLLSP127RPMSP_VDDMSS_ADDR A:0xfd4ad020
y.create.l HWIO_TCSR_CUSTOM_ACC_MHPLLSP127OCMEM_VDDMSS_ADDR A:0xfd4ad024
y.create.l HWIO_TCSR_CUSTOM_ACC_MHPLLSP127MEMPOOL_VDDMSS_ADDR A:0xfd4ad028
y.create.l HWIO_TCSR_CUSTOM_ACC_QFPROM_VDDMSS_ADDR A:0xfd4ad02c
y.create.l HWIO_TCSR_COMPILER_VDDCX_ACC_0_ADDR A:0xfd4ad080
y.create.l HWIO_TCSR_COMPILER_VDDCX_ACC_1_ADDR A:0xfd4ad084
y.create.l HWIO_TCSR_CUSTOM_ACC_HPLVF240WITHBYPASS_TYPE1_VDDCX_ADDR A:0xfd4ad090
y.create.l HWIO_TCSR_CUSTOM_ACC_6PRF_TYPE2_VDDCX_ADDR A:0xfd4ad094
y.create.l HWIO_TCSR_CUSTOM_ACC_8PRF_TYPE3_VDDCX_ADDR A:0xfd4ad098
y.create.l HWIO_TCSR_CUSTOM_ACC_UHPSP155_TYPE4_VDDCX_ADDR A:0xfd4ad09c
y.create.l HWIO_TCSR_CUSTOM_ACC_UHPSP155_L1OTHER_TYPE5_VDDCX_ADDR A:0xfd4ad0a0
y.create.l HWIO_TCSR_CUSTOM_ACC_UHPSP155_L2_TYPE6_VDDCX_ADDR A:0xfd4ad0a4
y.create.l HWIO_TCSR_CUSTOM_ACC_QFPROM_VDDCX_ADDR A:0xfd4ad0a8
y.create.l HWIO_TCSR_CUSTOM_ACC_UHPSP127_L2DATA_TYPE7_VDDCX_ADDR A:0xfd4ad0ac
y.create.l HWIO_TCSR_CUSTOM_ACC_HPLLSP127_TYPE8_VDDCX_ADDR A:0xfd4ad0b0
y.create.l HWIO_TCSR_CUSTOM_ACC_HDHPLLSP127_TYPE9_VDDCX_ADDR A:0xfd4ad0b4
y.create.l HWIO_TCSR_COMPILER_VDDGFX_ACC_0_ADDR A:0xfd4ad100
y.create.l HWIO_TCSR_COMPILER_VDDGFX_ACC_1_ADDR A:0xfd4ad104
y.create.l HWIO_TCSR_CUSTOM_ACC_MHPLRRFWITHBYPASS_VDDGFX_ADDR A:0xfd4ad110
y.create.l HWIO_TCSR_CUSTOM_ACC_6PRF_VDDGFX_ADDR A:0xfd4ad114
y.create.l HWIO_TCSR_CUSTOM_ACC_8PRF_VDDGFX_ADDR A:0xfd4ad118
y.create.l HWIO_TCSR_CUSTOM_ACC_MHPLLSP127VPESP_VDDGFX_ADDR A:0xfd4ad11c
y.create.l HWIO_TCSR_CUSTOM_ACC_MHPLLSP127RPMSP_VDDGFX_ADDR A:0xfd4ad120
y.create.l HWIO_TCSR_CUSTOM_ACC_MHPLLSP127OCMEM_VDDGFX_ADDR A:0xfd4ad124
y.create.l HWIO_TCSR_CUSTOM_ACC_MHPLLSP127MEMPOOL_VDDGFX_ADDR A:0xfd4ad128
y.create.l HWIO_TCSR_CUSTOM_ACC_QFPROM_VDDGFX_ADDR A:0xfd4ad12c
y.create.l HWIO_TCSR_MEM_ARRY_STBY_ADDR A:0xfd4ad180
y.create.l HWIO_TCSR_MEM_ACC_SEL_VDDCX_ADDR A:0xfd4ae000
y.create.l HWIO_TCSR_MEM_ACC_SEL_VDDGFX_ADDR A:0xfd4af000
y.create.l HWIO_CRYPTO0_CRYPTO_VERSION_ADDR A:0xfd41a000
y.create.l HWIO_CRYPTO0_CRYPTO_DATA_IN0_ADDR A:0xfd41a010
y.create.l HWIO_CRYPTO0_CRYPTO_DATA_IN1_ADDR A:0xfd41a014
y.create.l HWIO_CRYPTO0_CRYPTO_DATA_IN2_ADDR A:0xfd41a018
y.create.l HWIO_CRYPTO0_CRYPTO_DATA_IN3_ADDR A:0xfd41a01c
y.create.l HWIO_CRYPTO0_CRYPTO_DATA_OUT0_ADDR A:0xfd41a020
y.create.l HWIO_CRYPTO0_CRYPTO_DATA_OUT1_ADDR A:0xfd41a024
y.create.l HWIO_CRYPTO0_CRYPTO_DATA_OUT2_ADDR A:0xfd41a028
y.create.l HWIO_CRYPTO0_CRYPTO_DATA_OUT3_ADDR A:0xfd41a02c
y.create.l HWIO_CRYPTO0_CRYPTO_STATUS_ADDR A:0xfd41a100
y.create.l HWIO_CRYPTO0_CRYPTO_STATUS2_ADDR A:0xfd41a104
y.create.l HWIO_CRYPTO0_CRYPTO_ENGINES_AVAIL_ADDR A:0xfd41a108
y.create.l HWIO_CRYPTO0_CRYPTO_FIFO_SIZES_ADDR A:0xfd41a10c
y.create.l HWIO_CRYPTO0_CRYPTO_SEG_SIZE_ADDR A:0xfd41a110
y.create.l HWIO_CRYPTO0_CRYPTO_GOPROC_ADDR A:0xfd41a120
y.create.l HWIO_CRYPTO0_CRYPTO_GOPROC_QC_KEY_ADDR A:0xfd41b000
y.create.l HWIO_CRYPTO0_CRYPTO_GOPROC_OEM_KEY_ADDR A:0xfd41c000
y.create.l HWIO_CRYPTO0_CRYPTO_ENCR_SEG_CFG_ADDR A:0xfd41a200
y.create.l HWIO_CRYPTO0_CRYPTO_ENCR_SEG_SIZE_ADDR A:0xfd41a204
y.create.l HWIO_CRYPTO0_CRYPTO_ENCR_SEG_START_ADDR A:0xfd41a208
y.create.l HWIO_CRYPTO0_CRYPTO_ENCR_KEY0_ADDR A:0xfd41d000
y.create.l HWIO_CRYPTO0_CRYPTO_ENCR_KEY1_ADDR A:0xfd41d004
y.create.l HWIO_CRYPTO0_CRYPTO_ENCR_KEY2_ADDR A:0xfd41d008
y.create.l HWIO_CRYPTO0_CRYPTO_ENCR_KEY3_ADDR A:0xfd41d00c
y.create.l HWIO_CRYPTO0_CRYPTO_ENCR_KEY4_ADDR A:0xfd41d010
y.create.l HWIO_CRYPTO0_CRYPTO_ENCR_KEY5_ADDR A:0xfd41d014
y.create.l HWIO_CRYPTO0_CRYPTO_ENCR_KEY6_ADDR A:0xfd41d018
y.create.l HWIO_CRYPTO0_CRYPTO_ENCR_KEY7_ADDR A:0xfd41d01c
y.create.l HWIO_CRYPTO0_CRYPTO_ENCR_PIPE0_KEY0_ADDR A:0xfd41e000
y.create.l HWIO_CRYPTO0_CRYPTO_ENCR_PIPE0_KEY1_ADDR A:0xfd41e004
y.create.l HWIO_CRYPTO0_CRYPTO_ENCR_PIPE0_KEY2_ADDR A:0xfd41e008
y.create.l HWIO_CRYPTO0_CRYPTO_ENCR_PIPE0_KEY3_ADDR A:0xfd41e00c
y.create.l HWIO_CRYPTO0_CRYPTO_ENCR_PIPE1_KEY0_ADDR A:0xfd41e020
y.create.l HWIO_CRYPTO0_CRYPTO_ENCR_PIPE1_KEY1_ADDR A:0xfd41e024
y.create.l HWIO_CRYPTO0_CRYPTO_ENCR_PIPE1_KEY2_ADDR A:0xfd41e028
y.create.l HWIO_CRYPTO0_CRYPTO_ENCR_PIPE1_KEY3_ADDR A:0xfd41e02c
y.create.l HWIO_CRYPTO0_CRYPTO_ENCR_PIPE2_KEY0_ADDR A:0xfd41e040
y.create.l HWIO_CRYPTO0_CRYPTO_ENCR_PIPE2_KEY1_ADDR A:0xfd41e044
y.create.l HWIO_CRYPTO0_CRYPTO_ENCR_PIPE2_KEY2_ADDR A:0xfd41e048
y.create.l HWIO_CRYPTO0_CRYPTO_ENCR_PIPE2_KEY3_ADDR A:0xfd41e04c
y.create.l HWIO_CRYPTO0_CRYPTO_ENCR_PIPE3_KEY0_ADDR A:0xfd41e060
y.create.l HWIO_CRYPTO0_CRYPTO_ENCR_PIPE3_KEY1_ADDR A:0xfd41e064
y.create.l HWIO_CRYPTO0_CRYPTO_ENCR_PIPE3_KEY2_ADDR A:0xfd41e068
y.create.l HWIO_CRYPTO0_CRYPTO_ENCR_PIPE3_KEY3_ADDR A:0xfd41e06c
y.create.l HWIO_CRYPTO0_CRYPTO_ENCR_XTS_KEY0_ADDR A:0xfd41d020
y.create.l HWIO_CRYPTO0_CRYPTO_ENCR_XTS_KEY1_ADDR A:0xfd41d024
y.create.l HWIO_CRYPTO0_CRYPTO_ENCR_XTS_KEY2_ADDR A:0xfd41d028
y.create.l HWIO_CRYPTO0_CRYPTO_ENCR_XTS_KEY3_ADDR A:0xfd41d02c
y.create.l HWIO_CRYPTO0_CRYPTO_ENCR_XTS_KEY4_ADDR A:0xfd41d030
y.create.l HWIO_CRYPTO0_CRYPTO_ENCR_XTS_KEY5_ADDR A:0xfd41d034
y.create.l HWIO_CRYPTO0_CRYPTO_ENCR_XTS_KEY6_ADDR A:0xfd41d038
y.create.l HWIO_CRYPTO0_CRYPTO_ENCR_XTS_KEY7_ADDR A:0xfd41d03c
y.create.l HWIO_CRYPTO0_CRYPTO_ENCR_PIPE0_XTS_KEY0_ADDR A:0xfd41e200
y.create.l HWIO_CRYPTO0_CRYPTO_ENCR_PIPE0_XTS_KEY1_ADDR A:0xfd41e204
y.create.l HWIO_CRYPTO0_CRYPTO_ENCR_PIPE0_XTS_KEY2_ADDR A:0xfd41e208
y.create.l HWIO_CRYPTO0_CRYPTO_ENCR_PIPE0_XTS_KEY3_ADDR A:0xfd41e20c
y.create.l HWIO_CRYPTO0_CRYPTO_ENCR_PIPE1_XTS_KEY0_ADDR A:0xfd41e220
y.create.l HWIO_CRYPTO0_CRYPTO_ENCR_PIPE1_XTS_KEY1_ADDR A:0xfd41e224
y.create.l HWIO_CRYPTO0_CRYPTO_ENCR_PIPE1_XTS_KEY2_ADDR A:0xfd41e228
y.create.l HWIO_CRYPTO0_CRYPTO_ENCR_PIPE1_XTS_KEY3_ADDR A:0xfd41e22c
y.create.l HWIO_CRYPTO0_CRYPTO_ENCR_PIPE2_XTS_KEY0_ADDR A:0xfd41e240
y.create.l HWIO_CRYPTO0_CRYPTO_ENCR_PIPE2_XTS_KEY1_ADDR A:0xfd41e244
y.create.l HWIO_CRYPTO0_CRYPTO_ENCR_PIPE2_XTS_KEY2_ADDR A:0xfd41e248
y.create.l HWIO_CRYPTO0_CRYPTO_ENCR_PIPE2_XTS_KEY3_ADDR A:0xfd41e24c
y.create.l HWIO_CRYPTO0_CRYPTO_ENCR_PIPE3_XTS_KEY0_ADDR A:0xfd41e260
y.create.l HWIO_CRYPTO0_CRYPTO_ENCR_PIPE3_XTS_KEY1_ADDR A:0xfd41e264
y.create.l HWIO_CRYPTO0_CRYPTO_ENCR_PIPE3_XTS_KEY2_ADDR A:0xfd41e268
y.create.l HWIO_CRYPTO0_CRYPTO_ENCR_PIPE3_XTS_KEY3_ADDR A:0xfd41e26c
y.create.l HWIO_CRYPTO0_CRYPTO_ENCR_CNTR0_IV0_ADDR A:0xfd41a20c
y.create.l HWIO_CRYPTO0_CRYPTO_ENCR_CNTR1_IV1_ADDR A:0xfd41a210
y.create.l HWIO_CRYPTO0_CRYPTO_ENCR_CNTR2_IV2_ADDR A:0xfd41a214
y.create.l HWIO_CRYPTO0_CRYPTO_ENCR_CNTR3_IV3_ADDR A:0xfd41a218
y.create.l HWIO_CRYPTO0_CRYPTO_ENCR_CNTR_MASK_ADDR A:0xfd41a21c
y.create.l HWIO_CRYPTO0_CRYPTO_ENCR_CCM_INIT_CNTR0_ADDR A:0xfd41a220
y.create.l HWIO_CRYPTO0_CRYPTO_ENCR_CCM_INIT_CNTR1_ADDR A:0xfd41a224
y.create.l HWIO_CRYPTO0_CRYPTO_ENCR_CCM_INIT_CNTR2_ADDR A:0xfd41a228
y.create.l HWIO_CRYPTO0_CRYPTO_ENCR_CCM_INIT_CNTR3_ADDR A:0xfd41a22c
y.create.l HWIO_CRYPTO0_CRYPTO_ENCR_XTS_DU_SIZE_ADDR A:0xfd41a230
y.create.l HWIO_CRYPTO0_CRYPTO_AUTH_SEG_CFG_ADDR A:0xfd41a300
y.create.l HWIO_CRYPTO0_CRYPTO_AUTH_SEG_SIZE_ADDR A:0xfd41a304
y.create.l HWIO_CRYPTO0_CRYPTO_AUTH_SEG_START_ADDR A:0xfd41a308
y.create.l HWIO_CRYPTO0_CRYPTO_AUTH_KEY0_ADDR A:0xfd41d040
y.create.l HWIO_CRYPTO0_CRYPTO_AUTH_KEY1_ADDR A:0xfd41d044
y.create.l HWIO_CRYPTO0_CRYPTO_AUTH_KEY2_ADDR A:0xfd41d048
y.create.l HWIO_CRYPTO0_CRYPTO_AUTH_KEY3_ADDR A:0xfd41d04c
y.create.l HWIO_CRYPTO0_CRYPTO_AUTH_KEY4_ADDR A:0xfd41d050
y.create.l HWIO_CRYPTO0_CRYPTO_AUTH_KEY5_ADDR A:0xfd41d054
y.create.l HWIO_CRYPTO0_CRYPTO_AUTH_KEY6_ADDR A:0xfd41d058
y.create.l HWIO_CRYPTO0_CRYPTO_AUTH_KEY7_ADDR A:0xfd41d05c
y.create.l HWIO_CRYPTO0_CRYPTO_AUTH_KEY8_ADDR A:0xfd41d060
y.create.l HWIO_CRYPTO0_CRYPTO_AUTH_KEY9_ADDR A:0xfd41d064
y.create.l HWIO_CRYPTO0_CRYPTO_AUTH_PIPE0_KEY0_ADDR A:0xfd41e800
y.create.l HWIO_CRYPTO0_CRYPTO_AUTH_PIPE0_KEY1_ADDR A:0xfd41e804
y.create.l HWIO_CRYPTO0_CRYPTO_AUTH_PIPE0_KEY2_ADDR A:0xfd41e808
y.create.l HWIO_CRYPTO0_CRYPTO_AUTH_PIPE0_KEY3_ADDR A:0xfd41e80c
y.create.l HWIO_CRYPTO0_CRYPTO_AUTH_PIPE1_KEY0_ADDR A:0xfd41e880
y.create.l HWIO_CRYPTO0_CRYPTO_AUTH_PIPE1_KEY1_ADDR A:0xfd41e884
y.create.l HWIO_CRYPTO0_CRYPTO_AUTH_PIPE1_KEY2_ADDR A:0xfd41e888
y.create.l HWIO_CRYPTO0_CRYPTO_AUTH_PIPE1_KEY3_ADDR A:0xfd41e88c
y.create.l HWIO_CRYPTO0_CRYPTO_AUTH_PIPE2_KEY0_ADDR A:0xfd41e900
y.create.l HWIO_CRYPTO0_CRYPTO_AUTH_PIPE2_KEY1_ADDR A:0xfd41e904
y.create.l HWIO_CRYPTO0_CRYPTO_AUTH_PIPE2_KEY2_ADDR A:0xfd41e908
y.create.l HWIO_CRYPTO0_CRYPTO_AUTH_PIPE2_KEY3_ADDR A:0xfd41e90c
y.create.l HWIO_CRYPTO0_CRYPTO_AUTH_PIPE3_KEY0_ADDR A:0xfd41e980
y.create.l HWIO_CRYPTO0_CRYPTO_AUTH_PIPE3_KEY1_ADDR A:0xfd41e984
y.create.l HWIO_CRYPTO0_CRYPTO_AUTH_PIPE3_KEY2_ADDR A:0xfd41e988
y.create.l HWIO_CRYPTO0_CRYPTO_AUTH_PIPE3_KEY3_ADDR A:0xfd41e98c
y.create.l HWIO_CRYPTO0_CRYPTO_AUTH_IV0_ADDR A:0xfd41a310
y.create.l HWIO_CRYPTO0_CRYPTO_AUTH_IV1_ADDR A:0xfd41a314
y.create.l HWIO_CRYPTO0_CRYPTO_AUTH_IV2_ADDR A:0xfd41a318
y.create.l HWIO_CRYPTO0_CRYPTO_AUTH_IV3_ADDR A:0xfd41a31c
y.create.l HWIO_CRYPTO0_CRYPTO_AUTH_IV4_ADDR A:0xfd41a320
y.create.l HWIO_CRYPTO0_CRYPTO_AUTH_IV5_ADDR A:0xfd41a324
y.create.l HWIO_CRYPTO0_CRYPTO_AUTH_IV6_ADDR A:0xfd41a328
y.create.l HWIO_CRYPTO0_CRYPTO_AUTH_IV7_ADDR A:0xfd41a32c
y.create.l HWIO_CRYPTO0_CRYPTO_AUTH_INFO_NONCE0_ADDR A:0xfd41a350
y.create.l HWIO_CRYPTO0_CRYPTO_AUTH_INFO_NONCE1_ADDR A:0xfd41a354
y.create.l HWIO_CRYPTO0_CRYPTO_AUTH_INFO_NONCE2_ADDR A:0xfd41a358
y.create.l HWIO_CRYPTO0_CRYPTO_AUTH_INFO_NONCE3_ADDR A:0xfd41a35c
y.create.l HWIO_CRYPTO0_CRYPTO_AUTH_BYTECNT0_ADDR A:0xfd41a390
y.create.l HWIO_CRYPTO0_CRYPTO_AUTH_BYTECNT1_ADDR A:0xfd41a394
y.create.l HWIO_CRYPTO0_CRYPTO_AUTH_EXP_MAC0_ADDR A:0xfd41a3a0
y.create.l HWIO_CRYPTO0_CRYPTO_AUTH_EXP_MAC1_ADDR A:0xfd41a3a4
y.create.l HWIO_CRYPTO0_CRYPTO_AUTH_EXP_MAC2_ADDR A:0xfd41a3a8
y.create.l HWIO_CRYPTO0_CRYPTO_AUTH_EXP_MAC3_ADDR A:0xfd41a3ac
y.create.l HWIO_CRYPTO0_CRYPTO_AUTH_EXP_MAC4_ADDR A:0xfd41a3b0
y.create.l HWIO_CRYPTO0_CRYPTO_AUTH_EXP_MAC5_ADDR A:0xfd41a3b4
y.create.l HWIO_CRYPTO0_CRYPTO_AUTH_EXP_MAC6_ADDR A:0xfd41a3b8
y.create.l HWIO_CRYPTO0_CRYPTO_AUTH_EXP_MAC7_ADDR A:0xfd41a3bc
y.create.l HWIO_CRYPTO0_CRYPTO_CONFIG_ADDR A:0xfd41a400
y.create.l HWIO_CRYPTO0_CRYPTO_DEBUG_ENABLE_ADDR A:0xfd41f000
y.create.l HWIO_CRYPTO0_CRYPTO_DEBUG_ADDR A:0xfd41f004
y.create.l HWIO_CRYPTO0_CRYPTO_PWR_CTRL_ADDR A:0xfd41f008
y.create.l HWIO_CRYPTO0_CRYPTO_AXI_VMIDMT_SCR0_ADDR A:0xfd419000
y.create.l HWIO_CRYPTO0_CRYPTO_AXI_VMIDMT_SCR1_ADDR A:0xfd419004
y.create.l HWIO_CRYPTO0_CRYPTO_AXI_VMIDMT_SCR2_ADDR A:0xfd419008
y.create.l HWIO_CRYPTO0_CRYPTO_AXI_VMIDMT_SACR_ADDR A:0xfd419010
y.create.l HWIO_CRYPTO0_CRYPTO_AXI_VMIDMT_SIDR0_ADDR A:0xfd419020
y.create.l HWIO_CRYPTO0_CRYPTO_AXI_VMIDMT_SIDR1_ADDR A:0xfd419024
y.create.l HWIO_CRYPTO0_CRYPTO_AXI_VMIDMT_SIDR2_ADDR A:0xfd419028
y.create.l HWIO_CRYPTO0_CRYPTO_AXI_VMIDMT_SIDR4_ADDR A:0xfd419030
y.create.l HWIO_CRYPTO0_CRYPTO_AXI_VMIDMT_SIDR5_ADDR A:0xfd419034
y.create.l HWIO_CRYPTO0_CRYPTO_AXI_VMIDMT_SIDR7_ADDR A:0xfd41903c
y.create.l HWIO_CRYPTO0_CRYPTO_AXI_VMIDMT_SGFAR0_ADDR A:0xfd419040
y.create.l HWIO_CRYPTO0_CRYPTO_AXI_VMIDMT_SGFSR_ADDR A:0xfd419048
y.create.l HWIO_CRYPTO0_CRYPTO_AXI_VMIDMT_SGFSRRESTORE_ADDR A:0xfd41904c
y.create.l HWIO_CRYPTO0_CRYPTO_AXI_VMIDMT_SGFSYNDR0_ADDR A:0xfd419050
y.create.l HWIO_CRYPTO0_CRYPTO_AXI_VMIDMT_SGFSYNDR1_ADDR A:0xfd419054
y.create.l HWIO_CRYPTO0_CRYPTO_AXI_VMIDMT_SGFSYNDR2_ADDR A:0xfd419058
y.create.l HWIO_CRYPTO0_CRYPTO_AXI_VMIDMT_VMIDMTSCR0_ADDR A:0xfd419090
y.create.l HWIO_CRYPTO0_CRYPTO_AXI_VMIDMT_CR0_ADDR A:0xfd419000
y.create.l HWIO_CRYPTO0_CRYPTO_AXI_VMIDMT_CR2_ADDR A:0xfd419008
y.create.l HWIO_CRYPTO0_CRYPTO_AXI_VMIDMT_ACR_ADDR A:0xfd419010
y.create.l HWIO_CRYPTO0_CRYPTO_AXI_VMIDMT_IDR0_ADDR A:0xfd419020
y.create.l HWIO_CRYPTO0_CRYPTO_AXI_VMIDMT_IDR1_ADDR A:0xfd419024
y.create.l HWIO_CRYPTO0_CRYPTO_AXI_VMIDMT_IDR2_ADDR A:0xfd419028
y.create.l HWIO_CRYPTO0_CRYPTO_AXI_VMIDMT_IDR4_ADDR A:0xfd419030
y.create.l HWIO_CRYPTO0_CRYPTO_AXI_VMIDMT_IDR5_ADDR A:0xfd419034
y.create.l HWIO_CRYPTO0_CRYPTO_AXI_VMIDMT_IDR7_ADDR A:0xfd41903c
y.create.l HWIO_CRYPTO0_CRYPTO_AXI_VMIDMT_GFAR0_ADDR A:0xfd419040
y.create.l HWIO_CRYPTO0_CRYPTO_AXI_VMIDMT_GFSR_ADDR A:0xfd419048
y.create.l HWIO_CRYPTO0_CRYPTO_AXI_VMIDMT_GFSRRESTORE_ADDR A:0xfd41904c
y.create.l HWIO_CRYPTO0_CRYPTO_AXI_VMIDMT_GFSYNDR0_ADDR A:0xfd419050
y.create.l HWIO_CRYPTO0_CRYPTO_AXI_VMIDMT_GFSYNDR1_ADDR A:0xfd419054
y.create.l HWIO_CRYPTO0_CRYPTO_AXI_VMIDMT_GFSYNDR2_ADDR A:0xfd419058
y.create.l HWIO_CRYPTO0_CRYPTO_AXI_VMIDMT_VMIDMTCR0_ADDR A:0xfd419090
y.create.l HWIO_CRYPTO0_CRYPTO_AXI_VMIDMT_VMIDMTACR_ADDR A:0xfd41909c
y.create.l HWIO_CRYPTO0_CRYPTO_AXI_VMIDMT_NSCR0_ADDR A:0xfd419400
y.create.l HWIO_CRYPTO0_CRYPTO_AXI_VMIDMT_NSCR2_ADDR A:0xfd419408
y.create.l HWIO_CRYPTO0_CRYPTO_AXI_VMIDMT_NSACR_ADDR A:0xfd419410
y.create.l HWIO_CRYPTO0_CRYPTO_AXI_VMIDMT_NSGFAR0_ADDR A:0xfd419440
y.create.l HWIO_CRYPTO0_CRYPTO_AXI_VMIDMT_NSGFSR_ADDR A:0xfd419448
y.create.l HWIO_CRYPTO0_CRYPTO_AXI_VMIDMT_NSGFSRRESTORE_ADDR A:0xfd41944c
y.create.l HWIO_CRYPTO0_CRYPTO_AXI_VMIDMT_NSGFSYNDR0_ADDR A:0xfd419450
y.create.l HWIO_CRYPTO0_CRYPTO_AXI_VMIDMT_NSGFSYNDR1_ADDR A:0xfd419454
y.create.l HWIO_CRYPTO0_CRYPTO_AXI_VMIDMT_NSGFSYNDR2_ADDR A:0xfd419458
y.create.l HWIO_CRYPTO0_CRYPTO_AXI_VMIDMT_NSVMIDMTCR0_ADDR A:0xfd419490
y.create.l HWIO_CRYPTO0_CRYPTO_AXI_VMIDMT_SSDR0_ADDR A:0xfd419080
y.create.l HWIO_CRYPTO0_CRYPTO_AXI_VMIDMT_MSDR0_ADDR A:0xfd419480
y.create.l HWIO_CRYPTO0_CRYPTO_AXI_VMIDMT_MCR_ADDR A:0xfd419494
y.create.l HWIO_CRYPTO0_CRYPTO_AXI_VMIDMT_S2VR0_ADDR A:0xfd419c00
y.create.l HWIO_CRYPTO0_CRYPTO_AXI_VMIDMT_S2VR1_ADDR A:0xfd419c04
y.create.l HWIO_CRYPTO0_CRYPTO_AXI_VMIDMT_S2VR2_ADDR A:0xfd419c08
y.create.l HWIO_CRYPTO0_CRYPTO_AXI_VMIDMT_S2VR3_ADDR A:0xfd419c0c
y.create.l HWIO_CRYPTO0_CRYPTO_AXI_VMIDMT_S2VR4_ADDR A:0xfd419c10
y.create.l HWIO_CRYPTO0_CRYPTO_AXI_VMIDMT_S2VR5_ADDR A:0xfd419c14
y.create.l HWIO_CRYPTO0_CRYPTO_AXI_VMIDMT_S2VR6_ADDR A:0xfd419c18
y.create.l HWIO_CRYPTO0_CRYPTO_AXI_VMIDMT_S2VR7_ADDR A:0xfd419c1c
y.create.l HWIO_CRYPTO0_CRYPTO_AXI_VMIDMT_S2VR8_ADDR A:0xfd419c20
y.create.l HWIO_CRYPTO0_CRYPTO_AXI_VMIDMT_S2VR9_ADDR A:0xfd419c24
y.create.l HWIO_CRYPTO0_CRYPTO_AXI_VMIDMT_AS2VR0_ADDR A:0xfd419e00
y.create.l HWIO_CRYPTO0_CRYPTO_AXI_VMIDMT_AS2VR1_ADDR A:0xfd419e04
y.create.l HWIO_CRYPTO0_CRYPTO_AXI_VMIDMT_AS2VR2_ADDR A:0xfd419e08
y.create.l HWIO_CRYPTO0_CRYPTO_AXI_VMIDMT_AS2VR3_ADDR A:0xfd419e0c
y.create.l HWIO_CRYPTO0_CRYPTO_AXI_VMIDMT_AS2VR4_ADDR A:0xfd419e10
y.create.l HWIO_CRYPTO0_CRYPTO_AXI_VMIDMT_AS2VR5_ADDR A:0xfd419e14
y.create.l HWIO_CRYPTO0_CRYPTO_AXI_VMIDMT_AS2VR6_ADDR A:0xfd419e18
y.create.l HWIO_CRYPTO0_CRYPTO_AXI_VMIDMT_AS2VR7_ADDR A:0xfd419e1c
y.create.l HWIO_CRYPTO0_CRYPTO_AXI_VMIDMT_AS2VR8_ADDR A:0xfd419e20
y.create.l HWIO_CRYPTO0_CRYPTO_AXI_VMIDMT_AS2VR9_ADDR A:0xfd419e24
y.create.l HWIO_CRYPTO0_CRYPTO_AXI_VMIDMT_SMR0_ADDR A:0xfd419800
y.create.l HWIO_CRYPTO0_CRYPTO_AXI_VMIDMT_SMR1_ADDR A:0xfd419804
y.create.l HWIO_CRYPTO0_CRYPTO_AXI_VMIDMT_SMR2_ADDR A:0xfd419808
y.create.l HWIO_CRYPTO0_CRYPTO_AXI_VMIDMT_SMR3_ADDR A:0xfd41980c
y.create.l HWIO_CRYPTO0_CRYPTO_AXI_VMIDMT_SMR4_ADDR A:0xfd419810
y.create.l HWIO_CRYPTO0_CRYPTO_AXI_VMIDMT_SMR5_ADDR A:0xfd419814
y.create.l HWIO_CRYPTO0_CRYPTO_AXI_VMIDMT_SMR6_ADDR A:0xfd419818
y.create.l HWIO_CRYPTO0_CRYPTO_AXI_VMIDMT_SMR7_ADDR A:0xfd41981c
y.create.l HWIO_CRYPTO0_CRYPTO_AXI_VMIDMT_SMR8_ADDR A:0xfd419820
y.create.l HWIO_CRYPTO0_CRYPTO_AXI_VMIDMT_SMR9_ADDR A:0xfd419824
y.create.l HWIO_CRYPTO0_CRYPTO_BAM_CTRL_ADDR A:0xfd404000
y.create.l HWIO_CRYPTO0_CRYPTO_BAM_REVISION_ADDR A:0xfd404004
y.create.l HWIO_CRYPTO0_CRYPTO_BAM_SW_VERSION_ADDR A:0xfd404080
y.create.l HWIO_CRYPTO0_CRYPTO_BAM_NUM_PIPES_ADDR A:0xfd40403c
y.create.l HWIO_CRYPTO0_CRYPTO_BAM_TIMER_ADDR A:0xfd404040
y.create.l HWIO_CRYPTO0_CRYPTO_BAM_TIMER_CTRL_ADDR A:0xfd404044
y.create.l HWIO_CRYPTO0_CRYPTO_BAM_DESC_CNT_TRSHLD_ADDR A:0xfd404008
y.create.l HWIO_CRYPTO0_CRYPTO_BAM_IRQ_SRCS_ADDR A:0xfd40400c
y.create.l HWIO_CRYPTO0_CRYPTO_BAM_IRQ_SRCS_MSK_ADDR A:0xfd404010
y.create.l HWIO_CRYPTO0_CRYPTO_BAM_IRQ_SRCS_UNMASKED_ADDR A:0xfd404030
y.create.l HWIO_CRYPTO0_CRYPTO_BAM_IRQ_STTS_ADDR A:0xfd404014
y.create.l HWIO_CRYPTO0_CRYPTO_BAM_IRQ_CLR_ADDR A:0xfd404018
y.create.l HWIO_CRYPTO0_CRYPTO_BAM_IRQ_EN_ADDR A:0xfd40401c
y.create.l HWIO_CRYPTO0_CRYPTO_BAM_AHB_MASTER_ERR_CTRLS_ADDR A:0xfd404024
y.create.l HWIO_CRYPTO0_CRYPTO_BAM_AHB_MASTER_ERR_ADDR_ADDR A:0xfd404028
y.create.l HWIO_CRYPTO0_CRYPTO_BAM_AHB_MASTER_ERR_DATA_ADDR A:0xfd40402c
y.create.l HWIO_CRYPTO0_CRYPTO_BAM_TRUST_REG_ADDR A:0xfd404070
y.create.l HWIO_CRYPTO0_CRYPTO_BAM_TEST_BUS_SEL_ADDR A:0xfd404074
y.create.l HWIO_CRYPTO0_CRYPTO_BAM_TEST_BUS_REG_ADDR A:0xfd404078
y.create.l HWIO_CRYPTO0_CRYPTO_BAM_CNFG_BITS_ADDR A:0xfd40407c
y.create.l HWIO_CRYPTO0_CRYPTO_BAM_IRQ_SRCS_EE0_ADDR A:0xfd404800
y.create.l HWIO_CRYPTO0_CRYPTO_BAM_IRQ_SRCS_EE1_ADDR A:0xfd404880
y.create.l HWIO_CRYPTO0_CRYPTO_BAM_IRQ_SRCS_EE2_ADDR A:0xfd404900
y.create.l HWIO_CRYPTO0_CRYPTO_BAM_IRQ_SRCS_EE3_ADDR A:0xfd404980
y.create.l HWIO_CRYPTO0_CRYPTO_BAM_IRQ_SRCS_EE4_ADDR A:0xfd404a00
y.create.l HWIO_CRYPTO0_CRYPTO_BAM_IRQ_SRCS_EE5_ADDR A:0xfd404a80
y.create.l HWIO_CRYPTO0_CRYPTO_BAM_IRQ_SRCS_EE6_ADDR A:0xfd404b00
y.create.l HWIO_CRYPTO0_CRYPTO_BAM_IRQ_SRCS_EE7_ADDR A:0xfd404b80
y.create.l HWIO_CRYPTO0_CRYPTO_BAM_IRQ_SRCS_MSK_EE0_ADDR A:0xfd404804
y.create.l HWIO_CRYPTO0_CRYPTO_BAM_IRQ_SRCS_MSK_EE1_ADDR A:0xfd404884
y.create.l HWIO_CRYPTO0_CRYPTO_BAM_IRQ_SRCS_MSK_EE2_ADDR A:0xfd404904
y.create.l HWIO_CRYPTO0_CRYPTO_BAM_IRQ_SRCS_MSK_EE3_ADDR A:0xfd404984
y.create.l HWIO_CRYPTO0_CRYPTO_BAM_IRQ_SRCS_MSK_EE4_ADDR A:0xfd404a04
y.create.l HWIO_CRYPTO0_CRYPTO_BAM_IRQ_SRCS_MSK_EE5_ADDR A:0xfd404a84
y.create.l HWIO_CRYPTO0_CRYPTO_BAM_IRQ_SRCS_MSK_EE6_ADDR A:0xfd404b04
y.create.l HWIO_CRYPTO0_CRYPTO_BAM_IRQ_SRCS_MSK_EE7_ADDR A:0xfd404b84
y.create.l HWIO_CRYPTO0_CRYPTO_BAM_IRQ_SRCS_UNMASKED_EE0_ADDR A:0xfd404808
y.create.l HWIO_CRYPTO0_CRYPTO_BAM_IRQ_SRCS_UNMASKED_EE1_ADDR A:0xfd404888
y.create.l HWIO_CRYPTO0_CRYPTO_BAM_IRQ_SRCS_UNMASKED_EE2_ADDR A:0xfd404908
y.create.l HWIO_CRYPTO0_CRYPTO_BAM_IRQ_SRCS_UNMASKED_EE3_ADDR A:0xfd404988
y.create.l HWIO_CRYPTO0_CRYPTO_BAM_IRQ_SRCS_UNMASKED_EE4_ADDR A:0xfd404a08
y.create.l HWIO_CRYPTO0_CRYPTO_BAM_IRQ_SRCS_UNMASKED_EE5_ADDR A:0xfd404a88
y.create.l HWIO_CRYPTO0_CRYPTO_BAM_IRQ_SRCS_UNMASKED_EE6_ADDR A:0xfd404b08
y.create.l HWIO_CRYPTO0_CRYPTO_BAM_IRQ_SRCS_UNMASKED_EE7_ADDR A:0xfd404b88
y.create.l HWIO_CRYPTO0_CRYPTO_BAM_P_CTRL0_ADDR A:0xfd405000
y.create.l HWIO_CRYPTO0_CRYPTO_BAM_P_CTRL1_ADDR A:0xfd406000
y.create.l HWIO_CRYPTO0_CRYPTO_BAM_P_CTRL2_ADDR A:0xfd407000
y.create.l HWIO_CRYPTO0_CRYPTO_BAM_P_CTRL3_ADDR A:0xfd408000
y.create.l HWIO_CRYPTO0_CRYPTO_BAM_P_CTRL4_ADDR A:0xfd409000
y.create.l HWIO_CRYPTO0_CRYPTO_BAM_P_CTRL5_ADDR A:0xfd40a000
y.create.l HWIO_CRYPTO0_CRYPTO_BAM_P_CTRL6_ADDR A:0xfd40b000
y.create.l HWIO_CRYPTO0_CRYPTO_BAM_P_CTRL7_ADDR A:0xfd40c000
y.create.l HWIO_CRYPTO0_CRYPTO_BAM_P_RST0_ADDR A:0xfd405004
y.create.l HWIO_CRYPTO0_CRYPTO_BAM_P_RST1_ADDR A:0xfd406004
y.create.l HWIO_CRYPTO0_CRYPTO_BAM_P_RST2_ADDR A:0xfd407004
y.create.l HWIO_CRYPTO0_CRYPTO_BAM_P_RST3_ADDR A:0xfd408004
y.create.l HWIO_CRYPTO0_CRYPTO_BAM_P_RST4_ADDR A:0xfd409004
y.create.l HWIO_CRYPTO0_CRYPTO_BAM_P_RST5_ADDR A:0xfd40a004
y.create.l HWIO_CRYPTO0_CRYPTO_BAM_P_RST6_ADDR A:0xfd40b004
y.create.l HWIO_CRYPTO0_CRYPTO_BAM_P_RST7_ADDR A:0xfd40c004
y.create.l HWIO_CRYPTO0_CRYPTO_BAM_P_HALT0_ADDR A:0xfd405008
y.create.l HWIO_CRYPTO0_CRYPTO_BAM_P_HALT1_ADDR A:0xfd406008
y.create.l HWIO_CRYPTO0_CRYPTO_BAM_P_HALT2_ADDR A:0xfd407008
y.create.l HWIO_CRYPTO0_CRYPTO_BAM_P_HALT3_ADDR A:0xfd408008
y.create.l HWIO_CRYPTO0_CRYPTO_BAM_P_HALT4_ADDR A:0xfd409008
y.create.l HWIO_CRYPTO0_CRYPTO_BAM_P_HALT5_ADDR A:0xfd40a008
y.create.l HWIO_CRYPTO0_CRYPTO_BAM_P_HALT6_ADDR A:0xfd40b008
y.create.l HWIO_CRYPTO0_CRYPTO_BAM_P_HALT7_ADDR A:0xfd40c008
y.create.l HWIO_CRYPTO0_CRYPTO_BAM_P_TRUST_REG0_ADDR A:0xfd405030
y.create.l HWIO_CRYPTO0_CRYPTO_BAM_P_TRUST_REG1_ADDR A:0xfd406030
y.create.l HWIO_CRYPTO0_CRYPTO_BAM_P_TRUST_REG2_ADDR A:0xfd407030
y.create.l HWIO_CRYPTO0_CRYPTO_BAM_P_TRUST_REG3_ADDR A:0xfd408030
y.create.l HWIO_CRYPTO0_CRYPTO_BAM_P_TRUST_REG4_ADDR A:0xfd409030
y.create.l HWIO_CRYPTO0_CRYPTO_BAM_P_TRUST_REG5_ADDR A:0xfd40a030
y.create.l HWIO_CRYPTO0_CRYPTO_BAM_P_TRUST_REG6_ADDR A:0xfd40b030
y.create.l HWIO_CRYPTO0_CRYPTO_BAM_P_TRUST_REG7_ADDR A:0xfd40c030
y.create.l HWIO_CRYPTO0_CRYPTO_BAM_P_IRQ_STTS0_ADDR A:0xfd405010
y.create.l HWIO_CRYPTO0_CRYPTO_BAM_P_IRQ_STTS1_ADDR A:0xfd406010
y.create.l HWIO_CRYPTO0_CRYPTO_BAM_P_IRQ_STTS2_ADDR A:0xfd407010
y.create.l HWIO_CRYPTO0_CRYPTO_BAM_P_IRQ_STTS3_ADDR A:0xfd408010
y.create.l HWIO_CRYPTO0_CRYPTO_BAM_P_IRQ_STTS4_ADDR A:0xfd409010
y.create.l HWIO_CRYPTO0_CRYPTO_BAM_P_IRQ_STTS5_ADDR A:0xfd40a010
y.create.l HWIO_CRYPTO0_CRYPTO_BAM_P_IRQ_STTS6_ADDR A:0xfd40b010
y.create.l HWIO_CRYPTO0_CRYPTO_BAM_P_IRQ_STTS7_ADDR A:0xfd40c010
y.create.l HWIO_CRYPTO0_CRYPTO_BAM_P_IRQ_CLR0_ADDR A:0xfd405014
y.create.l HWIO_CRYPTO0_CRYPTO_BAM_P_IRQ_CLR1_ADDR A:0xfd406014
y.create.l HWIO_CRYPTO0_CRYPTO_BAM_P_IRQ_CLR2_ADDR A:0xfd407014
y.create.l HWIO_CRYPTO0_CRYPTO_BAM_P_IRQ_CLR3_ADDR A:0xfd408014
y.create.l HWIO_CRYPTO0_CRYPTO_BAM_P_IRQ_CLR4_ADDR A:0xfd409014
y.create.l HWIO_CRYPTO0_CRYPTO_BAM_P_IRQ_CLR5_ADDR A:0xfd40a014
y.create.l HWIO_CRYPTO0_CRYPTO_BAM_P_IRQ_CLR6_ADDR A:0xfd40b014
y.create.l HWIO_CRYPTO0_CRYPTO_BAM_P_IRQ_CLR7_ADDR A:0xfd40c014
y.create.l HWIO_CRYPTO0_CRYPTO_BAM_P_IRQ_EN0_ADDR A:0xfd405018
y.create.l HWIO_CRYPTO0_CRYPTO_BAM_P_IRQ_EN1_ADDR A:0xfd406018
y.create.l HWIO_CRYPTO0_CRYPTO_BAM_P_IRQ_EN2_ADDR A:0xfd407018
y.create.l HWIO_CRYPTO0_CRYPTO_BAM_P_IRQ_EN3_ADDR A:0xfd408018
y.create.l HWIO_CRYPTO0_CRYPTO_BAM_P_IRQ_EN4_ADDR A:0xfd409018
y.create.l HWIO_CRYPTO0_CRYPTO_BAM_P_IRQ_EN5_ADDR A:0xfd40a018
y.create.l HWIO_CRYPTO0_CRYPTO_BAM_P_IRQ_EN6_ADDR A:0xfd40b018
y.create.l HWIO_CRYPTO0_CRYPTO_BAM_P_IRQ_EN7_ADDR A:0xfd40c018
y.create.l HWIO_CRYPTO0_CRYPTO_BAM_P_TIMER0_ADDR A:0xfd40501c
y.create.l HWIO_CRYPTO0_CRYPTO_BAM_P_TIMER1_ADDR A:0xfd40601c
y.create.l HWIO_CRYPTO0_CRYPTO_BAM_P_TIMER2_ADDR A:0xfd40701c
y.create.l HWIO_CRYPTO0_CRYPTO_BAM_P_TIMER3_ADDR A:0xfd40801c
y.create.l HWIO_CRYPTO0_CRYPTO_BAM_P_TIMER4_ADDR A:0xfd40901c
y.create.l HWIO_CRYPTO0_CRYPTO_BAM_P_TIMER5_ADDR A:0xfd40a01c
y.create.l HWIO_CRYPTO0_CRYPTO_BAM_P_TIMER6_ADDR A:0xfd40b01c
y.create.l HWIO_CRYPTO0_CRYPTO_BAM_P_TIMER7_ADDR A:0xfd40c01c
y.create.l HWIO_CRYPTO0_CRYPTO_BAM_P_TIMER_CTRL0_ADDR A:0xfd405020
y.create.l HWIO_CRYPTO0_CRYPTO_BAM_P_TIMER_CTRL1_ADDR A:0xfd406020
y.create.l HWIO_CRYPTO0_CRYPTO_BAM_P_TIMER_CTRL2_ADDR A:0xfd407020
y.create.l HWIO_CRYPTO0_CRYPTO_BAM_P_TIMER_CTRL3_ADDR A:0xfd408020
y.create.l HWIO_CRYPTO0_CRYPTO_BAM_P_TIMER_CTRL4_ADDR A:0xfd409020
y.create.l HWIO_CRYPTO0_CRYPTO_BAM_P_TIMER_CTRL5_ADDR A:0xfd40a020
y.create.l HWIO_CRYPTO0_CRYPTO_BAM_P_TIMER_CTRL6_ADDR A:0xfd40b020
y.create.l HWIO_CRYPTO0_CRYPTO_BAM_P_TIMER_CTRL7_ADDR A:0xfd40c020
y.create.l HWIO_CRYPTO0_CRYPTO_BAM_P_PRDCR_SDBND0_ADDR A:0xfd405024
y.create.l HWIO_CRYPTO0_CRYPTO_BAM_P_PRDCR_SDBND1_ADDR A:0xfd406024
y.create.l HWIO_CRYPTO0_CRYPTO_BAM_P_PRDCR_SDBND2_ADDR A:0xfd407024
y.create.l HWIO_CRYPTO0_CRYPTO_BAM_P_PRDCR_SDBND3_ADDR A:0xfd408024
y.create.l HWIO_CRYPTO0_CRYPTO_BAM_P_PRDCR_SDBND4_ADDR A:0xfd409024
y.create.l HWIO_CRYPTO0_CRYPTO_BAM_P_PRDCR_SDBND5_ADDR A:0xfd40a024
y.create.l HWIO_CRYPTO0_CRYPTO_BAM_P_PRDCR_SDBND6_ADDR A:0xfd40b024
y.create.l HWIO_CRYPTO0_CRYPTO_BAM_P_PRDCR_SDBND7_ADDR A:0xfd40c024
y.create.l HWIO_CRYPTO0_CRYPTO_BAM_P_CNSMR_SDBND0_ADDR A:0xfd405028
y.create.l HWIO_CRYPTO0_CRYPTO_BAM_P_CNSMR_SDBND1_ADDR A:0xfd406028
y.create.l HWIO_CRYPTO0_CRYPTO_BAM_P_CNSMR_SDBND2_ADDR A:0xfd407028
y.create.l HWIO_CRYPTO0_CRYPTO_BAM_P_CNSMR_SDBND3_ADDR A:0xfd408028
y.create.l HWIO_CRYPTO0_CRYPTO_BAM_P_CNSMR_SDBND4_ADDR A:0xfd409028
y.create.l HWIO_CRYPTO0_CRYPTO_BAM_P_CNSMR_SDBND5_ADDR A:0xfd40a028
y.create.l HWIO_CRYPTO0_CRYPTO_BAM_P_CNSMR_SDBND6_ADDR A:0xfd40b028
y.create.l HWIO_CRYPTO0_CRYPTO_BAM_P_CNSMR_SDBND7_ADDR A:0xfd40c028
y.create.l HWIO_CRYPTO0_CRYPTO_BAM_P_EVNT_DEST_ADDR0_ADDR A:0xfd40582c
y.create.l HWIO_CRYPTO0_CRYPTO_BAM_P_EVNT_DEST_ADDR1_ADDR A:0xfd40682c
y.create.l HWIO_CRYPTO0_CRYPTO_BAM_P_EVNT_DEST_ADDR2_ADDR A:0xfd40782c
y.create.l HWIO_CRYPTO0_CRYPTO_BAM_P_EVNT_DEST_ADDR3_ADDR A:0xfd40882c
y.create.l HWIO_CRYPTO0_CRYPTO_BAM_P_EVNT_DEST_ADDR4_ADDR A:0xfd40982c
y.create.l HWIO_CRYPTO0_CRYPTO_BAM_P_EVNT_DEST_ADDR5_ADDR A:0xfd40a82c
y.create.l HWIO_CRYPTO0_CRYPTO_BAM_P_EVNT_DEST_ADDR6_ADDR A:0xfd40b82c
y.create.l HWIO_CRYPTO0_CRYPTO_BAM_P_EVNT_DEST_ADDR7_ADDR A:0xfd40c82c
y.create.l HWIO_CRYPTO0_CRYPTO_BAM_P_EVNT_REG0_ADDR A:0xfd405818
y.create.l HWIO_CRYPTO0_CRYPTO_BAM_P_EVNT_REG1_ADDR A:0xfd406818
y.create.l HWIO_CRYPTO0_CRYPTO_BAM_P_EVNT_REG2_ADDR A:0xfd407818
y.create.l HWIO_CRYPTO0_CRYPTO_BAM_P_EVNT_REG3_ADDR A:0xfd408818
y.create.l HWIO_CRYPTO0_CRYPTO_BAM_P_EVNT_REG4_ADDR A:0xfd409818
y.create.l HWIO_CRYPTO0_CRYPTO_BAM_P_EVNT_REG5_ADDR A:0xfd40a818
y.create.l HWIO_CRYPTO0_CRYPTO_BAM_P_EVNT_REG6_ADDR A:0xfd40b818
y.create.l HWIO_CRYPTO0_CRYPTO_BAM_P_EVNT_REG7_ADDR A:0xfd40c818
y.create.l HWIO_CRYPTO0_CRYPTO_BAM_P_SW_OFSTS0_ADDR A:0xfd405800
y.create.l HWIO_CRYPTO0_CRYPTO_BAM_P_SW_OFSTS1_ADDR A:0xfd406800
y.create.l HWIO_CRYPTO0_CRYPTO_BAM_P_SW_OFSTS2_ADDR A:0xfd407800
y.create.l HWIO_CRYPTO0_CRYPTO_BAM_P_SW_OFSTS3_ADDR A:0xfd408800
y.create.l HWIO_CRYPTO0_CRYPTO_BAM_P_SW_OFSTS4_ADDR A:0xfd409800
y.create.l HWIO_CRYPTO0_CRYPTO_BAM_P_SW_OFSTS5_ADDR A:0xfd40a800
y.create.l HWIO_CRYPTO0_CRYPTO_BAM_P_SW_OFSTS6_ADDR A:0xfd40b800
y.create.l HWIO_CRYPTO0_CRYPTO_BAM_P_SW_OFSTS7_ADDR A:0xfd40c800
y.create.l HWIO_CRYPTO0_CRYPTO_BAM_P_DATA_FIFO_ADDR0_ADDR A:0xfd405824
y.create.l HWIO_CRYPTO0_CRYPTO_BAM_P_DATA_FIFO_ADDR1_ADDR A:0xfd406824
y.create.l HWIO_CRYPTO0_CRYPTO_BAM_P_DATA_FIFO_ADDR2_ADDR A:0xfd407824
y.create.l HWIO_CRYPTO0_CRYPTO_BAM_P_DATA_FIFO_ADDR3_ADDR A:0xfd408824
y.create.l HWIO_CRYPTO0_CRYPTO_BAM_P_DATA_FIFO_ADDR4_ADDR A:0xfd409824
y.create.l HWIO_CRYPTO0_CRYPTO_BAM_P_DATA_FIFO_ADDR5_ADDR A:0xfd40a824
y.create.l HWIO_CRYPTO0_CRYPTO_BAM_P_DATA_FIFO_ADDR6_ADDR A:0xfd40b824
y.create.l HWIO_CRYPTO0_CRYPTO_BAM_P_DATA_FIFO_ADDR7_ADDR A:0xfd40c824
y.create.l HWIO_CRYPTO0_CRYPTO_BAM_P_DESC_FIFO_ADDR0_ADDR A:0xfd40581c
y.create.l HWIO_CRYPTO0_CRYPTO_BAM_P_DESC_FIFO_ADDR1_ADDR A:0xfd40681c
y.create.l HWIO_CRYPTO0_CRYPTO_BAM_P_DESC_FIFO_ADDR2_ADDR A:0xfd40781c
y.create.l HWIO_CRYPTO0_CRYPTO_BAM_P_DESC_FIFO_ADDR3_ADDR A:0xfd40881c
y.create.l HWIO_CRYPTO0_CRYPTO_BAM_P_DESC_FIFO_ADDR4_ADDR A:0xfd40981c
y.create.l HWIO_CRYPTO0_CRYPTO_BAM_P_DESC_FIFO_ADDR5_ADDR A:0xfd40a81c
y.create.l HWIO_CRYPTO0_CRYPTO_BAM_P_DESC_FIFO_ADDR6_ADDR A:0xfd40b81c
y.create.l HWIO_CRYPTO0_CRYPTO_BAM_P_DESC_FIFO_ADDR7_ADDR A:0xfd40c81c
y.create.l HWIO_CRYPTO0_CRYPTO_BAM_P_EVNT_GEN_TRSHLD0_ADDR A:0xfd405828
y.create.l HWIO_CRYPTO0_CRYPTO_BAM_P_EVNT_GEN_TRSHLD1_ADDR A:0xfd406828
y.create.l HWIO_CRYPTO0_CRYPTO_BAM_P_EVNT_GEN_TRSHLD2_ADDR A:0xfd407828
y.create.l HWIO_CRYPTO0_CRYPTO_BAM_P_EVNT_GEN_TRSHLD3_ADDR A:0xfd408828
y.create.l HWIO_CRYPTO0_CRYPTO_BAM_P_EVNT_GEN_TRSHLD4_ADDR A:0xfd409828
y.create.l HWIO_CRYPTO0_CRYPTO_BAM_P_EVNT_GEN_TRSHLD5_ADDR A:0xfd40a828
y.create.l HWIO_CRYPTO0_CRYPTO_BAM_P_EVNT_GEN_TRSHLD6_ADDR A:0xfd40b828
y.create.l HWIO_CRYPTO0_CRYPTO_BAM_P_EVNT_GEN_TRSHLD7_ADDR A:0xfd40c828
y.create.l HWIO_CRYPTO0_CRYPTO_BAM_P_FIFO_SIZES0_ADDR A:0xfd405820
y.create.l HWIO_CRYPTO0_CRYPTO_BAM_P_FIFO_SIZES1_ADDR A:0xfd406820
y.create.l HWIO_CRYPTO0_CRYPTO_BAM_P_FIFO_SIZES2_ADDR A:0xfd407820
y.create.l HWIO_CRYPTO0_CRYPTO_BAM_P_FIFO_SIZES3_ADDR A:0xfd408820
y.create.l HWIO_CRYPTO0_CRYPTO_BAM_P_FIFO_SIZES4_ADDR A:0xfd409820
y.create.l HWIO_CRYPTO0_CRYPTO_BAM_P_FIFO_SIZES5_ADDR A:0xfd40a820
y.create.l HWIO_CRYPTO0_CRYPTO_BAM_P_FIFO_SIZES6_ADDR A:0xfd40b820
y.create.l HWIO_CRYPTO0_CRYPTO_BAM_P_FIFO_SIZES7_ADDR A:0xfd40c820
y.create.l HWIO_CRYPTO0_CRYPTO_BAM_P_RETR_CNTXT_0_ADDR A:0xfd405834
y.create.l HWIO_CRYPTO0_CRYPTO_BAM_P_RETR_CNTXT_1_ADDR A:0xfd406834
y.create.l HWIO_CRYPTO0_CRYPTO_BAM_P_RETR_CNTXT_2_ADDR A:0xfd407834
y.create.l HWIO_CRYPTO0_CRYPTO_BAM_P_RETR_CNTXT_3_ADDR A:0xfd408834
y.create.l HWIO_CRYPTO0_CRYPTO_BAM_P_RETR_CNTXT_4_ADDR A:0xfd409834
y.create.l HWIO_CRYPTO0_CRYPTO_BAM_P_RETR_CNTXT_5_ADDR A:0xfd40a834
y.create.l HWIO_CRYPTO0_CRYPTO_BAM_P_RETR_CNTXT_6_ADDR A:0xfd40b834
y.create.l HWIO_CRYPTO0_CRYPTO_BAM_P_RETR_CNTXT_7_ADDR A:0xfd40c834
y.create.l HWIO_CRYPTO0_CRYPTO_BAM_P_SI_CNTXT_0_ADDR A:0xfd405838
y.create.l HWIO_CRYPTO0_CRYPTO_BAM_P_SI_CNTXT_1_ADDR A:0xfd406838
y.create.l HWIO_CRYPTO0_CRYPTO_BAM_P_SI_CNTXT_2_ADDR A:0xfd407838
y.create.l HWIO_CRYPTO0_CRYPTO_BAM_P_SI_CNTXT_3_ADDR A:0xfd408838
y.create.l HWIO_CRYPTO0_CRYPTO_BAM_P_SI_CNTXT_4_ADDR A:0xfd409838
y.create.l HWIO_CRYPTO0_CRYPTO_BAM_P_SI_CNTXT_5_ADDR A:0xfd40a838
y.create.l HWIO_CRYPTO0_CRYPTO_BAM_P_SI_CNTXT_6_ADDR A:0xfd40b838
y.create.l HWIO_CRYPTO0_CRYPTO_BAM_P_SI_CNTXT_7_ADDR A:0xfd40c838
y.create.l HWIO_CRYPTO0_CRYPTO_BAM_P_DF_CNTXT_0_ADDR A:0xfd405830
y.create.l HWIO_CRYPTO0_CRYPTO_BAM_P_DF_CNTXT_1_ADDR A:0xfd406830
y.create.l HWIO_CRYPTO0_CRYPTO_BAM_P_DF_CNTXT_2_ADDR A:0xfd407830
y.create.l HWIO_CRYPTO0_CRYPTO_BAM_P_DF_CNTXT_3_ADDR A:0xfd408830
y.create.l HWIO_CRYPTO0_CRYPTO_BAM_P_DF_CNTXT_4_ADDR A:0xfd409830
y.create.l HWIO_CRYPTO0_CRYPTO_BAM_P_DF_CNTXT_5_ADDR A:0xfd40a830
y.create.l HWIO_CRYPTO0_CRYPTO_BAM_P_DF_CNTXT_6_ADDR A:0xfd40b830
y.create.l HWIO_CRYPTO0_CRYPTO_BAM_P_DF_CNTXT_7_ADDR A:0xfd40c830
y.create.l HWIO_CRYPTO0_CRYPTO_BAM_P_AU_PSM_CNTXT_1_0_ADDR A:0xfd405804
y.create.l HWIO_CRYPTO0_CRYPTO_BAM_P_AU_PSM_CNTXT_1_1_ADDR A:0xfd406804
y.create.l HWIO_CRYPTO0_CRYPTO_BAM_P_AU_PSM_CNTXT_1_2_ADDR A:0xfd407804
y.create.l HWIO_CRYPTO0_CRYPTO_BAM_P_AU_PSM_CNTXT_1_3_ADDR A:0xfd408804
y.create.l HWIO_CRYPTO0_CRYPTO_BAM_P_AU_PSM_CNTXT_1_4_ADDR A:0xfd409804
y.create.l HWIO_CRYPTO0_CRYPTO_BAM_P_AU_PSM_CNTXT_1_5_ADDR A:0xfd40a804
y.create.l HWIO_CRYPTO0_CRYPTO_BAM_P_AU_PSM_CNTXT_1_6_ADDR A:0xfd40b804
y.create.l HWIO_CRYPTO0_CRYPTO_BAM_P_AU_PSM_CNTXT_1_7_ADDR A:0xfd40c804
y.create.l HWIO_CRYPTO0_CRYPTO_BAM_P_PSM_CNTXT_2_0_ADDR A:0xfd405808
y.create.l HWIO_CRYPTO0_CRYPTO_BAM_P_PSM_CNTXT_2_1_ADDR A:0xfd406808
y.create.l HWIO_CRYPTO0_CRYPTO_BAM_P_PSM_CNTXT_2_2_ADDR A:0xfd407808
y.create.l HWIO_CRYPTO0_CRYPTO_BAM_P_PSM_CNTXT_2_3_ADDR A:0xfd408808
y.create.l HWIO_CRYPTO0_CRYPTO_BAM_P_PSM_CNTXT_2_4_ADDR A:0xfd409808
y.create.l HWIO_CRYPTO0_CRYPTO_BAM_P_PSM_CNTXT_2_5_ADDR A:0xfd40a808
y.create.l HWIO_CRYPTO0_CRYPTO_BAM_P_PSM_CNTXT_2_6_ADDR A:0xfd40b808
y.create.l HWIO_CRYPTO0_CRYPTO_BAM_P_PSM_CNTXT_2_7_ADDR A:0xfd40c808
y.create.l HWIO_CRYPTO0_CRYPTO_BAM_P_PSM_CNTXT_3_0_ADDR A:0xfd40580c
y.create.l HWIO_CRYPTO0_CRYPTO_BAM_P_PSM_CNTXT_3_1_ADDR A:0xfd40680c
y.create.l HWIO_CRYPTO0_CRYPTO_BAM_P_PSM_CNTXT_3_2_ADDR A:0xfd40780c
y.create.l HWIO_CRYPTO0_CRYPTO_BAM_P_PSM_CNTXT_3_3_ADDR A:0xfd40880c
y.create.l HWIO_CRYPTO0_CRYPTO_BAM_P_PSM_CNTXT_3_4_ADDR A:0xfd40980c
y.create.l HWIO_CRYPTO0_CRYPTO_BAM_P_PSM_CNTXT_3_5_ADDR A:0xfd40a80c
y.create.l HWIO_CRYPTO0_CRYPTO_BAM_P_PSM_CNTXT_3_6_ADDR A:0xfd40b80c
y.create.l HWIO_CRYPTO0_CRYPTO_BAM_P_PSM_CNTXT_3_7_ADDR A:0xfd40c80c
y.create.l HWIO_CRYPTO0_CRYPTO_BAM_P_PSM_CNTXT_4_0_ADDR A:0xfd405810
y.create.l HWIO_CRYPTO0_CRYPTO_BAM_P_PSM_CNTXT_4_1_ADDR A:0xfd406810
y.create.l HWIO_CRYPTO0_CRYPTO_BAM_P_PSM_CNTXT_4_2_ADDR A:0xfd407810
y.create.l HWIO_CRYPTO0_CRYPTO_BAM_P_PSM_CNTXT_4_3_ADDR A:0xfd408810
y.create.l HWIO_CRYPTO0_CRYPTO_BAM_P_PSM_CNTXT_4_4_ADDR A:0xfd409810
y.create.l HWIO_CRYPTO0_CRYPTO_BAM_P_PSM_CNTXT_4_5_ADDR A:0xfd40a810
y.create.l HWIO_CRYPTO0_CRYPTO_BAM_P_PSM_CNTXT_4_6_ADDR A:0xfd40b810
y.create.l HWIO_CRYPTO0_CRYPTO_BAM_P_PSM_CNTXT_4_7_ADDR A:0xfd40c810
y.create.l HWIO_CRYPTO0_CRYPTO_BAM_P_PSM_CNTXT_5_0_ADDR A:0xfd405814
y.create.l HWIO_CRYPTO0_CRYPTO_BAM_P_PSM_CNTXT_5_1_ADDR A:0xfd406814
y.create.l HWIO_CRYPTO0_CRYPTO_BAM_P_PSM_CNTXT_5_2_ADDR A:0xfd407814
y.create.l HWIO_CRYPTO0_CRYPTO_BAM_P_PSM_CNTXT_5_3_ADDR A:0xfd408814
y.create.l HWIO_CRYPTO0_CRYPTO_BAM_P_PSM_CNTXT_5_4_ADDR A:0xfd409814
y.create.l HWIO_CRYPTO0_CRYPTO_BAM_P_PSM_CNTXT_5_5_ADDR A:0xfd40a814
y.create.l HWIO_CRYPTO0_CRYPTO_BAM_P_PSM_CNTXT_5_6_ADDR A:0xfd40b814
y.create.l HWIO_CRYPTO0_CRYPTO_BAM_P_PSM_CNTXT_5_7_ADDR A:0xfd40c814
y.create.l HWIO_CRYPTO0_CRYPTO_BAM_XPU_SCR_ADDR A:0xfd402000
y.create.l HWIO_CRYPTO0_CRYPTO_BAM_XPU_SWDR_ADDR A:0xfd402004
y.create.l HWIO_CRYPTO0_CRYPTO_BAM_XPU_SEAR0_ADDR A:0xfd402040
y.create.l HWIO_CRYPTO0_CRYPTO_BAM_XPU_SESR_ADDR A:0xfd402048
y.create.l HWIO_CRYPTO0_CRYPTO_BAM_XPU_SESRRESTORE_ADDR A:0xfd40204c
y.create.l HWIO_CRYPTO0_CRYPTO_BAM_XPU_SESYNR0_ADDR A:0xfd402050
y.create.l HWIO_CRYPTO0_CRYPTO_BAM_XPU_SESYNR1_ADDR A:0xfd402054
y.create.l HWIO_CRYPTO0_CRYPTO_BAM_XPU_SESYNR2_ADDR A:0xfd402058
y.create.l HWIO_CRYPTO0_CRYPTO_BAM_XPU_MCR_ADDR A:0xfd402100
y.create.l HWIO_CRYPTO0_CRYPTO_BAM_XPU_MEAR0_ADDR A:0xfd402140
y.create.l HWIO_CRYPTO0_CRYPTO_BAM_XPU_MESR_ADDR A:0xfd402148
y.create.l HWIO_CRYPTO0_CRYPTO_BAM_XPU_MESRRESTORE_ADDR A:0xfd40214c
y.create.l HWIO_CRYPTO0_CRYPTO_BAM_XPU_MESYNR0_ADDR A:0xfd402150
y.create.l HWIO_CRYPTO0_CRYPTO_BAM_XPU_MESYNR1_ADDR A:0xfd402154
y.create.l HWIO_CRYPTO0_CRYPTO_BAM_XPU_MESYNR2_ADDR A:0xfd402158
y.create.l HWIO_CRYPTO0_CRYPTO_BAM_XPU_CR_ADDR A:0xfd402080
y.create.l HWIO_CRYPTO0_CRYPTO_BAM_XPU_RPU_ACR0_ADDR A:0xfd4020a0
y.create.l HWIO_CRYPTO0_CRYPTO_BAM_XPU_EAR0_ADDR A:0xfd4020c0
y.create.l HWIO_CRYPTO0_CRYPTO_BAM_XPU_ESR_ADDR A:0xfd4020c8
y.create.l HWIO_CRYPTO0_CRYPTO_BAM_XPU_ESRRESTORE_ADDR A:0xfd4020cc
y.create.l HWIO_CRYPTO0_CRYPTO_BAM_XPU_ESYNR0_ADDR A:0xfd4020d0
y.create.l HWIO_CRYPTO0_CRYPTO_BAM_XPU_ESYNR1_ADDR A:0xfd4020d4
y.create.l HWIO_CRYPTO0_CRYPTO_BAM_XPU_ESYNR2_ADDR A:0xfd4020d8
y.create.l HWIO_CRYPTO0_CRYPTO_BAM_XPU_IDR0_ADDR A:0xfd402074
y.create.l HWIO_CRYPTO0_CRYPTO_BAM_XPU_IDR1_ADDR A:0xfd402078
y.create.l HWIO_CRYPTO0_CRYPTO_BAM_XPU_REV_ADDR A:0xfd40207c
y.create.l HWIO_CRYPTO0_CRYPTO_BAM_XPU_RG0_RACR0_ADDR A:0xfd402200
y.create.l HWIO_CRYPTO0_CRYPTO_BAM_XPU_RG1_RACR0_ADDR A:0xfd402280
y.create.l HWIO_CRYPTO0_CRYPTO_BAM_XPU_RG2_RACR0_ADDR A:0xfd402300
y.create.l HWIO_CRYPTO0_CRYPTO_BAM_XPU_RG3_RACR0_ADDR A:0xfd402380
y.create.l HWIO_CRYPTO0_CRYPTO_BAM_XPU_RG4_RACR0_ADDR A:0xfd402400
y.create.l HWIO_CRYPTO0_CRYPTO_BAM_XPU_RG5_RACR0_ADDR A:0xfd402480
y.create.l HWIO_CRYPTO0_CRYPTO_BAM_XPU_RG6_RACR0_ADDR A:0xfd402500
y.create.l HWIO_CRYPTO0_CRYPTO_BAM_XPU_RG7_RACR0_ADDR A:0xfd402580
y.create.l HWIO_CRYPTO0_CRYPTO_BAM_XPU_RG8_RACR0_ADDR A:0xfd402600
y.create.l HWIO_CRYPTO0_CRYPTO_BAM_XPU_RG9_RACR0_ADDR A:0xfd402680
y.create.l HWIO_CRYPTO0_CRYPTO_BAM_XPU_RG0_SCR_ADDR A:0xfd402250
y.create.l HWIO_CRYPTO0_CRYPTO_BAM_XPU_RG1_SCR_ADDR A:0xfd4022d0
y.create.l HWIO_CRYPTO0_CRYPTO_BAM_XPU_RG2_SCR_ADDR A:0xfd402350
y.create.l HWIO_CRYPTO0_CRYPTO_BAM_XPU_RG3_SCR_ADDR A:0xfd4023d0
y.create.l HWIO_CRYPTO0_CRYPTO_BAM_XPU_RG4_SCR_ADDR A:0xfd402450
y.create.l HWIO_CRYPTO0_CRYPTO_BAM_XPU_RG5_SCR_ADDR A:0xfd4024d0
y.create.l HWIO_CRYPTO0_CRYPTO_BAM_XPU_RG6_SCR_ADDR A:0xfd402550
y.create.l HWIO_CRYPTO0_CRYPTO_BAM_XPU_RG7_SCR_ADDR A:0xfd4025d0
y.create.l HWIO_CRYPTO0_CRYPTO_BAM_XPU_RG8_SCR_ADDR A:0xfd402650
y.create.l HWIO_CRYPTO0_CRYPTO_BAM_XPU_RG9_SCR_ADDR A:0xfd4026d0
y.create.l HWIO_CRYPTO0_CRYPTO_BAM_XPU_RG0_MCR_ADDR A:0xfd402254
y.create.l HWIO_CRYPTO0_CRYPTO_BAM_XPU_RG1_MCR_ADDR A:0xfd4022d4
y.create.l HWIO_CRYPTO0_CRYPTO_BAM_XPU_RG2_MCR_ADDR A:0xfd402354
y.create.l HWIO_CRYPTO0_CRYPTO_BAM_XPU_RG3_MCR_ADDR A:0xfd4023d4
y.create.l HWIO_CRYPTO0_CRYPTO_BAM_XPU_RG4_MCR_ADDR A:0xfd402454
y.create.l HWIO_CRYPTO0_CRYPTO_BAM_XPU_RG5_MCR_ADDR A:0xfd4024d4
y.create.l HWIO_CRYPTO0_CRYPTO_BAM_XPU_RG6_MCR_ADDR A:0xfd402554
y.create.l HWIO_CRYPTO0_CRYPTO_BAM_XPU_RG7_MCR_ADDR A:0xfd4025d4
y.create.l HWIO_CRYPTO0_CRYPTO_BAM_XPU_RG8_MCR_ADDR A:0xfd402654
y.create.l HWIO_CRYPTO0_CRYPTO_BAM_XPU_RG9_MCR_ADDR A:0xfd4026d4
y.create.l HWIO_CRYPTO0_CRYPTO_BAM_VMIDMT_SCR0_ADDR A:0xfd400000
y.create.l HWIO_CRYPTO0_CRYPTO_BAM_VMIDMT_SCR1_ADDR A:0xfd400004
y.create.l HWIO_CRYPTO0_CRYPTO_BAM_VMIDMT_SCR2_ADDR A:0xfd400008
y.create.l HWIO_CRYPTO0_CRYPTO_BAM_VMIDMT_SACR_ADDR A:0xfd400010
y.create.l HWIO_CRYPTO0_CRYPTO_BAM_VMIDMT_SIDR0_ADDR A:0xfd400020
y.create.l HWIO_CRYPTO0_CRYPTO_BAM_VMIDMT_SIDR1_ADDR A:0xfd400024
y.create.l HWIO_CRYPTO0_CRYPTO_BAM_VMIDMT_SIDR2_ADDR A:0xfd400028
y.create.l HWIO_CRYPTO0_CRYPTO_BAM_VMIDMT_SIDR4_ADDR A:0xfd400030
y.create.l HWIO_CRYPTO0_CRYPTO_BAM_VMIDMT_SIDR5_ADDR A:0xfd400034
y.create.l HWIO_CRYPTO0_CRYPTO_BAM_VMIDMT_SIDR7_ADDR A:0xfd40003c
y.create.l HWIO_CRYPTO0_CRYPTO_BAM_VMIDMT_SGFAR0_ADDR A:0xfd400040
y.create.l HWIO_CRYPTO0_CRYPTO_BAM_VMIDMT_SGFSR_ADDR A:0xfd400048
y.create.l HWIO_CRYPTO0_CRYPTO_BAM_VMIDMT_SGFSRRESTORE_ADDR A:0xfd40004c
y.create.l HWIO_CRYPTO0_CRYPTO_BAM_VMIDMT_SGFSYNDR0_ADDR A:0xfd400050
y.create.l HWIO_CRYPTO0_CRYPTO_BAM_VMIDMT_SGFSYNDR1_ADDR A:0xfd400054
y.create.l HWIO_CRYPTO0_CRYPTO_BAM_VMIDMT_SGFSYNDR2_ADDR A:0xfd400058
y.create.l HWIO_CRYPTO0_CRYPTO_BAM_VMIDMT_VMIDMTSCR0_ADDR A:0xfd400090
y.create.l HWIO_CRYPTO0_CRYPTO_BAM_VMIDMT_CR0_ADDR A:0xfd400000
y.create.l HWIO_CRYPTO0_CRYPTO_BAM_VMIDMT_CR2_ADDR A:0xfd400008
y.create.l HWIO_CRYPTO0_CRYPTO_BAM_VMIDMT_ACR_ADDR A:0xfd400010
y.create.l HWIO_CRYPTO0_CRYPTO_BAM_VMIDMT_IDR0_ADDR A:0xfd400020
y.create.l HWIO_CRYPTO0_CRYPTO_BAM_VMIDMT_IDR1_ADDR A:0xfd400024
y.create.l HWIO_CRYPTO0_CRYPTO_BAM_VMIDMT_IDR2_ADDR A:0xfd400028
y.create.l HWIO_CRYPTO0_CRYPTO_BAM_VMIDMT_IDR4_ADDR A:0xfd400030
y.create.l HWIO_CRYPTO0_CRYPTO_BAM_VMIDMT_IDR5_ADDR A:0xfd400034
y.create.l HWIO_CRYPTO0_CRYPTO_BAM_VMIDMT_IDR7_ADDR A:0xfd40003c
y.create.l HWIO_CRYPTO0_CRYPTO_BAM_VMIDMT_GFAR0_ADDR A:0xfd400040
y.create.l HWIO_CRYPTO0_CRYPTO_BAM_VMIDMT_GFSR_ADDR A:0xfd400048
y.create.l HWIO_CRYPTO0_CRYPTO_BAM_VMIDMT_GFSRRESTORE_ADDR A:0xfd40004c
y.create.l HWIO_CRYPTO0_CRYPTO_BAM_VMIDMT_GFSYNDR0_ADDR A:0xfd400050
y.create.l HWIO_CRYPTO0_CRYPTO_BAM_VMIDMT_GFSYNDR1_ADDR A:0xfd400054
y.create.l HWIO_CRYPTO0_CRYPTO_BAM_VMIDMT_GFSYNDR2_ADDR A:0xfd400058
y.create.l HWIO_CRYPTO0_CRYPTO_BAM_VMIDMT_VMIDMTCR0_ADDR A:0xfd400090
y.create.l HWIO_CRYPTO0_CRYPTO_BAM_VMIDMT_VMIDMTACR_ADDR A:0xfd40009c
y.create.l HWIO_CRYPTO0_CRYPTO_BAM_VMIDMT_NSCR0_ADDR A:0xfd400400
y.create.l HWIO_CRYPTO0_CRYPTO_BAM_VMIDMT_NSCR2_ADDR A:0xfd400408
y.create.l HWIO_CRYPTO0_CRYPTO_BAM_VMIDMT_NSACR_ADDR A:0xfd400410
y.create.l HWIO_CRYPTO0_CRYPTO_BAM_VMIDMT_NSGFAR0_ADDR A:0xfd400440
y.create.l HWIO_CRYPTO0_CRYPTO_BAM_VMIDMT_NSGFSR_ADDR A:0xfd400448
y.create.l HWIO_CRYPTO0_CRYPTO_BAM_VMIDMT_NSGFSRRESTORE_ADDR A:0xfd40044c
y.create.l HWIO_CRYPTO0_CRYPTO_BAM_VMIDMT_NSGFSYNDR0_ADDR A:0xfd400450
y.create.l HWIO_CRYPTO0_CRYPTO_BAM_VMIDMT_NSGFSYNDR1_ADDR A:0xfd400454
y.create.l HWIO_CRYPTO0_CRYPTO_BAM_VMIDMT_NSGFSYNDR2_ADDR A:0xfd400458
y.create.l HWIO_CRYPTO0_CRYPTO_BAM_VMIDMT_NSVMIDMTCR0_ADDR A:0xfd400490
y.create.l HWIO_CRYPTO0_CRYPTO_BAM_VMIDMT_SSDR0_ADDR A:0xfd400080
y.create.l HWIO_CRYPTO0_CRYPTO_BAM_VMIDMT_MSDR0_ADDR A:0xfd400480
y.create.l HWIO_CRYPTO0_CRYPTO_BAM_VMIDMT_MCR_ADDR A:0xfd400494
y.create.l HWIO_CRYPTO0_CRYPTO_BAM_VMIDMT_S2VR0_ADDR A:0xfd400c00
y.create.l HWIO_CRYPTO0_CRYPTO_BAM_VMIDMT_S2VR1_ADDR A:0xfd400c04
y.create.l HWIO_CRYPTO0_CRYPTO_BAM_VMIDMT_S2VR2_ADDR A:0xfd400c08
y.create.l HWIO_CRYPTO0_CRYPTO_BAM_VMIDMT_S2VR3_ADDR A:0xfd400c0c
y.create.l HWIO_CRYPTO0_CRYPTO_BAM_VMIDMT_S2VR4_ADDR A:0xfd400c10
y.create.l HWIO_CRYPTO0_CRYPTO_BAM_VMIDMT_S2VR5_ADDR A:0xfd400c14
y.create.l HWIO_CRYPTO0_CRYPTO_BAM_VMIDMT_S2VR6_ADDR A:0xfd400c18
y.create.l HWIO_CRYPTO0_CRYPTO_BAM_VMIDMT_S2VR7_ADDR A:0xfd400c1c
y.create.l HWIO_CRYPTO0_CRYPTO_BAM_VMIDMT_S2VR8_ADDR A:0xfd400c20
y.create.l HWIO_CRYPTO0_CRYPTO_BAM_VMIDMT_AS2VR0_ADDR A:0xfd400e00
y.create.l HWIO_CRYPTO0_CRYPTO_BAM_VMIDMT_AS2VR1_ADDR A:0xfd400e04
y.create.l HWIO_CRYPTO0_CRYPTO_BAM_VMIDMT_AS2VR2_ADDR A:0xfd400e08
y.create.l HWIO_CRYPTO0_CRYPTO_BAM_VMIDMT_AS2VR3_ADDR A:0xfd400e0c
y.create.l HWIO_CRYPTO0_CRYPTO_BAM_VMIDMT_AS2VR4_ADDR A:0xfd400e10
y.create.l HWIO_CRYPTO0_CRYPTO_BAM_VMIDMT_AS2VR5_ADDR A:0xfd400e14
y.create.l HWIO_CRYPTO0_CRYPTO_BAM_VMIDMT_AS2VR6_ADDR A:0xfd400e18
y.create.l HWIO_CRYPTO0_CRYPTO_BAM_VMIDMT_AS2VR7_ADDR A:0xfd400e1c
y.create.l HWIO_CRYPTO0_CRYPTO_BAM_VMIDMT_AS2VR8_ADDR A:0xfd400e20
y.create.l HWIO_CRYPTO0_CRYPTO_BAM_VMIDMT_SMR0_ADDR A:0xfd400800
y.create.l HWIO_CRYPTO0_CRYPTO_BAM_VMIDMT_SMR1_ADDR A:0xfd400804
y.create.l HWIO_CRYPTO0_CRYPTO_BAM_VMIDMT_SMR2_ADDR A:0xfd400808
y.create.l HWIO_CRYPTO0_CRYPTO_BAM_VMIDMT_SMR3_ADDR A:0xfd40080c
y.create.l HWIO_CRYPTO0_CRYPTO_BAM_VMIDMT_SMR4_ADDR A:0xfd400810
y.create.l HWIO_CRYPTO0_CRYPTO_BAM_VMIDMT_SMR5_ADDR A:0xfd400814
y.create.l HWIO_CRYPTO0_CRYPTO_BAM_VMIDMT_SMR6_ADDR A:0xfd400818
y.create.l HWIO_CRYPTO0_CRYPTO_BAM_VMIDMT_SMR7_ADDR A:0xfd40081c
y.create.l HWIO_CRYPTO0_CRYPTO_BAM_VMIDMT_SMR8_ADDR A:0xfd400820
y.create.l HWIO_CSI_PHY_0_MIPI_CSIPHY_LN0_CFG1_ADDR A:0xfda00c00
y.create.l HWIO_CSI_PHY_0_MIPI_CSIPHY_LN1_CFG1_ADDR A:0xfda00c40
y.create.l HWIO_CSI_PHY_0_MIPI_CSIPHY_LN2_CFG1_ADDR A:0xfda00c80
y.create.l HWIO_CSI_PHY_0_MIPI_CSIPHY_LN3_CFG1_ADDR A:0xfda00cc0
y.create.l HWIO_CSI_PHY_0_MIPI_CSIPHY_LN0_CFG2_ADDR A:0xfda00c04
y.create.l HWIO_CSI_PHY_0_MIPI_CSIPHY_LN1_CFG2_ADDR A:0xfda00c44
y.create.l HWIO_CSI_PHY_0_MIPI_CSIPHY_LN2_CFG2_ADDR A:0xfda00c84
y.create.l HWIO_CSI_PHY_0_MIPI_CSIPHY_LN3_CFG2_ADDR A:0xfda00cc4
y.create.l HWIO_CSI_PHY_0_MIPI_CSIPHY_LN0_CFG3_ADDR A:0xfda00c08
y.create.l HWIO_CSI_PHY_0_MIPI_CSIPHY_LN1_CFG3_ADDR A:0xfda00c48
y.create.l HWIO_CSI_PHY_0_MIPI_CSIPHY_LN2_CFG3_ADDR A:0xfda00c88
y.create.l HWIO_CSI_PHY_0_MIPI_CSIPHY_LN3_CFG3_ADDR A:0xfda00cc8
y.create.l HWIO_CSI_PHY_0_MIPI_CSIPHY_LN0_CFG4_ADDR A:0xfda00c0c
y.create.l HWIO_CSI_PHY_0_MIPI_CSIPHY_LN1_CFG4_ADDR A:0xfda00c4c
y.create.l HWIO_CSI_PHY_0_MIPI_CSIPHY_LN2_CFG4_ADDR A:0xfda00c8c
y.create.l HWIO_CSI_PHY_0_MIPI_CSIPHY_LN3_CFG4_ADDR A:0xfda00ccc
y.create.l HWIO_CSI_PHY_0_MIPI_CSIPHY_LN0_CFG5_ADDR A:0xfda00c10
y.create.l HWIO_CSI_PHY_0_MIPI_CSIPHY_LN1_CFG5_ADDR A:0xfda00c50
y.create.l HWIO_CSI_PHY_0_MIPI_CSIPHY_LN2_CFG5_ADDR A:0xfda00c90
y.create.l HWIO_CSI_PHY_0_MIPI_CSIPHY_LN3_CFG5_ADDR A:0xfda00cd0
y.create.l HWIO_CSI_PHY_0_MIPI_CSIPHY_LN0_TEST_FORCE_ADDR A:0xfda00c14
y.create.l HWIO_CSI_PHY_0_MIPI_CSIPHY_LN1_TEST_FORCE_ADDR A:0xfda00c54
y.create.l HWIO_CSI_PHY_0_MIPI_CSIPHY_LN2_TEST_FORCE_ADDR A:0xfda00c94
y.create.l HWIO_CSI_PHY_0_MIPI_CSIPHY_LN3_TEST_FORCE_ADDR A:0xfda00cd4
y.create.l HWIO_CSI_PHY_0_MIPI_CSIPHY_LN0_TEST_DPATH_ADDR A:0xfda00c18
y.create.l HWIO_CSI_PHY_0_MIPI_CSIPHY_LN1_TEST_DPATH_ADDR A:0xfda00c58
y.create.l HWIO_CSI_PHY_0_MIPI_CSIPHY_LN2_TEST_DPATH_ADDR A:0xfda00c98
y.create.l HWIO_CSI_PHY_0_MIPI_CSIPHY_LN3_TEST_DPATH_ADDR A:0xfda00cd8
y.create.l HWIO_CSI_PHY_0_MIPI_CSIPHY_LN0_TEST_IMP_ADDR A:0xfda00c1c
y.create.l HWIO_CSI_PHY_0_MIPI_CSIPHY_LN1_TEST_IMP_ADDR A:0xfda00c5c
y.create.l HWIO_CSI_PHY_0_MIPI_CSIPHY_LN2_TEST_IMP_ADDR A:0xfda00c9c
y.create.l HWIO_CSI_PHY_0_MIPI_CSIPHY_LN3_TEST_IMP_ADDR A:0xfda00cdc
y.create.l HWIO_CSI_PHY_0_MIPI_CSIPHY_LN0_BIST_CTL1_ADDR A:0xfda00c20
y.create.l HWIO_CSI_PHY_0_MIPI_CSIPHY_LN1_BIST_CTL1_ADDR A:0xfda00c60
y.create.l HWIO_CSI_PHY_0_MIPI_CSIPHY_LN2_BIST_CTL1_ADDR A:0xfda00ca0
y.create.l HWIO_CSI_PHY_0_MIPI_CSIPHY_LN3_BIST_CTL1_ADDR A:0xfda00ce0
y.create.l HWIO_CSI_PHY_0_MIPI_CSIPHY_LN0_BIST_CTL2_ADDR A:0xfda00c24
y.create.l HWIO_CSI_PHY_0_MIPI_CSIPHY_LN1_BIST_CTL2_ADDR A:0xfda00c64
y.create.l HWIO_CSI_PHY_0_MIPI_CSIPHY_LN2_BIST_CTL2_ADDR A:0xfda00ca4
y.create.l HWIO_CSI_PHY_0_MIPI_CSIPHY_LN3_BIST_CTL2_ADDR A:0xfda00ce4
y.create.l HWIO_CSI_PHY_0_MIPI_CSIPHY_LN0_MISC1_ADDR A:0xfda00c28
y.create.l HWIO_CSI_PHY_0_MIPI_CSIPHY_LN1_MISC1_ADDR A:0xfda00c68
y.create.l HWIO_CSI_PHY_0_MIPI_CSIPHY_LN2_MISC1_ADDR A:0xfda00ca8
y.create.l HWIO_CSI_PHY_0_MIPI_CSIPHY_LN3_MISC1_ADDR A:0xfda00ce8
y.create.l HWIO_CSI_PHY_0_MIPI_CSIPHY_LN0_STATUS_ADDR A:0xfda00c2c
y.create.l HWIO_CSI_PHY_0_MIPI_CSIPHY_LN1_STATUS_ADDR A:0xfda00c6c
y.create.l HWIO_CSI_PHY_0_MIPI_CSIPHY_LN2_STATUS_ADDR A:0xfda00cac
y.create.l HWIO_CSI_PHY_0_MIPI_CSIPHY_LN3_STATUS_ADDR A:0xfda00cec
y.create.l HWIO_CSI_PHY_0_MIPI_CSIPHY_LN0_BIST_MISR_STAT1_ADDR A:0xfda00c30
y.create.l HWIO_CSI_PHY_0_MIPI_CSIPHY_LN1_BIST_MISR_STAT1_ADDR A:0xfda00c70
y.create.l HWIO_CSI_PHY_0_MIPI_CSIPHY_LN2_BIST_MISR_STAT1_ADDR A:0xfda00cb0
y.create.l HWIO_CSI_PHY_0_MIPI_CSIPHY_LN3_BIST_MISR_STAT1_ADDR A:0xfda00cf0
y.create.l HWIO_CSI_PHY_0_MIPI_CSIPHY_LN0_BIST_MISR_STAT2_ADDR A:0xfda00c34
y.create.l HWIO_CSI_PHY_0_MIPI_CSIPHY_LN1_BIST_MISR_STAT2_ADDR A:0xfda00c74
y.create.l HWIO_CSI_PHY_0_MIPI_CSIPHY_LN2_BIST_MISR_STAT2_ADDR A:0xfda00cb4
y.create.l HWIO_CSI_PHY_0_MIPI_CSIPHY_LN3_BIST_MISR_STAT2_ADDR A:0xfda00cf4
y.create.l HWIO_CSI_PHY_0_MIPI_CSIPHY_LN0_MISR_STAT3_ADDR A:0xfda00c38
y.create.l HWIO_CSI_PHY_0_MIPI_CSIPHY_LN1_MISR_STAT3_ADDR A:0xfda00c78
y.create.l HWIO_CSI_PHY_0_MIPI_CSIPHY_LN2_MISR_STAT3_ADDR A:0xfda00cb8
y.create.l HWIO_CSI_PHY_0_MIPI_CSIPHY_LN3_MISR_STAT3_ADDR A:0xfda00cf8
y.create.l HWIO_CSI_PHY_0_MIPI_CSIPHY_LN0_MISR_STAT4_ADDR A:0xfda00c3c
y.create.l HWIO_CSI_PHY_0_MIPI_CSIPHY_LN1_MISR_STAT4_ADDR A:0xfda00c7c
y.create.l HWIO_CSI_PHY_0_MIPI_CSIPHY_LN2_MISR_STAT4_ADDR A:0xfda00cbc
y.create.l HWIO_CSI_PHY_0_MIPI_CSIPHY_LN3_MISR_STAT4_ADDR A:0xfda00cfc
y.create.l HWIO_CSI_PHY_0_MIPI_CSIPHY_LNCK_CFG1_ADDR A:0xfda00d00
y.create.l HWIO_CSI_PHY_0_MIPI_CSIPHY_LNCK_CFG2_ADDR A:0xfda00d04
y.create.l HWIO_CSI_PHY_0_MIPI_CSIPHY_LNCK_CFG3_ADDR A:0xfda00d08
y.create.l HWIO_CSI_PHY_0_MIPI_CSIPHY_LNCK_CFG4_ADDR A:0xfda00d0c
y.create.l HWIO_CSI_PHY_0_MIPI_CSIPHY_LNCK_CFG5_ADDR A:0xfda00d10
y.create.l HWIO_CSI_PHY_0_MIPI_CSIPHY_LNCK_TEST_FORCE_ADDR A:0xfda00d14
y.create.l HWIO_CSI_PHY_0_MIPI_CSIPHY_LNCK_TEST_DPATH_ADDR A:0xfda00d18
y.create.l HWIO_CSI_PHY_0_MIPI_CSIPHY_LNCK_TEST_IMP_ADDR A:0xfda00d1c
y.create.l HWIO_CSI_PHY_0_MIPI_CSIPHY_LNCK_TEST_CFG1_ADDR A:0xfda00d20
y.create.l HWIO_CSI_PHY_0_MIPI_CSIPHY_LNCK_TEST_CFG2_ADDR A:0xfda00d24
y.create.l HWIO_CSI_PHY_0_MIPI_CSIPHY_LNCK_MISC1_ADDR A:0xfda00d28
y.create.l HWIO_CSI_PHY_0_MIPI_CSIPHY_LNCK_STATUS_ADDR A:0xfda00d2c
y.create.l HWIO_CSI_PHY_0_MIPI_CSIPHY_LNCK_STATUS1_ADDR A:0xfda00d30
y.create.l HWIO_CSI_PHY_0_MIPI_CSIPHY_LNCK_STATUS2_ADDR A:0xfda00d34
y.create.l HWIO_CSI_PHY_0_MIPI_CSIPHY_LNCK_STATUS3_ADDR A:0xfda00d38
y.create.l HWIO_CSI_PHY_0_MIPI_CSIPHY_LNCK_STATUS4_ADDR A:0xfda00d3c
y.create.l HWIO_CSI_PHY_0_MIPI_CSIPHY_GLBL_RESET_ADDR A:0xfda00d40
y.create.l HWIO_CSI_PHY_0_MIPI_CSIPHY_GLBL_PWR_CFG_ADDR A:0xfda00d44
y.create.l HWIO_CSI_PHY_0_MIPI_CSIPHY_GLBL_TEST_FORCE_ADDR A:0xfda00d48
y.create.l HWIO_CSI_PHY_0_MIPI_CSIPHY_GLBL_TEST_IMP_ADDR A:0xfda00d4c
y.create.l HWIO_CSI_PHY_0_MIPI_CSIPHY_GLBL_BIST_CFG1_ADDR A:0xfda00d50
y.create.l HWIO_CSI_PHY_0_MIPI_CSIPHY_GLBL_BIST_CFG2_ADDR A:0xfda00d54
y.create.l HWIO_CSI_PHY_0_MIPI_CSIPHY_GLBL_BIST_CFG3_ADDR A:0xfda00d58
y.create.l HWIO_CSI_PHY_0_MIPI_CSIPHY_GLBL_BIST_CFG4_ADDR A:0xfda00d5c
y.create.l HWIO_CSI_PHY_0_MIPI_CSIPHY_GLBL_MISR_CFG_ADDR A:0xfda00d60
y.create.l HWIO_CSI_PHY_0_MIPI_CSIPHY_GLBL_IRQ_CMD_ADDR A:0xfda00d64
y.create.l HWIO_CSI_PHY_0_MIPI_CSIPHY_GLBL_STATUS1_ADDR A:0xfda00d68
y.create.l HWIO_CSI_PHY_0_MIPI_CSIPHY_GLBL_STATUS2_ADDR A:0xfda00d6c
y.create.l HWIO_CSI_PHY_0_MIPI_CSIPHY_DEBUG_BUS0_ADDR A:0xfda00d70
y.create.l HWIO_CSI_PHY_0_MIPI_CSIPHY_DEBUG_BUS1_ADDR A:0xfda00d74
y.create.l HWIO_CSI_PHY_0_MIPI_CSIPHY_DEBUG_BUS2_ADDR A:0xfda00d78
y.create.l HWIO_CSI_PHY_0_MIPI_CSIPHY_DEBUG_BUS3_ADDR A:0xfda00d7c
y.create.l HWIO_CSI_PHY_0_MIPI_CSIPHY_INTERRUPT_STATUS0_ADDR A:0xfda00d80
y.create.l HWIO_CSI_PHY_0_MIPI_CSIPHY_INTERRUPT_STATUS1_ADDR A:0xfda00d84
y.create.l HWIO_CSI_PHY_0_MIPI_CSIPHY_INTERRUPT_STATUS2_ADDR A:0xfda00d88
y.create.l HWIO_CSI_PHY_0_MIPI_CSIPHY_INTERRUPT_STATUS3_ADDR A:0xfda00d8c
y.create.l HWIO_CSI_PHY_0_MIPI_CSIPHY_INTERRUPT_STATUS4_ADDR A:0xfda00d90
y.create.l HWIO_CSI_PHY_0_MIPI_CSIPHY_INTERRUPT_STATUS5_ADDR A:0xfda00d94
y.create.l HWIO_CSI_PHY_0_MIPI_CSIPHY_INTERRUPT_STATUS6_ADDR A:0xfda00d98
y.create.l HWIO_CSI_PHY_0_MIPI_CSIPHY_INTERRUPT_STATUS7_ADDR A:0xfda00d9c
y.create.l HWIO_CSI_PHY_0_MIPI_CSIPHY_INTERRUPT_MASK0_ADDR A:0xfda00da0
y.create.l HWIO_CSI_PHY_0_MIPI_CSIPHY_INTERRUPT_MASK1_ADDR A:0xfda00da4
y.create.l HWIO_CSI_PHY_0_MIPI_CSIPHY_INTERRUPT_MASK2_ADDR A:0xfda00da8
y.create.l HWIO_CSI_PHY_0_MIPI_CSIPHY_INTERRUPT_MASK3_ADDR A:0xfda00dac
y.create.l HWIO_CSI_PHY_0_MIPI_CSIPHY_INTERRUPT_MASK4_ADDR A:0xfda00db0
y.create.l HWIO_CSI_PHY_0_MIPI_CSIPHY_INTERRUPT_MASK5_ADDR A:0xfda00db4
y.create.l HWIO_CSI_PHY_0_MIPI_CSIPHY_INTERRUPT_MASK6_ADDR A:0xfda00db8
y.create.l HWIO_CSI_PHY_0_MIPI_CSIPHY_INTERRUPT_MASK7_ADDR A:0xfda00dbc
y.create.l HWIO_CSI_PHY_0_MIPI_CSIPHY_INTERRUPT_CLEAR0_ADDR A:0xfda00dc0
y.create.l HWIO_CSI_PHY_0_MIPI_CSIPHY_INTERRUPT_CLEAR1_ADDR A:0xfda00dc4
y.create.l HWIO_CSI_PHY_0_MIPI_CSIPHY_INTERRUPT_CLEAR2_ADDR A:0xfda00dc8
y.create.l HWIO_CSI_PHY_0_MIPI_CSIPHY_INTERRUPT_CLEAR3_ADDR A:0xfda00dcc
y.create.l HWIO_CSI_PHY_0_MIPI_CSIPHY_INTERRUPT_CLEAR4_ADDR A:0xfda00dd0
y.create.l HWIO_CSI_PHY_0_MIPI_CSIPHY_INTERRUPT_CLEAR5_ADDR A:0xfda00dd4
y.create.l HWIO_CSI_PHY_0_MIPI_CSIPHY_INTERRUPT_CLEAR6_ADDR A:0xfda00dd8
y.create.l HWIO_CSI_PHY_0_MIPI_CSIPHY_INTERRUPT_CLEAR7_ADDR A:0xfda00ddc
y.create.l HWIO_CSI_PHY_0_MIPI_CSIPHY_GLBL_T_INIT_CFG0_ADDR A:0xfda00de0
y.create.l HWIO_CSI_PHY_0_MIPI_CSIPHY_GLBL_T_INIT_CFG1_ADDR A:0xfda00de4
y.create.l HWIO_CSI_PHY_0_MIPI_CSIPHY_T_WAKEUP_CFG0_ADDR A:0xfda00de8
y.create.l HWIO_CSI_PHY_0_MIPI_CSIPHY_T_WAKEUP_CFG1_ADDR A:0xfda00dec
y.create.l HWIO_CSI_PHY_0_MIPI_CSIPHY_GLBL_PWG_CFG0_ADDR A:0xfda00df0
y.create.l HWIO_CSI_PHY_1_MIPI_CSIPHY_LN0_CFG1_ADDR A:0xfda01000
y.create.l HWIO_CSI_PHY_1_MIPI_CSIPHY_LN1_CFG1_ADDR A:0xfda01040
y.create.l HWIO_CSI_PHY_1_MIPI_CSIPHY_LN2_CFG1_ADDR A:0xfda01080
y.create.l HWIO_CSI_PHY_1_MIPI_CSIPHY_LN3_CFG1_ADDR A:0xfda010c0
y.create.l HWIO_CSI_PHY_1_MIPI_CSIPHY_LN0_CFG2_ADDR A:0xfda01004
y.create.l HWIO_CSI_PHY_1_MIPI_CSIPHY_LN1_CFG2_ADDR A:0xfda01044
y.create.l HWIO_CSI_PHY_1_MIPI_CSIPHY_LN2_CFG2_ADDR A:0xfda01084
y.create.l HWIO_CSI_PHY_1_MIPI_CSIPHY_LN3_CFG2_ADDR A:0xfda010c4
y.create.l HWIO_CSI_PHY_1_MIPI_CSIPHY_LN0_CFG3_ADDR A:0xfda01008
y.create.l HWIO_CSI_PHY_1_MIPI_CSIPHY_LN1_CFG3_ADDR A:0xfda01048
y.create.l HWIO_CSI_PHY_1_MIPI_CSIPHY_LN2_CFG3_ADDR A:0xfda01088
y.create.l HWIO_CSI_PHY_1_MIPI_CSIPHY_LN3_CFG3_ADDR A:0xfda010c8
y.create.l HWIO_CSI_PHY_1_MIPI_CSIPHY_LN0_CFG4_ADDR A:0xfda0100c
y.create.l HWIO_CSI_PHY_1_MIPI_CSIPHY_LN1_CFG4_ADDR A:0xfda0104c
y.create.l HWIO_CSI_PHY_1_MIPI_CSIPHY_LN2_CFG4_ADDR A:0xfda0108c
y.create.l HWIO_CSI_PHY_1_MIPI_CSIPHY_LN3_CFG4_ADDR A:0xfda010cc
y.create.l HWIO_CSI_PHY_1_MIPI_CSIPHY_LN0_CFG5_ADDR A:0xfda01010
y.create.l HWIO_CSI_PHY_1_MIPI_CSIPHY_LN1_CFG5_ADDR A:0xfda01050
y.create.l HWIO_CSI_PHY_1_MIPI_CSIPHY_LN2_CFG5_ADDR A:0xfda01090
y.create.l HWIO_CSI_PHY_1_MIPI_CSIPHY_LN3_CFG5_ADDR A:0xfda010d0
y.create.l HWIO_CSI_PHY_1_MIPI_CSIPHY_LN0_TEST_FORCE_ADDR A:0xfda01014
y.create.l HWIO_CSI_PHY_1_MIPI_CSIPHY_LN1_TEST_FORCE_ADDR A:0xfda01054
y.create.l HWIO_CSI_PHY_1_MIPI_CSIPHY_LN2_TEST_FORCE_ADDR A:0xfda01094
y.create.l HWIO_CSI_PHY_1_MIPI_CSIPHY_LN3_TEST_FORCE_ADDR A:0xfda010d4
y.create.l HWIO_CSI_PHY_1_MIPI_CSIPHY_LN0_TEST_DPATH_ADDR A:0xfda01018
y.create.l HWIO_CSI_PHY_1_MIPI_CSIPHY_LN1_TEST_DPATH_ADDR A:0xfda01058
y.create.l HWIO_CSI_PHY_1_MIPI_CSIPHY_LN2_TEST_DPATH_ADDR A:0xfda01098
y.create.l HWIO_CSI_PHY_1_MIPI_CSIPHY_LN3_TEST_DPATH_ADDR A:0xfda010d8
y.create.l HWIO_CSI_PHY_1_MIPI_CSIPHY_LN0_TEST_IMP_ADDR A:0xfda0101c
y.create.l HWIO_CSI_PHY_1_MIPI_CSIPHY_LN1_TEST_IMP_ADDR A:0xfda0105c
y.create.l HWIO_CSI_PHY_1_MIPI_CSIPHY_LN2_TEST_IMP_ADDR A:0xfda0109c
y.create.l HWIO_CSI_PHY_1_MIPI_CSIPHY_LN3_TEST_IMP_ADDR A:0xfda010dc
y.create.l HWIO_CSI_PHY_1_MIPI_CSIPHY_LN0_BIST_CTL1_ADDR A:0xfda01020
y.create.l HWIO_CSI_PHY_1_MIPI_CSIPHY_LN1_BIST_CTL1_ADDR A:0xfda01060
y.create.l HWIO_CSI_PHY_1_MIPI_CSIPHY_LN2_BIST_CTL1_ADDR A:0xfda010a0
y.create.l HWIO_CSI_PHY_1_MIPI_CSIPHY_LN3_BIST_CTL1_ADDR A:0xfda010e0
y.create.l HWIO_CSI_PHY_1_MIPI_CSIPHY_LN0_BIST_CTL2_ADDR A:0xfda01024
y.create.l HWIO_CSI_PHY_1_MIPI_CSIPHY_LN1_BIST_CTL2_ADDR A:0xfda01064
y.create.l HWIO_CSI_PHY_1_MIPI_CSIPHY_LN2_BIST_CTL2_ADDR A:0xfda010a4
y.create.l HWIO_CSI_PHY_1_MIPI_CSIPHY_LN3_BIST_CTL2_ADDR A:0xfda010e4
y.create.l HWIO_CSI_PHY_1_MIPI_CSIPHY_LN0_MISC1_ADDR A:0xfda01028
y.create.l HWIO_CSI_PHY_1_MIPI_CSIPHY_LN1_MISC1_ADDR A:0xfda01068
y.create.l HWIO_CSI_PHY_1_MIPI_CSIPHY_LN2_MISC1_ADDR A:0xfda010a8
y.create.l HWIO_CSI_PHY_1_MIPI_CSIPHY_LN3_MISC1_ADDR A:0xfda010e8
y.create.l HWIO_CSI_PHY_1_MIPI_CSIPHY_LN0_STATUS_ADDR A:0xfda0102c
y.create.l HWIO_CSI_PHY_1_MIPI_CSIPHY_LN1_STATUS_ADDR A:0xfda0106c
y.create.l HWIO_CSI_PHY_1_MIPI_CSIPHY_LN2_STATUS_ADDR A:0xfda010ac
y.create.l HWIO_CSI_PHY_1_MIPI_CSIPHY_LN3_STATUS_ADDR A:0xfda010ec
y.create.l HWIO_CSI_PHY_1_MIPI_CSIPHY_LN0_BIST_MISR_STAT1_ADDR A:0xfda01030
y.create.l HWIO_CSI_PHY_1_MIPI_CSIPHY_LN1_BIST_MISR_STAT1_ADDR A:0xfda01070
y.create.l HWIO_CSI_PHY_1_MIPI_CSIPHY_LN2_BIST_MISR_STAT1_ADDR A:0xfda010b0
y.create.l HWIO_CSI_PHY_1_MIPI_CSIPHY_LN3_BIST_MISR_STAT1_ADDR A:0xfda010f0
y.create.l HWIO_CSI_PHY_1_MIPI_CSIPHY_LN0_BIST_MISR_STAT2_ADDR A:0xfda01034
y.create.l HWIO_CSI_PHY_1_MIPI_CSIPHY_LN1_BIST_MISR_STAT2_ADDR A:0xfda01074
y.create.l HWIO_CSI_PHY_1_MIPI_CSIPHY_LN2_BIST_MISR_STAT2_ADDR A:0xfda010b4
y.create.l HWIO_CSI_PHY_1_MIPI_CSIPHY_LN3_BIST_MISR_STAT2_ADDR A:0xfda010f4
y.create.l HWIO_CSI_PHY_1_MIPI_CSIPHY_LN0_MISR_STAT3_ADDR A:0xfda01038
y.create.l HWIO_CSI_PHY_1_MIPI_CSIPHY_LN1_MISR_STAT3_ADDR A:0xfda01078
y.create.l HWIO_CSI_PHY_1_MIPI_CSIPHY_LN2_MISR_STAT3_ADDR A:0xfda010b8
y.create.l HWIO_CSI_PHY_1_MIPI_CSIPHY_LN3_MISR_STAT3_ADDR A:0xfda010f8
y.create.l HWIO_CSI_PHY_1_MIPI_CSIPHY_LN0_MISR_STAT4_ADDR A:0xfda0103c
y.create.l HWIO_CSI_PHY_1_MIPI_CSIPHY_LN1_MISR_STAT4_ADDR A:0xfda0107c
y.create.l HWIO_CSI_PHY_1_MIPI_CSIPHY_LN2_MISR_STAT4_ADDR A:0xfda010bc
y.create.l HWIO_CSI_PHY_1_MIPI_CSIPHY_LN3_MISR_STAT4_ADDR A:0xfda010fc
y.create.l HWIO_CSI_PHY_1_MIPI_CSIPHY_LNCK_CFG1_ADDR A:0xfda01100
y.create.l HWIO_CSI_PHY_1_MIPI_CSIPHY_LNCK_CFG2_ADDR A:0xfda01104
y.create.l HWIO_CSI_PHY_1_MIPI_CSIPHY_LNCK_CFG3_ADDR A:0xfda01108
y.create.l HWIO_CSI_PHY_1_MIPI_CSIPHY_LNCK_CFG4_ADDR A:0xfda0110c
y.create.l HWIO_CSI_PHY_1_MIPI_CSIPHY_LNCK_CFG5_ADDR A:0xfda01110
y.create.l HWIO_CSI_PHY_1_MIPI_CSIPHY_LNCK_TEST_FORCE_ADDR A:0xfda01114
y.create.l HWIO_CSI_PHY_1_MIPI_CSIPHY_LNCK_TEST_DPATH_ADDR A:0xfda01118
y.create.l HWIO_CSI_PHY_1_MIPI_CSIPHY_LNCK_TEST_IMP_ADDR A:0xfda0111c
y.create.l HWIO_CSI_PHY_1_MIPI_CSIPHY_LNCK_TEST_CFG1_ADDR A:0xfda01120
y.create.l HWIO_CSI_PHY_1_MIPI_CSIPHY_LNCK_TEST_CFG2_ADDR A:0xfda01124
y.create.l HWIO_CSI_PHY_1_MIPI_CSIPHY_LNCK_MISC1_ADDR A:0xfda01128
y.create.l HWIO_CSI_PHY_1_MIPI_CSIPHY_LNCK_STATUS_ADDR A:0xfda0112c
y.create.l HWIO_CSI_PHY_1_MIPI_CSIPHY_LNCK_STATUS1_ADDR A:0xfda01130
y.create.l HWIO_CSI_PHY_1_MIPI_CSIPHY_LNCK_STATUS2_ADDR A:0xfda01134
y.create.l HWIO_CSI_PHY_1_MIPI_CSIPHY_LNCK_STATUS3_ADDR A:0xfda01138
y.create.l HWIO_CSI_PHY_1_MIPI_CSIPHY_LNCK_STATUS4_ADDR A:0xfda0113c
y.create.l HWIO_CSI_PHY_1_MIPI_CSIPHY_GLBL_RESET_ADDR A:0xfda01140
y.create.l HWIO_CSI_PHY_1_MIPI_CSIPHY_GLBL_PWR_CFG_ADDR A:0xfda01144
y.create.l HWIO_CSI_PHY_1_MIPI_CSIPHY_GLBL_TEST_FORCE_ADDR A:0xfda01148
y.create.l HWIO_CSI_PHY_1_MIPI_CSIPHY_GLBL_TEST_IMP_ADDR A:0xfda0114c
y.create.l HWIO_CSI_PHY_1_MIPI_CSIPHY_GLBL_BIST_CFG1_ADDR A:0xfda01150
y.create.l HWIO_CSI_PHY_1_MIPI_CSIPHY_GLBL_BIST_CFG2_ADDR A:0xfda01154
y.create.l HWIO_CSI_PHY_1_MIPI_CSIPHY_GLBL_BIST_CFG3_ADDR A:0xfda01158
y.create.l HWIO_CSI_PHY_1_MIPI_CSIPHY_GLBL_BIST_CFG4_ADDR A:0xfda0115c
y.create.l HWIO_CSI_PHY_1_MIPI_CSIPHY_GLBL_MISR_CFG_ADDR A:0xfda01160
y.create.l HWIO_CSI_PHY_1_MIPI_CSIPHY_GLBL_IRQ_CMD_ADDR A:0xfda01164
y.create.l HWIO_CSI_PHY_1_MIPI_CSIPHY_GLBL_STATUS1_ADDR A:0xfda01168
y.create.l HWIO_CSI_PHY_1_MIPI_CSIPHY_GLBL_STATUS2_ADDR A:0xfda0116c
y.create.l HWIO_CSI_PHY_1_MIPI_CSIPHY_DEBUG_BUS0_ADDR A:0xfda01170
y.create.l HWIO_CSI_PHY_1_MIPI_CSIPHY_DEBUG_BUS1_ADDR A:0xfda01174
y.create.l HWIO_CSI_PHY_1_MIPI_CSIPHY_DEBUG_BUS2_ADDR A:0xfda01178
y.create.l HWIO_CSI_PHY_1_MIPI_CSIPHY_DEBUG_BUS3_ADDR A:0xfda0117c
y.create.l HWIO_CSI_PHY_1_MIPI_CSIPHY_INTERRUPT_STATUS0_ADDR A:0xfda01180
y.create.l HWIO_CSI_PHY_1_MIPI_CSIPHY_INTERRUPT_STATUS1_ADDR A:0xfda01184
y.create.l HWIO_CSI_PHY_1_MIPI_CSIPHY_INTERRUPT_STATUS2_ADDR A:0xfda01188
y.create.l HWIO_CSI_PHY_1_MIPI_CSIPHY_INTERRUPT_STATUS3_ADDR A:0xfda0118c
y.create.l HWIO_CSI_PHY_1_MIPI_CSIPHY_INTERRUPT_STATUS4_ADDR A:0xfda01190
y.create.l HWIO_CSI_PHY_1_MIPI_CSIPHY_INTERRUPT_STATUS5_ADDR A:0xfda01194
y.create.l HWIO_CSI_PHY_1_MIPI_CSIPHY_INTERRUPT_STATUS6_ADDR A:0xfda01198
y.create.l HWIO_CSI_PHY_1_MIPI_CSIPHY_INTERRUPT_STATUS7_ADDR A:0xfda0119c
y.create.l HWIO_CSI_PHY_1_MIPI_CSIPHY_INTERRUPT_MASK0_ADDR A:0xfda011a0
y.create.l HWIO_CSI_PHY_1_MIPI_CSIPHY_INTERRUPT_MASK1_ADDR A:0xfda011a4
y.create.l HWIO_CSI_PHY_1_MIPI_CSIPHY_INTERRUPT_MASK2_ADDR A:0xfda011a8
y.create.l HWIO_CSI_PHY_1_MIPI_CSIPHY_INTERRUPT_MASK3_ADDR A:0xfda011ac
y.create.l HWIO_CSI_PHY_1_MIPI_CSIPHY_INTERRUPT_MASK4_ADDR A:0xfda011b0
y.create.l HWIO_CSI_PHY_1_MIPI_CSIPHY_INTERRUPT_MASK5_ADDR A:0xfda011b4
y.create.l HWIO_CSI_PHY_1_MIPI_CSIPHY_INTERRUPT_MASK6_ADDR A:0xfda011b8
y.create.l HWIO_CSI_PHY_1_MIPI_CSIPHY_INTERRUPT_MASK7_ADDR A:0xfda011bc
y.create.l HWIO_CSI_PHY_1_MIPI_CSIPHY_INTERRUPT_CLEAR0_ADDR A:0xfda011c0
y.create.l HWIO_CSI_PHY_1_MIPI_CSIPHY_INTERRUPT_CLEAR1_ADDR A:0xfda011c4
y.create.l HWIO_CSI_PHY_1_MIPI_CSIPHY_INTERRUPT_CLEAR2_ADDR A:0xfda011c8
y.create.l HWIO_CSI_PHY_1_MIPI_CSIPHY_INTERRUPT_CLEAR3_ADDR A:0xfda011cc
y.create.l HWIO_CSI_PHY_1_MIPI_CSIPHY_INTERRUPT_CLEAR4_ADDR A:0xfda011d0
y.create.l HWIO_CSI_PHY_1_MIPI_CSIPHY_INTERRUPT_CLEAR5_ADDR A:0xfda011d4
y.create.l HWIO_CSI_PHY_1_MIPI_CSIPHY_INTERRUPT_CLEAR6_ADDR A:0xfda011d8
y.create.l HWIO_CSI_PHY_1_MIPI_CSIPHY_INTERRUPT_CLEAR7_ADDR A:0xfda011dc
y.create.l HWIO_CSI_PHY_1_MIPI_CSIPHY_GLBL_T_INIT_CFG0_ADDR A:0xfda011e0
y.create.l HWIO_CSI_PHY_1_MIPI_CSIPHY_GLBL_T_INIT_CFG1_ADDR A:0xfda011e4
y.create.l HWIO_CSI_PHY_1_MIPI_CSIPHY_T_WAKEUP_CFG0_ADDR A:0xfda011e8
y.create.l HWIO_CSI_PHY_1_MIPI_CSIPHY_T_WAKEUP_CFG1_ADDR A:0xfda011ec
y.create.l HWIO_CSI_PHY_1_MIPI_CSIPHY_GLBL_PWG_CFG0_ADDR A:0xfda011f0
y.create.l HWIO_DEHR_BIMC_DEHR_HW_VERSION_ADDR A:0xfc49a000
y.create.l HWIO_DEHR_BIMC_DEHR_HW_INFO_ADDR A:0xfc49a004
y.create.l HWIO_DEHR_BIMC_DEHR_CGC_CFG_ADDR A:0xfc49a010
y.create.l HWIO_DEHR_BIMC_DEHR_SEC_CFG_ADDR A:0xfc49a100
y.create.l HWIO_DEHR_BIMC_DEHR_RAM_CFG_ADDR A:0xfc49a140
y.create.l HWIO_DEHR_BIMC_DEHR_DMA_STATUS_ADDR A:0xfc49a200
y.create.l HWIO_DEHR_BIMC_DEHR_DBG_CFG_ADDR A:0xfc49a400
y.create.l HWIO_DEHR_BIMC_DEHR_SW_DMA_CFG_ADDR A:0xfc49a404
y.create.l HWIO_DEHR_BIMC_DEHR_DBG_ADDR_ADDR A:0xfc49a408
y.create.l HWIO_DEHR_XPU_SCR_ADDR A:0xfc498000
y.create.l HWIO_DEHR_XPU_SWDR_ADDR A:0xfc498004
y.create.l HWIO_DEHR_XPU_SEAR0_ADDR A:0xfc498040
y.create.l HWIO_DEHR_XPU_SESR_ADDR A:0xfc498048
y.create.l HWIO_DEHR_XPU_SESRRESTORE_ADDR A:0xfc49804c
y.create.l HWIO_DEHR_XPU_SESYNR0_ADDR A:0xfc498050
y.create.l HWIO_DEHR_XPU_SESYNR1_ADDR A:0xfc498054
y.create.l HWIO_DEHR_XPU_SESYNR2_ADDR A:0xfc498058
y.create.l HWIO_DEHR_XPU_MCR_ADDR A:0xfc498100
y.create.l HWIO_DEHR_XPU_MEAR0_ADDR A:0xfc498140
y.create.l HWIO_DEHR_XPU_MESR_ADDR A:0xfc498148
y.create.l HWIO_DEHR_XPU_MESRRESTORE_ADDR A:0xfc49814c
y.create.l HWIO_DEHR_XPU_MESYNR0_ADDR A:0xfc498150
y.create.l HWIO_DEHR_XPU_MESYNR1_ADDR A:0xfc498154
y.create.l HWIO_DEHR_XPU_MESYNR2_ADDR A:0xfc498158
y.create.l HWIO_DEHR_XPU_CR_ADDR A:0xfc498080
y.create.l HWIO_DEHR_XPU_RPU_ACR0_ADDR A:0xfc4980a0
y.create.l HWIO_DEHR_XPU_EAR0_ADDR A:0xfc4980c0
y.create.l HWIO_DEHR_XPU_ESR_ADDR A:0xfc4980c8
y.create.l HWIO_DEHR_XPU_ESRRESTORE_ADDR A:0xfc4980cc
y.create.l HWIO_DEHR_XPU_ESYNR0_ADDR A:0xfc4980d0
y.create.l HWIO_DEHR_XPU_ESYNR1_ADDR A:0xfc4980d4
y.create.l HWIO_DEHR_XPU_ESYNR2_ADDR A:0xfc4980d8
y.create.l HWIO_DEHR_XPU_IDR0_ADDR A:0xfc498074
y.create.l HWIO_DEHR_XPU_IDR1_ADDR A:0xfc498078
y.create.l HWIO_DEHR_XPU_REV_ADDR A:0xfc49807c
y.create.l HWIO_DEHR_XPU_RG0_RACR0_ADDR A:0xfc498200
y.create.l HWIO_DEHR_XPU_RG1_RACR0_ADDR A:0xfc498280
y.create.l HWIO_DEHR_XPU_RG0_SCR_ADDR A:0xfc498250
y.create.l HWIO_DEHR_XPU_RG1_SCR_ADDR A:0xfc4982d0
y.create.l HWIO_DEHR_XPU_RG0_MCR_ADDR A:0xfc498254
y.create.l HWIO_DEHR_XPU_RG1_MCR_ADDR A:0xfc4982d4
y.create.l HWIO_DEHR_VMIDMT_SCR0_ADDR A:0xfc499000
y.create.l HWIO_DEHR_VMIDMT_SCR1_ADDR A:0xfc499004
y.create.l HWIO_DEHR_VMIDMT_SCR2_ADDR A:0xfc499008
y.create.l HWIO_DEHR_VMIDMT_SACR_ADDR A:0xfc499010
y.create.l HWIO_DEHR_VMIDMT_SIDR0_ADDR A:0xfc499020
y.create.l HWIO_DEHR_VMIDMT_SIDR1_ADDR A:0xfc499024
y.create.l HWIO_DEHR_VMIDMT_SIDR2_ADDR A:0xfc499028
y.create.l HWIO_DEHR_VMIDMT_SIDR4_ADDR A:0xfc499030
y.create.l HWIO_DEHR_VMIDMT_SIDR5_ADDR A:0xfc499034
y.create.l HWIO_DEHR_VMIDMT_SIDR7_ADDR A:0xfc49903c
y.create.l HWIO_DEHR_VMIDMT_SGFAR0_ADDR A:0xfc499040
y.create.l HWIO_DEHR_VMIDMT_SGFSR_ADDR A:0xfc499048
y.create.l HWIO_DEHR_VMIDMT_SGFSRRESTORE_ADDR A:0xfc49904c
y.create.l HWIO_DEHR_VMIDMT_SGFSYNDR0_ADDR A:0xfc499050
y.create.l HWIO_DEHR_VMIDMT_SGFSYNDR1_ADDR A:0xfc499054
y.create.l HWIO_DEHR_VMIDMT_SGFSYNDR2_ADDR A:0xfc499058
y.create.l HWIO_DEHR_VMIDMT_VMIDMTSCR0_ADDR A:0xfc499090
y.create.l HWIO_DEHR_VMIDMT_CR0_ADDR A:0xfc499000
y.create.l HWIO_DEHR_VMIDMT_CR2_ADDR A:0xfc499008
y.create.l HWIO_DEHR_VMIDMT_ACR_ADDR A:0xfc499010
y.create.l HWIO_DEHR_VMIDMT_IDR0_ADDR A:0xfc499020
y.create.l HWIO_DEHR_VMIDMT_IDR1_ADDR A:0xfc499024
y.create.l HWIO_DEHR_VMIDMT_IDR2_ADDR A:0xfc499028
y.create.l HWIO_DEHR_VMIDMT_IDR4_ADDR A:0xfc499030
y.create.l HWIO_DEHR_VMIDMT_IDR5_ADDR A:0xfc499034
y.create.l HWIO_DEHR_VMIDMT_IDR7_ADDR A:0xfc49903c
y.create.l HWIO_DEHR_VMIDMT_GFAR0_ADDR A:0xfc499040
y.create.l HWIO_DEHR_VMIDMT_GFSR_ADDR A:0xfc499048
y.create.l HWIO_DEHR_VMIDMT_GFSRRESTORE_ADDR A:0xfc49904c
y.create.l HWIO_DEHR_VMIDMT_GFSYNDR0_ADDR A:0xfc499050
y.create.l HWIO_DEHR_VMIDMT_GFSYNDR1_ADDR A:0xfc499054
y.create.l HWIO_DEHR_VMIDMT_GFSYNDR2_ADDR A:0xfc499058
y.create.l HWIO_DEHR_VMIDMT_VMIDMTCR0_ADDR A:0xfc499090
y.create.l HWIO_DEHR_VMIDMT_VMIDMTACR_ADDR A:0xfc49909c
y.create.l HWIO_DEHR_VMIDMT_NSCR0_ADDR A:0xfc499400
y.create.l HWIO_DEHR_VMIDMT_NSCR2_ADDR A:0xfc499408
y.create.l HWIO_DEHR_VMIDMT_NSACR_ADDR A:0xfc499410
y.create.l HWIO_DEHR_VMIDMT_NSGFAR0_ADDR A:0xfc499440
y.create.l HWIO_DEHR_VMIDMT_NSGFSR_ADDR A:0xfc499448
y.create.l HWIO_DEHR_VMIDMT_NSGFSRRESTORE_ADDR A:0xfc49944c
y.create.l HWIO_DEHR_VMIDMT_NSGFSYNDR0_ADDR A:0xfc499450
y.create.l HWIO_DEHR_VMIDMT_NSGFSYNDR1_ADDR A:0xfc499454
y.create.l HWIO_DEHR_VMIDMT_NSGFSYNDR2_ADDR A:0xfc499458
y.create.l HWIO_DEHR_VMIDMT_NSVMIDMTCR0_ADDR A:0xfc499490
y.create.l HWIO_DEHR_VMIDMT_SSDR0_ADDR A:0xfc499080
y.create.l HWIO_DEHR_VMIDMT_MSDR0_ADDR A:0xfc499480
y.create.l HWIO_DEHR_VMIDMT_MCR_ADDR A:0xfc499494
y.create.l HWIO_DEHR_VMIDMT_S2VR0_ADDR A:0xfc499c00
y.create.l HWIO_DEHR_VMIDMT_AS2VR0_ADDR A:0xfc499e00
y.create.l HWIO_DIM_C00_DIM_CA_TOP_CFG_ADDR A:0xfc4e0000
y.create.l HWIO_DIM_C00_DIM_CA_HW_INFO_ADDR A:0xfc4e0004
y.create.l HWIO_DIM_C00_DIM_CA_HW_VERSION_ADDR A:0xfc4e0008
y.create.l HWIO_DIM_C00_DIM_CA_PAD_CFG0_ADDR A:0xfc4e0010
y.create.l HWIO_DIM_C00_DIM_CA_PAD_CFG1_ADDR A:0xfc4e0014
y.create.l HWIO_DIM_C00_DIM_CA_PAD_CFG2_ADDR A:0xfc4e0018
y.create.l HWIO_DIM_C00_DIM_CA_PAD_CFG3_ADDR A:0xfc4e001c
y.create.l HWIO_DIM_C00_DIM_CA_PAD_CFG4_ADDR A:0xfc4e0020
y.create.l HWIO_DIM_C00_DDRPHY_CA_MISR_CFG_ADDR A:0xfc4e0024
y.create.l HWIO_DIM_C00_DDRPHY_CA_MISR_EVEN_STATUS_ADDR A:0xfc4e0028
y.create.l HWIO_DIM_C00_DDRPHY_CA_MISR_ODD_STATUS_ADDR A:0xfc4e002c
y.create.l HWIO_DIM_C00_DIM_CA_CDC_CTLR_CFG0_ADDR A:0xfc4e0030
y.create.l HWIO_DIM_C00_DIM_CA_CDC_CTLR_CFG1_ADDR A:0xfc4e0034
y.create.l HWIO_DIM_C00_DIM_CA_CDC_CAL_TIMER_CFG0_ADDR A:0xfc4e0038
y.create.l HWIO_DIM_C00_DIM_CA_CDC_CAL_TIMER_CFG1_ADDR A:0xfc4e003c
y.create.l HWIO_DIM_C00_DIM_CA_CDC_REFCOUNT_CFG_ADDR A:0xfc4e0040
y.create.l HWIO_DIM_C00_DIM_CA_CDC_COARSE_CAL_CFG_ADDR A:0xfc4e0044
y.create.l HWIO_DIM_C00_DIM_CA_CDC_RSVD_CFG_ADDR A:0xfc4e0048
y.create.l HWIO_DIM_C00_DIM_CA_CDC_OFFSET_CFG_ADDR A:0xfc4e004c
y.create.l HWIO_DIM_C00_DIM_CA_CDC_DELAY_CFG_ADDR A:0xfc4e0050
y.create.l HWIO_DIM_C00_DIM_CA_CDC_SW_MODE_CFG_ADDR A:0xfc4e0054
y.create.l HWIO_DIM_C00_DIM_CA_CDC_TEST_CFG_ADDR A:0xfc4e0058
y.create.l HWIO_DIM_C00_DIM_CA_CDC_SW_OVRD_CFG_ADDR A:0xfc4e005c
y.create.l HWIO_DIM_C00_DIM_CA_CDC_STATUS0_ADDR A:0xfc4e0070
y.create.l HWIO_DIM_C00_DIM_CA_CDC_STATUS1_ADDR A:0xfc4e0074
y.create.l HWIO_DIM_C00_DIM_CA_CDC_STATUS2_ADDR A:0xfc4e0078
y.create.l HWIO_DIM_C00_DIM_CA_CDC_STATUS3_ADDR A:0xfc4e007c
y.create.l HWIO_DIM_C00_DIM_CA_IOC_CTLR_CFG_ADDR A:0xfc4e00e0
y.create.l HWIO_DIM_C00_DIM_CA_IOC_CTLR_PNCNT_CFG_ADDR A:0xfc4e00e4
y.create.l HWIO_DIM_C00_DIM_CA_IOC_CTLR_TIMER_CFG_ADDR A:0xfc4e00e8
y.create.l HWIO_DIM_C00_DIM_CA_IOC_CTLR_TIMER_STATUS_ADDR A:0xfc4e00ec
y.create.l HWIO_DIM_C00_DIM_CA_IOC_CTLR_CHAR_CFG_ADDR A:0xfc4e00f0
y.create.l HWIO_DIM_C00_DIM_CA_IOC_CTLR_STATUS_ADDR A:0xfc4e00f4
y.create.l HWIO_DIM_C00_DIM_CA_CA_IOC_SLV_CFG_ADDR A:0xfc4e0100
y.create.l HWIO_DIM_C00_DIM_CA_CA_IOC_SLV_STATUS_ADDR A:0xfc4e0104
y.create.l HWIO_DIM_C00_DIM_CA_CK_IOC_SLV_CFG_ADDR A:0xfc4e0110
y.create.l HWIO_DIM_C00_DIM_CA_CK_IOC_SLV_STATUS_ADDR A:0xfc4e0114
y.create.l HWIO_DIM_D00_DIM_DQ_TOP_CFG_ADDR A:0xfc4e0800
y.create.l HWIO_DIM_D00_DIM_DQ_HW_INFO_ADDR A:0xfc4e0804
y.create.l HWIO_DIM_D00_DIM_DQ_HW_VERSION_ADDR A:0xfc4e0808
y.create.l HWIO_DIM_D00_DIM_DQ_PAD_CFG0_ADDR A:0xfc4e0810
y.create.l HWIO_DIM_D00_DIM_DQ_PAD_CFG1_ADDR A:0xfc4e0814
y.create.l HWIO_DIM_D00_DIM_DQ_PAD_CFG2_ADDR A:0xfc4e0818
y.create.l HWIO_DIM_D00_DIM_DQ_PAD_CFG3_ADDR A:0xfc4e0820
y.create.l HWIO_DIM_D00_DIM_DQ_PAD_CFG4_ADDR A:0xfc4e0824
y.create.l HWIO_DIM_D00_DDRPHY_DQ_MISR_CFG_ADDR A:0xfc4e080c
y.create.l HWIO_DIM_D00_DDRPHY_DQ_MISR_EVEN_STATUS_ADDR A:0xfc4e0828
y.create.l HWIO_DIM_D00_DDRPHY_DQ_MISR_ODD_STATUS_ADDR A:0xfc4e082c
y.create.l HWIO_DIM_D00_DIM_DQ_CDC_CTLR_CFG0_ADDR A:0xfc4e0830
y.create.l HWIO_DIM_D00_DIM_DQ_CDC_CTLR_CFG1_ADDR A:0xfc4e0834
y.create.l HWIO_DIM_D00_DIM_DQ_CDC_CAL_TIMER_CFG0_ADDR A:0xfc4e0838
y.create.l HWIO_DIM_D00_DIM_DQ_CDC_CAL_TIMER_CFG1_ADDR A:0xfc4e083c
y.create.l HWIO_DIM_D00_DIM_DQ_CDC_REFCOUNT_CFG_ADDR A:0xfc4e0840
y.create.l HWIO_DIM_D00_DIM_DQ_CDC_COARSE_CAL_CFG_ADDR A:0xfc4e0844
y.create.l HWIO_DIM_D00_DIM_DQ_CDC_RSVD_CFG_ADDR A:0xfc4e0848
y.create.l HWIO_DIM_D00_DIM_DQ_RD_CDC_OFFSET_CFG_ADDR A:0xfc4e084c
y.create.l HWIO_DIM_D00_DIM_DQ_RD_CDC_DELAY_CFG_ADDR A:0xfc4e0850
y.create.l HWIO_DIM_D00_DIM_DQ_RD_CDC_SW_MODE_CFG_ADDR A:0xfc4e0854
y.create.l HWIO_DIM_D00_DIM_DQ_RD_CDC_TEST_CFG_ADDR A:0xfc4e0858
y.create.l HWIO_DIM_D00_DIM_DQ_RD_CDC_SW_OVRD_CFG_ADDR A:0xfc4e085c
y.create.l HWIO_DIM_D00_DIM_DQ_RD_CDC_SLAVE_DDA_CFG_ADDR A:0xfc4e0860
y.create.l HWIO_DIM_D00_DIM_DQ_RD_CDC_STATUS0_ADDR A:0xfc4e0870
y.create.l HWIO_DIM_D00_DIM_DQ_RD_CDC_STATUS1_ADDR A:0xfc4e0874
y.create.l HWIO_DIM_D00_DIM_DQ_RD_CDC_STATUS2_ADDR A:0xfc4e0878
y.create.l HWIO_DIM_D00_DIM_DQ_RD_CDC_STATUS3_ADDR A:0xfc4e087c
y.create.l HWIO_DIM_D00_DIM_DQ_RD_CDC_STATUS4_ADDR A:0xfc4e0880
y.create.l HWIO_DIM_D00_DIM_DQ_WR_CDC_OFFSET_CFG_ADDR A:0xfc4e08ac
y.create.l HWIO_DIM_D00_DIM_DQ_WR_CDC_DELAY_CFG_ADDR A:0xfc4e08b0
y.create.l HWIO_DIM_D00_DIM_DQ_WR_CDC_SW_MODE_CFG_ADDR A:0xfc4e08b4
y.create.l HWIO_DIM_D00_DIM_DQ_WR_CDC_TEST_CFG_ADDR A:0xfc4e08b8
y.create.l HWIO_DIM_D00_DIM_DQ_WR_CDC_SW_OVRD_CFG_ADDR A:0xfc4e08bc
y.create.l HWIO_DIM_D00_DIM_DQ_WR_CDC_STATUS0_ADDR A:0xfc4e08d0
y.create.l HWIO_DIM_D00_DIM_DQ_WR_CDC_STATUS1_ADDR A:0xfc4e08d4
y.create.l HWIO_DIM_D00_DIM_DQ_WR_CDC_STATUS2_ADDR A:0xfc4e08d8
y.create.l HWIO_DIM_D00_DIM_DQ_WR_CDC_STATUS3_ADDR A:0xfc4e08dc
y.create.l HWIO_DIM_D00_DIM_DQ_DQ_IOC_SLV_CFG_ADDR A:0xfc4e0900
y.create.l HWIO_DIM_D00_DIM_DQ_DQ_IOC_SLV_STATUS_ADDR A:0xfc4e0904
y.create.l HWIO_DIM_D00_DIM_DQ_DQS_IOC_SLV_CFG_ADDR A:0xfc4e0910
y.create.l HWIO_DIM_D00_DIM_DQ_DQS_IOC_SLV_STATUS_ADDR A:0xfc4e0914
y.create.l HWIO_DIM_D01_DIM_DQ_TOP_CFG_ADDR A:0xfc4e1000
y.create.l HWIO_DIM_D01_DIM_DQ_HW_INFO_ADDR A:0xfc4e1004
y.create.l HWIO_DIM_D01_DIM_DQ_HW_VERSION_ADDR A:0xfc4e1008
y.create.l HWIO_DIM_D01_DIM_DQ_PAD_CFG0_ADDR A:0xfc4e1010
y.create.l HWIO_DIM_D01_DIM_DQ_PAD_CFG1_ADDR A:0xfc4e1014
y.create.l HWIO_DIM_D01_DIM_DQ_PAD_CFG2_ADDR A:0xfc4e1018
y.create.l HWIO_DIM_D01_DIM_DQ_PAD_CFG3_ADDR A:0xfc4e1020
y.create.l HWIO_DIM_D01_DIM_DQ_PAD_CFG4_ADDR A:0xfc4e1024
y.create.l HWIO_DIM_D01_DDRPHY_DQ_MISR_CFG_ADDR A:0xfc4e100c
y.create.l HWIO_DIM_D01_DDRPHY_DQ_MISR_EVEN_STATUS_ADDR A:0xfc4e1028
y.create.l HWIO_DIM_D01_DDRPHY_DQ_MISR_ODD_STATUS_ADDR A:0xfc4e102c
y.create.l HWIO_DIM_D01_DIM_DQ_CDC_CTLR_CFG0_ADDR A:0xfc4e1030
y.create.l HWIO_DIM_D01_DIM_DQ_CDC_CTLR_CFG1_ADDR A:0xfc4e1034
y.create.l HWIO_DIM_D01_DIM_DQ_CDC_CAL_TIMER_CFG0_ADDR A:0xfc4e1038
y.create.l HWIO_DIM_D01_DIM_DQ_CDC_CAL_TIMER_CFG1_ADDR A:0xfc4e103c
y.create.l HWIO_DIM_D01_DIM_DQ_CDC_REFCOUNT_CFG_ADDR A:0xfc4e1040
y.create.l HWIO_DIM_D01_DIM_DQ_CDC_COARSE_CAL_CFG_ADDR A:0xfc4e1044
y.create.l HWIO_DIM_D01_DIM_DQ_CDC_RSVD_CFG_ADDR A:0xfc4e1048
y.create.l HWIO_DIM_D01_DIM_DQ_RD_CDC_OFFSET_CFG_ADDR A:0xfc4e104c
y.create.l HWIO_DIM_D01_DIM_DQ_RD_CDC_DELAY_CFG_ADDR A:0xfc4e1050
y.create.l HWIO_DIM_D01_DIM_DQ_RD_CDC_SW_MODE_CFG_ADDR A:0xfc4e1054
y.create.l HWIO_DIM_D01_DIM_DQ_RD_CDC_TEST_CFG_ADDR A:0xfc4e1058
y.create.l HWIO_DIM_D01_DIM_DQ_RD_CDC_SW_OVRD_CFG_ADDR A:0xfc4e105c
y.create.l HWIO_DIM_D01_DIM_DQ_RD_CDC_SLAVE_DDA_CFG_ADDR A:0xfc4e1060
y.create.l HWIO_DIM_D01_DIM_DQ_RD_CDC_STATUS0_ADDR A:0xfc4e1070
y.create.l HWIO_DIM_D01_DIM_DQ_RD_CDC_STATUS1_ADDR A:0xfc4e1074
y.create.l HWIO_DIM_D01_DIM_DQ_RD_CDC_STATUS2_ADDR A:0xfc4e1078
y.create.l HWIO_DIM_D01_DIM_DQ_RD_CDC_STATUS3_ADDR A:0xfc4e107c
y.create.l HWIO_DIM_D01_DIM_DQ_RD_CDC_STATUS4_ADDR A:0xfc4e1080
y.create.l HWIO_DIM_D01_DIM_DQ_WR_CDC_OFFSET_CFG_ADDR A:0xfc4e10ac
y.create.l HWIO_DIM_D01_DIM_DQ_WR_CDC_DELAY_CFG_ADDR A:0xfc4e10b0
y.create.l HWIO_DIM_D01_DIM_DQ_WR_CDC_SW_MODE_CFG_ADDR A:0xfc4e10b4
y.create.l HWIO_DIM_D01_DIM_DQ_WR_CDC_TEST_CFG_ADDR A:0xfc4e10b8
y.create.l HWIO_DIM_D01_DIM_DQ_WR_CDC_SW_OVRD_CFG_ADDR A:0xfc4e10bc
y.create.l HWIO_DIM_D01_DIM_DQ_WR_CDC_STATUS0_ADDR A:0xfc4e10d0
y.create.l HWIO_DIM_D01_DIM_DQ_WR_CDC_STATUS1_ADDR A:0xfc4e10d4
y.create.l HWIO_DIM_D01_DIM_DQ_WR_CDC_STATUS2_ADDR A:0xfc4e10d8
y.create.l HWIO_DIM_D01_DIM_DQ_WR_CDC_STATUS3_ADDR A:0xfc4e10dc
y.create.l HWIO_DIM_D01_DIM_DQ_DQ_IOC_SLV_CFG_ADDR A:0xfc4e1100
y.create.l HWIO_DIM_D01_DIM_DQ_DQ_IOC_SLV_STATUS_ADDR A:0xfc4e1104
y.create.l HWIO_DIM_D01_DIM_DQ_DQS_IOC_SLV_CFG_ADDR A:0xfc4e1110
y.create.l HWIO_DIM_D01_DIM_DQ_DQS_IOC_SLV_STATUS_ADDR A:0xfc4e1114
y.create.l HWIO_DIM_D02_DIM_DQ_TOP_CFG_ADDR A:0xfc4e1800
y.create.l HWIO_DIM_D02_DIM_DQ_HW_INFO_ADDR A:0xfc4e1804
y.create.l HWIO_DIM_D02_DIM_DQ_HW_VERSION_ADDR A:0xfc4e1808
y.create.l HWIO_DIM_D02_DIM_DQ_PAD_CFG0_ADDR A:0xfc4e1810
y.create.l HWIO_DIM_D02_DIM_DQ_PAD_CFG1_ADDR A:0xfc4e1814
y.create.l HWIO_DIM_D02_DIM_DQ_PAD_CFG2_ADDR A:0xfc4e1818
y.create.l HWIO_DIM_D02_DIM_DQ_PAD_CFG3_ADDR A:0xfc4e1820
y.create.l HWIO_DIM_D02_DIM_DQ_PAD_CFG4_ADDR A:0xfc4e1824
y.create.l HWIO_DIM_D02_DDRPHY_DQ_MISR_CFG_ADDR A:0xfc4e180c
y.create.l HWIO_DIM_D02_DDRPHY_DQ_MISR_EVEN_STATUS_ADDR A:0xfc4e1828
y.create.l HWIO_DIM_D02_DDRPHY_DQ_MISR_ODD_STATUS_ADDR A:0xfc4e182c
y.create.l HWIO_DIM_D02_DIM_DQ_CDC_CTLR_CFG0_ADDR A:0xfc4e1830
y.create.l HWIO_DIM_D02_DIM_DQ_CDC_CTLR_CFG1_ADDR A:0xfc4e1834
y.create.l HWIO_DIM_D02_DIM_DQ_CDC_CAL_TIMER_CFG0_ADDR A:0xfc4e1838
y.create.l HWIO_DIM_D02_DIM_DQ_CDC_CAL_TIMER_CFG1_ADDR A:0xfc4e183c
y.create.l HWIO_DIM_D02_DIM_DQ_CDC_REFCOUNT_CFG_ADDR A:0xfc4e1840
y.create.l HWIO_DIM_D02_DIM_DQ_CDC_COARSE_CAL_CFG_ADDR A:0xfc4e1844
y.create.l HWIO_DIM_D02_DIM_DQ_CDC_RSVD_CFG_ADDR A:0xfc4e1848
y.create.l HWIO_DIM_D02_DIM_DQ_RD_CDC_OFFSET_CFG_ADDR A:0xfc4e184c
y.create.l HWIO_DIM_D02_DIM_DQ_RD_CDC_DELAY_CFG_ADDR A:0xfc4e1850
y.create.l HWIO_DIM_D02_DIM_DQ_RD_CDC_SW_MODE_CFG_ADDR A:0xfc4e1854
y.create.l HWIO_DIM_D02_DIM_DQ_RD_CDC_TEST_CFG_ADDR A:0xfc4e1858
y.create.l HWIO_DIM_D02_DIM_DQ_RD_CDC_SW_OVRD_CFG_ADDR A:0xfc4e185c
y.create.l HWIO_DIM_D02_DIM_DQ_RD_CDC_SLAVE_DDA_CFG_ADDR A:0xfc4e1860
y.create.l HWIO_DIM_D02_DIM_DQ_RD_CDC_STATUS0_ADDR A:0xfc4e1870
y.create.l HWIO_DIM_D02_DIM_DQ_RD_CDC_STATUS1_ADDR A:0xfc4e1874
y.create.l HWIO_DIM_D02_DIM_DQ_RD_CDC_STATUS2_ADDR A:0xfc4e1878
y.create.l HWIO_DIM_D02_DIM_DQ_RD_CDC_STATUS3_ADDR A:0xfc4e187c
y.create.l HWIO_DIM_D02_DIM_DQ_RD_CDC_STATUS4_ADDR A:0xfc4e1880
y.create.l HWIO_DIM_D02_DIM_DQ_WR_CDC_OFFSET_CFG_ADDR A:0xfc4e18ac
y.create.l HWIO_DIM_D02_DIM_DQ_WR_CDC_DELAY_CFG_ADDR A:0xfc4e18b0
y.create.l HWIO_DIM_D02_DIM_DQ_WR_CDC_SW_MODE_CFG_ADDR A:0xfc4e18b4
y.create.l HWIO_DIM_D02_DIM_DQ_WR_CDC_TEST_CFG_ADDR A:0xfc4e18b8
y.create.l HWIO_DIM_D02_DIM_DQ_WR_CDC_SW_OVRD_CFG_ADDR A:0xfc4e18bc
y.create.l HWIO_DIM_D02_DIM_DQ_WR_CDC_STATUS0_ADDR A:0xfc4e18d0
y.create.l HWIO_DIM_D02_DIM_DQ_WR_CDC_STATUS1_ADDR A:0xfc4e18d4
y.create.l HWIO_DIM_D02_DIM_DQ_WR_CDC_STATUS2_ADDR A:0xfc4e18d8
y.create.l HWIO_DIM_D02_DIM_DQ_WR_CDC_STATUS3_ADDR A:0xfc4e18dc
y.create.l HWIO_DIM_D02_DIM_DQ_DQ_IOC_SLV_CFG_ADDR A:0xfc4e1900
y.create.l HWIO_DIM_D02_DIM_DQ_DQ_IOC_SLV_STATUS_ADDR A:0xfc4e1904
y.create.l HWIO_DIM_D02_DIM_DQ_DQS_IOC_SLV_CFG_ADDR A:0xfc4e1910
y.create.l HWIO_DIM_D02_DIM_DQ_DQS_IOC_SLV_STATUS_ADDR A:0xfc4e1914
y.create.l HWIO_DIM_D03_DIM_DQ_TOP_CFG_ADDR A:0xfc4e2000
y.create.l HWIO_DIM_D03_DIM_DQ_HW_INFO_ADDR A:0xfc4e2004
y.create.l HWIO_DIM_D03_DIM_DQ_HW_VERSION_ADDR A:0xfc4e2008
y.create.l HWIO_DIM_D03_DIM_DQ_PAD_CFG0_ADDR A:0xfc4e2010
y.create.l HWIO_DIM_D03_DIM_DQ_PAD_CFG1_ADDR A:0xfc4e2014
y.create.l HWIO_DIM_D03_DIM_DQ_PAD_CFG2_ADDR A:0xfc4e2018
y.create.l HWIO_DIM_D03_DIM_DQ_PAD_CFG3_ADDR A:0xfc4e2020
y.create.l HWIO_DIM_D03_DIM_DQ_PAD_CFG4_ADDR A:0xfc4e2024
y.create.l HWIO_DIM_D03_DDRPHY_DQ_MISR_CFG_ADDR A:0xfc4e200c
y.create.l HWIO_DIM_D03_DDRPHY_DQ_MISR_EVEN_STATUS_ADDR A:0xfc4e2028
y.create.l HWIO_DIM_D03_DDRPHY_DQ_MISR_ODD_STATUS_ADDR A:0xfc4e202c
y.create.l HWIO_DIM_D03_DIM_DQ_CDC_CTLR_CFG0_ADDR A:0xfc4e2030
y.create.l HWIO_DIM_D03_DIM_DQ_CDC_CTLR_CFG1_ADDR A:0xfc4e2034
y.create.l HWIO_DIM_D03_DIM_DQ_CDC_CAL_TIMER_CFG0_ADDR A:0xfc4e2038
y.create.l HWIO_DIM_D03_DIM_DQ_CDC_CAL_TIMER_CFG1_ADDR A:0xfc4e203c
y.create.l HWIO_DIM_D03_DIM_DQ_CDC_REFCOUNT_CFG_ADDR A:0xfc4e2040
y.create.l HWIO_DIM_D03_DIM_DQ_CDC_COARSE_CAL_CFG_ADDR A:0xfc4e2044
y.create.l HWIO_DIM_D03_DIM_DQ_CDC_RSVD_CFG_ADDR A:0xfc4e2048
y.create.l HWIO_DIM_D03_DIM_DQ_RD_CDC_OFFSET_CFG_ADDR A:0xfc4e204c
y.create.l HWIO_DIM_D03_DIM_DQ_RD_CDC_DELAY_CFG_ADDR A:0xfc4e2050
y.create.l HWIO_DIM_D03_DIM_DQ_RD_CDC_SW_MODE_CFG_ADDR A:0xfc4e2054
y.create.l HWIO_DIM_D03_DIM_DQ_RD_CDC_TEST_CFG_ADDR A:0xfc4e2058
y.create.l HWIO_DIM_D03_DIM_DQ_RD_CDC_SW_OVRD_CFG_ADDR A:0xfc4e205c
y.create.l HWIO_DIM_D03_DIM_DQ_RD_CDC_SLAVE_DDA_CFG_ADDR A:0xfc4e2060
y.create.l HWIO_DIM_D03_DIM_DQ_RD_CDC_STATUS0_ADDR A:0xfc4e2070
y.create.l HWIO_DIM_D03_DIM_DQ_RD_CDC_STATUS1_ADDR A:0xfc4e2074
y.create.l HWIO_DIM_D03_DIM_DQ_RD_CDC_STATUS2_ADDR A:0xfc4e2078
y.create.l HWIO_DIM_D03_DIM_DQ_RD_CDC_STATUS3_ADDR A:0xfc4e207c
y.create.l HWIO_DIM_D03_DIM_DQ_RD_CDC_STATUS4_ADDR A:0xfc4e2080
y.create.l HWIO_DIM_D03_DIM_DQ_WR_CDC_OFFSET_CFG_ADDR A:0xfc4e20ac
y.create.l HWIO_DIM_D03_DIM_DQ_WR_CDC_DELAY_CFG_ADDR A:0xfc4e20b0
y.create.l HWIO_DIM_D03_DIM_DQ_WR_CDC_SW_MODE_CFG_ADDR A:0xfc4e20b4
y.create.l HWIO_DIM_D03_DIM_DQ_WR_CDC_TEST_CFG_ADDR A:0xfc4e20b8
y.create.l HWIO_DIM_D03_DIM_DQ_WR_CDC_SW_OVRD_CFG_ADDR A:0xfc4e20bc
y.create.l HWIO_DIM_D03_DIM_DQ_WR_CDC_STATUS0_ADDR A:0xfc4e20d0
y.create.l HWIO_DIM_D03_DIM_DQ_WR_CDC_STATUS1_ADDR A:0xfc4e20d4
y.create.l HWIO_DIM_D03_DIM_DQ_WR_CDC_STATUS2_ADDR A:0xfc4e20d8
y.create.l HWIO_DIM_D03_DIM_DQ_WR_CDC_STATUS3_ADDR A:0xfc4e20dc
y.create.l HWIO_DIM_D03_DIM_DQ_DQ_IOC_SLV_CFG_ADDR A:0xfc4e2100
y.create.l HWIO_DIM_D03_DIM_DQ_DQ_IOC_SLV_STATUS_ADDR A:0xfc4e2104
y.create.l HWIO_DIM_D03_DIM_DQ_DQS_IOC_SLV_CFG_ADDR A:0xfc4e2110
y.create.l HWIO_DIM_D03_DIM_DQ_DQS_IOC_SLV_STATUS_ADDR A:0xfc4e2114
y.create.l HWIO_EBI1_HW_VERSION_ADDR A:0xfc4ff000
y.create.l HWIO_EBI1_HW_INFO_ADDR A:0xfc4ff004
y.create.l HWIO_EBI1_AHB2PHY_BROADCAST_EN_CFG_LOWER_ADDR A:0xfc4ff008
y.create.l HWIO_EBI1_AHB2PHY_BROADCAST_EN_CFG_UPPER_ADDR A:0xfc4ff00c
y.create.l HWIO_EBI1_AHB2PHY_TOP_CFG_ADDR A:0xfc4ff010
y.create.l HWIO_EBI1_AHB2PHY_DEBUG_BUS_CFG_ADDR A:0xfc4ff014
y.create.l HWIO_EBI1_AHB2PHY_BROADCAST_ADDRESS_SPACE_0_ADDR A:0xfc4ff800
y.create.l HWIO_EBI1_AHB2PHY_BROADCAST_ADDRESS_SPACE_1_ADDR A:0xfc4ff804
y.create.l HWIO_EBI1_AHB2PHY_BROADCAST_ADDRESS_SPACE_2_ADDR A:0xfc4ff808
y.create.l HWIO_EBI1_AHB2PHY_BROADCAST_ADDRESS_SPACE_3_ADDR A:0xfc4ff80c
y.create.l HWIO_EBI1_AHB2PHY_BROADCAST_ADDRESS_SPACE_4_ADDR A:0xfc4ff810
y.create.l HWIO_EBI1_AHB2PHY_BROADCAST_ADDRESS_SPACE_5_ADDR A:0xfc4ff814
y.create.l HWIO_EBI1_AHB2PHY_BROADCAST_ADDRESS_SPACE_6_ADDR A:0xfc4ff818
y.create.l HWIO_EBI1_AHB2PHY_BROADCAST_ADDRESS_SPACE_7_ADDR A:0xfc4ff81c
y.create.l HWIO_EBI1_AHB2PHY_BROADCAST_ADDRESS_SPACE_8_ADDR A:0xfc4ff820
y.create.l HWIO_EBI1_AHB2PHY_BROADCAST_ADDRESS_SPACE_9_ADDR A:0xfc4ff824
y.create.l HWIO_LPASS_LPAAUDIO_PLL_MODE_ADDR A:0xfe000000
y.create.l HWIO_LPASS_LPAAUDIO_PLL_L_ADDR A:0xfe000004
y.create.l HWIO_LPASS_LPAAUDIO_PLL_M_ADDR A:0xfe000008
y.create.l HWIO_LPASS_LPAAUDIO_PLL_N_ADDR A:0xfe00000c
y.create.l HWIO_LPASS_LPAAUDIO_PLL_USER_CTL_ADDR A:0xfe000010
y.create.l HWIO_LPASS_LPAAUDIO_PLL_CONFIG_CTL_ADDR A:0xfe000014
y.create.l HWIO_LPASS_LPAAUDIO_PLL_TEST_CTL_ADDR A:0xfe000018
y.create.l HWIO_LPASS_LPAAUDIO_PLL_STATUS_ADDR A:0xfe00001c
y.create.l HWIO_LPASS_LPAAUDIO_PLL_CLK_SRC_SEL_ADDR A:0xfe000020
y.create.l HWIO_LPASS_LPAQ6_PLL_MODE_ADDR A:0xfe001000
y.create.l HWIO_LPASS_LPAQ6_PLL_L_ADDR A:0xfe001004
y.create.l HWIO_LPASS_LPAQ6_PLL_M_ADDR A:0xfe001008
y.create.l HWIO_LPASS_LPAQ6_PLL_N_ADDR A:0xfe00100c
y.create.l HWIO_LPASS_LPAQ6_PLL_USER_CTL_ADDR A:0xfe001010
y.create.l HWIO_LPASS_LPAQ6_PLL_CONFIG_CTL_ADDR A:0xfe001014
y.create.l HWIO_LPASS_LPAQ6_PLL_TEST_CTL_ADDR A:0xfe001018
y.create.l HWIO_LPASS_LPAQ6_PLL_STATUS_ADDR A:0xfe00101c
y.create.l HWIO_LPASS_LPA_PLL_VOTE_APPS_ADDR A:0xfe002000
y.create.l HWIO_LPASS_LPA_PLL_VOTE_LPASSQ6_ADDR A:0xfe003000
y.create.l HWIO_LPASS_AUDIO_CORE_BCR_ADDR A:0xfe004000
y.create.l HWIO_LPASS_AUDIO_CORE_BCR_SLP_CBCR_ADDR A:0xfe004004
y.create.l HWIO_LPASS_AUDIO_WRAPPER_BCR_ADDR A:0xfe005000
y.create.l HWIO_LPASS_Q6SS_BCR_ADDR A:0xfe006000
y.create.l HWIO_LPASS_Q6SS_BCR_SLP_CBCR_ADDR A:0xfe006004
y.create.l HWIO_LPASS_AUDIO_CORE_GDSCR_ADDR A:0xfe007000
y.create.l HWIO_LPASS_AUDIO_CORE_GDSC_XO_CBCR_ADDR A:0xfe007004
y.create.l HWIO_LPASS_MIDI_CMD_RCGR_ADDR A:0xfe008000
y.create.l HWIO_LPASS_MIDI_CFG_RCGR_ADDR A:0xfe008004
y.create.l HWIO_LPASS_AUDIO_CORE_MIDI_CORE_CBCR_ADDR A:0xfe008014
y.create.l HWIO_LPASS_AUDIO_CORE_MIDI_LFABIF_CBCR_ADDR A:0xfe008018
y.create.l HWIO_LPASS_AUDIO_CORE_LPAIF_DMA_CBCR_ADDR A:0xfe009000
y.create.l HWIO_LPASS_AUDIO_CORE_LPAIF_CSR_CBCR_ADDR A:0xfe009004
y.create.l HWIO_LPASS_LPAIF_SPKR_CMD_RCGR_ADDR A:0xfe00a000
y.create.l HWIO_LPASS_LPAIF_SPKR_CFG_RCGR_ADDR A:0xfe00a004
y.create.l HWIO_LPASS_LPAIF_SPKR_M_ADDR A:0xfe00a008
y.create.l HWIO_LPASS_LPAIF_SPKR_N_ADDR A:0xfe00a00c
y.create.l HWIO_LPASS_LPAIF_SPKR_D_ADDR A:0xfe00a010
y.create.l HWIO_LPASS_AUDIO_CORE_LPAIF_CODEC_SPKR_OSR_CBCR_ADDR A:0xfe00a014
y.create.l HWIO_LPASS_AUDIO_CORE_LPAIF_CODEC_SPKR_IBIT_CBCR_ADDR A:0xfe00a018
y.create.l HWIO_LPASS_AUDIO_CORE_LPAIF_CODEC_SPKR_EBIT_CBCR_ADDR A:0xfe00a01c
y.create.l HWIO_LPASS_LPAIF_PRI_CMD_RCGR_ADDR A:0xfe00b000
y.create.l HWIO_LPASS_LPAIF_PRI_CFG_RCGR_ADDR A:0xfe00b004
y.create.l HWIO_LPASS_LPAIF_PRI_M_ADDR A:0xfe00b008
y.create.l HWIO_LPASS_LPAIF_PRI_N_ADDR A:0xfe00b00c
y.create.l HWIO_LPASS_LPAIF_PRI_D_ADDR A:0xfe00b010
y.create.l HWIO_LPASS_AUDIO_CORE_LPAIF_PRI_OSR_CBCR_ADDR A:0xfe00b014
y.create.l HWIO_LPASS_AUDIO_CORE_LPAIF_PRI_IBIT_CBCR_ADDR A:0xfe00b018
y.create.l HWIO_LPASS_AUDIO_CORE_LPAIF_PRI_EBIT_CBCR_ADDR A:0xfe00b01c
y.create.l HWIO_LPASS_LPAIF_SEC_CMD_RCGR_ADDR A:0xfe00c000
y.create.l HWIO_LPASS_LPAIF_SEC_CFG_RCGR_ADDR A:0xfe00c004
y.create.l HWIO_LPASS_LPAIF_SEC_M_ADDR A:0xfe00c008
y.create.l HWIO_LPASS_LPAIF_SEC_N_ADDR A:0xfe00c00c
y.create.l HWIO_LPASS_LPAIF_SEC_D_ADDR A:0xfe00c010
y.create.l HWIO_LPASS_AUDIO_CORE_LPAIF_SEC_OSR_CBCR_ADDR A:0xfe00c014
y.create.l HWIO_LPASS_AUDIO_CORE_LPAIF_SEC_IBIT_CBCR_ADDR A:0xfe00c018
y.create.l HWIO_LPASS_AUDIO_CORE_LPAIF_SEC_EBIT_CBCR_ADDR A:0xfe00c01c
y.create.l HWIO_LPASS_LPAIF_TER_CMD_RCGR_ADDR A:0xfe00d000
y.create.l HWIO_LPASS_LPAIF_TER_CFG_RCGR_ADDR A:0xfe00d004
y.create.l HWIO_LPASS_LPAIF_TER_M_ADDR A:0xfe00d008
y.create.l HWIO_LPASS_LPAIF_TER_N_ADDR A:0xfe00d00c
y.create.l HWIO_LPASS_LPAIF_TER_D_ADDR A:0xfe00d010
y.create.l HWIO_LPASS_AUDIO_CORE_LPAIF_TER_OSR_CBCR_ADDR A:0xfe00d014
y.create.l HWIO_LPASS_AUDIO_CORE_LPAIF_TER_IBIT_CBCR_ADDR A:0xfe00d018
y.create.l HWIO_LPASS_AUDIO_CORE_LPAIF_TER_EBIT_CBCR_ADDR A:0xfe00d01c
y.create.l HWIO_LPASS_LPAIF_QUAD_CMD_RCGR_ADDR A:0xfe00e000
y.create.l HWIO_LPASS_LPAIF_QUAD_CFG_RCGR_ADDR A:0xfe00e004
y.create.l HWIO_LPASS_LPAIF_QUAD_M_ADDR A:0xfe00e008
y.create.l HWIO_LPASS_LPAIF_QUAD_N_ADDR A:0xfe00e00c
y.create.l HWIO_LPASS_LPAIF_QUAD_D_ADDR A:0xfe00e010
y.create.l HWIO_LPASS_AUDIO_CORE_LPAIF_QUAD_OSR_CBCR_ADDR A:0xfe00e014
y.create.l HWIO_LPASS_AUDIO_CORE_LPAIF_QUAD_IBIT_CBCR_ADDR A:0xfe00e018
y.create.l HWIO_LPASS_AUDIO_CORE_LPAIF_QUAD_EBIT_CBCR_ADDR A:0xfe00e01c
y.create.l HWIO_LPASS_LPAIF_PCM0_CMD_RCGR_ADDR A:0xfe00f000
y.create.l HWIO_LPASS_LPAIF_PCM0_CFG_RCGR_ADDR A:0xfe00f004
y.create.l HWIO_LPASS_LPAIF_PCM0_M_ADDR A:0xfe00f008
y.create.l HWIO_LPASS_LPAIF_PCM0_N_ADDR A:0xfe00f00c
y.create.l HWIO_LPASS_LPAIF_PCM0_D_ADDR A:0xfe00f010
y.create.l HWIO_LPASS_AUDIO_CORE_LPAIF_PCM0_IBIT_CBCR_ADDR A:0xfe00f014
y.create.l HWIO_LPASS_AUDIO_CORE_LPAIF_PCM0_EBIT_CBCR_ADDR A:0xfe00f018
y.create.l HWIO_LPASS_LPAIF_PCM1_CMD_RCGR_ADDR A:0xfe010000
y.create.l HWIO_LPASS_LPAIF_PCM1_CFG_RCGR_ADDR A:0xfe010004
y.create.l HWIO_LPASS_LPAIF_PCM1_M_ADDR A:0xfe010008
y.create.l HWIO_LPASS_LPAIF_PCM1_N_ADDR A:0xfe01000c
y.create.l HWIO_LPASS_LPAIF_PCM1_D_ADDR A:0xfe010010
y.create.l HWIO_LPASS_AUDIO_CORE_LPAIF_PCM1_IBIT_CBCR_ADDR A:0xfe010014
y.create.l HWIO_LPASS_AUDIO_CORE_LPAIF_PCM1_EBIT_CBCR_ADDR A:0xfe010018
y.create.l HWIO_LPASS_RESAMPLER_CMD_RCGR_ADDR A:0xfe011000
y.create.l HWIO_LPASS_RESAMPLER_CFG_RCGR_ADDR A:0xfe011004
y.create.l HWIO_LPASS_RESAMPLER_M_ADDR A:0xfe011008
y.create.l HWIO_LPASS_RESAMPLER_N_ADDR A:0xfe01100c
y.create.l HWIO_LPASS_RESAMPLER_D_ADDR A:0xfe011010
y.create.l HWIO_LPASS_AUDIO_CORE_RESAMPLER_CORE_CBCR_ADDR A:0xfe011014
y.create.l HWIO_LPASS_AUDIO_CORE_RESAMPLER_LFABIF_CBCR_ADDR A:0xfe011018
y.create.l HWIO_LPASS_SLIMBUS_CMD_RCGR_ADDR A:0xfe012000
y.create.l HWIO_LPASS_SLIMBUS_CFG_RCGR_ADDR A:0xfe012004
y.create.l HWIO_LPASS_SLIMBUS_M_ADDR A:0xfe012008
y.create.l HWIO_LPASS_SLIMBUS_N_ADDR A:0xfe01200c
y.create.l HWIO_LPASS_SLIMBUS_D_ADDR A:0xfe012010
y.create.l HWIO_LPASS_AUDIO_CORE_SLIMBUS_CORE_CBCR_ADDR A:0xfe012014
y.create.l HWIO_LPASS_AUDIO_CORE_SLIMBUS_LFABIF_CBCR_ADDR A:0xfe012018
y.create.l HWIO_LPASS_LPAIF_PCMOE_CMD_RCGR_ADDR A:0xfe013000
y.create.l HWIO_LPASS_LPAIF_PCMOE_CFG_RCGR_ADDR A:0xfe013004
y.create.l HWIO_LPASS_LPAIF_PCMOE_M_ADDR A:0xfe013008
y.create.l HWIO_LPASS_LPAIF_PCMOE_N_ADDR A:0xfe01300c
y.create.l HWIO_LPASS_LPAIF_PCMOE_D_ADDR A:0xfe013010
y.create.l HWIO_LPASS_AUDIO_CORE_LPAIF_PCM_DATA_OE_CBCR_ADDR A:0xfe013014
y.create.l HWIO_LPASS_Q6CORE_CMD_RCGR_ADDR A:0xfe014000
y.create.l HWIO_LPASS_Q6CORE_CFG_RCGR_ADDR A:0xfe014004
y.create.l HWIO_LPASS_Q6CORE_M_ADDR A:0xfe014008
y.create.l HWIO_LPASS_Q6CORE_N_ADDR A:0xfe01400c
y.create.l HWIO_LPASS_Q6CORE_D_ADDR A:0xfe014010
y.create.l HWIO_LPASS_SLEEP_CMD_RCGR_ADDR A:0xfe015000
y.create.l HWIO_LPASS_SLEEP_CFG_RCGR_ADDR A:0xfe015004
y.create.l HWIO_LPASS_Q6_SPDM_CMD_RCGR_ADDR A:0xfe016000
y.create.l HWIO_LPASS_SPDM_CMD_RCGR_ADDR A:0xfe016000
y.create.l HWIO_LPASS_Q6_SPDM_CFG_RCGR_ADDR A:0xfe016004
y.create.l HWIO_LPASS_SPDM_CFG_RCGR_ADDR A:0xfe016004
y.create.l HWIO_LPASS_Q6_SPDM_CBCR_ADDR A:0xfe016014
y.create.l HWIO_LPASS_AUDIO_WRAPPER_SPDM_CBCR_ADDR A:0xfe016014
y.create.l HWIO_LPASS_AHB_SPDM_CBCR_ADDR A:0xfe016018
y.create.l HWIO_LPASS_XO_CMD_RCGR_ADDR A:0xfe017000
y.create.l HWIO_LPASS_XO_CFG_RCGR_ADDR A:0xfe017004
y.create.l HWIO_LPASS_AHBFABRIC_CMD_RCGR_ADDR A:0xfe018000
y.create.l HWIO_LPASS_AHBFABRIC_CFG_RCGR_ADDR A:0xfe018004
y.create.l HWIO_LPASS_AHBFABRIC_M_ADDR A:0xfe018008
y.create.l HWIO_LPASS_AHBFABRIC_N_ADDR A:0xfe01800c
y.create.l HWIO_LPASS_AHBFABRIC_D_ADDR A:0xfe018010
y.create.l HWIO_LPASS_AUDIO_CORE_LPM_CBCR_ADDR A:0xfe019000
y.create.l HWIO_LPASS_AUDIO_CORE_LPM_MEM0_CBCR_ADDR A:0xfe019004
y.create.l HWIO_LPASS_AUDIO_CORE_LPM_MEM1_CBCR_ADDR A:0xfe019008
y.create.l HWIO_LPASS_AUDIO_CORE_LPM_MEM2_CBCR_ADDR A:0xfe01900c
y.create.l HWIO_LPASS_AUDIO_CORE_LPM_MEM3_CBCR_ADDR A:0xfe019010
y.create.l HWIO_LPASS_AUDIO_CORE_AVSYNC_CSR_CBCR_ADDR A:0xfe01a000
y.create.l HWIO_LPASS_AUDIO_CORE_AVSYNC_XO_CBCR_ADDR A:0xfe01a004
y.create.l HWIO_LPASS_AUDIO_CORE_AVSYNC_BT_XO_CBCR_ADDR A:0xfe01a008
y.create.l HWIO_LPASS_AUDIO_CORE_AVSYNC_FM_XO_CBCR_ADDR A:0xfe01a00c
y.create.l HWIO_LPASS_AUDIO_CORE_AVSYNC_ATIME_CBCR_ADDR A:0xfe01a010
y.create.l HWIO_LPASS_AUDIO_CORE_IXFABRIC_CBCR_ADDR A:0xfe01b000
y.create.l HWIO_LPASS_AUDIO_WRAPPER_EFABRIC_CBCR_ADDR A:0xfe01b004
y.create.l HWIO_LPASS_Q6SS_TCM_SLAVE_CBCR_ADDR A:0xfe01c000
y.create.l HWIO_LPASS_AUDIO_CORE_CSR_CBCR_ADDR A:0xfe01d000
y.create.l HWIO_LPASS_AUDIO_CORE_DML_CBCR_ADDR A:0xfe01e000
y.create.l HWIO_LPASS_AUDIO_WRAPPER_SYSNOC_MPORT_CBCR_ADDR A:0xfe01f000
y.create.l HWIO_LPASS_AUDIO_CORE_SYSNOC_CBCR_ADDR A:0xfe01f000
y.create.l HWIO_LPASS_AUDIO_WRAPPER_SYSNOC_SWAY_CBCR_ADDR A:0xfe01f004
y.create.l HWIO_LPASS_AUDIO_CORE_TIMEOUT_CBCR_ADDR A:0xfe020000
y.create.l HWIO_LPASS_AUDIO_WRAPPER_TIMEOUT_CBCR_ADDR A:0xfe020004
y.create.l HWIO_LPASS_AUDIO_CORE_SECURITY_CBCR_ADDR A:0xfe021000
y.create.l HWIO_LPASS_AUDIO_WRAPPER_SECURITY_CBCR_ADDR A:0xfe021004
y.create.l HWIO_LPASS_Q6SS_AHB_LFABIF_CBCR_ADDR A:0xfe022000
y.create.l HWIO_LPASS_Q6SS_AHBM_CBCR_ADDR A:0xfe022004
y.create.l HWIO_LPASS_AUDIO_WRAPPER_LCC_CSR_CBCR_ADDR A:0xfe023000
y.create.l HWIO_LPASS_AUDIO_WRAPPER_BR_CBCR_ADDR A:0xfe024000
y.create.l HWIO_LPASS_AUDIO_WRAPPER_SMEM_CBCR_ADDR A:0xfe025000
y.create.l HWIO_LPASS_Q6SS_XO_CBCR_ADDR A:0xfe026000
y.create.l HWIO_LPASS_Q6SS_SLP_CBCR_ADDR A:0xfe026004
y.create.l HWIO_LPASS_AUDIO_WRAPPER_STM_XO_CBCR_ADDR A:0xfe027000
y.create.l HWIO_LPASS_AUDIO_CORE_IXFABRIC_SPDMTM_CSR_CBCR_ADDR A:0xfe028000
y.create.l HWIO_LPASS_AUDIO_WRAPPER_EFABRIC_SPDMTM_CSR_CBCR_ADDR A:0xfe028004
y.create.l HWIO_LPASS_SPDIFTX_BMC_CMD_RCGR_ADDR A:0xfe029000
y.create.l HWIO_LPASS_SPDIFTX_BMC_CFG_RCGR_ADDR A:0xfe029004
y.create.l HWIO_LPASS_SPDIFTX_BMC_M_ADDR A:0xfe029008
y.create.l HWIO_LPASS_SPDIFTX_BMC_N_ADDR A:0xfe02900c
y.create.l HWIO_LPASS_SPDIFTX_BMC_D_ADDR A:0xfe029010
y.create.l HWIO_LPASS_SPDIFTX_BMC_CBCR_ADDR A:0xfe029014
y.create.l HWIO_LPASS_SPDIFTX_AHBS_CBCR_ADDR A:0xfe029018
y.create.l HWIO_LPASS_SPDIFTX_AHBM_CBCR_ADDR A:0xfe02901c
y.create.l HWIO_LPASS_SIF_CBCR_ADDR A:0xfe02a000
y.create.l HWIO_LPASS_SIF_AHB_CBCR_ADDR A:0xfe02a004
y.create.l HWIO_LPASS_HDMIRX_AHB_CBCR_ADDR A:0xfe02b000
y.create.l HWIO_LPASS_DIGCODEC_CMD_RCGR_ADDR A:0xfe02c000
y.create.l HWIO_LPASS_DIGCODEC_CFG_RCGR_ADDR A:0xfe02c004
y.create.l HWIO_LPASS_DIGCODEC_M_ADDR A:0xfe02c008
y.create.l HWIO_LPASS_DIGCODEC_N_ADDR A:0xfe02c00c
y.create.l HWIO_LPASS_DIGCODEC_D_ADDR A:0xfe02c010
y.create.l HWIO_LPASS_DIGCODEC_CBCR_ADDR A:0xfe02c014
y.create.l HWIO_LPASS_DIGCODEC_AHB_CBCR_ADDR A:0xfe02c018
y.create.l HWIO_LPASS_CORE_SMMU_CFG_CLK_CBCR_ADDR A:0xfe02d000
y.create.l HWIO_LPASS_Q6_SMMU_CFG_CLK_CBCR_ADDR A:0xfe02d004
y.create.l HWIO_LPASS_DBG_CLK_ADDR A:0xfe02e000
y.create.l HWIO_LPASS_AUDIO_CORE_LPAIF_CODEC_SPKR_MODE_MUXSEL_ADDR A:0xfe02f000
y.create.l HWIO_LPASS_AUDIO_CORE_LPAIF_PRI_MODE_MUXSEL_ADDR A:0xfe030000
y.create.l HWIO_LPASS_AUDIO_CORE_LPAIF_SEC_MODE_MUXSEL_ADDR A:0xfe031000
y.create.l HWIO_LPASS_AUDIO_CORE_LPAIF_TER_MODE_MUXSEL_ADDR A:0xfe032000
y.create.l HWIO_LPASS_AUDIO_CORE_LPAIF_QUAD_MODE_MUXSEL_ADDR A:0xfe033000
y.create.l HWIO_LPASS_AUDIO_CORE_LPAIF_PCM0_MODE_MUXSEL_ADDR A:0xfe034000
y.create.l HWIO_LPASS_AUDIO_CORE_LPAIF_PCM1_MODE_MUXSEL_ADDR A:0xfe035000
y.create.l HWIO_LPASS_AUDIO_CORE_XFABRIC_SPDMTM_CGC_ADDR A:0xfe036000
y.create.l HWIO_LPASS_AUDIO_CORE_IFABRIC_SPDMTM_CGC_ADDR A:0xfe036004
y.create.l HWIO_LPASS_AUDIO_WRAPPER_EFABRIC_SPDMTM_CGC_ADDR A:0xfe036008
y.create.l HWIO_LPASS_Q6SS_RST_EVB_SEL_ADDR A:0xfe037000
y.create.l HWIO_LPASS_Q6SS_RST_EVB_ADDR A:0xfe037004
y.create.l HWIO_LPASS_VFR_IRQ_MUX_CTL_ADDR A:0xfe038000
y.create.l HWIO_LPASS_SYSNOC_HYSTERESIS_CLK_GRP_0_ADDR A:0xfe039000
y.create.l HWIO_LPASS_SYSNOC_HYSTERESIS_CLK_GRP_1_ADDR A:0xfe039004
y.create.l HWIO_LPASS_SYSNOC_HYSTERESIS_CLK_GRP_2_ADDR A:0xfe039008
y.create.l HWIO_LPASS_SYSNOC_HYSTERESIS_CLK_GRP_3_ADDR A:0xfe03900c
y.create.l HWIO_LPASS_Q6SS_HYSTERESIS_CLK_GRP_0_ADDR A:0xfe039020
y.create.l HWIO_LPASS_Q6SS_HYSTERESIS_CLK_GRP_1_ADDR A:0xfe039024
y.create.l HWIO_LPASS_Q6SS_HYSTERESIS_CLK_GRP_2_ADDR A:0xfe039028
y.create.l HWIO_LPASS_Q6SS_HYSTERESIS_CLK_GRP_3_ADDR A:0xfe03902c
y.create.l HWIO_LPASS_STM_MUXSEL_0_ADDR A:0xfe03a000
y.create.l HWIO_LPASS_STM_MUXSEL_1_ADDR A:0xfe03a004
y.create.l HWIO_LPASS_STM_MUXSEL_2_ADDR A:0xfe03a008
y.create.l HWIO_LPASS_STM_MUXSEL_3_ADDR A:0xfe03a00c
y.create.l HWIO_LPASS_STM_MUXSEL_4_ADDR A:0xfe03a010
y.create.l HWIO_LPASS_STM_MUXSEL_5_ADDR A:0xfe03a014
y.create.l HWIO_LPASS_STM_MUXSEL_6_ADDR A:0xfe03a018
y.create.l HWIO_LPASS_STM_MUXSEL_7_ADDR A:0xfe03a01c
y.create.l HWIO_LPASS_STM_MUXSEL_8_ADDR A:0xfe03a020
y.create.l HWIO_LPASS_STM_MUXSEL_9_ADDR A:0xfe03a024
y.create.l HWIO_LPASS_AUDIO_WRAPPER_SMMU_BYPASS_ADDR A:0xfe03b000
y.create.l HWIO_LPASS_AUDIO_CORE_DIG_CODEC_CLK_SEL_ADDR A:0xfe03b004
y.create.l HWIO_LPASS_HW_VERSION_ADDR A:0xfe03f000
y.create.l HWIO_LPASS_TCSR_DEBUG_CTL_ADDR A:0xfe03f004
y.create.l HWIO_LPASS_AHBE_CFG_ADDR A:0xfe03f100
y.create.l HWIO_LPASS_AHBE_LOCK_CTL_ADDR A:0xfe03f104
y.create.l HWIO_LPASS_AHBE_STATUS_ADDR A:0xfe03f108
y.create.l HWIO_LPASS_AHBE_ACK_ADDR A:0xfe03f10c
y.create.l HWIO_LPASS_AHBE_SPARE_ADDR A:0xfe03f110
y.create.l HWIO_LPASS_AHBE_ABT_HW_VERSION_ADDR A:0xfe040000
y.create.l HWIO_LPASS_AHBE_ABT_INST_ID_ADDR A:0xfe040004
y.create.l HWIO_LPASS_AHBE_ABT_NUM_SLAVES_ADDR A:0xfe040008
y.create.l HWIO_LPASS_AHBE_ABT_TIMER_LOADVAL_ADDR A:0xfe04000c
y.create.l HWIO_LPASS_AHBE_ABT_TIMER_MODE_ADDR A:0xfe040010
y.create.l HWIO_LPASS_AHBE_ABT_INTR_STATUS_ADDR A:0xfe040014
y.create.l HWIO_LPASS_AHBE_ABT_INTR_CLEAR_ADDR A:0xfe040018
y.create.l HWIO_LPASS_AHBE_ABT_INTR_ENABLE_ADDR A:0xfe04001c
y.create.l HWIO_LPASS_AHBE_ABT_SYND_VALID_ADDR A:0xfe040020
y.create.l HWIO_LPASS_AHBE_ABT_SYND_CLEAR_ADDR A:0xfe040024
y.create.l HWIO_LPASS_AHBE_ABT_SYND_ID_ADDR A:0xfe040028
y.create.l HWIO_LPASS_AHBE_ABT_SYND_ADDR0_ADDR A:0xfe04002c
y.create.l HWIO_LPASS_AHBE_ABT_SYND_ADDR1_ADDR A:0xfe040030
y.create.l HWIO_LPASS_AHBE_ABT_SYND_HREADY_ADDR A:0xfe040034
y.create.l HWIO_LPASS_Q6AHB_VMIDMT_SCR0_ADDR A:0xfe041000
y.create.l HWIO_LPASS_Q6AHB_VMIDMT_SCR1_ADDR A:0xfe041004
y.create.l HWIO_LPASS_Q6AHB_VMIDMT_SCR2_ADDR A:0xfe041008
y.create.l HWIO_LPASS_Q6AHB_VMIDMT_SACR_ADDR A:0xfe041010
y.create.l HWIO_LPASS_Q6AHB_VMIDMT_SIDR0_ADDR A:0xfe041020
y.create.l HWIO_LPASS_Q6AHB_VMIDMT_SIDR1_ADDR A:0xfe041024
y.create.l HWIO_LPASS_Q6AHB_VMIDMT_SIDR2_ADDR A:0xfe041028
y.create.l HWIO_LPASS_Q6AHB_VMIDMT_SIDR4_ADDR A:0xfe041030
y.create.l HWIO_LPASS_Q6AHB_VMIDMT_SIDR5_ADDR A:0xfe041034
y.create.l HWIO_LPASS_Q6AHB_VMIDMT_SIDR7_ADDR A:0xfe04103c
y.create.l HWIO_LPASS_Q6AHB_VMIDMT_SGFAR0_ADDR A:0xfe041040
y.create.l HWIO_LPASS_Q6AHB_VMIDMT_SGFSR_ADDR A:0xfe041048
y.create.l HWIO_LPASS_Q6AHB_VMIDMT_SGFSRRESTORE_ADDR A:0xfe04104c
y.create.l HWIO_LPASS_Q6AHB_VMIDMT_SGFSYNDR0_ADDR A:0xfe041050
y.create.l HWIO_LPASS_Q6AHB_VMIDMT_SGFSYNDR1_ADDR A:0xfe041054
y.create.l HWIO_LPASS_Q6AHB_VMIDMT_SGFSYNDR2_ADDR A:0xfe041058
y.create.l HWIO_LPASS_Q6AHB_VMIDMT_VMIDMTSCR0_ADDR A:0xfe041090
y.create.l HWIO_LPASS_Q6AHB_VMIDMT_CR0_ADDR A:0xfe041000
y.create.l HWIO_LPASS_Q6AHB_VMIDMT_CR2_ADDR A:0xfe041008
y.create.l HWIO_LPASS_Q6AHB_VMIDMT_ACR_ADDR A:0xfe041010
y.create.l HWIO_LPASS_Q6AHB_VMIDMT_IDR0_ADDR A:0xfe041020
y.create.l HWIO_LPASS_Q6AHB_VMIDMT_IDR1_ADDR A:0xfe041024
y.create.l HWIO_LPASS_Q6AHB_VMIDMT_IDR2_ADDR A:0xfe041028
y.create.l HWIO_LPASS_Q6AHB_VMIDMT_IDR4_ADDR A:0xfe041030
y.create.l HWIO_LPASS_Q6AHB_VMIDMT_IDR5_ADDR A:0xfe041034
y.create.l HWIO_LPASS_Q6AHB_VMIDMT_IDR7_ADDR A:0xfe04103c
y.create.l HWIO_LPASS_Q6AHB_VMIDMT_GFAR0_ADDR A:0xfe041040
y.create.l HWIO_LPASS_Q6AHB_VMIDMT_GFSR_ADDR A:0xfe041048
y.create.l HWIO_LPASS_Q6AHB_VMIDMT_GFSRRESTORE_ADDR A:0xfe04104c
y.create.l HWIO_LPASS_Q6AHB_VMIDMT_GFSYNDR0_ADDR A:0xfe041050
y.create.l HWIO_LPASS_Q6AHB_VMIDMT_GFSYNDR1_ADDR A:0xfe041054
y.create.l HWIO_LPASS_Q6AHB_VMIDMT_GFSYNDR2_ADDR A:0xfe041058
y.create.l HWIO_LPASS_Q6AHB_VMIDMT_VMIDMTCR0_ADDR A:0xfe041090
y.create.l HWIO_LPASS_Q6AHB_VMIDMT_VMIDMTACR_ADDR A:0xfe04109c
y.create.l HWIO_LPASS_Q6AHB_VMIDMT_NSCR0_ADDR A:0xfe041400
y.create.l HWIO_LPASS_Q6AHB_VMIDMT_NSCR2_ADDR A:0xfe041408
y.create.l HWIO_LPASS_Q6AHB_VMIDMT_NSACR_ADDR A:0xfe041410
y.create.l HWIO_LPASS_Q6AHB_VMIDMT_NSGFAR0_ADDR A:0xfe041440
y.create.l HWIO_LPASS_Q6AHB_VMIDMT_NSGFSR_ADDR A:0xfe041448
y.create.l HWIO_LPASS_Q6AHB_VMIDMT_NSGFSRRESTORE_ADDR A:0xfe04144c
y.create.l HWIO_LPASS_Q6AHB_VMIDMT_NSGFSYNDR0_ADDR A:0xfe041450
y.create.l HWIO_LPASS_Q6AHB_VMIDMT_NSGFSYNDR1_ADDR A:0xfe041454
y.create.l HWIO_LPASS_Q6AHB_VMIDMT_NSGFSYNDR2_ADDR A:0xfe041458
y.create.l HWIO_LPASS_Q6AHB_VMIDMT_NSVMIDMTCR0_ADDR A:0xfe041490
y.create.l HWIO_LPASS_Q6AHB_VMIDMT_SSDR0_ADDR A:0xfe041080
y.create.l HWIO_LPASS_Q6AHB_VMIDMT_MSDR0_ADDR A:0xfe041480
y.create.l HWIO_LPASS_Q6AHB_VMIDMT_MCR_ADDR A:0xfe041494
y.create.l HWIO_LPASS_Q6AHB_VMIDMT_S2VR0_ADDR A:0xfe041c00
y.create.l HWIO_LPASS_Q6AHB_VMIDMT_AS2VR0_ADDR A:0xfe041e00
y.create.l HWIO_LPASS_Q6AXI_VMIDMT_SCR0_ADDR A:0xfe042000
y.create.l HWIO_LPASS_Q6AXI_VMIDMT_SCR1_ADDR A:0xfe042004
y.create.l HWIO_LPASS_Q6AXI_VMIDMT_SCR2_ADDR A:0xfe042008
y.create.l HWIO_LPASS_Q6AXI_VMIDMT_SACR_ADDR A:0xfe042010
y.create.l HWIO_LPASS_Q6AXI_VMIDMT_SIDR0_ADDR A:0xfe042020
y.create.l HWIO_LPASS_Q6AXI_VMIDMT_SIDR1_ADDR A:0xfe042024
y.create.l HWIO_LPASS_Q6AXI_VMIDMT_SIDR2_ADDR A:0xfe042028
y.create.l HWIO_LPASS_Q6AXI_VMIDMT_SIDR4_ADDR A:0xfe042030
y.create.l HWIO_LPASS_Q6AXI_VMIDMT_SIDR5_ADDR A:0xfe042034
y.create.l HWIO_LPASS_Q6AXI_VMIDMT_SIDR7_ADDR A:0xfe04203c
y.create.l HWIO_LPASS_Q6AXI_VMIDMT_SGFAR0_ADDR A:0xfe042040
y.create.l HWIO_LPASS_Q6AXI_VMIDMT_SGFSR_ADDR A:0xfe042048
y.create.l HWIO_LPASS_Q6AXI_VMIDMT_SGFSRRESTORE_ADDR A:0xfe04204c
y.create.l HWIO_LPASS_Q6AXI_VMIDMT_SGFSYNDR0_ADDR A:0xfe042050
y.create.l HWIO_LPASS_Q6AXI_VMIDMT_SGFSYNDR1_ADDR A:0xfe042054
y.create.l HWIO_LPASS_Q6AXI_VMIDMT_SGFSYNDR2_ADDR A:0xfe042058
y.create.l HWIO_LPASS_Q6AXI_VMIDMT_VMIDMTSCR0_ADDR A:0xfe042090
y.create.l HWIO_LPASS_Q6AXI_VMIDMT_CR0_ADDR A:0xfe042000
y.create.l HWIO_LPASS_Q6AXI_VMIDMT_CR2_ADDR A:0xfe042008
y.create.l HWIO_LPASS_Q6AXI_VMIDMT_ACR_ADDR A:0xfe042010
y.create.l HWIO_LPASS_Q6AXI_VMIDMT_IDR0_ADDR A:0xfe042020
y.create.l HWIO_LPASS_Q6AXI_VMIDMT_IDR1_ADDR A:0xfe042024
y.create.l HWIO_LPASS_Q6AXI_VMIDMT_IDR2_ADDR A:0xfe042028
y.create.l HWIO_LPASS_Q6AXI_VMIDMT_IDR4_ADDR A:0xfe042030
y.create.l HWIO_LPASS_Q6AXI_VMIDMT_IDR5_ADDR A:0xfe042034
y.create.l HWIO_LPASS_Q6AXI_VMIDMT_IDR7_ADDR A:0xfe04203c
y.create.l HWIO_LPASS_Q6AXI_VMIDMT_GFAR0_ADDR A:0xfe042040
y.create.l HWIO_LPASS_Q6AXI_VMIDMT_GFSR_ADDR A:0xfe042048
y.create.l HWIO_LPASS_Q6AXI_VMIDMT_GFSRRESTORE_ADDR A:0xfe04204c
y.create.l HWIO_LPASS_Q6AXI_VMIDMT_GFSYNDR0_ADDR A:0xfe042050
y.create.l HWIO_LPASS_Q6AXI_VMIDMT_GFSYNDR1_ADDR A:0xfe042054
y.create.l HWIO_LPASS_Q6AXI_VMIDMT_GFSYNDR2_ADDR A:0xfe042058
y.create.l HWIO_LPASS_Q6AXI_VMIDMT_VMIDMTCR0_ADDR A:0xfe042090
y.create.l HWIO_LPASS_Q6AXI_VMIDMT_VMIDMTACR_ADDR A:0xfe04209c
y.create.l HWIO_LPASS_Q6AXI_VMIDMT_NSCR0_ADDR A:0xfe042400
y.create.l HWIO_LPASS_Q6AXI_VMIDMT_NSCR2_ADDR A:0xfe042408
y.create.l HWIO_LPASS_Q6AXI_VMIDMT_NSACR_ADDR A:0xfe042410
y.create.l HWIO_LPASS_Q6AXI_VMIDMT_NSGFAR0_ADDR A:0xfe042440
y.create.l HWIO_LPASS_Q6AXI_VMIDMT_NSGFSR_ADDR A:0xfe042448
y.create.l HWIO_LPASS_Q6AXI_VMIDMT_NSGFSRRESTORE_ADDR A:0xfe04244c
y.create.l HWIO_LPASS_Q6AXI_VMIDMT_NSGFSYNDR0_ADDR A:0xfe042450
y.create.l HWIO_LPASS_Q6AXI_VMIDMT_NSGFSYNDR1_ADDR A:0xfe042454
y.create.l HWIO_LPASS_Q6AXI_VMIDMT_NSGFSYNDR2_ADDR A:0xfe042458
y.create.l HWIO_LPASS_Q6AXI_VMIDMT_NSVMIDMTCR0_ADDR A:0xfe042490
y.create.l HWIO_LPASS_Q6AXI_VMIDMT_SSDR0_ADDR A:0xfe042080
y.create.l HWIO_LPASS_Q6AXI_VMIDMT_MSDR0_ADDR A:0xfe042480
y.create.l HWIO_LPASS_Q6AXI_VMIDMT_MCR_ADDR A:0xfe042494
y.create.l HWIO_LPASS_Q6AXI_VMIDMT_S2VR0_ADDR A:0xfe042c00
y.create.l HWIO_LPASS_Q6AXI_VMIDMT_S2VR1_ADDR A:0xfe042c04
y.create.l HWIO_LPASS_Q6AXI_VMIDMT_S2VR2_ADDR A:0xfe042c08
y.create.l HWIO_LPASS_Q6AXI_VMIDMT_S2VR3_ADDR A:0xfe042c0c
y.create.l HWIO_LPASS_Q6AXI_VMIDMT_AS2VR0_ADDR A:0xfe042e00
y.create.l HWIO_LPASS_Q6AXI_VMIDMT_AS2VR1_ADDR A:0xfe042e04
y.create.l HWIO_LPASS_Q6AXI_VMIDMT_AS2VR2_ADDR A:0xfe042e08
y.create.l HWIO_LPASS_Q6AXI_VMIDMT_AS2VR3_ADDR A:0xfe042e0c
y.create.l HWIO_LPASS_CDC_CLK_RX_RESET_CTL_ADDR A:0xfe043000
y.create.l HWIO_LPASS_CDC_CLK_TX_RESET_B1_CTL_ADDR A:0xfe043004
y.create.l HWIO_LPASS_CDC_CLK_DMIC_B1_CTL_ADDR A:0xfe043008
y.create.l HWIO_LPASS_CDC_CLK_RX_I2S_CTL_ADDR A:0xfe04300c
y.create.l HWIO_LPASS_CDC_CLK_TX_I2S_CTL_ADDR A:0xfe043010
y.create.l HWIO_LPASS_CDC_CLK_OTHR_RESET_B1_CTL_ADDR A:0xfe043014
y.create.l HWIO_LPASS_CDC_CLK_TX_CLK_EN_B1_CTL_ADDR A:0xfe043018
y.create.l HWIO_LPASS_CDC_CLK_OTHR_CTL_ADDR A:0xfe04301c
y.create.l HWIO_LPASS_CDC_CLK_RX_B1_CTL_ADDR A:0xfe043020
y.create.l HWIO_LPASS_CDC_CLK_MCLK_CTL_ADDR A:0xfe043024
y.create.l HWIO_LPASS_CDC_CLK_PDM_CTL_ADDR A:0xfe043028
y.create.l HWIO_LPASS_CDC_CLK_SD_CTL_ADDR A:0xfe04302c
y.create.l HWIO_LPASS_CDC_RX1_B1_CTL_ADDR A:0xfe043040
y.create.l HWIO_LPASS_CDC_RX2_B1_CTL_ADDR A:0xfe043060
y.create.l HWIO_LPASS_CDC_RX3_B1_CTL_ADDR A:0xfe043080
y.create.l HWIO_LPASS_CDC_RX1_B2_CTL_ADDR A:0xfe043044
y.create.l HWIO_LPASS_CDC_RX2_B2_CTL_ADDR A:0xfe043064
y.create.l HWIO_LPASS_CDC_RX3_B2_CTL_ADDR A:0xfe043084
y.create.l HWIO_LPASS_CDC_RX1_B3_CTL_ADDR A:0xfe043048
y.create.l HWIO_LPASS_CDC_RX2_B3_CTL_ADDR A:0xfe043068
y.create.l HWIO_LPASS_CDC_RX3_B3_CTL_ADDR A:0xfe043088
y.create.l HWIO_LPASS_CDC_RX1_B4_CTL_ADDR A:0xfe04304c
y.create.l HWIO_LPASS_CDC_RX2_B4_CTL_ADDR A:0xfe04306c
y.create.l HWIO_LPASS_CDC_RX3_B4_CTL_ADDR A:0xfe04308c
y.create.l HWIO_LPASS_CDC_RX1_B5_CTL_ADDR A:0xfe043050
y.create.l HWIO_LPASS_CDC_RX2_B5_CTL_ADDR A:0xfe043070
y.create.l HWIO_LPASS_CDC_RX3_B5_CTL_ADDR A:0xfe043090
y.create.l HWIO_LPASS_CDC_RX1_B6_CTL_ADDR A:0xfe043054
y.create.l HWIO_LPASS_CDC_RX2_B6_CTL_ADDR A:0xfe043074
y.create.l HWIO_LPASS_CDC_RX3_B6_CTL_ADDR A:0xfe043094
y.create.l HWIO_LPASS_CDC_RX1_VOL_CTL_B1_CTL_ADDR A:0xfe043058
y.create.l HWIO_LPASS_CDC_RX2_VOL_CTL_B1_CTL_ADDR A:0xfe043078
y.create.l HWIO_LPASS_CDC_RX3_VOL_CTL_B1_CTL_ADDR A:0xfe043098
y.create.l HWIO_LPASS_CDC_RX1_VOL_CTL_B2_CTL_ADDR A:0xfe04305c
y.create.l HWIO_LPASS_CDC_RX2_VOL_CTL_B2_CTL_ADDR A:0xfe04307c
y.create.l HWIO_LPASS_CDC_RX3_VOL_CTL_B2_CTL_ADDR A:0xfe04309c
y.create.l HWIO_LPASS_CDC_CLSG_FREQ_THRESH_B1_CTL_ADDR A:0xfe0430a0
y.create.l HWIO_LPASS_CDC_CLSG_FREQ_THRESH_B2_CTL_ADDR A:0xfe0430a4
y.create.l HWIO_LPASS_CDC_CLSG_FREQ_THRESH_B3_CTL_ADDR A:0xfe0430a8
y.create.l HWIO_LPASS_CDC_CLSG_FREQ_THRESH_B4_CTL_ADDR A:0xfe0430ac
y.create.l HWIO_LPASS_CDC_CLSG_GAIN_THRESH_CTL_ADDR A:0xfe0430b0
y.create.l HWIO_LPASS_CDC_CLSG_TIMER_B1_CFG_ADDR A:0xfe0430b4
y.create.l HWIO_LPASS_CDC_CLSG_TIMER_B2_CFG_ADDR A:0xfe0430b8
y.create.l HWIO_LPASS_CDC_CLSG_CTL_ADDR A:0xfe0430bc
y.create.l HWIO_LPASS_CDC_TX1_VOL_CTL_TIMER_ADDR A:0xfe0430c0
y.create.l HWIO_LPASS_CDC_TX2_VOL_CTL_TIMER_ADDR A:0xfe0430e0
y.create.l HWIO_LPASS_CDC_TX1_VOL_CTL_GAIN_ADDR A:0xfe0430c4
y.create.l HWIO_LPASS_CDC_TX2_VOL_CTL_GAIN_ADDR A:0xfe0430e4
y.create.l HWIO_LPASS_CDC_TX1_VOL_CTL_CFG_ADDR A:0xfe0430c8
y.create.l HWIO_LPASS_CDC_TX2_VOL_CTL_CFG_ADDR A:0xfe0430e8
y.create.l HWIO_LPASS_CDC_TX1_MUX_CTL_ADDR A:0xfe0430cc
y.create.l HWIO_LPASS_CDC_TX2_MUX_CTL_ADDR A:0xfe0430ec
y.create.l HWIO_LPASS_CDC_TX1_CLK_FS_CTL_ADDR A:0xfe0430d0
y.create.l HWIO_LPASS_CDC_TX2_CLK_FS_CTL_ADDR A:0xfe0430f0
y.create.l HWIO_LPASS_CDC_TX1_DMIC_CTL_ADDR A:0xfe0430d4
y.create.l HWIO_LPASS_CDC_TX2_DMIC_CTL_ADDR A:0xfe0430f4
y.create.l HWIO_LPASS_CDC_IIR1_GAIN_B1_CTL_ADDR A:0xfe043100
y.create.l HWIO_LPASS_CDC_IIR2_GAIN_B1_CTL_ADDR A:0xfe043140
y.create.l HWIO_LPASS_CDC_IIR1_GAIN_B2_CTL_ADDR A:0xfe043104
y.create.l HWIO_LPASS_CDC_IIR2_GAIN_B2_CTL_ADDR A:0xfe043144
y.create.l HWIO_LPASS_CDC_IIR1_GAIN_B3_CTL_ADDR A:0xfe043108
y.create.l HWIO_LPASS_CDC_IIR2_GAIN_B3_CTL_ADDR A:0xfe043148
y.create.l HWIO_LPASS_CDC_IIR1_GAIN_B4_CTL_ADDR A:0xfe04310c
y.create.l HWIO_LPASS_CDC_IIR2_GAIN_B4_CTL_ADDR A:0xfe04314c
y.create.l HWIO_LPASS_CDC_IIR1_GAIN_B5_CTL_ADDR A:0xfe043110
y.create.l HWIO_LPASS_CDC_IIR2_GAIN_B5_CTL_ADDR A:0xfe043150
y.create.l HWIO_LPASS_CDC_IIR1_GAIN_B6_CTL_ADDR A:0xfe043114
y.create.l HWIO_LPASS_CDC_IIR2_GAIN_B6_CTL_ADDR A:0xfe043154
y.create.l HWIO_LPASS_CDC_IIR1_GAIN_B7_CTL_ADDR A:0xfe043118
y.create.l HWIO_LPASS_CDC_IIR2_GAIN_B7_CTL_ADDR A:0xfe043158
y.create.l HWIO_LPASS_CDC_IIR1_GAIN_B8_CTL_ADDR A:0xfe04311c
y.create.l HWIO_LPASS_CDC_IIR2_GAIN_B8_CTL_ADDR A:0xfe04315c
y.create.l HWIO_LPASS_CDC_IIR1_CTL_ADDR A:0xfe043120
y.create.l HWIO_LPASS_CDC_IIR2_CTL_ADDR A:0xfe043160
y.create.l HWIO_LPASS_CDC_IIR1_GAIN_TIMER_CTL_ADDR A:0xfe043124
y.create.l HWIO_LPASS_CDC_IIR2_GAIN_TIMER_CTL_ADDR A:0xfe043164
y.create.l HWIO_LPASS_CDC_IIR1_COEF_B1_CTL_ADDR A:0xfe043128
y.create.l HWIO_LPASS_CDC_IIR2_COEF_B1_CTL_ADDR A:0xfe043168
y.create.l HWIO_LPASS_CDC_IIR1_COEF_B2_CTL_ADDR A:0xfe04312c
y.create.l HWIO_LPASS_CDC_IIR2_COEF_B2_CTL_ADDR A:0xfe04316c
y.create.l HWIO_LPASS_CDC_CONN_RX1_B1_CTL_ADDR A:0xfe043180
y.create.l HWIO_LPASS_CDC_CONN_RX1_B2_CTL_ADDR A:0xfe043184
y.create.l HWIO_LPASS_CDC_CONN_RX1_B3_CTL_ADDR A:0xfe043188
y.create.l HWIO_LPASS_CDC_CONN_RX2_B1_CTL_ADDR A:0xfe04318c
y.create.l HWIO_LPASS_CDC_CONN_RX2_B2_CTL_ADDR A:0xfe043190
y.create.l HWIO_LPASS_CDC_CONN_RX2_B3_CTL_ADDR A:0xfe043194
y.create.l HWIO_LPASS_CDC_CONN_RX3_B1_CTL_ADDR A:0xfe043198
y.create.l HWIO_LPASS_CDC_CONN_RX3_B2_CTL_ADDR A:0xfe04319c
y.create.l HWIO_LPASS_CDC_CONN_TX_B1_CTL_ADDR A:0xfe0431a4
y.create.l HWIO_LPASS_CDC_CONN_EQ1_B1_CTL_ADDR A:0xfe0431a8
y.create.l HWIO_LPASS_CDC_CONN_EQ1_B2_CTL_ADDR A:0xfe0431ac
y.create.l HWIO_LPASS_CDC_CONN_EQ1_B3_CTL_ADDR A:0xfe0431b0
y.create.l HWIO_LPASS_CDC_CONN_EQ1_B4_CTL_ADDR A:0xfe0431b4
y.create.l HWIO_LPASS_CDC_CONN_EQ2_B1_CTL_ADDR A:0xfe0431b8
y.create.l HWIO_LPASS_CDC_CONN_EQ2_B2_CTL_ADDR A:0xfe0431bc
y.create.l HWIO_LPASS_CDC_CONN_EQ2_B3_CTL_ADDR A:0xfe0431c0
y.create.l HWIO_LPASS_CDC_CONN_EQ2_B4_CTL_ADDR A:0xfe0431c4
y.create.l HWIO_LPASS_CDC_CONN_TX_I2S_SD1_CTL_ADDR A:0xfe0431c8
y.create.l HWIO_LPASS_CDC_TOP_GAIN_UPDATE_ADDR A:0xfe0431d0
y.create.l HWIO_LPASS_CDC_TOP_CTL_ADDR A:0xfe0431d8
y.create.l HWIO_LPASS_CDC_DEBUG_DESER1_CTL_ADDR A:0xfe0431e0
y.create.l HWIO_LPASS_CDC_DEBUG_DESER2_CTL_ADDR A:0xfe0431e4
y.create.l HWIO_LPASS_CDC_DEBUG_B1_CTL_ADDR A:0xfe0431e8
y.create.l HWIO_LPASS_CDC_DEBUG_B2_CTL_ADDR A:0xfe0431ec
y.create.l HWIO_LPASS_CDC_DEBUG_B3_CTL_ADDR A:0xfe0431f0
y.create.l HWIO_LPASS_LCC_XPU_SCR_ADDR A:0xfe044000
y.create.l HWIO_LPASS_LCC_XPU_SWDR_ADDR A:0xfe044004
y.create.l HWIO_LPASS_LCC_XPU_SEAR0_ADDR A:0xfe044040
y.create.l HWIO_LPASS_LCC_XPU_SESR_ADDR A:0xfe044048
y.create.l HWIO_LPASS_LCC_XPU_SESRRESTORE_ADDR A:0xfe04404c
y.create.l HWIO_LPASS_LCC_XPU_SESYNR0_ADDR A:0xfe044050
y.create.l HWIO_LPASS_LCC_XPU_SESYNR1_ADDR A:0xfe044054
y.create.l HWIO_LPASS_LCC_XPU_SESYNR2_ADDR A:0xfe044058
y.create.l HWIO_LPASS_LCC_XPU_MCR_ADDR A:0xfe044100
y.create.l HWIO_LPASS_LCC_XPU_MEAR0_ADDR A:0xfe044140
y.create.l HWIO_LPASS_LCC_XPU_MESR_ADDR A:0xfe044148
y.create.l HWIO_LPASS_LCC_XPU_MESRRESTORE_ADDR A:0xfe04414c
y.create.l HWIO_LPASS_LCC_XPU_MESYNR0_ADDR A:0xfe044150
y.create.l HWIO_LPASS_LCC_XPU_MESYNR1_ADDR A:0xfe044154
y.create.l HWIO_LPASS_LCC_XPU_MESYNR2_ADDR A:0xfe044158
y.create.l HWIO_LPASS_LCC_XPU_CR_ADDR A:0xfe044080
y.create.l HWIO_LPASS_LCC_XPU_RPU_ACR0_ADDR A:0xfe0440a0
y.create.l HWIO_LPASS_LCC_XPU_EAR0_ADDR A:0xfe0440c0
y.create.l HWIO_LPASS_LCC_XPU_ESR_ADDR A:0xfe0440c8
y.create.l HWIO_LPASS_LCC_XPU_ESRRESTORE_ADDR A:0xfe0440cc
y.create.l HWIO_LPASS_LCC_XPU_ESYNR0_ADDR A:0xfe0440d0
y.create.l HWIO_LPASS_LCC_XPU_ESYNR1_ADDR A:0xfe0440d4
y.create.l HWIO_LPASS_LCC_XPU_ESYNR2_ADDR A:0xfe0440d8
y.create.l HWIO_LPASS_LCC_XPU_IDR0_ADDR A:0xfe044074
y.create.l HWIO_LPASS_LCC_XPU_IDR1_ADDR A:0xfe044078
y.create.l HWIO_LPASS_LCC_XPU_REV_ADDR A:0xfe04407c
y.create.l HWIO_LPASS_LCC_XPU_RG0_RACR0_ADDR A:0xfe044200
y.create.l HWIO_LPASS_LCC_XPU_RG1_RACR0_ADDR A:0xfe044280
y.create.l HWIO_LPASS_LCC_XPU_RG2_RACR0_ADDR A:0xfe044300
y.create.l HWIO_LPASS_LCC_XPU_RG3_RACR0_ADDR A:0xfe044380
y.create.l HWIO_LPASS_LCC_XPU_RG4_RACR0_ADDR A:0xfe044400
y.create.l HWIO_LPASS_LCC_XPU_RG5_RACR0_ADDR A:0xfe044480
y.create.l HWIO_LPASS_LCC_XPU_RG6_RACR0_ADDR A:0xfe044500
y.create.l HWIO_LPASS_LCC_XPU_RG7_RACR0_ADDR A:0xfe044580
y.create.l HWIO_LPASS_LCC_XPU_RG8_RACR0_ADDR A:0xfe044600
y.create.l HWIO_LPASS_LCC_XPU_RG9_RACR0_ADDR A:0xfe044680
y.create.l HWIO_LPASS_LCC_XPU_RG0_WACR0_ADDR A:0xfe044220
y.create.l HWIO_LPASS_LCC_XPU_RG1_WACR0_ADDR A:0xfe0442a0
y.create.l HWIO_LPASS_LCC_XPU_RG2_WACR0_ADDR A:0xfe044320
y.create.l HWIO_LPASS_LCC_XPU_RG3_WACR0_ADDR A:0xfe0443a0
y.create.l HWIO_LPASS_LCC_XPU_RG4_WACR0_ADDR A:0xfe044420
y.create.l HWIO_LPASS_LCC_XPU_RG5_WACR0_ADDR A:0xfe0444a0
y.create.l HWIO_LPASS_LCC_XPU_RG6_WACR0_ADDR A:0xfe044520
y.create.l HWIO_LPASS_LCC_XPU_RG7_WACR0_ADDR A:0xfe0445a0
y.create.l HWIO_LPASS_LCC_XPU_RG8_WACR0_ADDR A:0xfe044620
y.create.l HWIO_LPASS_LCC_XPU_RG9_WACR0_ADDR A:0xfe0446a0
y.create.l HWIO_LPASS_LCC_XPU_RG0_SCR_ADDR A:0xfe044250
y.create.l HWIO_LPASS_LCC_XPU_RG1_SCR_ADDR A:0xfe0442d0
y.create.l HWIO_LPASS_LCC_XPU_RG2_SCR_ADDR A:0xfe044350
y.create.l HWIO_LPASS_LCC_XPU_RG3_SCR_ADDR A:0xfe0443d0
y.create.l HWIO_LPASS_LCC_XPU_RG4_SCR_ADDR A:0xfe044450
y.create.l HWIO_LPASS_LCC_XPU_RG5_SCR_ADDR A:0xfe0444d0
y.create.l HWIO_LPASS_LCC_XPU_RG6_SCR_ADDR A:0xfe044550
y.create.l HWIO_LPASS_LCC_XPU_RG7_SCR_ADDR A:0xfe0445d0
y.create.l HWIO_LPASS_LCC_XPU_RG8_SCR_ADDR A:0xfe044650
y.create.l HWIO_LPASS_LCC_XPU_RG9_SCR_ADDR A:0xfe0446d0
y.create.l HWIO_LPASS_LCC_XPU_RG0_MCR_ADDR A:0xfe044254
y.create.l HWIO_LPASS_LCC_XPU_RG1_MCR_ADDR A:0xfe0442d4
y.create.l HWIO_LPASS_LCC_XPU_RG2_MCR_ADDR A:0xfe044354
y.create.l HWIO_LPASS_LCC_XPU_RG3_MCR_ADDR A:0xfe0443d4
y.create.l HWIO_LPASS_LCC_XPU_RG4_MCR_ADDR A:0xfe044454
y.create.l HWIO_LPASS_LCC_XPU_RG5_MCR_ADDR A:0xfe0444d4
y.create.l HWIO_LPASS_LCC_XPU_RG6_MCR_ADDR A:0xfe044554
y.create.l HWIO_LPASS_LCC_XPU_RG7_MCR_ADDR A:0xfe0445d4
y.create.l HWIO_LPASS_LCC_XPU_RG8_MCR_ADDR A:0xfe044654
y.create.l HWIO_LPASS_LCC_XPU_RG9_MCR_ADDR A:0xfe0446d4
y.create.l HWIO_LPASS_TOP_XPU_SCR_ADDR A:0xfe046000
y.create.l HWIO_LPASS_TOP_XPU_SWDR_ADDR A:0xfe046004
y.create.l HWIO_LPASS_TOP_XPU_SEAR0_ADDR A:0xfe046040
y.create.l HWIO_LPASS_TOP_XPU_SESR_ADDR A:0xfe046048
y.create.l HWIO_LPASS_TOP_XPU_SESRRESTORE_ADDR A:0xfe04604c
y.create.l HWIO_LPASS_TOP_XPU_SESYNR0_ADDR A:0xfe046050
y.create.l HWIO_LPASS_TOP_XPU_SESYNR1_ADDR A:0xfe046054
y.create.l HWIO_LPASS_TOP_XPU_SESYNR2_ADDR A:0xfe046058
y.create.l HWIO_LPASS_TOP_XPU_MCR_ADDR A:0xfe046100
y.create.l HWIO_LPASS_TOP_XPU_MEAR0_ADDR A:0xfe046140
y.create.l HWIO_LPASS_TOP_XPU_MESR_ADDR A:0xfe046148
y.create.l HWIO_LPASS_TOP_XPU_MESRRESTORE_ADDR A:0xfe04614c
y.create.l HWIO_LPASS_TOP_XPU_MESYNR0_ADDR A:0xfe046150
y.create.l HWIO_LPASS_TOP_XPU_MESYNR1_ADDR A:0xfe046154
y.create.l HWIO_LPASS_TOP_XPU_MESYNR2_ADDR A:0xfe046158
y.create.l HWIO_LPASS_TOP_XPU_CR_ADDR A:0xfe046080
y.create.l HWIO_LPASS_TOP_XPU_RPU_ACR0_ADDR A:0xfe0460a0
y.create.l HWIO_LPASS_TOP_XPU_EAR0_ADDR A:0xfe0460c0
y.create.l HWIO_LPASS_TOP_XPU_ESR_ADDR A:0xfe0460c8
y.create.l HWIO_LPASS_TOP_XPU_ESRRESTORE_ADDR A:0xfe0460cc
y.create.l HWIO_LPASS_TOP_XPU_ESYNR0_ADDR A:0xfe0460d0
y.create.l HWIO_LPASS_TOP_XPU_ESYNR1_ADDR A:0xfe0460d4
y.create.l HWIO_LPASS_TOP_XPU_ESYNR2_ADDR A:0xfe0460d8
y.create.l HWIO_LPASS_TOP_XPU_IDR0_ADDR A:0xfe046074
y.create.l HWIO_LPASS_TOP_XPU_IDR1_ADDR A:0xfe046078
y.create.l HWIO_LPASS_TOP_XPU_REV_ADDR A:0xfe04607c
y.create.l HWIO_LPASS_TOP_XPU_RG0_RACR0_ADDR A:0xfe046200
y.create.l HWIO_LPASS_TOP_XPU_RG1_RACR0_ADDR A:0xfe046280
y.create.l HWIO_LPASS_TOP_XPU_RG2_RACR0_ADDR A:0xfe046300
y.create.l HWIO_LPASS_TOP_XPU_RG3_RACR0_ADDR A:0xfe046380
y.create.l HWIO_LPASS_TOP_XPU_RG4_RACR0_ADDR A:0xfe046400
y.create.l HWIO_LPASS_TOP_XPU_RG5_RACR0_ADDR A:0xfe046480
y.create.l HWIO_LPASS_TOP_XPU_RG0_SCR_ADDR A:0xfe046250
y.create.l HWIO_LPASS_TOP_XPU_RG1_SCR_ADDR A:0xfe0462d0
y.create.l HWIO_LPASS_TOP_XPU_RG2_SCR_ADDR A:0xfe046350
y.create.l HWIO_LPASS_TOP_XPU_RG3_SCR_ADDR A:0xfe0463d0
y.create.l HWIO_LPASS_TOP_XPU_RG4_SCR_ADDR A:0xfe046450
y.create.l HWIO_LPASS_TOP_XPU_RG5_SCR_ADDR A:0xfe0464d0
y.create.l HWIO_LPASS_TOP_XPU_RG0_MCR_ADDR A:0xfe046254
y.create.l HWIO_LPASS_TOP_XPU_RG1_MCR_ADDR A:0xfe0462d4
y.create.l HWIO_LPASS_TOP_XPU_RG2_MCR_ADDR A:0xfe046354
y.create.l HWIO_LPASS_TOP_XPU_RG3_MCR_ADDR A:0xfe0463d4
y.create.l HWIO_LPASS_TOP_XPU_RG4_MCR_ADDR A:0xfe046454
y.create.l HWIO_LPASS_TOP_XPU_RG5_MCR_ADDR A:0xfe0464d4
y.create.l HWIO_LPASS_CSR_GP_CTL_ADDR A:0xfe048000
y.create.l HWIO_LPASS_CSR_MEMTYPE_CTL_ADDR A:0xfe048004
y.create.l HWIO_LPASS_CSR_DEBUG_CTL_ADDR A:0xfe048010
y.create.l HWIO_LPASS_CSR_DEBUG_BUS_ADDR A:0xfe048014
y.create.l HWIO_LPASS_AHBI_CFG_ADDR A:0xfe049004
y.create.l HWIO_LPASS_AHBI_LOCK_CTL_ADDR A:0xfe049008
y.create.l HWIO_LPASS_AHBI_CFG_EXT_ADDR A:0xfe04900c
y.create.l HWIO_LPASS_AHBX_CFG_ADDR A:0xfe049020
y.create.l HWIO_LPASS_AHBX_LOCK_CTL_ADDR A:0xfe049024
y.create.l HWIO_LPASS_AHBIX_STATUS_ADDR A:0xfe049030
y.create.l HWIO_LPASS_AHBIX_ACK_ADDR A:0xfe049034
y.create.l HWIO_LPASS_DML_CTL_ADDR A:0xfe04a000
y.create.l HWIO_LPASS_DML_SRC_ADDR A:0xfe04a004
y.create.l HWIO_LPASS_DML_DST_ADDR A:0xfe04a008
y.create.l HWIO_LPASS_DML_TRAN_ADDR A:0xfe04a00c
y.create.l HWIO_LPASS_DML_STATUS_ADDR A:0xfe04a010
y.create.l HWIO_LPASS_DML_ACK_ADDR A:0xfe04a014
y.create.l HWIO_LPASS_LPM_CTL_ADDR A:0xfe04b000
y.create.l HWIO_LPASS_RESAMPLER_CTL_ADDR A:0xfe04c000
y.create.l HWIO_LPASS_MIDI_CTL_ADDR A:0xfe04d000
y.create.l HWIO_LPASS_SPDIFTX_CTL_ADDR A:0xfe04e700
y.create.l HWIO_LPASS_SPDIFTX_STAT_ADDR A:0xfe04e704
y.create.l HWIO_LPASS_LPAIF_CTL_ADDR A:0xfe04e000
y.create.l HWIO_LPASS_AHBTM_CFG_ADDR A:0xfe051000
y.create.l HWIO_LPASS_AHBTM_C0_CFG0_ADDR A:0xfe051020
y.create.l HWIO_LPASS_AHBTM_C1_CFG0_ADDR A:0xfe051040
y.create.l HWIO_LPASS_AHBTM_C2_CFG0_ADDR A:0xfe051060
y.create.l HWIO_LPASS_AHBTM_C3_CFG0_ADDR A:0xfe051080
y.create.l HWIO_LPASS_AHBTM_C4_CFG0_ADDR A:0xfe0510a0
y.create.l HWIO_LPASS_AHBTM_C5_CFG0_ADDR A:0xfe0510c0
y.create.l HWIO_LPASS_AHBTM_C6_CFG0_ADDR A:0xfe0510e0
y.create.l HWIO_LPASS_AHBTM_C7_CFG0_ADDR A:0xfe051100
y.create.l HWIO_LPASS_AHBTM_C0_CFG1_ADDR A:0xfe051024
y.create.l HWIO_LPASS_AHBTM_C1_CFG1_ADDR A:0xfe051044
y.create.l HWIO_LPASS_AHBTM_C2_CFG1_ADDR A:0xfe051064
y.create.l HWIO_LPASS_AHBTM_C3_CFG1_ADDR A:0xfe051084
y.create.l HWIO_LPASS_AHBTM_C4_CFG1_ADDR A:0xfe0510a4
y.create.l HWIO_LPASS_AHBTM_C5_CFG1_ADDR A:0xfe0510c4
y.create.l HWIO_LPASS_AHBTM_C6_CFG1_ADDR A:0xfe0510e4
y.create.l HWIO_LPASS_AHBTM_C7_CFG1_ADDR A:0xfe051104
y.create.l HWIO_LPASS_AHBTM_C0_CFG2_ADDR A:0xfe051028
y.create.l HWIO_LPASS_AHBTM_C1_CFG2_ADDR A:0xfe051048
y.create.l HWIO_LPASS_AHBTM_C2_CFG2_ADDR A:0xfe051068
y.create.l HWIO_LPASS_AHBTM_C3_CFG2_ADDR A:0xfe051088
y.create.l HWIO_LPASS_AHBTM_C4_CFG2_ADDR A:0xfe0510a8
y.create.l HWIO_LPASS_AHBTM_C5_CFG2_ADDR A:0xfe0510c8
y.create.l HWIO_LPASS_AHBTM_C6_CFG2_ADDR A:0xfe0510e8
y.create.l HWIO_LPASS_AHBTM_C7_CFG2_ADDR A:0xfe051108
y.create.l HWIO_LPASS_AHBTM_C0_CFG3_ADDR A:0xfe05102c
y.create.l HWIO_LPASS_AHBTM_C1_CFG3_ADDR A:0xfe05104c
y.create.l HWIO_LPASS_AHBTM_C2_CFG3_ADDR A:0xfe05106c
y.create.l HWIO_LPASS_AHBTM_C3_CFG3_ADDR A:0xfe05108c
y.create.l HWIO_LPASS_AHBTM_C4_CFG3_ADDR A:0xfe0510ac
y.create.l HWIO_LPASS_AHBTM_C5_CFG3_ADDR A:0xfe0510cc
y.create.l HWIO_LPASS_AHBTM_C6_CFG3_ADDR A:0xfe0510ec
y.create.l HWIO_LPASS_AHBTM_C7_CFG3_ADDR A:0xfe05110c
y.create.l HWIO_LPASS_AHBTM_C0_CFG4_ADDR A:0xfe051030
y.create.l HWIO_LPASS_AHBTM_C1_CFG4_ADDR A:0xfe051050
y.create.l HWIO_LPASS_AHBTM_C2_CFG4_ADDR A:0xfe051070
y.create.l HWIO_LPASS_AHBTM_C3_CFG4_ADDR A:0xfe051090
y.create.l HWIO_LPASS_AHBTM_C4_CFG4_ADDR A:0xfe0510b0
y.create.l HWIO_LPASS_AHBTM_C5_CFG4_ADDR A:0xfe0510d0
y.create.l HWIO_LPASS_AHBTM_C6_CFG4_ADDR A:0xfe0510f0
y.create.l HWIO_LPASS_AHBTM_C7_CFG4_ADDR A:0xfe051110
y.create.l HWIO_LPASS_AHBTM_C0_CFG5_ADDR A:0xfe051034
y.create.l HWIO_LPASS_AHBTM_C1_CFG5_ADDR A:0xfe051054
y.create.l HWIO_LPASS_AHBTM_C2_CFG5_ADDR A:0xfe051074
y.create.l HWIO_LPASS_AHBTM_C3_CFG5_ADDR A:0xfe051094
y.create.l HWIO_LPASS_AHBTM_C4_CFG5_ADDR A:0xfe0510b4
y.create.l HWIO_LPASS_AHBTM_C5_CFG5_ADDR A:0xfe0510d4
y.create.l HWIO_LPASS_AHBTM_C6_CFG5_ADDR A:0xfe0510f4
y.create.l HWIO_LPASS_AHBTM_C7_CFG5_ADDR A:0xfe051114
y.create.l HWIO_LPASS_AHBTM_C0_CFG6_ADDR A:0xfe051038
y.create.l HWIO_LPASS_AHBTM_C1_CFG6_ADDR A:0xfe051058
y.create.l HWIO_LPASS_AHBTM_C2_CFG6_ADDR A:0xfe051078
y.create.l HWIO_LPASS_AHBTM_C3_CFG6_ADDR A:0xfe051098
y.create.l HWIO_LPASS_AHBTM_C4_CFG6_ADDR A:0xfe0510b8
y.create.l HWIO_LPASS_AHBTM_C5_CFG6_ADDR A:0xfe0510d8
y.create.l HWIO_LPASS_AHBTM_C6_CFG6_ADDR A:0xfe0510f8
y.create.l HWIO_LPASS_AHBTM_C7_CFG6_ADDR A:0xfe051118
y.create.l HWIO_LPASS_AHBI_ABT_HW_VERSION_ADDR A:0xfe052000
y.create.l HWIO_LPASS_AHBI_ABT_INST_ID_ADDR A:0xfe052004
y.create.l HWIO_LPASS_AHBI_ABT_NUM_SLAVES_ADDR A:0xfe052008
y.create.l HWIO_LPASS_AHBI_ABT_TIMER_LOADVAL_ADDR A:0xfe05200c
y.create.l HWIO_LPASS_AHBI_ABT_TIMER_MODE_ADDR A:0xfe052010
y.create.l HWIO_LPASS_AHBI_ABT_INTR_STATUS_ADDR A:0xfe052014
y.create.l HWIO_LPASS_AHBI_ABT_INTR_CLEAR_ADDR A:0xfe052018
y.create.l HWIO_LPASS_AHBI_ABT_INTR_ENABLE_ADDR A:0xfe05201c
y.create.l HWIO_LPASS_AHBI_ABT_SYND_VALID_ADDR A:0xfe052020
y.create.l HWIO_LPASS_AHBI_ABT_SYND_CLEAR_ADDR A:0xfe052024
y.create.l HWIO_LPASS_AHBI_ABT_SYND_ID_ADDR A:0xfe052028
y.create.l HWIO_LPASS_AHBI_ABT_SYND_ADDR0_ADDR A:0xfe05202c
y.create.l HWIO_LPASS_AHBI_ABT_SYND_ADDR1_ADDR A:0xfe052030
y.create.l HWIO_LPASS_AHBI_ABT_SYND_HREADY_ADDR A:0xfe052034
y.create.l HWIO_LPASS_AVTIMER_CTL_ADDR A:0xfe053000
y.create.l HWIO_LPASS_AVTIMER_RESMOD_ADDR A:0xfe053004
y.create.l HWIO_LPASS_AVTIMER_TIMER_LSB_ADDR A:0xfe053008
y.create.l HWIO_LPASS_AVTIMER_TIMER_MSB_ADDR A:0xfe05300c
y.create.l HWIO_LPASS_AVTIMER_INT0_LSB_ADDR A:0xfe053010
y.create.l HWIO_LPASS_AVTIMER_INT0_MSB_ADDR A:0xfe053014
y.create.l HWIO_LPASS_AVTIMER_INT1_LSB_ADDR A:0xfe053018
y.create.l HWIO_LPASS_AVTIMER_INT1_MSB_ADDR A:0xfe05301c
y.create.l HWIO_LPASS_AVTIMER_DRE_TARGET_VALUE_ADDR A:0xfe053020
y.create.l HWIO_LPASS_AVTIMER_TIMEOUT_VAL_ADDR A:0xfe053024
y.create.l HWIO_LPASS_AVTIMER_DRE_CNT_PXO_ADDR A:0xfe053028
y.create.l HWIO_LPASS_AUD_SYNC_CTL_ADDR A:0xfe053400
y.create.l HWIO_LPASS_AUD_SYNC_STATUS_ADDR A:0xfe053404
y.create.l HWIO_LPASS_AUD_SYNC_BT_REF_INC_ADDR A:0xfe053408
y.create.l HWIO_LPASS_AUD_SYNC_BT_XO_DIV_MOD_ADDR A:0xfe05340c
y.create.l HWIO_LPASS_AUD_SYNC_BT_PHASE_CHK_XO1_ADDR A:0xfe053410
y.create.l HWIO_LPASS_AUD_SYNC_BT_PHASE_CHK_REF1_ADDR A:0xfe053414
y.create.l HWIO_LPASS_AUD_SYNC_BT_VFR_TIMESTAMP_ADDR A:0xfe053418
y.create.l HWIO_LPASS_AUD_SYNC_BT_COUNT_LOAD_XO1_ADDR A:0xfe05341c
y.create.l HWIO_LPASS_AUD_SYNC_BT_COUNT_LOAD_REF1_ADDR A:0xfe053420
y.create.l HWIO_LPASS_AUD_SYNC_BT_PHASE_CHK_XO2_ADDR A:0xfe053424
y.create.l HWIO_LPASS_AUD_SYNC_BT_PHASE_CHK_REF2_ADDR A:0xfe053428
y.create.l HWIO_LPASS_AUD_SYNC_BT_COUNT_LOAD_XO2_ADDR A:0xfe05342c
y.create.l HWIO_LPASS_AUD_SYNC_BT_COUNT_LOAD_REF2_ADDR A:0xfe053430
y.create.l HWIO_LPASS_AUD_SYNC_FM_REF_INC_ADDR A:0xfe053434
y.create.l HWIO_LPASS_AUD_SYNC_FM_XO_DIV_MOD_ADDR A:0xfe053438
y.create.l HWIO_LPASS_AUD_SYNC_FM_PHASE_CHK_XO_ADDR A:0xfe05343c
y.create.l HWIO_LPASS_AUD_SYNC_FM_PHASE_CHK_REF_ADDR A:0xfe053440
y.create.l HWIO_LPASS_AUD_SYNC_FM_VFR_TIMESTAMP_ADDR A:0xfe053444
y.create.l HWIO_LPASS_AUD_SYNC_FM_COUNT_LOAD_XO_ADDR A:0xfe053448
y.create.l HWIO_LPASS_AUD_SYNC_FM_COUNT_LOAD_REF_ADDR A:0xfe05344c
y.create.l HWIO_LPASS_DM_VMIDMT_SCR0_ADDR A:0xfe056000
y.create.l HWIO_LPASS_DM_VMIDMT_SCR1_ADDR A:0xfe056004
y.create.l HWIO_LPASS_DM_VMIDMT_SCR2_ADDR A:0xfe056008
y.create.l HWIO_LPASS_DM_VMIDMT_SACR_ADDR A:0xfe056010
y.create.l HWIO_LPASS_DM_VMIDMT_SIDR0_ADDR A:0xfe056020
y.create.l HWIO_LPASS_DM_VMIDMT_SIDR1_ADDR A:0xfe056024
y.create.l HWIO_LPASS_DM_VMIDMT_SIDR2_ADDR A:0xfe056028
y.create.l HWIO_LPASS_DM_VMIDMT_SIDR4_ADDR A:0xfe056030
y.create.l HWIO_LPASS_DM_VMIDMT_SIDR5_ADDR A:0xfe056034
y.create.l HWIO_LPASS_DM_VMIDMT_SIDR7_ADDR A:0xfe05603c
y.create.l HWIO_LPASS_DM_VMIDMT_SGFAR0_ADDR A:0xfe056040
y.create.l HWIO_LPASS_DM_VMIDMT_SGFSR_ADDR A:0xfe056048
y.create.l HWIO_LPASS_DM_VMIDMT_SGFSRRESTORE_ADDR A:0xfe05604c
y.create.l HWIO_LPASS_DM_VMIDMT_SGFSYNDR0_ADDR A:0xfe056050
y.create.l HWIO_LPASS_DM_VMIDMT_SGFSYNDR1_ADDR A:0xfe056054
y.create.l HWIO_LPASS_DM_VMIDMT_SGFSYNDR2_ADDR A:0xfe056058
y.create.l HWIO_LPASS_DM_VMIDMT_VMIDMTSCR0_ADDR A:0xfe056090
y.create.l HWIO_LPASS_DM_VMIDMT_CR0_ADDR A:0xfe056000
y.create.l HWIO_LPASS_DM_VMIDMT_CR2_ADDR A:0xfe056008
y.create.l HWIO_LPASS_DM_VMIDMT_ACR_ADDR A:0xfe056010
y.create.l HWIO_LPASS_DM_VMIDMT_IDR0_ADDR A:0xfe056020
y.create.l HWIO_LPASS_DM_VMIDMT_IDR1_ADDR A:0xfe056024
y.create.l HWIO_LPASS_DM_VMIDMT_IDR2_ADDR A:0xfe056028
y.create.l HWIO_LPASS_DM_VMIDMT_IDR4_ADDR A:0xfe056030
y.create.l HWIO_LPASS_DM_VMIDMT_IDR5_ADDR A:0xfe056034
y.create.l HWIO_LPASS_DM_VMIDMT_IDR7_ADDR A:0xfe05603c
y.create.l HWIO_LPASS_DM_VMIDMT_GFAR0_ADDR A:0xfe056040
y.create.l HWIO_LPASS_DM_VMIDMT_GFSR_ADDR A:0xfe056048
y.create.l HWIO_LPASS_DM_VMIDMT_GFSRRESTORE_ADDR A:0xfe05604c
y.create.l HWIO_LPASS_DM_VMIDMT_GFSYNDR0_ADDR A:0xfe056050
y.create.l HWIO_LPASS_DM_VMIDMT_GFSYNDR1_ADDR A:0xfe056054
y.create.l HWIO_LPASS_DM_VMIDMT_GFSYNDR2_ADDR A:0xfe056058
y.create.l HWIO_LPASS_DM_VMIDMT_VMIDMTCR0_ADDR A:0xfe056090
y.create.l HWIO_LPASS_DM_VMIDMT_VMIDMTACR_ADDR A:0xfe05609c
y.create.l HWIO_LPASS_DM_VMIDMT_NSCR0_ADDR A:0xfe056400
y.create.l HWIO_LPASS_DM_VMIDMT_NSCR2_ADDR A:0xfe056408
y.create.l HWIO_LPASS_DM_VMIDMT_NSACR_ADDR A:0xfe056410
y.create.l HWIO_LPASS_DM_VMIDMT_NSGFAR0_ADDR A:0xfe056440
y.create.l HWIO_LPASS_DM_VMIDMT_NSGFSR_ADDR A:0xfe056448
y.create.l HWIO_LPASS_DM_VMIDMT_NSGFSRRESTORE_ADDR A:0xfe05644c
y.create.l HWIO_LPASS_DM_VMIDMT_NSGFSYNDR0_ADDR A:0xfe056450
y.create.l HWIO_LPASS_DM_VMIDMT_NSGFSYNDR1_ADDR A:0xfe056454
y.create.l HWIO_LPASS_DM_VMIDMT_NSGFSYNDR2_ADDR A:0xfe056458
y.create.l HWIO_LPASS_DM_VMIDMT_NSVMIDMTCR0_ADDR A:0xfe056490
y.create.l HWIO_LPASS_DM_VMIDMT_SSDR0_ADDR A:0xfe056080
y.create.l HWIO_LPASS_DM_VMIDMT_MSDR0_ADDR A:0xfe056480
y.create.l HWIO_LPASS_DM_VMIDMT_MCR_ADDR A:0xfe056494
y.create.l HWIO_LPASS_DM_VMIDMT_S2VR0_ADDR A:0xfe056c00
y.create.l HWIO_LPASS_DM_VMIDMT_AS2VR0_ADDR A:0xfe056e00
y.create.l HWIO_LPASS_DM_VMIDMT_SMR0_ADDR A:0xfe056800
y.create.l HWIO_LPASS_LPAIF_VMIDMT_SCR0_ADDR A:0xfe057000
y.create.l HWIO_LPASS_LPAIF_VMIDMT_SCR1_ADDR A:0xfe057004
y.create.l HWIO_LPASS_LPAIF_VMIDMT_SCR2_ADDR A:0xfe057008
y.create.l HWIO_LPASS_LPAIF_VMIDMT_SACR_ADDR A:0xfe057010
y.create.l HWIO_LPASS_LPAIF_VMIDMT_SIDR0_ADDR A:0xfe057020
y.create.l HWIO_LPASS_LPAIF_VMIDMT_SIDR1_ADDR A:0xfe057024
y.create.l HWIO_LPASS_LPAIF_VMIDMT_SIDR2_ADDR A:0xfe057028
y.create.l HWIO_LPASS_LPAIF_VMIDMT_SIDR4_ADDR A:0xfe057030
y.create.l HWIO_LPASS_LPAIF_VMIDMT_SIDR5_ADDR A:0xfe057034
y.create.l HWIO_LPASS_LPAIF_VMIDMT_SIDR7_ADDR A:0xfe05703c
y.create.l HWIO_LPASS_LPAIF_VMIDMT_SGFAR0_ADDR A:0xfe057040
y.create.l HWIO_LPASS_LPAIF_VMIDMT_SGFSR_ADDR A:0xfe057048
y.create.l HWIO_LPASS_LPAIF_VMIDMT_SGFSRRESTORE_ADDR A:0xfe05704c
y.create.l HWIO_LPASS_LPAIF_VMIDMT_SGFSYNDR0_ADDR A:0xfe057050
y.create.l HWIO_LPASS_LPAIF_VMIDMT_SGFSYNDR1_ADDR A:0xfe057054
y.create.l HWIO_LPASS_LPAIF_VMIDMT_SGFSYNDR2_ADDR A:0xfe057058
y.create.l HWIO_LPASS_LPAIF_VMIDMT_VMIDMTSCR0_ADDR A:0xfe057090
y.create.l HWIO_LPASS_LPAIF_VMIDMT_CR0_ADDR A:0xfe057000
y.create.l HWIO_LPASS_LPAIF_VMIDMT_CR2_ADDR A:0xfe057008
y.create.l HWIO_LPASS_LPAIF_VMIDMT_ACR_ADDR A:0xfe057010
y.create.l HWIO_LPASS_LPAIF_VMIDMT_IDR0_ADDR A:0xfe057020
y.create.l HWIO_LPASS_LPAIF_VMIDMT_IDR1_ADDR A:0xfe057024
y.create.l HWIO_LPASS_LPAIF_VMIDMT_IDR2_ADDR A:0xfe057028
y.create.l HWIO_LPASS_LPAIF_VMIDMT_IDR4_ADDR A:0xfe057030
y.create.l HWIO_LPASS_LPAIF_VMIDMT_IDR5_ADDR A:0xfe057034
y.create.l HWIO_LPASS_LPAIF_VMIDMT_IDR7_ADDR A:0xfe05703c
y.create.l HWIO_LPASS_LPAIF_VMIDMT_GFAR0_ADDR A:0xfe057040
y.create.l HWIO_LPASS_LPAIF_VMIDMT_GFSR_ADDR A:0xfe057048
y.create.l HWIO_LPASS_LPAIF_VMIDMT_GFSRRESTORE_ADDR A:0xfe05704c
y.create.l HWIO_LPASS_LPAIF_VMIDMT_GFSYNDR0_ADDR A:0xfe057050
y.create.l HWIO_LPASS_LPAIF_VMIDMT_GFSYNDR1_ADDR A:0xfe057054
y.create.l HWIO_LPASS_LPAIF_VMIDMT_GFSYNDR2_ADDR A:0xfe057058
y.create.l HWIO_LPASS_LPAIF_VMIDMT_VMIDMTCR0_ADDR A:0xfe057090
y.create.l HWIO_LPASS_LPAIF_VMIDMT_VMIDMTACR_ADDR A:0xfe05709c
y.create.l HWIO_LPASS_LPAIF_VMIDMT_NSCR0_ADDR A:0xfe057400
y.create.l HWIO_LPASS_LPAIF_VMIDMT_NSCR2_ADDR A:0xfe057408
y.create.l HWIO_LPASS_LPAIF_VMIDMT_NSACR_ADDR A:0xfe057410
y.create.l HWIO_LPASS_LPAIF_VMIDMT_NSGFAR0_ADDR A:0xfe057440
y.create.l HWIO_LPASS_LPAIF_VMIDMT_NSGFSR_ADDR A:0xfe057448
y.create.l HWIO_LPASS_LPAIF_VMIDMT_NSGFSRRESTORE_ADDR A:0xfe05744c
y.create.l HWIO_LPASS_LPAIF_VMIDMT_NSGFSYNDR0_ADDR A:0xfe057450
y.create.l HWIO_LPASS_LPAIF_VMIDMT_NSGFSYNDR1_ADDR A:0xfe057454
y.create.l HWIO_LPASS_LPAIF_VMIDMT_NSGFSYNDR2_ADDR A:0xfe057458
y.create.l HWIO_LPASS_LPAIF_VMIDMT_NSVMIDMTCR0_ADDR A:0xfe057490
y.create.l HWIO_LPASS_LPAIF_VMIDMT_SSDR0_ADDR A:0xfe057080
y.create.l HWIO_LPASS_LPAIF_VMIDMT_MSDR0_ADDR A:0xfe057480
y.create.l HWIO_LPASS_LPAIF_VMIDMT_MCR_ADDR A:0xfe057494
y.create.l HWIO_LPASS_LPAIF_VMIDMT_S2VR0_ADDR A:0xfe057c00
y.create.l HWIO_LPASS_LPAIF_VMIDMT_S2VR1_ADDR A:0xfe057c04
y.create.l HWIO_LPASS_LPAIF_VMIDMT_S2VR2_ADDR A:0xfe057c08
y.create.l HWIO_LPASS_LPAIF_VMIDMT_S2VR3_ADDR A:0xfe057c0c
y.create.l HWIO_LPASS_LPAIF_VMIDMT_S2VR4_ADDR A:0xfe057c10
y.create.l HWIO_LPASS_LPAIF_VMIDMT_S2VR5_ADDR A:0xfe057c14
y.create.l HWIO_LPASS_LPAIF_VMIDMT_S2VR6_ADDR A:0xfe057c18
y.create.l HWIO_LPASS_LPAIF_VMIDMT_S2VR7_ADDR A:0xfe057c1c
y.create.l HWIO_LPASS_LPAIF_VMIDMT_S2VR8_ADDR A:0xfe057c20
y.create.l HWIO_LPASS_LPAIF_VMIDMT_AS2VR0_ADDR A:0xfe057e00
y.create.l HWIO_LPASS_LPAIF_VMIDMT_AS2VR1_ADDR A:0xfe057e04
y.create.l HWIO_LPASS_LPAIF_VMIDMT_AS2VR2_ADDR A:0xfe057e08
y.create.l HWIO_LPASS_LPAIF_VMIDMT_AS2VR3_ADDR A:0xfe057e0c
y.create.l HWIO_LPASS_LPAIF_VMIDMT_AS2VR4_ADDR A:0xfe057e10
y.create.l HWIO_LPASS_LPAIF_VMIDMT_AS2VR5_ADDR A:0xfe057e14
y.create.l HWIO_LPASS_LPAIF_VMIDMT_AS2VR6_ADDR A:0xfe057e18
y.create.l HWIO_LPASS_LPAIF_VMIDMT_AS2VR7_ADDR A:0xfe057e1c
y.create.l HWIO_LPASS_LPAIF_VMIDMT_AS2VR8_ADDR A:0xfe057e20
y.create.l HWIO_LPASS_LPAIF_VMIDMT_SMR0_ADDR A:0xfe057800
y.create.l HWIO_LPASS_LPAIF_VMIDMT_SMR1_ADDR A:0xfe057804
y.create.l HWIO_LPASS_LPAIF_VMIDMT_SMR2_ADDR A:0xfe057808
y.create.l HWIO_LPASS_LPAIF_VMIDMT_SMR3_ADDR A:0xfe05780c
y.create.l HWIO_LPASS_LPAIF_VMIDMT_SMR4_ADDR A:0xfe057810
y.create.l HWIO_LPASS_LPAIF_VMIDMT_SMR5_ADDR A:0xfe057814
y.create.l HWIO_LPASS_LPAIF_VMIDMT_SMR6_ADDR A:0xfe057818
y.create.l HWIO_LPASS_LPAIF_VMIDMT_SMR7_ADDR A:0xfe05781c
y.create.l HWIO_LPASS_LPAIF_VMIDMT_SMR8_ADDR A:0xfe057820
y.create.l HWIO_LPASS_LPM_XPU_SCR_ADDR A:0xfe065000
y.create.l HWIO_LPASS_LPM_XPU_SWDR_ADDR A:0xfe065004
y.create.l HWIO_LPASS_LPM_XPU_PRTN_RACR_SSHADOW_ADDR A:0xfe065008
y.create.l HWIO_LPASS_LPM_XPU_PRTN_WACR_SSHADOW_ADDR A:0xfe06500c
y.create.l HWIO_LPASS_LPM_XPU_PRTN_START_SSHADOW0_ADDR A:0xfe065010
y.create.l HWIO_LPASS_LPM_XPU_PRTN_END_SSHADOW0_ADDR A:0xfe065018
y.create.l HWIO_LPASS_LPM_XPU_SEAR0_ADDR A:0xfe065040
y.create.l HWIO_LPASS_LPM_XPU_SESR_ADDR A:0xfe065048
y.create.l HWIO_LPASS_LPM_XPU_SESRRESTORE_ADDR A:0xfe06504c
y.create.l HWIO_LPASS_LPM_XPU_SESYNR0_ADDR A:0xfe065050
y.create.l HWIO_LPASS_LPM_XPU_SESYNR1_ADDR A:0xfe065054
y.create.l HWIO_LPASS_LPM_XPU_SESYNR2_ADDR A:0xfe065058
y.create.l HWIO_LPASS_LPM_XPU_MCR_ADDR A:0xfe065100
y.create.l HWIO_LPASS_LPM_XPU_MEAR0_ADDR A:0xfe065140
y.create.l HWIO_LPASS_LPM_XPU_MESR_ADDR A:0xfe065148
y.create.l HWIO_LPASS_LPM_XPU_MESRRESTORE_ADDR A:0xfe06514c
y.create.l HWIO_LPASS_LPM_XPU_MESYNR0_ADDR A:0xfe065150
y.create.l HWIO_LPASS_LPM_XPU_MESYNR1_ADDR A:0xfe065154
y.create.l HWIO_LPASS_LPM_XPU_MESYNR2_ADDR A:0xfe065158
y.create.l HWIO_LPASS_LPM_XPU_CR_ADDR A:0xfe065080
y.create.l HWIO_LPASS_LPM_XPU_PRTN_RACR_SHADOW_ADDR A:0xfe065088
y.create.l HWIO_LPASS_LPM_XPU_PRTN_WACR_SHADOW_ADDR A:0xfe06508c
y.create.l HWIO_LPASS_LPM_XPU_PRTN_START_SHADOW0_ADDR A:0xfe065090
y.create.l HWIO_LPASS_LPM_XPU_PRTN_END_SHADOW0_ADDR A:0xfe065098
y.create.l HWIO_LPASS_LPM_XPU_RPU_ACR0_ADDR A:0xfe0650a0
y.create.l HWIO_LPASS_LPM_XPU_EAR0_ADDR A:0xfe0650c0
y.create.l HWIO_LPASS_LPM_XPU_ESR_ADDR A:0xfe0650c8
y.create.l HWIO_LPASS_LPM_XPU_ESRRESTORE_ADDR A:0xfe0650cc
y.create.l HWIO_LPASS_LPM_XPU_ESYNR0_ADDR A:0xfe0650d0
y.create.l HWIO_LPASS_LPM_XPU_ESYNR1_ADDR A:0xfe0650d4
y.create.l HWIO_LPASS_LPM_XPU_ESYNR2_ADDR A:0xfe0650d8
y.create.l HWIO_LPASS_LPM_XPU_UMR_RACR_ADDR A:0xfe0650e0
y.create.l HWIO_LPASS_LPM_XPU_UMR_WACR_ADDR A:0xfe0650e4
y.create.l HWIO_LPASS_LPM_XPU_IDR0_ADDR A:0xfe065074
y.create.l HWIO_LPASS_LPM_XPU_IDR1_ADDR A:0xfe065078
y.create.l HWIO_LPASS_LPM_XPU_REV_ADDR A:0xfe06507c
y.create.l HWIO_LPASS_LPM_XPU_PRT0_RACR0_ADDR A:0xfe065200
y.create.l HWIO_LPASS_LPM_XPU_PRT1_RACR0_ADDR A:0xfe065280
y.create.l HWIO_LPASS_LPM_XPU_PRT2_RACR0_ADDR A:0xfe065300
y.create.l HWIO_LPASS_LPM_XPU_PRT3_RACR0_ADDR A:0xfe065380
y.create.l HWIO_LPASS_LPM_XPU_PRT4_RACR0_ADDR A:0xfe065400
y.create.l HWIO_LPASS_LPM_XPU_PRT5_RACR0_ADDR A:0xfe065480
y.create.l HWIO_LPASS_LPM_XPU_PRT6_RACR0_ADDR A:0xfe065500
y.create.l HWIO_LPASS_LPM_XPU_PRT7_RACR0_ADDR A:0xfe065580
y.create.l HWIO_LPASS_LPM_XPU_PRT8_RACR0_ADDR A:0xfe065600
y.create.l HWIO_LPASS_LPM_XPU_PRT9_RACR0_ADDR A:0xfe065680
y.create.l HWIO_LPASS_LPM_XPU_PRT0_WACR0_ADDR A:0xfe065220
y.create.l HWIO_LPASS_LPM_XPU_PRT1_WACR0_ADDR A:0xfe0652a0
y.create.l HWIO_LPASS_LPM_XPU_PRT2_WACR0_ADDR A:0xfe065320
y.create.l HWIO_LPASS_LPM_XPU_PRT3_WACR0_ADDR A:0xfe0653a0
y.create.l HWIO_LPASS_LPM_XPU_PRT4_WACR0_ADDR A:0xfe065420
y.create.l HWIO_LPASS_LPM_XPU_PRT5_WACR0_ADDR A:0xfe0654a0
y.create.l HWIO_LPASS_LPM_XPU_PRT6_WACR0_ADDR A:0xfe065520
y.create.l HWIO_LPASS_LPM_XPU_PRT7_WACR0_ADDR A:0xfe0655a0
y.create.l HWIO_LPASS_LPM_XPU_PRT8_WACR0_ADDR A:0xfe065620
y.create.l HWIO_LPASS_LPM_XPU_PRT9_WACR0_ADDR A:0xfe0656a0
y.create.l HWIO_LPASS_LPM_XPU_PRT0_START0_ADDR A:0xfe065240
y.create.l HWIO_LPASS_LPM_XPU_PRT1_START0_ADDR A:0xfe0652c0
y.create.l HWIO_LPASS_LPM_XPU_PRT2_START0_ADDR A:0xfe065340
y.create.l HWIO_LPASS_LPM_XPU_PRT3_START0_ADDR A:0xfe0653c0
y.create.l HWIO_LPASS_LPM_XPU_PRT4_START0_ADDR A:0xfe065440
y.create.l HWIO_LPASS_LPM_XPU_PRT5_START0_ADDR A:0xfe0654c0
y.create.l HWIO_LPASS_LPM_XPU_PRT6_START0_ADDR A:0xfe065540
y.create.l HWIO_LPASS_LPM_XPU_PRT7_START0_ADDR A:0xfe0655c0
y.create.l HWIO_LPASS_LPM_XPU_PRT8_START0_ADDR A:0xfe065640
y.create.l HWIO_LPASS_LPM_XPU_PRT9_START0_ADDR A:0xfe0656c0
y.create.l HWIO_LPASS_LPM_XPU_PRT0_END0_ADDR A:0xfe065248
y.create.l HWIO_LPASS_LPM_XPU_PRT1_END0_ADDR A:0xfe0652c8
y.create.l HWIO_LPASS_LPM_XPU_PRT2_END0_ADDR A:0xfe065348
y.create.l HWIO_LPASS_LPM_XPU_PRT3_END0_ADDR A:0xfe0653c8
y.create.l HWIO_LPASS_LPM_XPU_PRT4_END0_ADDR A:0xfe065448
y.create.l HWIO_LPASS_LPM_XPU_PRT5_END0_ADDR A:0xfe0654c8
y.create.l HWIO_LPASS_LPM_XPU_PRT6_END0_ADDR A:0xfe065548
y.create.l HWIO_LPASS_LPM_XPU_PRT7_END0_ADDR A:0xfe0655c8
y.create.l HWIO_LPASS_LPM_XPU_PRT8_END0_ADDR A:0xfe065648
y.create.l HWIO_LPASS_LPM_XPU_PRT9_END0_ADDR A:0xfe0656c8
y.create.l HWIO_LPASS_LPM_XPU_PRT0_SCR_ADDR A:0xfe065250
y.create.l HWIO_LPASS_LPM_XPU_PRT1_SCR_ADDR A:0xfe0652d0
y.create.l HWIO_LPASS_LPM_XPU_PRT2_SCR_ADDR A:0xfe065350
y.create.l HWIO_LPASS_LPM_XPU_PRT3_SCR_ADDR A:0xfe0653d0
y.create.l HWIO_LPASS_LPM_XPU_PRT4_SCR_ADDR A:0xfe065450
y.create.l HWIO_LPASS_LPM_XPU_PRT5_SCR_ADDR A:0xfe0654d0
y.create.l HWIO_LPASS_LPM_XPU_PRT6_SCR_ADDR A:0xfe065550
y.create.l HWIO_LPASS_LPM_XPU_PRT7_SCR_ADDR A:0xfe0655d0
y.create.l HWIO_LPASS_LPM_XPU_PRT8_SCR_ADDR A:0xfe065650
y.create.l HWIO_LPASS_LPM_XPU_PRT9_SCR_ADDR A:0xfe0656d0
y.create.l HWIO_LPASS_LPM_XPU_RG0_MCR_ADDR A:0xfe065254
y.create.l HWIO_LPASS_LPM_XPU_RG1_MCR_ADDR A:0xfe0652d4
y.create.l HWIO_LPASS_LPM_XPU_RG2_MCR_ADDR A:0xfe065354
y.create.l HWIO_LPASS_LPM_XPU_RG3_MCR_ADDR A:0xfe0653d4
y.create.l HWIO_LPASS_LPM_XPU_RG4_MCR_ADDR A:0xfe065454
y.create.l HWIO_LPASS_LPM_XPU_RG5_MCR_ADDR A:0xfe0654d4
y.create.l HWIO_LPASS_LPM_XPU_RG6_MCR_ADDR A:0xfe065554
y.create.l HWIO_LPASS_LPM_XPU_RG7_MCR_ADDR A:0xfe0655d4
y.create.l HWIO_LPASS_LPM_XPU_RG8_MCR_ADDR A:0xfe065654
y.create.l HWIO_LPASS_LPM_XPU_RG9_MCR_ADDR A:0xfe0656d4
y.create.l HWIO_LPASS_LPM_XPU_PRT0_CNTL0_ADDR A:0xfe065258
y.create.l HWIO_LPASS_LPM_XPU_PRT1_CNTL0_ADDR A:0xfe0652d8
y.create.l HWIO_LPASS_LPM_XPU_PRT2_CNTL0_ADDR A:0xfe065358
y.create.l HWIO_LPASS_LPM_XPU_PRT3_CNTL0_ADDR A:0xfe0653d8
y.create.l HWIO_LPASS_LPM_XPU_PRT4_CNTL0_ADDR A:0xfe065458
y.create.l HWIO_LPASS_LPM_XPU_PRT5_CNTL0_ADDR A:0xfe0654d8
y.create.l HWIO_LPASS_LPM_XPU_PRT6_CNTL0_ADDR A:0xfe065558
y.create.l HWIO_LPASS_LPM_XPU_PRT7_CNTL0_ADDR A:0xfe0655d8
y.create.l HWIO_LPASS_LPM_XPU_PRT8_CNTL0_ADDR A:0xfe065658
y.create.l HWIO_LPASS_LPM_XPU_PRT9_CNTL0_ADDR A:0xfe0656d8
y.create.l HWIO_LPASS_LPM_XPU_PRT0_CNTL1_ADDR A:0xfe06525c
y.create.l HWIO_LPASS_LPM_XPU_PRT1_CNTL1_ADDR A:0xfe0652dc
y.create.l HWIO_LPASS_LPM_XPU_PRT2_CNTL1_ADDR A:0xfe06535c
y.create.l HWIO_LPASS_LPM_XPU_PRT3_CNTL1_ADDR A:0xfe0653dc
y.create.l HWIO_LPASS_LPM_XPU_PRT4_CNTL1_ADDR A:0xfe06545c
y.create.l HWIO_LPASS_LPM_XPU_PRT5_CNTL1_ADDR A:0xfe0654dc
y.create.l HWIO_LPASS_LPM_XPU_PRT6_CNTL1_ADDR A:0xfe06555c
y.create.l HWIO_LPASS_LPM_XPU_PRT7_CNTL1_ADDR A:0xfe0655dc
y.create.l HWIO_LPASS_LPM_XPU_PRT8_CNTL1_ADDR A:0xfe06565c
y.create.l HWIO_LPASS_LPM_XPU_PRT9_CNTL1_ADDR A:0xfe0656dc
y.create.l HWIO_LPASS_CSR_XPU_SCR_ADDR A:0xfe066000
y.create.l HWIO_LPASS_CSR_XPU_SWDR_ADDR A:0xfe066004
y.create.l HWIO_LPASS_CSR_XPU_SEAR0_ADDR A:0xfe066040
y.create.l HWIO_LPASS_CSR_XPU_SESR_ADDR A:0xfe066048
y.create.l HWIO_LPASS_CSR_XPU_SESRRESTORE_ADDR A:0xfe06604c
y.create.l HWIO_LPASS_CSR_XPU_SESYNR0_ADDR A:0xfe066050
y.create.l HWIO_LPASS_CSR_XPU_SESYNR1_ADDR A:0xfe066054
y.create.l HWIO_LPASS_CSR_XPU_SESYNR2_ADDR A:0xfe066058
y.create.l HWIO_LPASS_CSR_XPU_MCR_ADDR A:0xfe066100
y.create.l HWIO_LPASS_CSR_XPU_MEAR0_ADDR A:0xfe066140
y.create.l HWIO_LPASS_CSR_XPU_MESR_ADDR A:0xfe066148
y.create.l HWIO_LPASS_CSR_XPU_MESRRESTORE_ADDR A:0xfe06614c
y.create.l HWIO_LPASS_CSR_XPU_MESYNR0_ADDR A:0xfe066150
y.create.l HWIO_LPASS_CSR_XPU_MESYNR1_ADDR A:0xfe066154
y.create.l HWIO_LPASS_CSR_XPU_MESYNR2_ADDR A:0xfe066158
y.create.l HWIO_LPASS_CSR_XPU_CR_ADDR A:0xfe066080
y.create.l HWIO_LPASS_CSR_XPU_RPU_ACR0_ADDR A:0xfe0660a0
y.create.l HWIO_LPASS_CSR_XPU_EAR0_ADDR A:0xfe0660c0
y.create.l HWIO_LPASS_CSR_XPU_ESR_ADDR A:0xfe0660c8
y.create.l HWIO_LPASS_CSR_XPU_ESRRESTORE_ADDR A:0xfe0660cc
y.create.l HWIO_LPASS_CSR_XPU_ESYNR0_ADDR A:0xfe0660d0
y.create.l HWIO_LPASS_CSR_XPU_ESYNR1_ADDR A:0xfe0660d4
y.create.l HWIO_LPASS_CSR_XPU_ESYNR2_ADDR A:0xfe0660d8
y.create.l HWIO_LPASS_CSR_XPU_IDR0_ADDR A:0xfe066074
y.create.l HWIO_LPASS_CSR_XPU_IDR1_ADDR A:0xfe066078
y.create.l HWIO_LPASS_CSR_XPU_REV_ADDR A:0xfe06607c
y.create.l HWIO_LPASS_CSR_XPU_RG0_RACR0_ADDR A:0xfe066200
y.create.l HWIO_LPASS_CSR_XPU_RG1_RACR0_ADDR A:0xfe066280
y.create.l HWIO_LPASS_CSR_XPU_RG2_RACR0_ADDR A:0xfe066300
y.create.l HWIO_LPASS_CSR_XPU_RG3_RACR0_ADDR A:0xfe066380
y.create.l HWIO_LPASS_CSR_XPU_RG4_RACR0_ADDR A:0xfe066400
y.create.l HWIO_LPASS_CSR_XPU_RG5_RACR0_ADDR A:0xfe066480
y.create.l HWIO_LPASS_CSR_XPU_RG6_RACR0_ADDR A:0xfe066500
y.create.l HWIO_LPASS_CSR_XPU_RG0_WACR0_ADDR A:0xfe066220
y.create.l HWIO_LPASS_CSR_XPU_RG1_WACR0_ADDR A:0xfe0662a0
y.create.l HWIO_LPASS_CSR_XPU_RG2_WACR0_ADDR A:0xfe066320
y.create.l HWIO_LPASS_CSR_XPU_RG3_WACR0_ADDR A:0xfe0663a0
y.create.l HWIO_LPASS_CSR_XPU_RG4_WACR0_ADDR A:0xfe066420
y.create.l HWIO_LPASS_CSR_XPU_RG5_WACR0_ADDR A:0xfe0664a0
y.create.l HWIO_LPASS_CSR_XPU_RG6_WACR0_ADDR A:0xfe066520
y.create.l HWIO_LPASS_CSR_XPU_RG0_SCR_ADDR A:0xfe066250
y.create.l HWIO_LPASS_CSR_XPU_RG1_SCR_ADDR A:0xfe0662d0
y.create.l HWIO_LPASS_CSR_XPU_RG2_SCR_ADDR A:0xfe066350
y.create.l HWIO_LPASS_CSR_XPU_RG3_SCR_ADDR A:0xfe0663d0
y.create.l HWIO_LPASS_CSR_XPU_RG4_SCR_ADDR A:0xfe066450
y.create.l HWIO_LPASS_CSR_XPU_RG5_SCR_ADDR A:0xfe0664d0
y.create.l HWIO_LPASS_CSR_XPU_RG6_SCR_ADDR A:0xfe066550
y.create.l HWIO_LPASS_CSR_XPU_RG0_MCR_ADDR A:0xfe066254
y.create.l HWIO_LPASS_CSR_XPU_RG1_MCR_ADDR A:0xfe0662d4
y.create.l HWIO_LPASS_CSR_XPU_RG2_MCR_ADDR A:0xfe066354
y.create.l HWIO_LPASS_CSR_XPU_RG3_MCR_ADDR A:0xfe0663d4
y.create.l HWIO_LPASS_CSR_XPU_RG4_MCR_ADDR A:0xfe066454
y.create.l HWIO_LPASS_CSR_XPU_RG5_MCR_ADDR A:0xfe0664d4
y.create.l HWIO_LPASS_CSR_XPU_RG6_MCR_ADDR A:0xfe066554
y.create.l HWIO_LPASS_CMN_XPU_SCR_ADDR A:0xfe067000
y.create.l HWIO_LPASS_CMN_XPU_SWDR_ADDR A:0xfe067004
y.create.l HWIO_LPASS_CMN_XPU_SEAR0_ADDR A:0xfe067040
y.create.l HWIO_LPASS_CMN_XPU_SESR_ADDR A:0xfe067048
y.create.l HWIO_LPASS_CMN_XPU_SESRRESTORE_ADDR A:0xfe06704c
y.create.l HWIO_LPASS_CMN_XPU_SESYNR0_ADDR A:0xfe067050
y.create.l HWIO_LPASS_CMN_XPU_SESYNR1_ADDR A:0xfe067054
y.create.l HWIO_LPASS_CMN_XPU_SESYNR2_ADDR A:0xfe067058
y.create.l HWIO_LPASS_CMN_XPU_MCR_ADDR A:0xfe067100
y.create.l HWIO_LPASS_CMN_XPU_MEAR0_ADDR A:0xfe067140
y.create.l HWIO_LPASS_CMN_XPU_MESR_ADDR A:0xfe067148
y.create.l HWIO_LPASS_CMN_XPU_MESRRESTORE_ADDR A:0xfe06714c
y.create.l HWIO_LPASS_CMN_XPU_MESYNR0_ADDR A:0xfe067150
y.create.l HWIO_LPASS_CMN_XPU_MESYNR1_ADDR A:0xfe067154
y.create.l HWIO_LPASS_CMN_XPU_MESYNR2_ADDR A:0xfe067158
y.create.l HWIO_LPASS_CMN_XPU_CR_ADDR A:0xfe067080
y.create.l HWIO_LPASS_CMN_XPU_RPU_ACR0_ADDR A:0xfe0670a0
y.create.l HWIO_LPASS_CMN_XPU_EAR0_ADDR A:0xfe0670c0
y.create.l HWIO_LPASS_CMN_XPU_ESR_ADDR A:0xfe0670c8
y.create.l HWIO_LPASS_CMN_XPU_ESRRESTORE_ADDR A:0xfe0670cc
y.create.l HWIO_LPASS_CMN_XPU_ESYNR0_ADDR A:0xfe0670d0
y.create.l HWIO_LPASS_CMN_XPU_ESYNR1_ADDR A:0xfe0670d4
y.create.l HWIO_LPASS_CMN_XPU_ESYNR2_ADDR A:0xfe0670d8
y.create.l HWIO_LPASS_CMN_XPU_IDR0_ADDR A:0xfe067074
y.create.l HWIO_LPASS_CMN_XPU_IDR1_ADDR A:0xfe067078
y.create.l HWIO_LPASS_CMN_XPU_REV_ADDR A:0xfe06707c
y.create.l HWIO_LPASS_CMN_XPU_RG0_RACR0_ADDR A:0xfe067200
y.create.l HWIO_LPASS_CMN_XPU_RG1_RACR0_ADDR A:0xfe067280
y.create.l HWIO_LPASS_CMN_XPU_RG2_RACR0_ADDR A:0xfe067300
y.create.l HWIO_LPASS_CMN_XPU_RG3_RACR0_ADDR A:0xfe067380
y.create.l HWIO_LPASS_CMN_XPU_RG0_SCR_ADDR A:0xfe067250
y.create.l HWIO_LPASS_CMN_XPU_RG1_SCR_ADDR A:0xfe0672d0
y.create.l HWIO_LPASS_CMN_XPU_RG2_SCR_ADDR A:0xfe067350
y.create.l HWIO_LPASS_CMN_XPU_RG3_SCR_ADDR A:0xfe0673d0
y.create.l HWIO_LPASS_CMN_XPU_RG0_MCR_ADDR A:0xfe067254
y.create.l HWIO_LPASS_CMN_XPU_RG1_MCR_ADDR A:0xfe0672d4
y.create.l HWIO_LPASS_CMN_XPU_RG2_MCR_ADDR A:0xfe067354
y.create.l HWIO_LPASS_CMN_XPU_RG3_MCR_ADDR A:0xfe0673d4
y.create.l HWIO_LPASS_LPAIF_XPU_SCR_ADDR A:0xfe06a000
y.create.l HWIO_LPASS_LPAIF_XPU_SWDR_ADDR A:0xfe06a004
y.create.l HWIO_LPASS_LPAIF_XPU_SEAR0_ADDR A:0xfe06a040
y.create.l HWIO_LPASS_LPAIF_XPU_SESR_ADDR A:0xfe06a048
y.create.l HWIO_LPASS_LPAIF_XPU_SESRRESTORE_ADDR A:0xfe06a04c
y.create.l HWIO_LPASS_LPAIF_XPU_SESYNR0_ADDR A:0xfe06a050
y.create.l HWIO_LPASS_LPAIF_XPU_SESYNR1_ADDR A:0xfe06a054
y.create.l HWIO_LPASS_LPAIF_XPU_SESYNR2_ADDR A:0xfe06a058
y.create.l HWIO_LPASS_LPAIF_XPU_MCR_ADDR A:0xfe06a100
y.create.l HWIO_LPASS_LPAIF_XPU_MEAR0_ADDR A:0xfe06a140
y.create.l HWIO_LPASS_LPAIF_XPU_MESR_ADDR A:0xfe06a148
y.create.l HWIO_LPASS_LPAIF_XPU_MESRRESTORE_ADDR A:0xfe06a14c
y.create.l HWIO_LPASS_LPAIF_XPU_MESYNR0_ADDR A:0xfe06a150
y.create.l HWIO_LPASS_LPAIF_XPU_MESYNR1_ADDR A:0xfe06a154
y.create.l HWIO_LPASS_LPAIF_XPU_MESYNR2_ADDR A:0xfe06a158
y.create.l HWIO_LPASS_LPAIF_XPU_CR_ADDR A:0xfe06a080
y.create.l HWIO_LPASS_LPAIF_XPU_RPU_ACR0_ADDR A:0xfe06a0a0
y.create.l HWIO_LPASS_LPAIF_XPU_EAR0_ADDR A:0xfe06a0c0
y.create.l HWIO_LPASS_LPAIF_XPU_ESR_ADDR A:0xfe06a0c8
y.create.l HWIO_LPASS_LPAIF_XPU_ESRRESTORE_ADDR A:0xfe06a0cc
y.create.l HWIO_LPASS_LPAIF_XPU_ESYNR0_ADDR A:0xfe06a0d0
y.create.l HWIO_LPASS_LPAIF_XPU_ESYNR1_ADDR A:0xfe06a0d4
y.create.l HWIO_LPASS_LPAIF_XPU_ESYNR2_ADDR A:0xfe06a0d8
y.create.l HWIO_LPASS_LPAIF_XPU_IDR0_ADDR A:0xfe06a074
y.create.l HWIO_LPASS_LPAIF_XPU_IDR1_ADDR A:0xfe06a078
y.create.l HWIO_LPASS_LPAIF_XPU_REV_ADDR A:0xfe06a07c
y.create.l HWIO_LPASS_LPAIF_XPU_RG0_RACR0_ADDR A:0xfe06a200
y.create.l HWIO_LPASS_LPAIF_XPU_RG1_RACR0_ADDR A:0xfe06a280
y.create.l HWIO_LPASS_LPAIF_XPU_RG2_RACR0_ADDR A:0xfe06a300
y.create.l HWIO_LPASS_LPAIF_XPU_RG3_RACR0_ADDR A:0xfe06a380
y.create.l HWIO_LPASS_LPAIF_XPU_RG4_RACR0_ADDR A:0xfe06a400
y.create.l HWIO_LPASS_LPAIF_XPU_RG5_RACR0_ADDR A:0xfe06a480
y.create.l HWIO_LPASS_LPAIF_XPU_RG6_RACR0_ADDR A:0xfe06a500
y.create.l HWIO_LPASS_LPAIF_XPU_RG7_RACR0_ADDR A:0xfe06a580
y.create.l HWIO_LPASS_LPAIF_XPU_RG8_RACR0_ADDR A:0xfe06a600
y.create.l HWIO_LPASS_LPAIF_XPU_RG9_RACR0_ADDR A:0xfe06a680
y.create.l HWIO_LPASS_LPAIF_XPU_RG0_WACR0_ADDR A:0xfe06a220
y.create.l HWIO_LPASS_LPAIF_XPU_RG1_WACR0_ADDR A:0xfe06a2a0
y.create.l HWIO_LPASS_LPAIF_XPU_RG2_WACR0_ADDR A:0xfe06a320
y.create.l HWIO_LPASS_LPAIF_XPU_RG3_WACR0_ADDR A:0xfe06a3a0
y.create.l HWIO_LPASS_LPAIF_XPU_RG4_WACR0_ADDR A:0xfe06a420
y.create.l HWIO_LPASS_LPAIF_XPU_RG5_WACR0_ADDR A:0xfe06a4a0
y.create.l HWIO_LPASS_LPAIF_XPU_RG6_WACR0_ADDR A:0xfe06a520
y.create.l HWIO_LPASS_LPAIF_XPU_RG7_WACR0_ADDR A:0xfe06a5a0
y.create.l HWIO_LPASS_LPAIF_XPU_RG8_WACR0_ADDR A:0xfe06a620
y.create.l HWIO_LPASS_LPAIF_XPU_RG9_WACR0_ADDR A:0xfe06a6a0
y.create.l HWIO_LPASS_LPAIF_XPU_RG0_SCR_ADDR A:0xfe06a250
y.create.l HWIO_LPASS_LPAIF_XPU_RG1_SCR_ADDR A:0xfe06a2d0
y.create.l HWIO_LPASS_LPAIF_XPU_RG2_SCR_ADDR A:0xfe06a350
y.create.l HWIO_LPASS_LPAIF_XPU_RG3_SCR_ADDR A:0xfe06a3d0
y.create.l HWIO_LPASS_LPAIF_XPU_RG4_SCR_ADDR A:0xfe06a450
y.create.l HWIO_LPASS_LPAIF_XPU_RG5_SCR_ADDR A:0xfe06a4d0
y.create.l HWIO_LPASS_LPAIF_XPU_RG6_SCR_ADDR A:0xfe06a550
y.create.l HWIO_LPASS_LPAIF_XPU_RG7_SCR_ADDR A:0xfe06a5d0
y.create.l HWIO_LPASS_LPAIF_XPU_RG8_SCR_ADDR A:0xfe06a650
y.create.l HWIO_LPASS_LPAIF_XPU_RG9_SCR_ADDR A:0xfe06a6d0
y.create.l HWIO_LPASS_LPAIF_XPU_RG0_MCR_ADDR A:0xfe06a254
y.create.l HWIO_LPASS_LPAIF_XPU_RG1_MCR_ADDR A:0xfe06a2d4
y.create.l HWIO_LPASS_LPAIF_XPU_RG2_MCR_ADDR A:0xfe06a354
y.create.l HWIO_LPASS_LPAIF_XPU_RG3_MCR_ADDR A:0xfe06a3d4
y.create.l HWIO_LPASS_LPAIF_XPU_RG4_MCR_ADDR A:0xfe06a454
y.create.l HWIO_LPASS_LPAIF_XPU_RG5_MCR_ADDR A:0xfe06a4d4
y.create.l HWIO_LPASS_LPAIF_XPU_RG6_MCR_ADDR A:0xfe06a554
y.create.l HWIO_LPASS_LPAIF_XPU_RG7_MCR_ADDR A:0xfe06a5d4
y.create.l HWIO_LPASS_LPAIF_XPU_RG8_MCR_ADDR A:0xfe06a654
y.create.l HWIO_LPASS_LPAIF_XPU_RG9_MCR_ADDR A:0xfe06a6d4
y.create.l HWIO_LPASS_LPAIF_VERSION_ADDR A:0xfe0c0000
y.create.l HWIO_LPASS_LPAIF_PCM_CTL0_ADDR A:0xfe0c0010
y.create.l HWIO_LPASS_LPAIF_PCM_CTL1_ADDR A:0xfe0c1010
y.create.l HWIO_LPASS_LPAIF_PCM_SLOT_CTL0_ADDR A:0xfe0c0014
y.create.l HWIO_LPASS_LPAIF_PCM_SLOT_CTL1_ADDR A:0xfe0c1014
y.create.l HWIO_LPASS_LPAIF_I2S_CTL0_ADDR A:0xfe0c4000
y.create.l HWIO_LPASS_LPAIF_I2S_CTL1_ADDR A:0xfe0c5000
y.create.l HWIO_LPASS_LPAIF_I2S_CTL2_ADDR A:0xfe0c6000
y.create.l HWIO_LPASS_LPAIF_I2S_CTL3_ADDR A:0xfe0c7000
y.create.l HWIO_LPASS_LPAIF_I2S_CTL4_ADDR A:0xfe0c8000
y.create.l HWIO_LPASS_LPAIF_DMIC_CTL_ADDR A:0xfe0cc000
y.create.l HWIO_LPASS_LPAIF_DMIC_VOL_CTL0_ADDR A:0xfe0cc010
y.create.l HWIO_LPASS_LPAIF_DMIC_VOL_CTL1_ADDR A:0xfe0cc014
y.create.l HWIO_LPASS_LPAIF_DMIC_VOL_CTL2_ADDR A:0xfe0cc018
y.create.l HWIO_LPASS_LPAIF_DMIC_VOL_CTL3_ADDR A:0xfe0cc01c
y.create.l HWIO_LPASS_LPAIF_WRDMA_LPBK_MIX_ADDR A:0xfe0cd000
y.create.l HWIO_LPASS_LPAIF_MIXER_CTL_ADDR A:0xfe0ce000
y.create.l HWIO_LPASS_LPAIF_IRQ_EN0_ADDR A:0xfe0cf000
y.create.l HWIO_LPASS_LPAIF_IRQ_EN1_ADDR A:0xfe0d0000
y.create.l HWIO_LPASS_LPAIF_IRQ_EN2_ADDR A:0xfe0d1000
y.create.l HWIO_LPASS_LPAIF_IRQ_STAT0_ADDR A:0xfe0cf004
y.create.l HWIO_LPASS_LPAIF_IRQ_STAT1_ADDR A:0xfe0d0004
y.create.l HWIO_LPASS_LPAIF_IRQ_STAT2_ADDR A:0xfe0d1004
y.create.l HWIO_LPASS_LPAIF_IRQ_RAW_STAT0_ADDR A:0xfe0cf008
y.create.l HWIO_LPASS_LPAIF_IRQ_RAW_STAT1_ADDR A:0xfe0d0008
y.create.l HWIO_LPASS_LPAIF_IRQ_RAW_STAT2_ADDR A:0xfe0d1008
y.create.l HWIO_LPASS_LPAIF_IRQ_CLEAR0_ADDR A:0xfe0cf00c
y.create.l HWIO_LPASS_LPAIF_IRQ_CLEAR1_ADDR A:0xfe0d000c
y.create.l HWIO_LPASS_LPAIF_IRQ_CLEAR2_ADDR A:0xfe0d100c
y.create.l HWIO_LPASS_LPAIF_IRQ_FORCE0_ADDR A:0xfe0cf010
y.create.l HWIO_LPASS_LPAIF_IRQ_FORCE1_ADDR A:0xfe0d0010
y.create.l HWIO_LPASS_LPAIF_IRQ_FORCE2_ADDR A:0xfe0d1010
y.create.l HWIO_LPASS_LPAIF_RDDMA_CTL0_ADDR A:0xfe0d2000
y.create.l HWIO_LPASS_LPAIF_RDDMA_CTL1_ADDR A:0xfe0d3000
y.create.l HWIO_LPASS_LPAIF_RDDMA_CTL2_ADDR A:0xfe0d4000
y.create.l HWIO_LPASS_LPAIF_RDDMA_CTL3_ADDR A:0xfe0d5000
y.create.l HWIO_LPASS_LPAIF_RDDMA_CTL4_ADDR A:0xfe0d6000
y.create.l HWIO_LPASS_LPAIF_RDDMA_BASE0_ADDR A:0xfe0d2004
y.create.l HWIO_LPASS_LPAIF_RDDMA_BASE1_ADDR A:0xfe0d3004
y.create.l HWIO_LPASS_LPAIF_RDDMA_BASE2_ADDR A:0xfe0d4004
y.create.l HWIO_LPASS_LPAIF_RDDMA_BASE3_ADDR A:0xfe0d5004
y.create.l HWIO_LPASS_LPAIF_RDDMA_BASE4_ADDR A:0xfe0d6004
y.create.l HWIO_LPASS_LPAIF_RDDMA_BUFF_LEN0_ADDR A:0xfe0d2008
y.create.l HWIO_LPASS_LPAIF_RDDMA_BUFF_LEN1_ADDR A:0xfe0d3008
y.create.l HWIO_LPASS_LPAIF_RDDMA_BUFF_LEN2_ADDR A:0xfe0d4008
y.create.l HWIO_LPASS_LPAIF_RDDMA_BUFF_LEN3_ADDR A:0xfe0d5008
y.create.l HWIO_LPASS_LPAIF_RDDMA_BUFF_LEN4_ADDR A:0xfe0d6008
y.create.l HWIO_LPASS_LPAIF_RDDMA_CURR_ADDR0_ADDR A:0xfe0d200c
y.create.l HWIO_LPASS_LPAIF_RDDMA_CURR_ADDR1_ADDR A:0xfe0d300c
y.create.l HWIO_LPASS_LPAIF_RDDMA_CURR_ADDR2_ADDR A:0xfe0d400c
y.create.l HWIO_LPASS_LPAIF_RDDMA_CURR_ADDR3_ADDR A:0xfe0d500c
y.create.l HWIO_LPASS_LPAIF_RDDMA_CURR_ADDR4_ADDR A:0xfe0d600c
y.create.l HWIO_LPASS_LPAIF_RDDMA_PER_LEN0_ADDR A:0xfe0d2010
y.create.l HWIO_LPASS_LPAIF_RDDMA_PER_LEN1_ADDR A:0xfe0d3010
y.create.l HWIO_LPASS_LPAIF_RDDMA_PER_LEN2_ADDR A:0xfe0d4010
y.create.l HWIO_LPASS_LPAIF_RDDMA_PER_LEN3_ADDR A:0xfe0d5010
y.create.l HWIO_LPASS_LPAIF_RDDMA_PER_LEN4_ADDR A:0xfe0d6010
y.create.l HWIO_LPASS_LPAIF_RDDMA_PER_CNT0_ADDR A:0xfe0d2014
y.create.l HWIO_LPASS_LPAIF_RDDMA_PER_CNT1_ADDR A:0xfe0d3014
y.create.l HWIO_LPASS_LPAIF_RDDMA_PER_CNT2_ADDR A:0xfe0d4014
y.create.l HWIO_LPASS_LPAIF_RDDMA_PER_CNT3_ADDR A:0xfe0d5014
y.create.l HWIO_LPASS_LPAIF_RDDMA_PER_CNT4_ADDR A:0xfe0d6014
y.create.l HWIO_LPASS_LPAIF_RDDMA_FRM0_ADDR A:0xfe0d2018
y.create.l HWIO_LPASS_LPAIF_RDDMA_FRM1_ADDR A:0xfe0d3018
y.create.l HWIO_LPASS_LPAIF_RDDMA_FRM2_ADDR A:0xfe0d4018
y.create.l HWIO_LPASS_LPAIF_RDDMA_FRM3_ADDR A:0xfe0d5018
y.create.l HWIO_LPASS_LPAIF_RDDMA_FRM4_ADDR A:0xfe0d6018
y.create.l HWIO_LPASS_LPAIF_RDDMA_FRMCLR0_ADDR A:0xfe0d201c
y.create.l HWIO_LPASS_LPAIF_RDDMA_FRMCLR1_ADDR A:0xfe0d301c
y.create.l HWIO_LPASS_LPAIF_RDDMA_FRMCLR2_ADDR A:0xfe0d401c
y.create.l HWIO_LPASS_LPAIF_RDDMA_FRMCLR3_ADDR A:0xfe0d501c
y.create.l HWIO_LPASS_LPAIF_RDDMA_FRMCLR4_ADDR A:0xfe0d601c
y.create.l HWIO_LPASS_LPAIF_RDDMA_SET_BUFF_CNT0_ADDR A:0xfe0d2020
y.create.l HWIO_LPASS_LPAIF_RDDMA_SET_BUFF_CNT1_ADDR A:0xfe0d3020
y.create.l HWIO_LPASS_LPAIF_RDDMA_SET_BUFF_CNT2_ADDR A:0xfe0d4020
y.create.l HWIO_LPASS_LPAIF_RDDMA_SET_BUFF_CNT3_ADDR A:0xfe0d5020
y.create.l HWIO_LPASS_LPAIF_RDDMA_SET_BUFF_CNT4_ADDR A:0xfe0d6020
y.create.l HWIO_LPASS_LPAIF_RDDMA_SET_PER_CNT0_ADDR A:0xfe0d2024
y.create.l HWIO_LPASS_LPAIF_RDDMA_SET_PER_CNT1_ADDR A:0xfe0d3024
y.create.l HWIO_LPASS_LPAIF_RDDMA_SET_PER_CNT2_ADDR A:0xfe0d4024
y.create.l HWIO_LPASS_LPAIF_RDDMA_SET_PER_CNT3_ADDR A:0xfe0d5024
y.create.l HWIO_LPASS_LPAIF_RDDMA_SET_PER_CNT4_ADDR A:0xfe0d6024
y.create.l HWIO_LPASS_LPAIF_WRDMA_CTL0_ADDR A:0xfe0d8000
y.create.l HWIO_LPASS_LPAIF_WRDMA_CTL1_ADDR A:0xfe0d9000
y.create.l HWIO_LPASS_LPAIF_WRDMA_CTL2_ADDR A:0xfe0da000
y.create.l HWIO_LPASS_LPAIF_WRDMA_CTL3_ADDR A:0xfe0db000
y.create.l HWIO_LPASS_LPAIF_WRDMA_BASE0_ADDR A:0xfe0d8004
y.create.l HWIO_LPASS_LPAIF_WRDMA_BASE1_ADDR A:0xfe0d9004
y.create.l HWIO_LPASS_LPAIF_WRDMA_BASE2_ADDR A:0xfe0da004
y.create.l HWIO_LPASS_LPAIF_WRDMA_BASE3_ADDR A:0xfe0db004
y.create.l HWIO_LPASS_LPAIF_WRDMA_BUFF_LEN0_ADDR A:0xfe0d8008
y.create.l HWIO_LPASS_LPAIF_WRDMA_BUFF_LEN1_ADDR A:0xfe0d9008
y.create.l HWIO_LPASS_LPAIF_WRDMA_BUFF_LEN2_ADDR A:0xfe0da008
y.create.l HWIO_LPASS_LPAIF_WRDMA_BUFF_LEN3_ADDR A:0xfe0db008
y.create.l HWIO_LPASS_LPAIF_WRDMA_CURR_ADDR0_ADDR A:0xfe0d800c
y.create.l HWIO_LPASS_LPAIF_WRDMA_CURR_ADDR1_ADDR A:0xfe0d900c
y.create.l HWIO_LPASS_LPAIF_WRDMA_CURR_ADDR2_ADDR A:0xfe0da00c
y.create.l HWIO_LPASS_LPAIF_WRDMA_CURR_ADDR3_ADDR A:0xfe0db00c
y.create.l HWIO_LPASS_LPAIF_WRDMA_PER_LEN0_ADDR A:0xfe0d8010
y.create.l HWIO_LPASS_LPAIF_WRDMA_PER_LEN1_ADDR A:0xfe0d9010
y.create.l HWIO_LPASS_LPAIF_WRDMA_PER_LEN2_ADDR A:0xfe0da010
y.create.l HWIO_LPASS_LPAIF_WRDMA_PER_LEN3_ADDR A:0xfe0db010
y.create.l HWIO_LPASS_LPAIF_WRDMA_PER_CNT0_ADDR A:0xfe0d8014
y.create.l HWIO_LPASS_LPAIF_WRDMA_PER_CNT1_ADDR A:0xfe0d9014
y.create.l HWIO_LPASS_LPAIF_WRDMA_PER_CNT2_ADDR A:0xfe0da014
y.create.l HWIO_LPASS_LPAIF_WRDMA_PER_CNT3_ADDR A:0xfe0db014
y.create.l HWIO_LPASS_LPAIF_WRDMA_FRM0_ADDR A:0xfe0d8018
y.create.l HWIO_LPASS_LPAIF_WRDMA_FRM1_ADDR A:0xfe0d9018
y.create.l HWIO_LPASS_LPAIF_WRDMA_FRM2_ADDR A:0xfe0da018
y.create.l HWIO_LPASS_LPAIF_WRDMA_FRM3_ADDR A:0xfe0db018
y.create.l HWIO_LPASS_LPAIF_WRDMA_FRMCLR0_ADDR A:0xfe0d801c
y.create.l HWIO_LPASS_LPAIF_WRDMA_FRMCLR1_ADDR A:0xfe0d901c
y.create.l HWIO_LPASS_LPAIF_WRDMA_FRMCLR2_ADDR A:0xfe0da01c
y.create.l HWIO_LPASS_LPAIF_WRDMA_FRMCLR3_ADDR A:0xfe0db01c
y.create.l HWIO_LPASS_LPAIF_WRDMA_SET_BUFF_CNT0_ADDR A:0xfe0d8020
y.create.l HWIO_LPASS_LPAIF_WRDMA_SET_BUFF_CNT1_ADDR A:0xfe0d9020
y.create.l HWIO_LPASS_LPAIF_WRDMA_SET_BUFF_CNT2_ADDR A:0xfe0da020
y.create.l HWIO_LPASS_LPAIF_WRDMA_SET_BUFF_CNT3_ADDR A:0xfe0db020
y.create.l HWIO_LPASS_LPAIF_WRDMA_SET_PER_CNT0_ADDR A:0xfe0d8024
y.create.l HWIO_LPASS_LPAIF_WRDMA_SET_PER_CNT1_ADDR A:0xfe0d9024
y.create.l HWIO_LPASS_LPAIF_WRDMA_SET_PER_CNT2_ADDR A:0xfe0da024
y.create.l HWIO_LPASS_LPAIF_WRDMA_SET_PER_CNT3_ADDR A:0xfe0db024
y.create.l HWIO_LPASS_LPAIF_EXT_VFR_ADDR A:0xfe0de000
y.create.l HWIO_LPASS_LPAIF_DEBUG_CTL_ADDR A:0xfe0de004
y.create.l HWIO_LPASS_LPAIF_SPARE_ADDR A:0xfe0de100
y.create.l HWIO_LPASS_QDSP6SS_VERSION_ADDR A:0xfe200000
y.create.l HWIO_LPASS_QDSP6SS_RST_EVB_ADDR A:0xfe200010
y.create.l HWIO_LPASS_QDSP6SS_RESET_ADDR A:0xfe200014
y.create.l HWIO_LPASS_QDSP6SS_DBG_CFG_ADDR A:0xfe200018
y.create.l HWIO_LPASS_QDSP6SS_GFMUX_CTL_ADDR A:0xfe200020
y.create.l HWIO_LPASS_QDSP6SS_GFMUX_STATUS_ADDR A:0xfe200024
y.create.l HWIO_LPASS_QDSP6SS_PWR_CTL_ADDR A:0xfe200030
y.create.l HWIO_LPASS_QDSP6SS_CGC_OVERRIDE_ADDR A:0xfe200034
y.create.l HWIO_LPASS_QDSP6SS_NMI_ADDR A:0xfe200040
y.create.l HWIO_LPASS_QDSP6SS_NMI_STATUS_ADDR A:0xfe200044
y.create.l HWIO_LPASS_QDSP6SS_LDO_CFG0_ADDR A:0xfe200050
y.create.l HWIO_LPASS_QDSP6SS_LDO_CFG1_ADDR A:0xfe200054
y.create.l HWIO_LPASS_QDSP6SS_LDO_CFG2_ADDR A:0xfe200058
y.create.l HWIO_LPASS_QDSP6SS_LDO_VREF_SET_ADDR A:0xfe20005c
y.create.l HWIO_LPASS_QDSP6SS_STRAP_TCM_ADDR A:0xfe200100
y.create.l HWIO_LPASS_QDSP6SS_STRAP_AHBUPPER_ADDR A:0xfe200104
y.create.l HWIO_LPASS_QDSP6SS_STRAP_AHBLOWER_ADDR A:0xfe200108
y.create.l HWIO_LPASS_QDSP6SS_STRAP_ACC_ADDR A:0xfe200110
y.create.l HWIO_LPASS_QDSP6SS_DCC_CTRL_ADDR A:0xfe200114
y.create.l HWIO_LPASS_QDSP6SS_EXT_WAKEUP_ADDR A:0xfe201000
y.create.l HWIO_LPASS_QDSP6SS_EXT_PD_ADDR A:0xfe201004
y.create.l HWIO_LPASS_QDSP6SS_FLL_CTL_ADDR A:0xfe201010
y.create.l HWIO_LPASS_QDSP6SS_FLL_STATUS_ADDR A:0xfe201014
y.create.l HWIO_LPASS_QDSP6SS_TEST_BUS_CTL_ADDR A:0xfe202000
y.create.l HWIO_LPASS_QDSP6SS_TEST_BUS_VALUE_ADDR A:0xfe202004
y.create.l HWIO_LPASS_QDSP6SS_TEST_BUS_WDATA_ADDR A:0xfe202008
y.create.l HWIO_LPASS_QDSP6SS_PWRDBG_CTL_ADDR A:0xfe20200c
y.create.l HWIO_LPASS_QDSP6SS_TEST_CLK_CTL_ADDR A:0xfe202010
y.create.l HWIO_LPASS_QDSP6SS_PWRDBG_STATUS_ADDR A:0xfe202014
y.create.l HWIO_LPASS_QDSP6SS_LDO_ATEST_ADDR A:0xfe202018
y.create.l HWIO_LPASS_QDSP6SS_LDO_DAC_STATUS_ADDR A:0xfe20201c
y.create.l HWIO_LPASS_QDSP6SS_ZMEAS_CONFIG_ADDR A:0xfe202020
y.create.l HWIO_LPASS_QDSP6SS_XPU_SCR_ADDR A:0xfe270000
y.create.l HWIO_LPASS_QDSP6SS_XPU_SWDR_ADDR A:0xfe270004
y.create.l HWIO_LPASS_QDSP6SS_XPU_SEAR0_ADDR A:0xfe270040
y.create.l HWIO_LPASS_QDSP6SS_XPU_SESR_ADDR A:0xfe270048
y.create.l HWIO_LPASS_QDSP6SS_XPU_SESRRESTORE_ADDR A:0xfe27004c
y.create.l HWIO_LPASS_QDSP6SS_XPU_SESYNR0_ADDR A:0xfe270050
y.create.l HWIO_LPASS_QDSP6SS_XPU_SESYNR1_ADDR A:0xfe270054
y.create.l HWIO_LPASS_QDSP6SS_XPU_SESYNR2_ADDR A:0xfe270058
y.create.l HWIO_LPASS_QDSP6SS_XPU_MCR_ADDR A:0xfe270100
y.create.l HWIO_LPASS_QDSP6SS_XPU_MEAR0_ADDR A:0xfe270140
y.create.l HWIO_LPASS_QDSP6SS_XPU_MESR_ADDR A:0xfe270148
y.create.l HWIO_LPASS_QDSP6SS_XPU_MESRRESTORE_ADDR A:0xfe27014c
y.create.l HWIO_LPASS_QDSP6SS_XPU_MESYNR0_ADDR A:0xfe270150
y.create.l HWIO_LPASS_QDSP6SS_XPU_MESYNR1_ADDR A:0xfe270154
y.create.l HWIO_LPASS_QDSP6SS_XPU_MESYNR2_ADDR A:0xfe270158
y.create.l HWIO_LPASS_QDSP6SS_XPU_CR_ADDR A:0xfe270080
y.create.l HWIO_LPASS_QDSP6SS_XPU_RPU_ACR0_ADDR A:0xfe2700a0
y.create.l HWIO_LPASS_QDSP6SS_XPU_EAR0_ADDR A:0xfe2700c0
y.create.l HWIO_LPASS_QDSP6SS_XPU_ESR_ADDR A:0xfe2700c8
y.create.l HWIO_LPASS_QDSP6SS_XPU_ESRRESTORE_ADDR A:0xfe2700cc
y.create.l HWIO_LPASS_QDSP6SS_XPU_ESYNR0_ADDR A:0xfe2700d0
y.create.l HWIO_LPASS_QDSP6SS_XPU_ESYNR1_ADDR A:0xfe2700d4
y.create.l HWIO_LPASS_QDSP6SS_XPU_ESYNR2_ADDR A:0xfe2700d8
y.create.l HWIO_LPASS_QDSP6SS_XPU_IDR0_ADDR A:0xfe270074
y.create.l HWIO_LPASS_QDSP6SS_XPU_IDR1_ADDR A:0xfe270078
y.create.l HWIO_LPASS_QDSP6SS_XPU_REV_ADDR A:0xfe27007c
y.create.l HWIO_LPASS_QDSP6SS_XPU_RG0_RACR0_ADDR A:0xfe270200
y.create.l HWIO_LPASS_QDSP6SS_XPU_RG1_RACR0_ADDR A:0xfe270280
y.create.l HWIO_LPASS_QDSP6SS_XPU_RG0_SCR_ADDR A:0xfe270250
y.create.l HWIO_LPASS_QDSP6SS_XPU_RG1_SCR_ADDR A:0xfe2702d0
y.create.l HWIO_LPASS_QDSP6SS_XPU_RG0_MCR_ADDR A:0xfe270254
y.create.l HWIO_LPASS_QDSP6SS_XPU_RG1_MCR_ADDR A:0xfe2702d4
y.create.l HWIO_LPASS_QDSP6SS_INSTANCE_ID_ADDR A:0xfe280000
y.create.l HWIO_LPASS_QDSP6SS_IDLT_MATCH_VAL_ADDR A:0xfe281000
y.create.l HWIO_LPASS_QDSP6SS_IDLT_COUNT_VAL_ADDR A:0xfe281004
y.create.l HWIO_LPASS_QDSP6SS_IDLT_ENABLE_ADDR A:0xfe281008
y.create.l HWIO_LPASS_QDSP6SS_IDLT_SYNC_STATUS_ADDR A:0xfe28100c
y.create.l HWIO_LPASS_QDSP6SS_WDOG_RESET_ADDR A:0xfe282000
y.create.l HWIO_LPASS_QDSP6SS_WDOG_CTL_ADDR A:0xfe282004
y.create.l HWIO_LPASS_QDSP6SS_WDOG_STATUS_ADDR A:0xfe282008
y.create.l HWIO_LPASS_QDSP6SS_WDOG_BARK_TIME_ADDR A:0xfe28200c
y.create.l HWIO_LPASS_QDSP6SS_WDOG_BITE_TIME_ADDR A:0xfe282010
y.create.l HWIO_LPASS_QDSP6SS_WDOG_NMI_TIME_ADDR A:0xfe282014
y.create.l HWIO_LPASS_QDSP6SS_WDOG_TEST_LOAD_ADDR A:0xfe282018
y.create.l HWIO_LPASS_QDSP6SS_WDOG_TEST_ADDR A:0xfe28201c
y.create.l HWIO_LPASS_QDSP6SS_IPC_ADDR A:0xfe285000
y.create.l HWIO_LPASS_QDSP6SS_L1_IRQ_BACKUP_EN_ADDR A:0xfe285010
y.create.l HWIO_LPASS_QDSP6SS_PD_HS_START_ADDR A:0xfe28700c
y.create.l HWIO_LPASS_QDSP6SS_PD_HS_DONE_ADDR A:0xfe287010
y.create.l HWIO_LPASS_QDSP6SS_PU_HS_START_ADDR A:0xfe287014
y.create.l HWIO_LPASS_QDSP6SS_SLPC_CFG_ADDR A:0xfe28701c
y.create.l HWIO_LPASS_QDSP6SS_SLPC_STATUS_ADDR A:0xfe287020
y.create.l HWIO_LPASS_QDSP6SS_SPMCTL_EN_ARES_ADDR A:0xfe287024
y.create.l HWIO_LPASS_QDSP6SS_SPMCTL_EN_CLAMP_ADDR A:0xfe287028
y.create.l HWIO_LPASS_QDSP6SS_SPMCTL_EN_CLK_ADDR A:0xfe28702c
y.create.l HWIO_LPASS_QDSP6SS_SPMCTL_EN_MEM_ADDR A:0xfe287030
y.create.l HWIO_LPASS_QDSP6SS_SPMCTL_EN_BHS_ADDR A:0xfe287034
y.create.l HWIO_LPASS_QDSP6SS_SPMCTL_EN_LDO_ADDR A:0xfe287038
y.create.l HWIO_LPASS_QDSP6SS_SPMCTL_EN_EXT_ADDR A:0xfe28703c
y.create.l HWIO_LPASS_QDSP6SS_L2VIC_VID_ADDR A:0xfe290000
y.create.l HWIO_LPASS_QDSP6SS_L2VIC_INT_ENABLE0_ADDR A:0xfe290100
y.create.l HWIO_LPASS_QDSP6SS_L2VIC_INT_ENABLE1_ADDR A:0xfe290104
y.create.l HWIO_LPASS_QDSP6SS_L2VIC_INT_ENABLE2_ADDR A:0xfe290108
y.create.l HWIO_LPASS_QDSP6SS_L2VIC_INT_ENABLE3_ADDR A:0xfe29010c
y.create.l HWIO_LPASS_QDSP6SS_L2VIC_INT_ENABLE4_ADDR A:0xfe290110
y.create.l HWIO_LPASS_QDSP6SS_L2VIC_INT_ENABLE5_ADDR A:0xfe290114
y.create.l HWIO_LPASS_QDSP6SS_L2VIC_INT_ENABLE6_ADDR A:0xfe290118
y.create.l HWIO_LPASS_QDSP6SS_L2VIC_INT_ENABLE7_ADDR A:0xfe29011c
y.create.l HWIO_LPASS_QDSP6SS_L2VIC_INT_ENABLE8_ADDR A:0xfe290120
y.create.l HWIO_LPASS_QDSP6SS_L2VIC_INT_ENABLE9_ADDR A:0xfe290124
y.create.l HWIO_LPASS_QDSP6SS_L2VIC_INT_ENABLE_CLEAR0_ADDR A:0xfe290180
y.create.l HWIO_LPASS_QDSP6SS_L2VIC_INT_ENABLE_CLEAR1_ADDR A:0xfe290184
y.create.l HWIO_LPASS_QDSP6SS_L2VIC_INT_ENABLE_CLEAR2_ADDR A:0xfe290188
y.create.l HWIO_LPASS_QDSP6SS_L2VIC_INT_ENABLE_CLEAR3_ADDR A:0xfe29018c
y.create.l HWIO_LPASS_QDSP6SS_L2VIC_INT_ENABLE_CLEAR4_ADDR A:0xfe290190
y.create.l HWIO_LPASS_QDSP6SS_L2VIC_INT_ENABLE_CLEAR5_ADDR A:0xfe290194
y.create.l HWIO_LPASS_QDSP6SS_L2VIC_INT_ENABLE_CLEAR6_ADDR A:0xfe290198
y.create.l HWIO_LPASS_QDSP6SS_L2VIC_INT_ENABLE_CLEAR7_ADDR A:0xfe29019c
y.create.l HWIO_LPASS_QDSP6SS_L2VIC_INT_ENABLE_CLEAR8_ADDR A:0xfe2901a0
y.create.l HWIO_LPASS_QDSP6SS_L2VIC_INT_ENABLE_CLEAR9_ADDR A:0xfe2901a4
y.create.l HWIO_LPASS_QDSP6SS_L2VIC_INT_ENABLE_SET0_ADDR A:0xfe290200
y.create.l HWIO_LPASS_QDSP6SS_L2VIC_INT_ENABLE_SET1_ADDR A:0xfe290204
y.create.l HWIO_LPASS_QDSP6SS_L2VIC_INT_ENABLE_SET2_ADDR A:0xfe290208
y.create.l HWIO_LPASS_QDSP6SS_L2VIC_INT_ENABLE_SET3_ADDR A:0xfe29020c
y.create.l HWIO_LPASS_QDSP6SS_L2VIC_INT_ENABLE_SET4_ADDR A:0xfe290210
y.create.l HWIO_LPASS_QDSP6SS_L2VIC_INT_ENABLE_SET5_ADDR A:0xfe290214
y.create.l HWIO_LPASS_QDSP6SS_L2VIC_INT_ENABLE_SET6_ADDR A:0xfe290218
y.create.l HWIO_LPASS_QDSP6SS_L2VIC_INT_ENABLE_SET7_ADDR A:0xfe29021c
y.create.l HWIO_LPASS_QDSP6SS_L2VIC_INT_ENABLE_SET8_ADDR A:0xfe290220
y.create.l HWIO_LPASS_QDSP6SS_L2VIC_INT_ENABLE_SET9_ADDR A:0xfe290224
y.create.l HWIO_LPASS_QDSP6SS_L2VIC_INT_TYPE0_ADDR A:0xfe290280
y.create.l HWIO_LPASS_QDSP6SS_L2VIC_INT_TYPE1_ADDR A:0xfe290284
y.create.l HWIO_LPASS_QDSP6SS_L2VIC_INT_TYPE2_ADDR A:0xfe290288
y.create.l HWIO_LPASS_QDSP6SS_L2VIC_INT_TYPE3_ADDR A:0xfe29028c
y.create.l HWIO_LPASS_QDSP6SS_L2VIC_INT_TYPE4_ADDR A:0xfe290290
y.create.l HWIO_LPASS_QDSP6SS_L2VIC_INT_TYPE5_ADDR A:0xfe290294
y.create.l HWIO_LPASS_QDSP6SS_L2VIC_INT_TYPE6_ADDR A:0xfe290298
y.create.l HWIO_LPASS_QDSP6SS_L2VIC_INT_TYPE7_ADDR A:0xfe29029c
y.create.l HWIO_LPASS_QDSP6SS_L2VIC_INT_TYPE8_ADDR A:0xfe2902a0
y.create.l HWIO_LPASS_QDSP6SS_L2VIC_INT_TYPE9_ADDR A:0xfe2902a4
y.create.l HWIO_LPASS_QDSP6SS_L2VIC_INT_STATUS0_ADDR A:0xfe290380
y.create.l HWIO_LPASS_QDSP6SS_L2VIC_INT_STATUS1_ADDR A:0xfe290384
y.create.l HWIO_LPASS_QDSP6SS_L2VIC_INT_STATUS2_ADDR A:0xfe290388
y.create.l HWIO_LPASS_QDSP6SS_L2VIC_INT_STATUS3_ADDR A:0xfe29038c
y.create.l HWIO_LPASS_QDSP6SS_L2VIC_INT_STATUS4_ADDR A:0xfe290390
y.create.l HWIO_LPASS_QDSP6SS_L2VIC_INT_STATUS5_ADDR A:0xfe290394
y.create.l HWIO_LPASS_QDSP6SS_L2VIC_INT_STATUS6_ADDR A:0xfe290398
y.create.l HWIO_LPASS_QDSP6SS_L2VIC_INT_STATUS7_ADDR A:0xfe29039c
y.create.l HWIO_LPASS_QDSP6SS_L2VIC_INT_STATUS8_ADDR A:0xfe2903a0
y.create.l HWIO_LPASS_QDSP6SS_L2VIC_INT_STATUS9_ADDR A:0xfe2903a4
y.create.l HWIO_LPASS_QDSP6SS_L2VIC_INT_CLEAR0_ADDR A:0xfe290400
y.create.l HWIO_LPASS_QDSP6SS_L2VIC_INT_CLEAR1_ADDR A:0xfe290404
y.create.l HWIO_LPASS_QDSP6SS_L2VIC_INT_CLEAR2_ADDR A:0xfe290408
y.create.l HWIO_LPASS_QDSP6SS_L2VIC_INT_CLEAR3_ADDR A:0xfe29040c
y.create.l HWIO_LPASS_QDSP6SS_L2VIC_INT_CLEAR4_ADDR A:0xfe290410
y.create.l HWIO_LPASS_QDSP6SS_L2VIC_INT_CLEAR5_ADDR A:0xfe290414
y.create.l HWIO_LPASS_QDSP6SS_L2VIC_INT_CLEAR6_ADDR A:0xfe290418
y.create.l HWIO_LPASS_QDSP6SS_L2VIC_INT_CLEAR7_ADDR A:0xfe29041c
y.create.l HWIO_LPASS_QDSP6SS_L2VIC_INT_CLEAR8_ADDR A:0xfe290420
y.create.l HWIO_LPASS_QDSP6SS_L2VIC_INT_CLEAR9_ADDR A:0xfe290424
y.create.l HWIO_LPASS_QDSP6SS_L2VIC_SOFT_INT0_ADDR A:0xfe290480
y.create.l HWIO_LPASS_QDSP6SS_L2VIC_SOFT_INT1_ADDR A:0xfe290484
y.create.l HWIO_LPASS_QDSP6SS_L2VIC_SOFT_INT2_ADDR A:0xfe290488
y.create.l HWIO_LPASS_QDSP6SS_L2VIC_SOFT_INT3_ADDR A:0xfe29048c
y.create.l HWIO_LPASS_QDSP6SS_L2VIC_SOFT_INT4_ADDR A:0xfe290490
y.create.l HWIO_LPASS_QDSP6SS_L2VIC_SOFT_INT5_ADDR A:0xfe290494
y.create.l HWIO_LPASS_QDSP6SS_L2VIC_SOFT_INT6_ADDR A:0xfe290498
y.create.l HWIO_LPASS_QDSP6SS_L2VIC_SOFT_INT7_ADDR A:0xfe29049c
y.create.l HWIO_LPASS_QDSP6SS_L2VIC_SOFT_INT8_ADDR A:0xfe2904a0
y.create.l HWIO_LPASS_QDSP6SS_L2VIC_SOFT_INT9_ADDR A:0xfe2904a4
y.create.l HWIO_LPASS_QDSP6SS_L2VIC_INT_PENDING0_ADDR A:0xfe290500
y.create.l HWIO_LPASS_QDSP6SS_L2VIC_INT_PENDING1_ADDR A:0xfe290504
y.create.l HWIO_LPASS_QDSP6SS_L2VIC_INT_PENDING2_ADDR A:0xfe290508
y.create.l HWIO_LPASS_QDSP6SS_L2VIC_INT_PENDING3_ADDR A:0xfe29050c
y.create.l HWIO_LPASS_QDSP6SS_L2VIC_INT_PENDING4_ADDR A:0xfe290510
y.create.l HWIO_LPASS_QDSP6SS_L2VIC_INT_PENDING5_ADDR A:0xfe290514
y.create.l HWIO_LPASS_QDSP6SS_L2VIC_INT_PENDING6_ADDR A:0xfe290518
y.create.l HWIO_LPASS_QDSP6SS_L2VIC_INT_PENDING7_ADDR A:0xfe29051c
y.create.l HWIO_LPASS_QDSP6SS_L2VIC_INT_PENDING8_ADDR A:0xfe290520
y.create.l HWIO_LPASS_QDSP6SS_L2VIC_INT_PENDING9_ADDR A:0xfe290524
y.create.l HWIO_LPASS_QDSP6SS_QTMR_AC_CNTFRQ_ADDR A:0xfe2a0000
y.create.l HWIO_LPASS_QDSP6SS_QTMR_AC_CNTSR_ADDR A:0xfe2a0004
y.create.l HWIO_LPASS_QDSP6SS_QTMR_AC_CNTTID_ADDR A:0xfe2a0008
y.create.l HWIO_LPASS_QDSP6SS_QTMR_AC_CNTACR_0_ADDR A:0xfe2a0040
y.create.l HWIO_LPASS_QDSP6SS_QTMR_AC_CNTACR_1_ADDR A:0xfe2a0044
y.create.l HWIO_LPASS_QDSP6SS_QTMR_AC_CNTACR_2_ADDR A:0xfe2a0048
y.create.l HWIO_LPASS_QDSP6SS_QTMR_AC_CNTVOFF_LO_0_ADDR A:0xfe2a0080
y.create.l HWIO_LPASS_QDSP6SS_QTMR_AC_CNTVOFF_LO_1_ADDR A:0xfe2a0088
y.create.l HWIO_LPASS_QDSP6SS_QTMR_AC_CNTVOFF_LO_2_ADDR A:0xfe2a0090
y.create.l HWIO_LPASS_QDSP6SS_QTMR_AC_CNTVOFF_HI_0_ADDR A:0xfe2a0084
y.create.l HWIO_LPASS_QDSP6SS_QTMR_AC_CNTVOFF_HI_1_ADDR A:0xfe2a008c
y.create.l HWIO_LPASS_QDSP6SS_QTMR_AC_CNTVOFF_HI_2_ADDR A:0xfe2a0094
y.create.l HWIO_LPASS_QDSP6SS_QTMR_AC_CFG_ADDR A:0xfe2a0fc0
y.create.l HWIO_LPASS_QDSP6SS_QTMR_AC_VERSION_ADDR A:0xfe2a0fd0
y.create.l HWIO_LPASS_QDSP6SS_QTMR_V1_CNTPCT_LO_0_ADDR A:0xfe2a1000
y.create.l HWIO_LPASS_QDSP6SS_QTMR_V1_CNTPCT_HI_0_ADDR A:0xfe2a1004
y.create.l HWIO_LPASS_QDSP6SS_QTMR_V1_CNTVCT_LO_0_ADDR A:0xfe2a1008
y.create.l HWIO_LPASS_QDSP6SS_QTMR_V1_CNTVCT_HI_0_ADDR A:0xfe2a100c
y.create.l HWIO_LPASS_QDSP6SS_QTMR_V1_CNTFRQ_0_ADDR A:0xfe2a1010
y.create.l HWIO_LPASS_QDSP6SS_QTMR_V1_CNTPL0ACR_0_ADDR A:0xfe2a1014
y.create.l HWIO_LPASS_QDSP6SS_QTMR_V1_CNTVOFF_LO_0_ADDR A:0xfe2a1018
y.create.l HWIO_LPASS_QDSP6SS_QTMR_V1_CNTVOFF_HI_0_ADDR A:0xfe2a101c
y.create.l HWIO_LPASS_QDSP6SS_QTMR_V1_CNTP_CVAL_LO_0_ADDR A:0xfe2a1020
y.create.l HWIO_LPASS_QDSP6SS_QTMR_V1_CNTP_CVAL_HI_0_ADDR A:0xfe2a1024
y.create.l HWIO_LPASS_QDSP6SS_QTMR_V1_CNTP_TVAL_0_ADDR A:0xfe2a1028
y.create.l HWIO_LPASS_QDSP6SS_QTMR_V1_CNTP_CTL_0_ADDR A:0xfe2a102c
y.create.l HWIO_LPASS_QDSP6SS_QTMR_V1_CNTV_CVAL_LO_0_ADDR A:0xfe2a1030
y.create.l HWIO_LPASS_QDSP6SS_QTMR_V1_CNTV_CVAL_HI_0_ADDR A:0xfe2a1034
y.create.l HWIO_LPASS_QDSP6SS_QTMR_V1_CNTV_TVAL_0_ADDR A:0xfe2a1038
y.create.l HWIO_LPASS_QDSP6SS_QTMR_V1_CNTV_CTL_0_ADDR A:0xfe2a103c
y.create.l HWIO_LPASS_QDSP6SS_QTMR_V1_VERSION_0_ADDR A:0xfe2a1fd0
y.create.l HWIO_LPASS_QDSP6SS_QTMR_V1_CNTPCT_LO_1_ADDR A:0xfe2a2000
y.create.l HWIO_LPASS_QDSP6SS_QTMR_V1_CNTPCT_HI_1_ADDR A:0xfe2a2004
y.create.l HWIO_LPASS_QDSP6SS_QTMR_V1_CNTVCT_LO_1_ADDR A:0xfe2a2008
y.create.l HWIO_LPASS_QDSP6SS_QTMR_V1_CNTVCT_HI_1_ADDR A:0xfe2a200c
y.create.l HWIO_LPASS_QDSP6SS_QTMR_V1_CNTFRQ_1_ADDR A:0xfe2a2010
y.create.l HWIO_LPASS_QDSP6SS_QTMR_V1_CNTPL0ACR_1_ADDR A:0xfe2a2014
y.create.l HWIO_LPASS_QDSP6SS_QTMR_V1_CNTVOFF_LO_1_ADDR A:0xfe2a2018
y.create.l HWIO_LPASS_QDSP6SS_QTMR_V1_CNTVOFF_HI_1_ADDR A:0xfe2a201c
y.create.l HWIO_LPASS_QDSP6SS_QTMR_V1_CNTP_CVAL_LO_1_ADDR A:0xfe2a2020
y.create.l HWIO_LPASS_QDSP6SS_QTMR_V1_CNTP_CVAL_HI_1_ADDR A:0xfe2a2024
y.create.l HWIO_LPASS_QDSP6SS_QTMR_V1_CNTP_TVAL_1_ADDR A:0xfe2a2028
y.create.l HWIO_LPASS_QDSP6SS_QTMR_V1_CNTP_CTL_1_ADDR A:0xfe2a202c
y.create.l HWIO_LPASS_QDSP6SS_QTMR_V1_CNTV_CVAL_LO_1_ADDR A:0xfe2a2030
y.create.l HWIO_LPASS_QDSP6SS_QTMR_V1_CNTV_CVAL_HI_1_ADDR A:0xfe2a2034
y.create.l HWIO_LPASS_QDSP6SS_QTMR_V1_CNTV_TVAL_1_ADDR A:0xfe2a2038
y.create.l HWIO_LPASS_QDSP6SS_QTMR_V1_CNTV_CTL_1_ADDR A:0xfe2a203c
y.create.l HWIO_LPASS_QDSP6SS_QTMR_V1_VERSION_1_ADDR A:0xfe2a2fd0
y.create.l HWIO_LPASS_QDSP6SS_QTMR_V1_CNTPCT_LO_2_ADDR A:0xfe2a3000
y.create.l HWIO_LPASS_QDSP6SS_QTMR_V1_CNTPCT_HI_2_ADDR A:0xfe2a3004
y.create.l HWIO_LPASS_QDSP6SS_QTMR_V1_CNTVCT_LO_2_ADDR A:0xfe2a3008
y.create.l HWIO_LPASS_QDSP6SS_QTMR_V1_CNTVCT_HI_2_ADDR A:0xfe2a300c
y.create.l HWIO_LPASS_QDSP6SS_QTMR_V1_CNTFRQ_2_ADDR A:0xfe2a3010
y.create.l HWIO_LPASS_QDSP6SS_QTMR_V1_CNTPL0ACR_2_ADDR A:0xfe2a3014
y.create.l HWIO_LPASS_QDSP6SS_QTMR_V1_CNTVOFF_LO_2_ADDR A:0xfe2a3018
y.create.l HWIO_LPASS_QDSP6SS_QTMR_V1_CNTVOFF_HI_2_ADDR A:0xfe2a301c
y.create.l HWIO_LPASS_QDSP6SS_QTMR_V1_CNTP_CVAL_LO_2_ADDR A:0xfe2a3020
y.create.l HWIO_LPASS_QDSP6SS_QTMR_V1_CNTP_CVAL_HI_2_ADDR A:0xfe2a3024
y.create.l HWIO_LPASS_QDSP6SS_QTMR_V1_CNTP_TVAL_2_ADDR A:0xfe2a3028
y.create.l HWIO_LPASS_QDSP6SS_QTMR_V1_CNTP_CTL_2_ADDR A:0xfe2a302c
y.create.l HWIO_LPASS_QDSP6SS_QTMR_V1_CNTV_CVAL_LO_2_ADDR A:0xfe2a3030
y.create.l HWIO_LPASS_QDSP6SS_QTMR_V1_CNTV_CVAL_HI_2_ADDR A:0xfe2a3034
y.create.l HWIO_LPASS_QDSP6SS_QTMR_V1_CNTV_TVAL_2_ADDR A:0xfe2a3038
y.create.l HWIO_LPASS_QDSP6SS_QTMR_V1_CNTV_CTL_2_ADDR A:0xfe2a303c
y.create.l HWIO_LPASS_QDSP6SS_QTMR_V1_VERSION_2_ADDR A:0xfe2a3fd0
y.create.l HWIO_LPASS_QDSP6SS_SAW2_SECURE_ADDR A:0xfe2b0000
y.create.l HWIO_LPASS_QDSP6SS_SAW2_ID_ADDR A:0xfe2b0004
y.create.l HWIO_LPASS_QDSP6SS_SAW2_CFG_ADDR A:0xfe2b0008
y.create.l HWIO_LPASS_QDSP6SS_SAW2_SPM_STS_ADDR A:0xfe2b000c
y.create.l HWIO_LPASS_QDSP6SS_SAW2_AVS_STS_ADDR A:0xfe2b0010
y.create.l HWIO_LPASS_QDSP6SS_SAW2_PMIC_STS_ADDR A:0xfe2b0014
y.create.l HWIO_LPASS_QDSP6SS_SAW2_RST_ADDR A:0xfe2b0018
y.create.l HWIO_LPASS_QDSP6SS_SAW2_VCTL_ADDR A:0xfe2b001c
y.create.l HWIO_LPASS_QDSP6SS_SAW2_AVS_CTL_ADDR A:0xfe2b0020
y.create.l HWIO_LPASS_QDSP6SS_SAW2_AVS_LIMIT_ADDR A:0xfe2b0024
y.create.l HWIO_LPASS_QDSP6SS_SAW2_AVS_DLY_ADDR A:0xfe2b0028
y.create.l HWIO_LPASS_QDSP6SS_SAW2_AVS_HYSTERESIS_ADDR A:0xfe2b002c
y.create.l HWIO_LPASS_QDSP6SS_SAW2_SPM_CTL_ADDR A:0xfe2b0030
y.create.l HWIO_LPASS_QDSP6SS_SAW2_SPM_DLY_ADDR A:0xfe2b0034
y.create.l HWIO_LPASS_QDSP6SS_SAW2_SPM_SLP_SEQ_ENTRY_0_ADDR A:0xfe2b0080
y.create.l HWIO_LPASS_QDSP6SS_SAW2_SPM_SLP_SEQ_ENTRY_1_ADDR A:0xfe2b0084
y.create.l HWIO_LPASS_QDSP6SS_SAW2_SPM_SLP_SEQ_ENTRY_2_ADDR A:0xfe2b0088
y.create.l HWIO_LPASS_QDSP6SS_SAW2_SPM_SLP_SEQ_ENTRY_3_ADDR A:0xfe2b008c
y.create.l HWIO_LPASS_QDSP6SS_SAW2_SPM_SLP_SEQ_ENTRY_4_ADDR A:0xfe2b0090
y.create.l HWIO_LPASS_QDSP6SS_SAW2_SPM_SLP_SEQ_ENTRY_5_ADDR A:0xfe2b0094
y.create.l HWIO_LPASS_QDSP6SS_SAW2_SPM_SLP_SEQ_ENTRY_6_ADDR A:0xfe2b0098
y.create.l HWIO_LPASS_QDSP6SS_SAW2_SPM_SLP_SEQ_ENTRY_7_ADDR A:0xfe2b009c
y.create.l HWIO_LPASS_QDSP6SS_SAW2_SPM_SLP_SEQ_ENTRY_8_ADDR A:0xfe2b00a0
y.create.l HWIO_LPASS_QDSP6SS_SAW2_SPM_SLP_SEQ_ENTRY_9_ADDR A:0xfe2b00a4
y.create.l HWIO_LPASS_QDSP6SS_SAW2_SPM_PMIC_DATA_0_ADDR A:0xfe2b0040
y.create.l HWIO_LPASS_QDSP6SS_SAW2_SPM_PMIC_DATA_1_ADDR A:0xfe2b0044
y.create.l HWIO_LPASS_QDSP6SS_SAW2_SPM_PMIC_DATA_2_ADDR A:0xfe2b0048
y.create.l HWIO_LPASS_QDSP6SS_SAW2_VERSION_ADDR A:0xfe2b0fd0
y.create.l HWIO_MIPI_DSI_1_DSI1_CTRL_ADDR A:0xfdd00000
y.create.l HWIO_MIPI_DSI_1_DSI1_STATUS_ADDR A:0xfdd00004
y.create.l HWIO_MIPI_DSI_1_DSI1_FIFO_STATUS_ADDR A:0xfdd00008
y.create.l HWIO_MIPI_DSI_1_DSI1_VIDEO_MODE_CTRL_ADDR A:0xfdd0000c
y.create.l HWIO_MIPI_DSI_1_DSI1_VIDEO_MODE_SYNC_DATATYPE_ADDR A:0xfdd00010
y.create.l HWIO_MIPI_DSI_1_DSI1_VIDEO_MODE_PIXEL_DATATYPE_ADDR A:0xfdd00014
y.create.l HWIO_MIPI_DSI_1_DSI1_VIDEO_MODE_BLANKING_DATATYPE_ADDR A:0xfdd00018
y.create.l HWIO_MIPI_DSI_1_DSI1_VIDEO_MODE_DATA_CTRL_ADDR A:0xfdd0001c
y.create.l HWIO_MIPI_DSI_1_DSI1_VIDEO_MODE_ACTIVE_H_ADDR A:0xfdd00020
y.create.l HWIO_MIPI_DSI_1_DSI1_VIDEO_MODE_ACTIVE_V_ADDR A:0xfdd00024
y.create.l HWIO_MIPI_DSI_1_DSI1_VIDEO_MODE_TOTAL_ADDR A:0xfdd00028
y.create.l HWIO_MIPI_DSI_1_DSI1_VIDEO_MODE_HSYNC_ADDR A:0xfdd0002c
y.create.l HWIO_MIPI_DSI_1_DSI1_VIDEO_MODE_VSYNC_ADDR A:0xfdd00030
y.create.l HWIO_MIPI_DSI_1_DSI1_VIDEO_MODE_VSYNC_VPOS_ADDR A:0xfdd00034
y.create.l HWIO_MIPI_DSI_1_DSI1_COMMAND_MODE_DMA_CTRL_ADDR A:0xfdd00038
y.create.l HWIO_MIPI_DSI_1_DSI1_COMMAND_MODE_MDP_CTRL_ADDR A:0xfdd0003c
y.create.l HWIO_MIPI_DSI_1_DSI1_COMMAND_MODE_MDP_DCS_CMD_CTRL_ADDR A:0xfdd00040
y.create.l HWIO_MIPI_DSI_1_DSI1_DMA_CMD_OFFSET_ADDR A:0xfdd00044
y.create.l HWIO_MIPI_DSI_1_DSI1_DMA_CMD_LENGTH_ADDR A:0xfdd00048
y.create.l HWIO_MIPI_DSI_1_DSI1_DMA_FIFO_CTRL_ADDR A:0xfdd0004c
y.create.l HWIO_MIPI_DSI_1_DSI1_DMA_NULL_PACKET_DATA_ADDR A:0xfdd00050
y.create.l HWIO_MIPI_DSI_1_DSI1_COMMAND_MODE_MDP_STREAM0_CTRL_ADDR A:0xfdd00054
y.create.l HWIO_MIPI_DSI_1_DSI1_COMMAND_MODE_MDP_STREAM0_TOTAL_ADDR A:0xfdd00058
y.create.l HWIO_MIPI_DSI_1_DSI1_COMMAND_MODE_MDP_STREAM1_CTRL_ADDR A:0xfdd0005c
y.create.l HWIO_MIPI_DSI_1_DSI1_COMMAND_MODE_MDP_STREAM1_TOTAL_ADDR A:0xfdd00060
y.create.l HWIO_MIPI_DSI_1_DSI1_ACK_ERR_STATUS_ADDR A:0xfdd00064
y.create.l HWIO_MIPI_DSI_1_DSI1_RDBK_DATA0_ADDR A:0xfdd00068
y.create.l HWIO_MIPI_DSI_1_DSI1_RDBK_DATA1_ADDR A:0xfdd0006c
y.create.l HWIO_MIPI_DSI_1_DSI1_RDBK_DATA2_ADDR A:0xfdd00070
y.create.l HWIO_MIPI_DSI_1_DSI1_RDBK_DATA3_ADDR A:0xfdd00074
y.create.l HWIO_MIPI_DSI_1_DSI1_RDBK_DATATYPE0_ADDR A:0xfdd00078
y.create.l HWIO_MIPI_DSI_1_DSI1_RDBK_DATATYPE1_ADDR A:0xfdd0007c
y.create.l HWIO_MIPI_DSI_1_DSI1_TRIG_CTRL_ADDR A:0xfdd00080
y.create.l HWIO_MIPI_DSI_1_DSI1_EXT_MUX_ADDR A:0xfdd00084
y.create.l HWIO_MIPI_DSI_1_DSI1_EXT_TE_PULSE_DETECT_CTRL_ADDR A:0xfdd00088
y.create.l HWIO_MIPI_DSI_1_DSI1_CMD_MODE_DMA_SW_TRIGGER_ADDR A:0xfdd0008c
y.create.l HWIO_MIPI_DSI_1_DSI1_CMD_MODE_MDP_SW_TRIGGER_ADDR A:0xfdd00090
y.create.l HWIO_MIPI_DSI_1_DSI1_CMD_MODE_BTA_SW_TRIGGER_ADDR A:0xfdd00094
y.create.l HWIO_MIPI_DSI_1_DSI1_RESET_SW_TRIGGER_ADDR A:0xfdd00098
y.create.l HWIO_MIPI_DSI_1_DSI1_MISR_CMD_CTRL_ADDR A:0xfdd0009c
y.create.l HWIO_MIPI_DSI_1_DSI1_MISR_VIDEO_CTRL_ADDR A:0xfdd000a0
y.create.l HWIO_MIPI_DSI_1_DSI1_LANE_STATUS_ADDR A:0xfdd000a4
y.create.l HWIO_MIPI_DSI_1_DSI1_LANE_CTRL_ADDR A:0xfdd000a8
y.create.l HWIO_MIPI_DSI_1_DSI1_LANE_SWAP_CTRL_ADDR A:0xfdd000ac
y.create.l HWIO_MIPI_DSI_1_DSI1_DLN0_PHY_ERR_ADDR A:0xfdd000b0
y.create.l HWIO_MIPI_DSI_1_DSI1_LP_TIMER_CTRL_ADDR A:0xfdd000b4
y.create.l HWIO_MIPI_DSI_1_DSI1_HS_TIMER_CTRL_ADDR A:0xfdd000b8
y.create.l HWIO_MIPI_DSI_1_DSI1_TIMEOUT_STATUS_ADDR A:0xfdd000bc
y.create.l HWIO_MIPI_DSI_1_DSI1_CLKOUT_TIMING_CTRL_ADDR A:0xfdd000c0
y.create.l HWIO_MIPI_DSI_1_DSI1_EOT_PACKET_ADDR A:0xfdd000c4
y.create.l HWIO_MIPI_DSI_1_DSI1_EOT_PACKET_CTRL_ADDR A:0xfdd000c8
y.create.l HWIO_MIPI_DSI_1_DSI1_GENERIC_ESC_TX_TRIGGER_ADDR A:0xfdd000cc
y.create.l HWIO_MIPI_DSI_1_DSI1_CAM_BIST_CTRL_ADDR A:0xfdd000d0
y.create.l HWIO_MIPI_DSI_1_DSI1_CAM_BIST_FRAME_SIZE_ADDR A:0xfdd000d4
y.create.l HWIO_MIPI_DSI_1_DSI1_CAM_BIST_BLOCK_SIZE_ADDR A:0xfdd000d8
y.create.l HWIO_MIPI_DSI_1_DSI1_CAM_BIST_FRAME_CONFIG_ADDR A:0xfdd000dc
y.create.l HWIO_MIPI_DSI_1_DSI1_CAM_BIST_LSFR_CTRL_ADDR A:0xfdd000e0
y.create.l HWIO_MIPI_DSI_1_DSI1_CAM_BIST_LSFR_INIT_ADDR A:0xfdd000e4
y.create.l HWIO_MIPI_DSI_1_DSI1_CAM_BIST_START_ADDR A:0xfdd000e8
y.create.l HWIO_MIPI_DSI_1_DSI1_CAM_BIST_STATUS_ADDR A:0xfdd000ec
y.create.l HWIO_MIPI_DSI_1_DSI1_ERR_INT_MASK0_ADDR A:0xfdd00108
y.create.l HWIO_MIPI_DSI_1_DSI1_INT_CTRL_ADDR A:0xfdd0010c
y.create.l HWIO_MIPI_DSI_1_DSI1_IOBIST_CTRL_ADDR A:0xfdd00110
y.create.l HWIO_MIPI_DSI_1_DSI1_SOFT_RESET_ADDR A:0xfdd00114
y.create.l HWIO_MIPI_DSI_1_DSI1_CLK_CTRL_ADDR A:0xfdd00118
y.create.l HWIO_MIPI_DSI_1_DSI1_CLK_STATUS_ADDR A:0xfdd0011c
y.create.l HWIO_MIPI_DSI_1_DSI1_DEBUG_BUS_CTRL_ADDR A:0xfdd00120
y.create.l HWIO_MIPI_DSI_1_DSI1_DEBUG_BUS_ADDR A:0xfdd00124
y.create.l HWIO_MIPI_DSI_1_DSI1_PHY_SW_RESET_ADDR A:0xfdd00128
y.create.l HWIO_MIPI_DSI_1_DSI1_AXI2AHB_CTRL_ADDR A:0xfdd0012c
y.create.l HWIO_MIPI_DSI_1_DSI1_MISR_CMD_MDP0_32BIT_ADDR A:0xfdd00130
y.create.l HWIO_MIPI_DSI_1_DSI1_MISR_CMD_MDP1_32BIT_ADDR A:0xfdd00134
y.create.l HWIO_MIPI_DSI_1_DSI1_MISR_CMD_DMA_32BIT_ADDR A:0xfdd00138
y.create.l HWIO_MIPI_DSI_1_DSI1_MISR_VIDEO_32BIT_ADDR A:0xfdd0013c
y.create.l HWIO_MIPI_DSI_1_DSI1_LANE_MISR_CTRL_ADDR A:0xfdd00140
y.create.l HWIO_MIPI_DSI_1_DSI1_LANE0_MISR_ADDR A:0xfdd00144
y.create.l HWIO_MIPI_DSI_1_DSI1_LANE1_MISR_ADDR A:0xfdd00148
y.create.l HWIO_MIPI_DSI_1_DSI1_LANE2_MISR_ADDR A:0xfdd0014c
y.create.l HWIO_MIPI_DSI_1_DSI1_LANE3_MISR_ADDR A:0xfdd00150
y.create.l HWIO_MIPI_DSI_1_DSI1_TEST_PATTERN_GEN_CTRL_ADDR A:0xfdd00158
y.create.l HWIO_MIPI_DSI_1_DSI1_TEST_PATTERN_GEN_VIDEO_POLY_ADDR A:0xfdd0015c
y.create.l HWIO_MIPI_DSI_1_DSI1_TEST_PATTERN_GEN_VIDEO_INIT_VAL_ADDR A:0xfdd00160
y.create.l HWIO_MIPI_DSI_1_DSI1_TEST_PATTERN_GEN_CMD_MDP_STREAM0_POLY_ADDR A:0xfdd00164
y.create.l HWIO_MIPI_DSI_1_DSI1_TEST_PATTERN_GEN_CMD_MDP_INIT_VAL0_ADDR A:0xfdd00168
y.create.l HWIO_MIPI_DSI_1_DSI1_TEST_PATTERN_GEN_CMD_MDP_STREAM1_POLY_ADDR A:0xfdd0016c
y.create.l HWIO_MIPI_DSI_1_DSI1_TEST_PATTERN_GEN_CMD_MDP_INIT_VAL1_ADDR A:0xfdd00170
y.create.l HWIO_MIPI_DSI_1_DSI1_TEST_PATTERN_GEN_CMD_DMA_POLY_ADDR A:0xfdd00174
y.create.l HWIO_MIPI_DSI_1_DSI1_TEST_PATTERN_GEN_CMD_DMA_INIT_VAL_ADDR A:0xfdd00178
y.create.l HWIO_MIPI_DSI_1_DSI1_TEST_PATTERN_GEN_VIDEO_ENABLE_ADDR A:0xfdd0017c
y.create.l HWIO_MIPI_DSI_1_DSI1_TEST_PATTERN_GEN_CMD_STREAM0_TRIGGER_ADDR A:0xfdd00180
y.create.l HWIO_MIPI_DSI_1_DSI1_TEST_PATTERN_GEN_CMD_STREAM1_TRIGGER_ADDR A:0xfdd00184
y.create.l HWIO_MIPI_DSI_1_DSI1_COMMAND_MODE_MDP_IDLE_CTRL_ADDR A:0xfdd00190
y.create.l HWIO_MIPI_DSI_1_DSI1_VERSION_ADDR A:0xfdd001f0
y.create.l HWIO_MIPI_DSI_1_DSI1_DSIPHY_PLL_CTRL_0_ADDR A:0xfdd00200
y.create.l HWIO_MIPI_DSI_1_DSI1_DSIPHY_PLL_CTRL_1_ADDR A:0xfdd00204
y.create.l HWIO_MIPI_DSI_1_DSI1_DSIPHY_PLL_CTRL_2_ADDR A:0xfdd00208
y.create.l HWIO_MIPI_DSI_1_DSI1_DSIPHY_PLL_CTRL_3_ADDR A:0xfdd0020c
y.create.l HWIO_MIPI_DSI_1_DSI1_DSIPHY_PLL_CTRL_4_ADDR A:0xfdd00210
y.create.l HWIO_MIPI_DSI_1_DSI1_DSIPHY_PLL_CTRL_5_ADDR A:0xfdd00214
y.create.l HWIO_MIPI_DSI_1_DSI1_DSIPHY_PLL_CTRL_6_ADDR A:0xfdd00218
y.create.l HWIO_MIPI_DSI_1_DSI1_DSIPHY_PLL_CTRL_7_ADDR A:0xfdd0021c
y.create.l HWIO_MIPI_DSI_1_DSI1_DSIPHY_PLL_CTRL_8_ADDR A:0xfdd00220
y.create.l HWIO_MIPI_DSI_1_DSI1_DSIPHY_PLL_CTRL_9_ADDR A:0xfdd00224
y.create.l HWIO_MIPI_DSI_1_DSI1_DSIPHY_PLL_CTRL_10_ADDR A:0xfdd00228
y.create.l HWIO_MIPI_DSI_1_DSI1_DSIPHY_PLL_CTRL_11_ADDR A:0xfdd0022c
y.create.l HWIO_MIPI_DSI_1_DSI1_DSIPHY_PLL_CTRL_12_ADDR A:0xfdd00230
y.create.l HWIO_MIPI_DSI_1_DSI1_DSIPHY_PLL_CTRL_13_ADDR A:0xfdd00234
y.create.l HWIO_MIPI_DSI_1_DSI1_DSIPHY_PLL_CTRL_14_ADDR A:0xfdd00238
y.create.l HWIO_MIPI_DSI_1_DSI1_DSIPHY_PLL_CTRL_15_ADDR A:0xfdd0023c
y.create.l HWIO_MIPI_DSI_1_DSI1_DSIPHY_PLL_CTRL_16_ADDR A:0xfdd00240
y.create.l HWIO_MIPI_DSI_1_DSI1_DSIPHY_PLL_CTRL_17_ADDR A:0xfdd00244
y.create.l HWIO_MIPI_DSI_1_DSI1_DSIPHY_PLL_CTRL_18_ADDR A:0xfdd00248
y.create.l HWIO_MIPI_DSI_1_DSI1_DSIPHY_PLL_CTRL_19_ADDR A:0xfdd0024c
y.create.l HWIO_MIPI_DSI_1_DSI1_DSIPHY_PLL_TEST_EFUSE_ADDR A:0xfdd00250
y.create.l HWIO_MIPI_DSI_1_DSI1_DSIPHY_PLL_TEST_SANITY_CHECK_ADDR A:0xfdd00254
y.create.l HWIO_MIPI_DSI_1_DSI1_DSIPHY_PLL_DEBUG_SEL_ADDR A:0xfdd00258
y.create.l HWIO_MIPI_DSI_1_DSI1_DSIPHY_PLL_ANA_CTRL0_ADDR A:0xfdd00260
y.create.l HWIO_MIPI_DSI_1_DSI1_DSIPHY_PLL_ANA_CTRL1_ADDR A:0xfdd00264
y.create.l HWIO_MIPI_DSI_1_DSI1_DSIPHY_PLL_ANA_CTRL2_ADDR A:0xfdd00268
y.create.l HWIO_MIPI_DSI_1_DSI1_DSIPHY_PLL_ANA_CTRL3_ADDR A:0xfdd0026c
y.create.l HWIO_MIPI_DSI_1_DSI1_DSIPHY_PLL_ANA_CTRL4_ADDR A:0xfdd00270
y.create.l HWIO_MIPI_DSI_1_DSI1_DSIPHY_PLL_ANA_CTRL5_ADDR A:0xfdd00274
y.create.l HWIO_MIPI_DSI_1_DSI1_DSIPHY_PLL_ANA_CTRL6_ADDR A:0xfdd00278
y.create.l HWIO_MIPI_DSI_1_DSI1_DSIPHY_PLL_ANA_CTRL7_ADDR A:0xfdd0027c
y.create.l HWIO_MIPI_DSI_1_DSI1_DSIPHY_PLL_RDY_ADDR A:0xfdd00280
y.create.l HWIO_MIPI_DSI_1_DSI1_DSIPHY_PLL_DBGBUS_STATUS0_ADDR A:0xfdd00284
y.create.l HWIO_MIPI_DSI_1_DSI1_DSIPHY_PLL_DBGBUS_STATUS1_ADDR A:0xfdd00288
y.create.l HWIO_MIPI_DSI_1_DSI1_DSIPHY_PLL_DBGBUS_STATUS2_ADDR A:0xfdd0028c
y.create.l HWIO_MIPI_DSI_1_DSI1_DSIPHY_PLL_DBGBUS_STATUS3_ADDR A:0xfdd00290
y.create.l HWIO_MIPI_DSI_1_DSI1_DSIPHY_PLL_ANA_STATUS0_ADDR A:0xfdd00294
y.create.l HWIO_MIPI_DSI_1_DSI1_DSIPHY_PLL_ANA_STATUS1_ADDR A:0xfdd00298
y.create.l HWIO_MIPI_DSI_1_DSI1_DSIPHY_PLL_ANA_STATUS2_ADDR A:0xfdd0029c
y.create.l HWIO_MIPI_DSI_1_DSI1_DSIPHY_LN0_CFG0_ADDR A:0xfdd00300
y.create.l HWIO_MIPI_DSI_1_DSI1_DSIPHY_LN0_CFG1_ADDR A:0xfdd00304
y.create.l HWIO_MIPI_DSI_1_DSI1_DSIPHY_LN0_CFG2_ADDR A:0xfdd00308
y.create.l HWIO_MIPI_DSI_1_DSI1_DSIPHY_LN0_TEST_DATAPATH_ADDR A:0xfdd0030c
y.create.l HWIO_MIPI_DSI_1_DSI1_DSIPHY_LN0_DEBUG_SEL_ADDR A:0xfdd00310
y.create.l HWIO_MIPI_DSI_1_DSI1_DSIPHY_LN0_TEST_STR0_ADDR A:0xfdd00314
y.create.l HWIO_MIPI_DSI_1_DSI1_DSIPHY_LN0_TEST_STR1_ADDR A:0xfdd00318
y.create.l HWIO_MIPI_DSI_1_DSI1_DSIPHY_LN0_BIST_CTL0_ADDR A:0xfdd0031c
y.create.l HWIO_MIPI_DSI_1_DSI1_DSIPHY_LN0_BIST_CTL1_ADDR A:0xfdd00320
y.create.l HWIO_MIPI_DSI_1_DSI1_DSIPHY_LN0_BIST_RXCHK_STATUS_ADDR A:0xfdd00328
y.create.l HWIO_MIPI_DSI_1_DSI1_DSIPHY_LN0_HSTX_STR_STATUS_ADDR A:0xfdd0032c
y.create.l HWIO_MIPI_DSI_1_DSI1_DSIPHY_LN0_BIST_MISR_STAT0_ADDR A:0xfdd00338
y.create.l HWIO_MIPI_DSI_1_DSI1_DSIPHY_LN0_BIST_MISR_STAT1_ADDR A:0xfdd0033c
y.create.l HWIO_MIPI_DSI_1_DSI1_DSIPHY_LN1_CFG0_ADDR A:0xfdd00340
y.create.l HWIO_MIPI_DSI_1_DSI1_DSIPHY_LN1_CFG1_ADDR A:0xfdd00344
y.create.l HWIO_MIPI_DSI_1_DSI1_DSIPHY_LN1_CFG2_ADDR A:0xfdd00348
y.create.l HWIO_MIPI_DSI_1_DSI1_DSIPHY_LN1_TEST_DATAPATH_ADDR A:0xfdd0034c
y.create.l HWIO_MIPI_DSI_1_DSI1_DSIPHY_LN1_DEBUG_SEL_ADDR A:0xfdd00350
y.create.l HWIO_MIPI_DSI_1_DSI1_DSIPHY_LN1_TEST_STR0_ADDR A:0xfdd00354
y.create.l HWIO_MIPI_DSI_1_DSI1_DSIPHY_LN1_TEST_STR1_ADDR A:0xfdd00358
y.create.l HWIO_MIPI_DSI_1_DSI1_DSIPHY_LN1_BIST_CTL0_ADDR A:0xfdd0035c
y.create.l HWIO_MIPI_DSI_1_DSI1_DSIPHY_LN1_BIST_CTL1_ADDR A:0xfdd00360
y.create.l HWIO_MIPI_DSI_1_DSI1_DSIPHY_LN1_BIST_RXCHK_STATUS_ADDR A:0xfdd00368
y.create.l HWIO_MIPI_DSI_1_DSI1_DSIPHY_LN1_HSTX_STR_STATUS_ADDR A:0xfdd0036c
y.create.l HWIO_MIPI_DSI_1_DSI1_DSIPHY_LN1_BIST_MISR_STAT0_ADDR A:0xfdd00378
y.create.l HWIO_MIPI_DSI_1_DSI1_DSIPHY_LN1_BIST_MISR_STAT1_ADDR A:0xfdd0037c
y.create.l HWIO_MIPI_DSI_1_DSI1_DSIPHY_LN2_CFG0_ADDR A:0xfdd00380
y.create.l HWIO_MIPI_DSI_1_DSI1_DSIPHY_LN2_CFG1_ADDR A:0xfdd00384
y.create.l HWIO_MIPI_DSI_1_DSI1_DSIPHY_LN2_CFG2_ADDR A:0xfdd00388
y.create.l HWIO_MIPI_DSI_1_DSI1_DSIPHY_LN2_TEST_DATAPATH_ADDR A:0xfdd0038c
y.create.l HWIO_MIPI_DSI_1_DSI1_DSIPHY_LN2_DEBUG_SEL_ADDR A:0xfdd00390
y.create.l HWIO_MIPI_DSI_1_DSI1_DSIPHY_LN2_TEST_STR0_ADDR A:0xfdd00394
y.create.l HWIO_MIPI_DSI_1_DSI1_DSIPHY_LN2_TEST_STR1_ADDR A:0xfdd00398
y.create.l HWIO_MIPI_DSI_1_DSI1_DSIPHY_LN2_BIST_CTL0_ADDR A:0xfdd0039c
y.create.l HWIO_MIPI_DSI_1_DSI1_DSIPHY_LN2_BIST_CTL1_ADDR A:0xfdd003a0
y.create.l HWIO_MIPI_DSI_1_DSI1_DSIPHY_LN2_BIST_RXCHK_STATUS_ADDR A:0xfdd003a8
y.create.l HWIO_MIPI_DSI_1_DSI1_DSIPHY_LN2_HSTX_STR_STATUS_ADDR A:0xfdd003ac
y.create.l HWIO_MIPI_DSI_1_DSI1_DSIPHY_LN2_BIST_MISR_STAT0_ADDR A:0xfdd003b8
y.create.l HWIO_MIPI_DSI_1_DSI1_DSIPHY_LN2_BIST_MISR_STAT1_ADDR A:0xfdd003bc
y.create.l HWIO_MIPI_DSI_1_DSI1_DSIPHY_LN3_CFG0_ADDR A:0xfdd003c0
y.create.l HWIO_MIPI_DSI_1_DSI1_DSIPHY_LN3_CFG1_ADDR A:0xfdd003c4
y.create.l HWIO_MIPI_DSI_1_DSI1_DSIPHY_LN3_CFG2_ADDR A:0xfdd003c8
y.create.l HWIO_MIPI_DSI_1_DSI1_DSIPHY_LN3_TEST_DATAPATH_ADDR A:0xfdd003cc
y.create.l HWIO_MIPI_DSI_1_DSI1_DSIPHY_LN3_DEBUG_SEL_ADDR A:0xfdd003d0
y.create.l HWIO_MIPI_DSI_1_DSI1_DSIPHY_LN3_TEST_STR0_ADDR A:0xfdd003d4
y.create.l HWIO_MIPI_DSI_1_DSI1_DSIPHY_LN3_TEST_STR1_ADDR A:0xfdd003d8
y.create.l HWIO_MIPI_DSI_1_DSI1_DSIPHY_LN3_BIST_CTL0_ADDR A:0xfdd003dc
y.create.l HWIO_MIPI_DSI_1_DSI1_DSIPHY_LN3_BIST_CTL1_ADDR A:0xfdd003e0
y.create.l HWIO_MIPI_DSI_1_DSI1_DSIPHY_LN3_BIST_RXCHK_STATUS_ADDR A:0xfdd003e8
y.create.l HWIO_MIPI_DSI_1_DSI1_DSIPHY_LN3_HSTX_STR_STATUS_ADDR A:0xfdd003ec
y.create.l HWIO_MIPI_DSI_1_DSI1_DSIPHY_LN3_BIST_MISR_STAT0_ADDR A:0xfdd003f8
y.create.l HWIO_MIPI_DSI_1_DSI1_DSIPHY_LN3_BIST_MISR_STAT1_ADDR A:0xfdd003fc
y.create.l HWIO_MIPI_DSI_1_DSI1_DSIPHY_LNCK_CFG0_ADDR A:0xfdd00400
y.create.l HWIO_MIPI_DSI_1_DSI1_DSIPHY_LNCK_CFG1_ADDR A:0xfdd00404
y.create.l HWIO_MIPI_DSI_1_DSI1_DSIPHY_LNCK_CFG2_ADDR A:0xfdd00408
y.create.l HWIO_MIPI_DSI_1_DSI1_DSIPHY_LNCK_TEST_DATAPATH_ADDR A:0xfdd0040c
y.create.l HWIO_MIPI_DSI_1_DSI1_DSIPHY_LNCK_DEBUG_SEL_ADDR A:0xfdd00410
y.create.l HWIO_MIPI_DSI_1_DSI1_DSIPHY_LNCK_TEST_STR0_ADDR A:0xfdd00414
y.create.l HWIO_MIPI_DSI_1_DSI1_DSIPHY_LNCK_TEST_STR1_ADDR A:0xfdd00418
y.create.l HWIO_MIPI_DSI_1_DSI1_DSIPHY_LNCK_BIST_CTL0_ADDR A:0xfdd0041c
y.create.l HWIO_MIPI_DSI_1_DSI1_DSIPHY_LNCK_BIST_CTL1_ADDR A:0xfdd00420
y.create.l HWIO_MIPI_DSI_1_DSI1_DSIPHY_LNCK_BIST_RXCHK_STATUS_ADDR A:0xfdd00428
y.create.l HWIO_MIPI_DSI_1_DSI1_DSIPHY_LNCK_HSTX_STR_STATUS_ADDR A:0xfdd0042c
y.create.l HWIO_MIPI_DSI_1_DSI1_DSIPHY_LNCK_BIST_MISR_STAT0_ADDR A:0xfdd00438
y.create.l HWIO_MIPI_DSI_1_DSI1_DSIPHY_LNCK_BIST_MISR_STAT1_ADDR A:0xfdd0043c
y.create.l HWIO_MIPI_DSI_1_DSI1_DSIPHY_TIMING_CTRL_0_ADDR A:0xfdd00440
y.create.l HWIO_MIPI_DSI_1_DSI1_DSIPHY_TIMING_CTRL_1_ADDR A:0xfdd00444
y.create.l HWIO_MIPI_DSI_1_DSI1_DSIPHY_TIMING_CTRL_2_ADDR A:0xfdd00448
y.create.l HWIO_MIPI_DSI_1_DSI1_DSIPHY_TIMING_CTRL_3_ADDR A:0xfdd0044c
y.create.l HWIO_MIPI_DSI_1_DSI1_DSIPHY_TIMING_CTRL_4_ADDR A:0xfdd00450
y.create.l HWIO_MIPI_DSI_1_DSI1_DSIPHY_TIMING_CTRL_5_ADDR A:0xfdd00454
y.create.l HWIO_MIPI_DSI_1_DSI1_DSIPHY_TIMING_CTRL_6_ADDR A:0xfdd00458
y.create.l HWIO_MIPI_DSI_1_DSI1_DSIPHY_TIMING_CTRL_7_ADDR A:0xfdd0045c
y.create.l HWIO_MIPI_DSI_1_DSI1_DSIPHY_TIMING_CTRL_8_ADDR A:0xfdd00460
y.create.l HWIO_MIPI_DSI_1_DSI1_DSIPHY_TIMING_CTRL_9_ADDR A:0xfdd00464
y.create.l HWIO_MIPI_DSI_1_DSI1_DSIPHY_TIMING_CTRL_10_ADDR A:0xfdd00468
y.create.l HWIO_MIPI_DSI_1_DSI1_DSIPHY_TIMING_CTRL_11_ADDR A:0xfdd0046c
y.create.l HWIO_MIPI_DSI_1_DSI1_DSIPHY_CTRL_0_ADDR A:0xfdd00470
y.create.l HWIO_MIPI_DSI_1_DSI1_DSIPHY_CTRL_1_ADDR A:0xfdd00474
y.create.l HWIO_MIPI_DSI_1_DSI1_DSIPHY_CTRL_2_ADDR A:0xfdd00478
y.create.l HWIO_MIPI_DSI_1_DSI1_DSIPHY_CTRL_3_ADDR A:0xfdd0047c
y.create.l HWIO_MIPI_DSI_1_DSI1_DSIPHY_STRENGTH_CTRL_0_ADDR A:0xfdd00480
y.create.l HWIO_MIPI_DSI_1_DSI1_DSIPHY_STRENGTH_CTRL_1_ADDR A:0xfdd00484
y.create.l HWIO_MIPI_DSI_1_DSI1_DSIPHY_STRENGTH_CTRL_2_ADDR A:0xfdd00488
y.create.l HWIO_MIPI_DSI_1_DSI1_DSIPHY_BIST_CTRL0_ADDR A:0xfdd0048c
y.create.l HWIO_MIPI_DSI_1_DSI1_DSIPHY_BIST_CTRL1_ADDR A:0xfdd00490
y.create.l HWIO_MIPI_DSI_1_DSI1_DSIPHY_BIST_CTRL2_ADDR A:0xfdd00494
y.create.l HWIO_MIPI_DSI_1_DSI1_DSIPHY_BIST_CTRL3_ADDR A:0xfdd00498
y.create.l HWIO_MIPI_DSI_1_DSI1_DSIPHY_BIST_CTRL4_ADDR A:0xfdd0049c
y.create.l HWIO_MIPI_DSI_1_DSI1_DSIPHY_BIST_CTRL5_ADDR A:0xfdd004a0
y.create.l HWIO_MIPI_DSI_1_DSI1_DSIPHY_GLBL_MISR_CTRL_ADDR A:0xfdd004a4
y.create.l HWIO_MIPI_DSI_1_DSI1_DSIPHY_GLBL_TEST_CTRL_ADDR A:0xfdd004a8
y.create.l HWIO_MIPI_DSI_1_DSI1_DSIPHY_GLBL_DIGTOP_DEBUG_SEL_ADDR A:0xfdd004ac
y.create.l HWIO_MIPI_DSI_1_DSI1_DSIPHY_LDO_CNTRL_ADDR A:0xfdd004b0
y.create.l HWIO_MIPI_DSI_1_DSI1_DSIPHY_GLBL_STATUS_DEBUG_BUS0_ADDR A:0xfdd004c0
y.create.l HWIO_MIPI_DSI_1_DSI1_DSIPHY_GLBL_STATUS_DEBUG_BUS1_ADDR A:0xfdd004c4
y.create.l HWIO_MIPI_DSI_1_DSI1_DSIPHY_GLBL_STATUS_DEBUG_BUS2_ADDR A:0xfdd004c8
y.create.l HWIO_MIPI_DSI_1_DSI1_DSIPHY_GLBL_STATUS_DEBUG_BUS3_ADDR A:0xfdd004cc
y.create.l HWIO_MIPI_DSI_1_DSI1_DSIPHY_REGULATOR_CTRL_0_ADDR A:0xfdd00500
y.create.l HWIO_MIPI_DSI_1_DSI1_DSIPHY_REGULATOR_CTRL_1_ADDR A:0xfdd00504
y.create.l HWIO_MIPI_DSI_1_DSI1_DSIPHY_REGULATOR_CTRL_2_ADDR A:0xfdd00508
y.create.l HWIO_MIPI_DSI_1_DSI1_DSIPHY_REGULATOR_CTRL_3_ADDR A:0xfdd0050c
y.create.l HWIO_MIPI_DSI_1_DSI1_DSIPHY_REGULATOR_CTRL_4_ADDR A:0xfdd00510
y.create.l HWIO_MIPI_DSI_1_DSI1_DSIPHY_REGULATOR_TEST_ADDR A:0xfdd00514
y.create.l HWIO_MIPI_DSI_1_DSI1_DSIPHY_REGULATOR_CAL_PWR_CFG_ADDR A:0xfdd00518
y.create.l HWIO_MIPI_DSI_1_DSI1_DSIPHY_REGULATOR_CAL_TEST_ADDR A:0xfdd0051c
y.create.l HWIO_MIPI_DSI_1_DSI1_DSIPHY_REGULATOR_CAL_TPA_ADDR A:0xfdd00520
y.create.l HWIO_MIPI_DSI_1_DSI1_DSIPHY_REG_CAL_DBG_SEL_ADDR A:0xfdd00524
y.create.l HWIO_MIPI_DSI_1_DSI1_DSIPHY_CAL_HW_TRIGGER_ADDR A:0xfdd00528
y.create.l HWIO_MIPI_DSI_1_DSI1_DSIPHY_CAL_SW_CFG0_ADDR A:0xfdd0052c
y.create.l HWIO_MIPI_DSI_1_DSI1_DSIPHY_CAL_SW_CFG1_ADDR A:0xfdd00530
y.create.l HWIO_MIPI_DSI_1_DSI1_DSIPHY_CAL_SW_CFG2_ADDR A:0xfdd00534
y.create.l HWIO_MIPI_DSI_1_DSI1_DSIPHY_CAL_HW_CFG0_ADDR A:0xfdd00538
y.create.l HWIO_MIPI_DSI_1_DSI1_DSIPHY_CAL_HW_CFG1_ADDR A:0xfdd0053c
y.create.l HWIO_MIPI_DSI_1_DSI1_DSIPHY_CAL_HW_CFG2_ADDR A:0xfdd00540
y.create.l HWIO_MIPI_DSI_1_DSI1_DSIPHY_CAL_HW_CFG3_ADDR A:0xfdd00544
y.create.l HWIO_MIPI_DSI_1_DSI1_DSIPHY_CAL_HW_CFG4_ADDR A:0xfdd00548
y.create.l HWIO_MIPI_DSI_1_DSI1_DSIPHY_CAL_TEST_EFUSE_ADDR A:0xfdd0054c
y.create.l HWIO_MIPI_DSI_1_DSI1_DSIPHY_REGULATOR_CAL_STATUS0_ADDR A:0xfdd00550
y.create.l HWIO_MIPI_DSI_1_DSI1_DSIPHY_REGULATOR_CAL_STATUS1_ADDR A:0xfdd00554
y.create.l HWIO_MIPI_DSI_1_DSI1_DSIPHY_REG_CAL_DBG_STAT0_ADDR A:0xfdd00558
y.create.l HWIO_MIPI_DSI_1_DSI1_DSIPHY_REG_CAL_DBG_STAT1_ADDR A:0xfdd0055c
y.create.l HWIO_MMSS_QHS_MMSS_ABT_HW_VERSION_ADDR A:0xfd800000
y.create.l HWIO_MMSS_QHS_MMSS_ABT_INST_ID_ADDR A:0xfd800004
y.create.l HWIO_MMSS_QHS_MMSS_ABT_NUM_SLAVES_ADDR A:0xfd800008
y.create.l HWIO_MMSS_QHS_MMSS_ABT_TIMER_LOADVAL_ADDR A:0xfd80000c
y.create.l HWIO_MMSS_QHS_MMSS_ABT_TIMER_MODE_ADDR A:0xfd800010
y.create.l HWIO_MMSS_QHS_MMSS_ABT_INTR_STATUS_ADDR A:0xfd800014
y.create.l HWIO_MMSS_QHS_MMSS_ABT_INTR_CLEAR_ADDR A:0xfd800018
y.create.l HWIO_MMSS_QHS_MMSS_ABT_INTR_ENABLE_ADDR A:0xfd80001c
y.create.l HWIO_MMSS_QHS_MMSS_ABT_SYND_VALID_ADDR A:0xfd800020
y.create.l HWIO_MMSS_QHS_MMSS_ABT_SYND_CLEAR_ADDR A:0xfd800024
y.create.l HWIO_MMSS_QHS_MMSS_ABT_SYND_ID_ADDR A:0xfd800028
y.create.l HWIO_MMSS_QHS_MMSS_ABT_SYND_ADDR0_ADDR A:0xfd80002c
y.create.l HWIO_MMSS_QHS_MMSS_ABT_SYND_ADDR1_ADDR A:0xfd800030
y.create.l HWIO_MMSS_QHS_MMSS_ABT_SYND_HREADY_ADDR A:0xfd800034
y.create.l HWIO_MMSS_QHS_MMSS1_ABT_HW_VERSION_ADDR A:0xfd808000
y.create.l HWIO_MMSS_QHS_MMSS1_ABT_INST_ID_ADDR A:0xfd808004
y.create.l HWIO_MMSS_QHS_MMSS1_ABT_NUM_SLAVES_ADDR A:0xfd808008
y.create.l HWIO_MMSS_QHS_MMSS1_ABT_TIMER_LOADVAL_ADDR A:0xfd80800c
y.create.l HWIO_MMSS_QHS_MMSS1_ABT_TIMER_MODE_ADDR A:0xfd808010
y.create.l HWIO_MMSS_QHS_MMSS1_ABT_INTR_STATUS_ADDR A:0xfd808014
y.create.l HWIO_MMSS_QHS_MMSS1_ABT_INTR_CLEAR_ADDR A:0xfd808018
y.create.l HWIO_MMSS_QHS_MMSS1_ABT_INTR_ENABLE_ADDR A:0xfd80801c
y.create.l HWIO_MMSS_QHS_MMSS1_ABT_SYND_VALID_ADDR A:0xfd808020
y.create.l HWIO_MMSS_QHS_MMSS1_ABT_SYND_CLEAR_ADDR A:0xfd808024
y.create.l HWIO_MMSS_QHS_MMSS1_ABT_SYND_ID_ADDR A:0xfd808028
y.create.l HWIO_MMSS_QHS_MMSS1_ABT_SYND_ADDR0_ADDR A:0xfd80802c
y.create.l HWIO_MMSS_QHS_MMSS1_ABT_SYND_ADDR1_ADDR A:0xfd808030
y.create.l HWIO_MMSS_QHS_MMSS1_ABT_SYND_HREADY_ADDR A:0xfd808034
y.create.l HWIO_MMSS_QHS_MMSS2_ABT_HW_VERSION_ADDR A:0xfd810000
y.create.l HWIO_MMSS_QHS_MMSS2_ABT_INST_ID_ADDR A:0xfd810004
y.create.l HWIO_MMSS_QHS_MMSS2_ABT_NUM_SLAVES_ADDR A:0xfd810008
y.create.l HWIO_MMSS_QHS_MMSS2_ABT_TIMER_LOADVAL_ADDR A:0xfd81000c
y.create.l HWIO_MMSS_QHS_MMSS2_ABT_TIMER_MODE_ADDR A:0xfd810010
y.create.l HWIO_MMSS_QHS_MMSS2_ABT_INTR_STATUS_ADDR A:0xfd810014
y.create.l HWIO_MMSS_QHS_MMSS2_ABT_INTR_CLEAR_ADDR A:0xfd810018
y.create.l HWIO_MMSS_QHS_MMSS2_ABT_INTR_ENABLE_ADDR A:0xfd81001c
y.create.l HWIO_MMSS_QHS_MMSS2_ABT_SYND_VALID_ADDR A:0xfd810020
y.create.l HWIO_MMSS_QHS_MMSS2_ABT_SYND_CLEAR_ADDR A:0xfd810024
y.create.l HWIO_MMSS_QHS_MMSS2_ABT_SYND_ID_ADDR A:0xfd810028
y.create.l HWIO_MMSS_QHS_MMSS2_ABT_SYND_ADDR0_ADDR A:0xfd81002c
y.create.l HWIO_MMSS_QHS_MMSS2_ABT_SYND_ADDR1_ADDR A:0xfd810030
y.create.l HWIO_MMSS_QHS_MMSS2_ABT_SYND_HREADY_ADDR A:0xfd810034
y.create.l HWIO_MMSS_QHS_MMSS3_ABT_HW_VERSION_ADDR A:0xfd818000
y.create.l HWIO_MMSS_QHS_MMSS3_ABT_INST_ID_ADDR A:0xfd818004
y.create.l HWIO_MMSS_QHS_MMSS3_ABT_NUM_SLAVES_ADDR A:0xfd818008
y.create.l HWIO_MMSS_QHS_MMSS3_ABT_TIMER_LOADVAL_ADDR A:0xfd81800c
y.create.l HWIO_MMSS_QHS_MMSS3_ABT_TIMER_MODE_ADDR A:0xfd818010
y.create.l HWIO_MMSS_QHS_MMSS3_ABT_INTR_STATUS_ADDR A:0xfd818014
y.create.l HWIO_MMSS_QHS_MMSS3_ABT_INTR_CLEAR_ADDR A:0xfd818018
y.create.l HWIO_MMSS_QHS_MMSS3_ABT_INTR_ENABLE_ADDR A:0xfd81801c
y.create.l HWIO_MMSS_QHS_MMSS3_ABT_SYND_VALID_ADDR A:0xfd818020
y.create.l HWIO_MMSS_QHS_MMSS3_ABT_SYND_CLEAR_ADDR A:0xfd818024
y.create.l HWIO_MMSS_QHS_MMSS3_ABT_SYND_ID_ADDR A:0xfd818028
y.create.l HWIO_MMSS_QHS_MMSS3_ABT_SYND_ADDR0_ADDR A:0xfd81802c
y.create.l HWIO_MMSS_QHS_MMSS3_ABT_SYND_ADDR1_ADDR A:0xfd818030
y.create.l HWIO_MMSS_QHS_MMSS3_ABT_SYND_HREADY_ADDR A:0xfd818034
y.create.l HWIO_MMSS_MMSS_RPM_IRQ_EN_ADDR A:0xfd820000
y.create.l HWIO_MMSS_MMSS_RPM_IRQ_CLEAR_ADDR A:0xfd820004
y.create.l HWIO_MMSS_MMSS_RPM_IRQ_STATUS_ADDR A:0xfd820008
y.create.l HWIO_MMSS_OXILI_GC_SYS_AHB_STATUS_ADDR A:0xfd82000c
y.create.l HWIO_MMSS_OXILI_CMD_REG_ADDR A:0xfd820010
y.create.l HWIO_MMSS_MMSS_MISC_HWEVENTS_MUX_CTRL0_ADDR A:0xfd820018
y.create.l HWIO_MMSS_MMSS_MISC_HWEVENTS_MUX_CTRL1_ADDR A:0xfd82001c
y.create.l HWIO_MMSS_MMSS_MISC_HWEVENTS_MUX_CTRL2_ADDR A:0xfd820020
y.create.l HWIO_MMSS_MMSS_MISC_HWEVENTS_MUX_CTRL3_ADDR A:0xfd820024
y.create.l HWIO_MMSS_MMSS_MISC_HWEVENTS_MUX_CTRL4_ADDR A:0xfd820028
y.create.l HWIO_MMSS_MMSS_MISC_HWEVENTS_MUX_CTRL5_ADDR A:0xfd82002c
y.create.l HWIO_MMSS_MMSS_MISC_HWEVENTS_MUX_CTRL6_ADDR A:0xfd820030
y.create.l HWIO_MMSS_MMSS_MISC_HWEVENTS_MUX_CTRL7_ADDR A:0xfd820034
y.create.l HWIO_MMSS_MMSS_MISC_HWEVENTS_MUX_CTRL8_ADDR A:0xfd820038
y.create.l HWIO_MMSS_MMSS_MISC_HWEVENTS_MUX_CTRL9_ADDR A:0xfd82003c
y.create.l HWIO_MMSS_MMSS_MISC_HWEVENTS_MUX_CTRL10_ADDR A:0xfd820040
y.create.l HWIO_MMSS_MMSS_MISC_HWEVENTS_MUX_CTRL11_ADDR A:0xfd820044
y.create.l HWIO_MMSS_MMSS_MISC_HWEVENTS_MUX_CTRL12_ADDR A:0xfd820048
y.create.l HWIO_MMSS_MMSS_MISC_HWEVENTS_MUX_CTRL13_ADDR A:0xfd82004c
y.create.l HWIO_MMSS_MMSS_MISC_HWEVENTS_MUX_CTRL14_ADDR A:0xfd820050
y.create.l HWIO_MMSS_MMSS_MISC_HWEVENTS_MUX_CTRL15_ADDR A:0xfd820054
y.create.l HWIO_MMSS_MMSS_MISC_HWEVENTS_MUX_CTRL16_ADDR A:0xfd820058
y.create.l HWIO_MMSS_MMSS_MISC_HWEVENTS_MUX_CTRL17_ADDR A:0xfd82005c
y.create.l HWIO_MMSS_MMSS_MISC_HWEVENTS_MUX_CTRL18_ADDR A:0xfd820060
y.create.l HWIO_MMSS_MMSS_MISC_HWEVENTS_MUX_CTRL19_ADDR A:0xfd820064
y.create.l HWIO_MMSS_MMSS_MISC_HWEVENTS_MUX_CTRL20_ADDR A:0xfd820068
y.create.l HWIO_MMSS_MMSS_MISC_HWEVENTS_MUX_CTRL21_ADDR A:0xfd82006c
y.create.l HWIO_MMSS_MMSS_MISC_HWEVENTS_MUX_CTRL22_ADDR A:0xfd820070
y.create.l HWIO_MMSS_MMSS_MISC_HWEVENTS_MUX_CTRL23_ADDR A:0xfd820074
y.create.l HWIO_MMSS_MMSS_MISC_HWEVENTS_MUX_CTRL24_ADDR A:0xfd820078
y.create.l HWIO_MMSS_MMSS_MISC_HWEVENTS_MUX_CTRL25_ADDR A:0xfd82007c
y.create.l HWIO_MMSS_MMSS_MISC_HWEVENTS_MUX_CTRL26_ADDR A:0xfd820080
y.create.l HWIO_MMSS_MMSS_MISC_HWEVENTS_MUX_CTRL27_ADDR A:0xfd820084
y.create.l HWIO_MMSS_MMSS_MISC_HWEVENTS_MUX_CTRL28_ADDR A:0xfd820088
y.create.l HWIO_MMSS_MMSS_MISC_HWEVENTS_MUX_CTRL29_ADDR A:0xfd82008c
y.create.l HWIO_MMSS_MMSS_MISC_HWEVENTS_MUX_CTRL30_ADDR A:0xfd820090
y.create.l HWIO_MMSS_MMSS_MISC_HWEVENTS_MUX_CTRL31_ADDR A:0xfd820094
y.create.l HWIO_MMSS_IMEM_FSCGC_TIMERS_ADDR A:0xfd820098
y.create.l HWIO_MMSS_IMEM_EX_FSCGC_CONTROL_ADDR A:0xfd82009c
y.create.l HWIO_MMSS_IMEM_RAM_CONFIG_ADDR A:0xfd820100
y.create.l HWIO_MMSS_MDP_TIMEOUT_ADDR A:0xfd820104
y.create.l HWIO_MMSS_MMSS_MISC_SPARE_FLOPS_ADDR A:0xfd820108
y.create.l HWIO_MMSS_MMSS_DEBUG_REG0_ADDR A:0xfd82010c
y.create.l HWIO_MMSS_XPU2_MMSS_MISC_XPU_SCR_ADDR A:0xfd828000
y.create.l HWIO_MMSS_XPU2_MMSS_MISC_XPU_SWDR_ADDR A:0xfd828004
y.create.l HWIO_MMSS_XPU2_MMSS_MISC_XPU_SEAR0_ADDR A:0xfd828040
y.create.l HWIO_MMSS_XPU2_MMSS_MISC_XPU_SESR_ADDR A:0xfd828048
y.create.l HWIO_MMSS_XPU2_MMSS_MISC_XPU_SESRRESTORE_ADDR A:0xfd82804c
y.create.l HWIO_MMSS_XPU2_MMSS_MISC_XPU_SESYNR0_ADDR A:0xfd828050
y.create.l HWIO_MMSS_XPU2_MMSS_MISC_XPU_SESYNR1_ADDR A:0xfd828054
y.create.l HWIO_MMSS_XPU2_MMSS_MISC_XPU_SESYNR2_ADDR A:0xfd828058
y.create.l HWIO_MMSS_XPU2_MMSS_MISC_XPU_MCR_ADDR A:0xfd828100
y.create.l HWIO_MMSS_XPU2_MMSS_MISC_XPU_MEAR0_ADDR A:0xfd828140
y.create.l HWIO_MMSS_XPU2_MMSS_MISC_XPU_MESR_ADDR A:0xfd828148
y.create.l HWIO_MMSS_XPU2_MMSS_MISC_XPU_MESRRESTORE_ADDR A:0xfd82814c
y.create.l HWIO_MMSS_XPU2_MMSS_MISC_XPU_MESYNR0_ADDR A:0xfd828150
y.create.l HWIO_MMSS_XPU2_MMSS_MISC_XPU_MESYNR1_ADDR A:0xfd828154
y.create.l HWIO_MMSS_XPU2_MMSS_MISC_XPU_MESYNR2_ADDR A:0xfd828158
y.create.l HWIO_MMSS_XPU2_MMSS_MISC_XPU_CR_ADDR A:0xfd828080
y.create.l HWIO_MMSS_XPU2_MMSS_MISC_XPU_RPU_ACR0_ADDR A:0xfd8280a0
y.create.l HWIO_MMSS_XPU2_MMSS_MISC_XPU_EAR0_ADDR A:0xfd8280c0
y.create.l HWIO_MMSS_XPU2_MMSS_MISC_XPU_ESR_ADDR A:0xfd8280c8
y.create.l HWIO_MMSS_XPU2_MMSS_MISC_XPU_ESRRESTORE_ADDR A:0xfd8280cc
y.create.l HWIO_MMSS_XPU2_MMSS_MISC_XPU_ESYNR0_ADDR A:0xfd8280d0
y.create.l HWIO_MMSS_XPU2_MMSS_MISC_XPU_ESYNR1_ADDR A:0xfd8280d4
y.create.l HWIO_MMSS_XPU2_MMSS_MISC_XPU_ESYNR2_ADDR A:0xfd8280d8
y.create.l HWIO_MMSS_XPU2_MMSS_MISC_XPU_IDR0_ADDR A:0xfd828074
y.create.l HWIO_MMSS_XPU2_MMSS_MISC_XPU_IDR1_ADDR A:0xfd828078
y.create.l HWIO_MMSS_XPU2_MMSS_MISC_XPU_REV_ADDR A:0xfd82807c
y.create.l HWIO_MMSS_XPU2_MMSS_MISC_XPU_RG0_RACR0_ADDR A:0xfd828200
y.create.l HWIO_MMSS_XPU2_MMSS_MISC_XPU_RG0_WACR0_ADDR A:0xfd828220
y.create.l HWIO_MMSS_XPU2_MMSS_MISC_XPU_RG0_SCR_ADDR A:0xfd828250
y.create.l HWIO_MMSS_XPU2_MMSS_MISC_XPU_RG0_MCR_ADDR A:0xfd828254
y.create.l HWIO_MMSS_XPU2_MNOC_XPU_SCR_ADDR A:0xfd830000
y.create.l HWIO_MMSS_XPU2_MNOC_XPU_SWDR_ADDR A:0xfd830004
y.create.l HWIO_MMSS_XPU2_MNOC_XPU_PRTN_RACR_SSHADOW_ADDR A:0xfd830008
y.create.l HWIO_MMSS_XPU2_MNOC_XPU_PRTN_WACR_SSHADOW_ADDR A:0xfd83000c
y.create.l HWIO_MMSS_XPU2_MNOC_XPU_PRTN_START_SSHADOW0_ADDR A:0xfd830010
y.create.l HWIO_MMSS_XPU2_MNOC_XPU_PRTN_END_SSHADOW0_ADDR A:0xfd830018
y.create.l HWIO_MMSS_XPU2_MNOC_XPU_SEAR0_ADDR A:0xfd830040
y.create.l HWIO_MMSS_XPU2_MNOC_XPU_SESR_ADDR A:0xfd830048
y.create.l HWIO_MMSS_XPU2_MNOC_XPU_SESRRESTORE_ADDR A:0xfd83004c
y.create.l HWIO_MMSS_XPU2_MNOC_XPU_SESYNR0_ADDR A:0xfd830050
y.create.l HWIO_MMSS_XPU2_MNOC_XPU_SESYNR1_ADDR A:0xfd830054
y.create.l HWIO_MMSS_XPU2_MNOC_XPU_SESYNR2_ADDR A:0xfd830058
y.create.l HWIO_MMSS_XPU2_MNOC_XPU_MCR_ADDR A:0xfd830100
y.create.l HWIO_MMSS_XPU2_MNOC_XPU_MEAR0_ADDR A:0xfd830140
y.create.l HWIO_MMSS_XPU2_MNOC_XPU_MESR_ADDR A:0xfd830148
y.create.l HWIO_MMSS_XPU2_MNOC_XPU_MESRRESTORE_ADDR A:0xfd83014c
y.create.l HWIO_MMSS_XPU2_MNOC_XPU_MESYNR0_ADDR A:0xfd830150
y.create.l HWIO_MMSS_XPU2_MNOC_XPU_MESYNR1_ADDR A:0xfd830154
y.create.l HWIO_MMSS_XPU2_MNOC_XPU_MESYNR2_ADDR A:0xfd830158
y.create.l HWIO_MMSS_XPU2_MNOC_XPU_CR_ADDR A:0xfd830080
y.create.l HWIO_MMSS_XPU2_MNOC_XPU_PRTN_RACR_SHADOW_ADDR A:0xfd830088
y.create.l HWIO_MMSS_XPU2_MNOC_XPU_PRTN_WACR_SHADOW_ADDR A:0xfd83008c
y.create.l HWIO_MMSS_XPU2_MNOC_XPU_PRTN_START_SHADOW0_ADDR A:0xfd830090
y.create.l HWIO_MMSS_XPU2_MNOC_XPU_PRTN_END_SHADOW0_ADDR A:0xfd830098
y.create.l HWIO_MMSS_XPU2_MNOC_XPU_RPU_ACR0_ADDR A:0xfd8300a0
y.create.l HWIO_MMSS_XPU2_MNOC_XPU_EAR0_ADDR A:0xfd8300c0
y.create.l HWIO_MMSS_XPU2_MNOC_XPU_ESR_ADDR A:0xfd8300c8
y.create.l HWIO_MMSS_XPU2_MNOC_XPU_ESRRESTORE_ADDR A:0xfd8300cc
y.create.l HWIO_MMSS_XPU2_MNOC_XPU_ESYNR0_ADDR A:0xfd8300d0
y.create.l HWIO_MMSS_XPU2_MNOC_XPU_ESYNR1_ADDR A:0xfd8300d4
y.create.l HWIO_MMSS_XPU2_MNOC_XPU_ESYNR2_ADDR A:0xfd8300d8
y.create.l HWIO_MMSS_XPU2_MNOC_XPU_UMR_RACR_ADDR A:0xfd8300e0
y.create.l HWIO_MMSS_XPU2_MNOC_XPU_UMR_WACR_ADDR A:0xfd8300e4
y.create.l HWIO_MMSS_XPU2_MNOC_XPU_IDR0_ADDR A:0xfd830074
y.create.l HWIO_MMSS_XPU2_MNOC_XPU_IDR1_ADDR A:0xfd830078
y.create.l HWIO_MMSS_XPU2_MNOC_XPU_REV_ADDR A:0xfd83007c
y.create.l HWIO_MMSS_XPU2_MNOC_XPU_PRT0_RACR0_ADDR A:0xfd830200
y.create.l HWIO_MMSS_XPU2_MNOC_XPU_PRT1_RACR0_ADDR A:0xfd830280
y.create.l HWIO_MMSS_XPU2_MNOC_XPU_PRT2_RACR0_ADDR A:0xfd830300
y.create.l HWIO_MMSS_XPU2_MNOC_XPU_PRT3_RACR0_ADDR A:0xfd830380
y.create.l HWIO_MMSS_XPU2_MNOC_XPU_PRT4_RACR0_ADDR A:0xfd830400
y.create.l HWIO_MMSS_XPU2_MNOC_XPU_PRT5_RACR0_ADDR A:0xfd830480
y.create.l HWIO_MMSS_XPU2_MNOC_XPU_PRT6_RACR0_ADDR A:0xfd830500
y.create.l HWIO_MMSS_XPU2_MNOC_XPU_PRT7_RACR0_ADDR A:0xfd830580
y.create.l HWIO_MMSS_XPU2_MNOC_XPU_PRT8_RACR0_ADDR A:0xfd830600
y.create.l HWIO_MMSS_XPU2_MNOC_XPU_PRT9_RACR0_ADDR A:0xfd830680
y.create.l HWIO_MMSS_XPU2_MNOC_XPU_PRT0_WACR0_ADDR A:0xfd830220
y.create.l HWIO_MMSS_XPU2_MNOC_XPU_PRT1_WACR0_ADDR A:0xfd8302a0
y.create.l HWIO_MMSS_XPU2_MNOC_XPU_PRT2_WACR0_ADDR A:0xfd830320
y.create.l HWIO_MMSS_XPU2_MNOC_XPU_PRT3_WACR0_ADDR A:0xfd8303a0
y.create.l HWIO_MMSS_XPU2_MNOC_XPU_PRT4_WACR0_ADDR A:0xfd830420
y.create.l HWIO_MMSS_XPU2_MNOC_XPU_PRT5_WACR0_ADDR A:0xfd8304a0
y.create.l HWIO_MMSS_XPU2_MNOC_XPU_PRT6_WACR0_ADDR A:0xfd830520
y.create.l HWIO_MMSS_XPU2_MNOC_XPU_PRT7_WACR0_ADDR A:0xfd8305a0
y.create.l HWIO_MMSS_XPU2_MNOC_XPU_PRT8_WACR0_ADDR A:0xfd830620
y.create.l HWIO_MMSS_XPU2_MNOC_XPU_PRT9_WACR0_ADDR A:0xfd8306a0
y.create.l HWIO_MMSS_XPU2_MNOC_XPU_PRT0_START0_ADDR A:0xfd830240
y.create.l HWIO_MMSS_XPU2_MNOC_XPU_PRT1_START0_ADDR A:0xfd8302c0
y.create.l HWIO_MMSS_XPU2_MNOC_XPU_PRT2_START0_ADDR A:0xfd830340
y.create.l HWIO_MMSS_XPU2_MNOC_XPU_PRT3_START0_ADDR A:0xfd8303c0
y.create.l HWIO_MMSS_XPU2_MNOC_XPU_PRT4_START0_ADDR A:0xfd830440
y.create.l HWIO_MMSS_XPU2_MNOC_XPU_PRT5_START0_ADDR A:0xfd8304c0
y.create.l HWIO_MMSS_XPU2_MNOC_XPU_PRT6_START0_ADDR A:0xfd830540
y.create.l HWIO_MMSS_XPU2_MNOC_XPU_PRT7_START0_ADDR A:0xfd8305c0
y.create.l HWIO_MMSS_XPU2_MNOC_XPU_PRT8_START0_ADDR A:0xfd830640
y.create.l HWIO_MMSS_XPU2_MNOC_XPU_PRT9_START0_ADDR A:0xfd8306c0
y.create.l HWIO_MMSS_XPU2_MNOC_XPU_PRT0_END0_ADDR A:0xfd830248
y.create.l HWIO_MMSS_XPU2_MNOC_XPU_PRT1_END0_ADDR A:0xfd8302c8
y.create.l HWIO_MMSS_XPU2_MNOC_XPU_PRT2_END0_ADDR A:0xfd830348
y.create.l HWIO_MMSS_XPU2_MNOC_XPU_PRT3_END0_ADDR A:0xfd8303c8
y.create.l HWIO_MMSS_XPU2_MNOC_XPU_PRT4_END0_ADDR A:0xfd830448
y.create.l HWIO_MMSS_XPU2_MNOC_XPU_PRT5_END0_ADDR A:0xfd8304c8
y.create.l HWIO_MMSS_XPU2_MNOC_XPU_PRT6_END0_ADDR A:0xfd830548
y.create.l HWIO_MMSS_XPU2_MNOC_XPU_PRT7_END0_ADDR A:0xfd8305c8
y.create.l HWIO_MMSS_XPU2_MNOC_XPU_PRT8_END0_ADDR A:0xfd830648
y.create.l HWIO_MMSS_XPU2_MNOC_XPU_PRT9_END0_ADDR A:0xfd8306c8
y.create.l HWIO_MMSS_XPU2_MNOC_XPU_PRT0_SCR_ADDR A:0xfd830250
y.create.l HWIO_MMSS_XPU2_MNOC_XPU_PRT1_SCR_ADDR A:0xfd8302d0
y.create.l HWIO_MMSS_XPU2_MNOC_XPU_PRT2_SCR_ADDR A:0xfd830350
y.create.l HWIO_MMSS_XPU2_MNOC_XPU_PRT3_SCR_ADDR A:0xfd8303d0
y.create.l HWIO_MMSS_XPU2_MNOC_XPU_PRT4_SCR_ADDR A:0xfd830450
y.create.l HWIO_MMSS_XPU2_MNOC_XPU_PRT5_SCR_ADDR A:0xfd8304d0
y.create.l HWIO_MMSS_XPU2_MNOC_XPU_PRT6_SCR_ADDR A:0xfd830550
y.create.l HWIO_MMSS_XPU2_MNOC_XPU_PRT7_SCR_ADDR A:0xfd8305d0
y.create.l HWIO_MMSS_XPU2_MNOC_XPU_PRT8_SCR_ADDR A:0xfd830650
y.create.l HWIO_MMSS_XPU2_MNOC_XPU_PRT9_SCR_ADDR A:0xfd8306d0
y.create.l HWIO_MMSS_XPU2_MNOC_XPU_PRT0_MCR_ADDR A:0xfd830254
y.create.l HWIO_MMSS_XPU2_MNOC_XPU_PRT1_MCR_ADDR A:0xfd8302d4
y.create.l HWIO_MMSS_XPU2_MNOC_XPU_PRT2_MCR_ADDR A:0xfd830354
y.create.l HWIO_MMSS_XPU2_MNOC_XPU_PRT3_MCR_ADDR A:0xfd8303d4
y.create.l HWIO_MMSS_XPU2_MNOC_XPU_PRT4_MCR_ADDR A:0xfd830454
y.create.l HWIO_MMSS_XPU2_MNOC_XPU_PRT5_MCR_ADDR A:0xfd8304d4
y.create.l HWIO_MMSS_XPU2_MNOC_XPU_PRT6_MCR_ADDR A:0xfd830554
y.create.l HWIO_MMSS_XPU2_MNOC_XPU_PRT7_MCR_ADDR A:0xfd8305d4
y.create.l HWIO_MMSS_XPU2_MNOC_XPU_PRT8_MCR_ADDR A:0xfd830654
y.create.l HWIO_MMSS_XPU2_MNOC_XPU_PRT9_MCR_ADDR A:0xfd8306d4
y.create.l HWIO_MMSS_XPU2_MNOC_XPU_PRT0_CNTL0_ADDR A:0xfd830258
y.create.l HWIO_MMSS_XPU2_MNOC_XPU_PRT1_CNTL0_ADDR A:0xfd8302d8
y.create.l HWIO_MMSS_XPU2_MNOC_XPU_PRT2_CNTL0_ADDR A:0xfd830358
y.create.l HWIO_MMSS_XPU2_MNOC_XPU_PRT3_CNTL0_ADDR A:0xfd8303d8
y.create.l HWIO_MMSS_XPU2_MNOC_XPU_PRT4_CNTL0_ADDR A:0xfd830458
y.create.l HWIO_MMSS_XPU2_MNOC_XPU_PRT5_CNTL0_ADDR A:0xfd8304d8
y.create.l HWIO_MMSS_XPU2_MNOC_XPU_PRT6_CNTL0_ADDR A:0xfd830558
y.create.l HWIO_MMSS_XPU2_MNOC_XPU_PRT7_CNTL0_ADDR A:0xfd8305d8
y.create.l HWIO_MMSS_XPU2_MNOC_XPU_PRT8_CNTL0_ADDR A:0xfd830658
y.create.l HWIO_MMSS_XPU2_MNOC_XPU_PRT9_CNTL0_ADDR A:0xfd8306d8
y.create.l HWIO_MMSS_XPU2_MNOC_XPU_PRT0_CNTL1_ADDR A:0xfd83025c
y.create.l HWIO_MMSS_XPU2_MNOC_XPU_PRT1_CNTL1_ADDR A:0xfd8302dc
y.create.l HWIO_MMSS_XPU2_MNOC_XPU_PRT2_CNTL1_ADDR A:0xfd83035c
y.create.l HWIO_MMSS_XPU2_MNOC_XPU_PRT3_CNTL1_ADDR A:0xfd8303dc
y.create.l HWIO_MMSS_XPU2_MNOC_XPU_PRT4_CNTL1_ADDR A:0xfd83045c
y.create.l HWIO_MMSS_XPU2_MNOC_XPU_PRT5_CNTL1_ADDR A:0xfd8304dc
y.create.l HWIO_MMSS_XPU2_MNOC_XPU_PRT6_CNTL1_ADDR A:0xfd83055c
y.create.l HWIO_MMSS_XPU2_MNOC_XPU_PRT7_CNTL1_ADDR A:0xfd8305dc
y.create.l HWIO_MMSS_XPU2_MNOC_XPU_PRT8_CNTL1_ADDR A:0xfd83065c
y.create.l HWIO_MMSS_XPU2_MNOC_XPU_PRT9_CNTL1_ADDR A:0xfd8306dc
y.create.l HWIO_MMSS_XPU2_MMSS_CC_XPU_SCR_ADDR A:0xfd838000
y.create.l HWIO_MMSS_XPU2_MMSS_CC_XPU_SWDR_ADDR A:0xfd838004
y.create.l HWIO_MMSS_XPU2_MMSS_CC_XPU_SEAR0_ADDR A:0xfd838040
y.create.l HWIO_MMSS_XPU2_MMSS_CC_XPU_SESR_ADDR A:0xfd838048
y.create.l HWIO_MMSS_XPU2_MMSS_CC_XPU_SESRRESTORE_ADDR A:0xfd83804c
y.create.l HWIO_MMSS_XPU2_MMSS_CC_XPU_SESYNR0_ADDR A:0xfd838050
y.create.l HWIO_MMSS_XPU2_MMSS_CC_XPU_SESYNR1_ADDR A:0xfd838054
y.create.l HWIO_MMSS_XPU2_MMSS_CC_XPU_SESYNR2_ADDR A:0xfd838058
y.create.l HWIO_MMSS_XPU2_MMSS_CC_XPU_MCR_ADDR A:0xfd838100
y.create.l HWIO_MMSS_XPU2_MMSS_CC_XPU_MEAR0_ADDR A:0xfd838140
y.create.l HWIO_MMSS_XPU2_MMSS_CC_XPU_MESR_ADDR A:0xfd838148
y.create.l HWIO_MMSS_XPU2_MMSS_CC_XPU_MESRRESTORE_ADDR A:0xfd83814c
y.create.l HWIO_MMSS_XPU2_MMSS_CC_XPU_MESYNR0_ADDR A:0xfd838150
y.create.l HWIO_MMSS_XPU2_MMSS_CC_XPU_MESYNR1_ADDR A:0xfd838154
y.create.l HWIO_MMSS_XPU2_MMSS_CC_XPU_MESYNR2_ADDR A:0xfd838158
y.create.l HWIO_MMSS_XPU2_MMSS_CC_XPU_CR_ADDR A:0xfd838080
y.create.l HWIO_MMSS_XPU2_MMSS_CC_XPU_RPU_ACR0_ADDR A:0xfd8380a0
y.create.l HWIO_MMSS_XPU2_MMSS_CC_XPU_EAR0_ADDR A:0xfd8380c0
y.create.l HWIO_MMSS_XPU2_MMSS_CC_XPU_ESR_ADDR A:0xfd8380c8
y.create.l HWIO_MMSS_XPU2_MMSS_CC_XPU_ESRRESTORE_ADDR A:0xfd8380cc
y.create.l HWIO_MMSS_XPU2_MMSS_CC_XPU_ESYNR0_ADDR A:0xfd8380d0
y.create.l HWIO_MMSS_XPU2_MMSS_CC_XPU_ESYNR1_ADDR A:0xfd8380d4
y.create.l HWIO_MMSS_XPU2_MMSS_CC_XPU_ESYNR2_ADDR A:0xfd8380d8
y.create.l HWIO_MMSS_XPU2_MMSS_CC_XPU_IDR0_ADDR A:0xfd838074
y.create.l HWIO_MMSS_XPU2_MMSS_CC_XPU_IDR1_ADDR A:0xfd838078
y.create.l HWIO_MMSS_XPU2_MMSS_CC_XPU_REV_ADDR A:0xfd83807c
y.create.l HWIO_MMSS_XPU2_MMSS_CC_XPU_RG0_RACR0_ADDR A:0xfd838200
y.create.l HWIO_MMSS_XPU2_MMSS_CC_XPU_RG1_RACR0_ADDR A:0xfd838280
y.create.l HWIO_MMSS_XPU2_MMSS_CC_XPU_RG2_RACR0_ADDR A:0xfd838300
y.create.l HWIO_MMSS_XPU2_MMSS_CC_XPU_RG3_RACR0_ADDR A:0xfd838380
y.create.l HWIO_MMSS_XPU2_MMSS_CC_XPU_RG4_RACR0_ADDR A:0xfd838400
y.create.l HWIO_MMSS_XPU2_MMSS_CC_XPU_RG5_RACR0_ADDR A:0xfd838480
y.create.l HWIO_MMSS_XPU2_MMSS_CC_XPU_RG0_WACR0_ADDR A:0xfd838220
y.create.l HWIO_MMSS_XPU2_MMSS_CC_XPU_RG1_WACR0_ADDR A:0xfd8382a0
y.create.l HWIO_MMSS_XPU2_MMSS_CC_XPU_RG2_WACR0_ADDR A:0xfd838320
y.create.l HWIO_MMSS_XPU2_MMSS_CC_XPU_RG3_WACR0_ADDR A:0xfd8383a0
y.create.l HWIO_MMSS_XPU2_MMSS_CC_XPU_RG4_WACR0_ADDR A:0xfd838420
y.create.l HWIO_MMSS_XPU2_MMSS_CC_XPU_RG5_WACR0_ADDR A:0xfd8384a0
y.create.l HWIO_MMSS_XPU2_MMSS_CC_XPU_RG0_SCR_ADDR A:0xfd838250
y.create.l HWIO_MMSS_XPU2_MMSS_CC_XPU_RG1_SCR_ADDR A:0xfd8382d0
y.create.l HWIO_MMSS_XPU2_MMSS_CC_XPU_RG2_SCR_ADDR A:0xfd838350
y.create.l HWIO_MMSS_XPU2_MMSS_CC_XPU_RG3_SCR_ADDR A:0xfd8383d0
y.create.l HWIO_MMSS_XPU2_MMSS_CC_XPU_RG4_SCR_ADDR A:0xfd838450
y.create.l HWIO_MMSS_XPU2_MMSS_CC_XPU_RG5_SCR_ADDR A:0xfd8384d0
y.create.l HWIO_MMSS_XPU2_MMSS_CC_XPU_RG0_MCR_ADDR A:0xfd838254
y.create.l HWIO_MMSS_XPU2_MMSS_CC_XPU_RG1_MCR_ADDR A:0xfd8382d4
y.create.l HWIO_MMSS_XPU2_MMSS_CC_XPU_RG2_MCR_ADDR A:0xfd838354
y.create.l HWIO_MMSS_XPU2_MMSS_CC_XPU_RG3_MCR_ADDR A:0xfd8383d4
y.create.l HWIO_MMSS_XPU2_MMSS_CC_XPU_RG4_MCR_ADDR A:0xfd838454
y.create.l HWIO_MMSS_XPU2_MMSS_CC_XPU_RG5_MCR_ADDR A:0xfd8384d4
y.create.l HWIO_MMSS_APU_MMSS_XPU_SCR_ADDR A:0xfd840000
y.create.l HWIO_MMSS_APU_MMSS_XPU_SWDR_ADDR A:0xfd840004
y.create.l HWIO_MMSS_APU_MMSS_XPU_SEAR0_ADDR A:0xfd840040
y.create.l HWIO_MMSS_APU_MMSS_XPU_SESR_ADDR A:0xfd840048
y.create.l HWIO_MMSS_APU_MMSS_XPU_SESRRESTORE_ADDR A:0xfd84004c
y.create.l HWIO_MMSS_APU_MMSS_XPU_SESYNR0_ADDR A:0xfd840050
y.create.l HWIO_MMSS_APU_MMSS_XPU_SESYNR1_ADDR A:0xfd840054
y.create.l HWIO_MMSS_APU_MMSS_XPU_SESYNR2_ADDR A:0xfd840058
y.create.l HWIO_MMSS_APU_MMSS_XPU_MCR_ADDR A:0xfd840100
y.create.l HWIO_MMSS_APU_MMSS_XPU_MEAR0_ADDR A:0xfd840140
y.create.l HWIO_MMSS_APU_MMSS_XPU_MESR_ADDR A:0xfd840148
y.create.l HWIO_MMSS_APU_MMSS_XPU_MESRRESTORE_ADDR A:0xfd84014c
y.create.l HWIO_MMSS_APU_MMSS_XPU_MESYNR0_ADDR A:0xfd840150
y.create.l HWIO_MMSS_APU_MMSS_XPU_MESYNR1_ADDR A:0xfd840154
y.create.l HWIO_MMSS_APU_MMSS_XPU_MESYNR2_ADDR A:0xfd840158
y.create.l HWIO_MMSS_APU_MMSS_XPU_CR_ADDR A:0xfd840080
y.create.l HWIO_MMSS_APU_MMSS_XPU_RPU_ACR0_ADDR A:0xfd8400a0
y.create.l HWIO_MMSS_APU_MMSS_XPU_EAR0_ADDR A:0xfd8400c0
y.create.l HWIO_MMSS_APU_MMSS_XPU_ESR_ADDR A:0xfd8400c8
y.create.l HWIO_MMSS_APU_MMSS_XPU_ESRRESTORE_ADDR A:0xfd8400cc
y.create.l HWIO_MMSS_APU_MMSS_XPU_ESYNR0_ADDR A:0xfd8400d0
y.create.l HWIO_MMSS_APU_MMSS_XPU_ESYNR1_ADDR A:0xfd8400d4
y.create.l HWIO_MMSS_APU_MMSS_XPU_ESYNR2_ADDR A:0xfd8400d8
y.create.l HWIO_MMSS_APU_MMSS_XPU_IDR0_ADDR A:0xfd840074
y.create.l HWIO_MMSS_APU_MMSS_XPU_IDR1_ADDR A:0xfd840078
y.create.l HWIO_MMSS_APU_MMSS_XPU_REV_ADDR A:0xfd84007c
y.create.l HWIO_MMSS_APU_MMSS_XPU_RG0_RACR0_ADDR A:0xfd840200
y.create.l HWIO_MMSS_APU_MMSS_XPU_RG1_RACR0_ADDR A:0xfd840280
y.create.l HWIO_MMSS_APU_MMSS_XPU_RG2_RACR0_ADDR A:0xfd840300
y.create.l HWIO_MMSS_APU_MMSS_XPU_RG3_RACR0_ADDR A:0xfd840380
y.create.l HWIO_MMSS_APU_MMSS_XPU_RG4_RACR0_ADDR A:0xfd840400
y.create.l HWIO_MMSS_APU_MMSS_XPU_RG0_SCR_ADDR A:0xfd840250
y.create.l HWIO_MMSS_APU_MMSS_XPU_RG1_SCR_ADDR A:0xfd8402d0
y.create.l HWIO_MMSS_APU_MMSS_XPU_RG2_SCR_ADDR A:0xfd840350
y.create.l HWIO_MMSS_APU_MMSS_XPU_RG3_SCR_ADDR A:0xfd8403d0
y.create.l HWIO_MMSS_APU_MMSS_XPU_RG4_SCR_ADDR A:0xfd840450
y.create.l HWIO_MMSS_APU_MMSS_XPU_RG0_MCR_ADDR A:0xfd840254
y.create.l HWIO_MMSS_APU_MMSS_XPU_RG1_MCR_ADDR A:0xfd8402d4
y.create.l HWIO_MMSS_APU_MMSS_XPU_RG2_MCR_ADDR A:0xfd840354
y.create.l HWIO_MMSS_APU_MMSS_XPU_RG3_MCR_ADDR A:0xfd8403d4
y.create.l HWIO_MMSS_APU_MMSS_XPU_RG4_MCR_ADDR A:0xfd840454
y.create.l HWIO_MMSS_SMMU_MDPE_SMMUX_CB0_SCTLR_ADDR A:0xfd860000
y.create.l HWIO_MMSS_SMMU_MDPE_SMMUX_CB1_SCTLR_ADDR A:0xfd861000
y.create.l HWIO_MMSS_SMMU_MDPE_SMMUX_CB0_ACTLR_ADDR A:0xfd860004
y.create.l HWIO_MMSS_SMMU_MDPE_SMMUX_CB1_ACTLR_ADDR A:0xfd861004
y.create.l HWIO_MMSS_SMMU_MDPE_SMMUX_CB0_CONTEXTIDR_ADDR A:0xfd860008
y.create.l HWIO_MMSS_SMMU_MDPE_SMMUX_CB1_CONTEXTIDR_ADDR A:0xfd861008
y.create.l HWIO_MMSS_SMMU_MDPE_SMMUX_CB0_TTBR0_ADDR A:0xfd860010
y.create.l HWIO_MMSS_SMMU_MDPE_SMMUX_CB1_TTBR0_ADDR A:0xfd861010
y.create.l HWIO_MMSS_SMMU_MDPE_SMMUX_CB0_TTBR1_ADDR A:0xfd860014
y.create.l HWIO_MMSS_SMMU_MDPE_SMMUX_CB1_TTBR1_ADDR A:0xfd861014
y.create.l HWIO_MMSS_SMMU_MDPE_SMMUX_CB0_TTBCR_ADDR A:0xfd860018
y.create.l HWIO_MMSS_SMMU_MDPE_SMMUX_CB1_TTBCR_ADDR A:0xfd861018
y.create.l HWIO_MMSS_SMMU_MDPE_SMMUX_CB0_PAR_ADDR A:0xfd86001c
y.create.l HWIO_MMSS_SMMU_MDPE_SMMUX_CB1_PAR_ADDR A:0xfd86101c
y.create.l HWIO_MMSS_SMMU_MDPE_SMMUX_CB0_FSR_ADDR A:0xfd860020
y.create.l HWIO_MMSS_SMMU_MDPE_SMMUX_CB1_FSR_ADDR A:0xfd861020
y.create.l HWIO_MMSS_SMMU_MDPE_SMMUX_CB0_FSRRESTORE_ADDR A:0xfd860024
y.create.l HWIO_MMSS_SMMU_MDPE_SMMUX_CB1_FSRRESTORE_ADDR A:0xfd861024
y.create.l HWIO_MMSS_SMMU_MDPE_SMMUX_CB0_FAR_ADDR A:0xfd860028
y.create.l HWIO_MMSS_SMMU_MDPE_SMMUX_CB1_FAR_ADDR A:0xfd861028
y.create.l HWIO_MMSS_SMMU_MDPE_SMMUX_CB0_FSYNR0_ADDR A:0xfd86002c
y.create.l HWIO_MMSS_SMMU_MDPE_SMMUX_CB1_FSYNR0_ADDR A:0xfd86102c
y.create.l HWIO_MMSS_SMMU_MDPE_SMMUX_CB0_FSYNR1_ADDR A:0xfd860030
y.create.l HWIO_MMSS_SMMU_MDPE_SMMUX_CB1_FSYNR1_ADDR A:0xfd861030
y.create.l HWIO_MMSS_SMMU_MDPE_SMMUX_CB0_PRRR_ADDR A:0xfd860034
y.create.l HWIO_MMSS_SMMU_MDPE_SMMUX_CB1_PRRR_ADDR A:0xfd861034
y.create.l HWIO_MMSS_SMMU_MDPE_SMMUX_CB0_NMRR_ADDR A:0xfd860038
y.create.l HWIO_MMSS_SMMU_MDPE_SMMUX_CB1_NMRR_ADDR A:0xfd861038
y.create.l HWIO_MMSS_SMMU_MDPE_SMMUX_CB0_TLBLKCR_ADDR A:0xfd86003c
y.create.l HWIO_MMSS_SMMU_MDPE_SMMUX_CB1_TLBLKCR_ADDR A:0xfd86103c
y.create.l HWIO_MMSS_SMMU_MDPE_SMMUX_CB0_V2PSR_ADDR A:0xfd860040
y.create.l HWIO_MMSS_SMMU_MDPE_SMMUX_CB1_V2PSR_ADDR A:0xfd861040
y.create.l HWIO_MMSS_SMMU_MDPE_SMMUX_CB0_TLBFLPTER_ADDR A:0xfd860044
y.create.l HWIO_MMSS_SMMU_MDPE_SMMUX_CB1_TLBFLPTER_ADDR A:0xfd861044
y.create.l HWIO_MMSS_SMMU_MDPE_SMMUX_CB0_TLBSLPTER_ADDR A:0xfd860048
y.create.l HWIO_MMSS_SMMU_MDPE_SMMUX_CB1_TLBSLPTER_ADDR A:0xfd861048
y.create.l HWIO_MMSS_SMMU_MDPE_SMMUX_CB0_BFBCR_ADDR A:0xfd86004c
y.create.l HWIO_MMSS_SMMU_MDPE_SMMUX_CB1_BFBCR_ADDR A:0xfd86104c
y.create.l HWIO_MMSS_SMMU_MDPE_SMMUX_CB0_TLBIALL_ADDR A:0xfd860800
y.create.l HWIO_MMSS_SMMU_MDPE_SMMUX_CB1_TLBIALL_ADDR A:0xfd861800
y.create.l HWIO_MMSS_SMMU_MDPE_SMMUX_CB0_TLBIASID_ADDR A:0xfd860804
y.create.l HWIO_MMSS_SMMU_MDPE_SMMUX_CB1_TLBIASID_ADDR A:0xfd861804
y.create.l HWIO_MMSS_SMMU_MDPE_SMMUX_CB0_TLBIVA_ADDR A:0xfd860808
y.create.l HWIO_MMSS_SMMU_MDPE_SMMUX_CB1_TLBIVA_ADDR A:0xfd861808
y.create.l HWIO_MMSS_SMMU_MDPE_SMMUX_CB0_TLBIVAA_ADDR A:0xfd86080c
y.create.l HWIO_MMSS_SMMU_MDPE_SMMUX_CB1_TLBIVAA_ADDR A:0xfd86180c
y.create.l HWIO_MMSS_SMMU_MDPE_SMMUX_CB0_V2PRR_ADDR A:0xfd860810
y.create.l HWIO_MMSS_SMMU_MDPE_SMMUX_CB1_V2PRR_ADDR A:0xfd861810
y.create.l HWIO_MMSS_SMMU_MDPE_SMMUX_CB0_V2PPW_ADDR A:0xfd860814
y.create.l HWIO_MMSS_SMMU_MDPE_SMMUX_CB1_V2PPW_ADDR A:0xfd861814
y.create.l HWIO_MMSS_SMMU_MDPE_SMMUX_CB0_V2PUR_ADDR A:0xfd860818
y.create.l HWIO_MMSS_SMMU_MDPE_SMMUX_CB1_V2PUR_ADDR A:0xfd861818
y.create.l HWIO_MMSS_SMMU_MDPE_SMMUX_CB0_V2PUW_ADDR A:0xfd86081c
y.create.l HWIO_MMSS_SMMU_MDPE_SMMUX_CB1_V2PUW_ADDR A:0xfd86181c
y.create.l HWIO_MMSS_SMMU_MDPE_SMMUX_CB0_RESUME_ADDR A:0xfd860820
y.create.l HWIO_MMSS_SMMU_MDPE_SMMUX_CB1_RESUME_ADDR A:0xfd861820
y.create.l HWIO_MMSS_SMMU_MDPE_SMMUX_M2VCBR0_ADDR A:0xfd86f000
y.create.l HWIO_MMSS_SMMU_MDPE_SMMUX_M2VCBR1_ADDR A:0xfd86f004
y.create.l HWIO_MMSS_SMMU_MDPE_SMMUX_M2VCBR2_ADDR A:0xfd86f008
y.create.l HWIO_MMSS_SMMU_MDPE_SMMUX_M2VCBR3_ADDR A:0xfd86f00c
y.create.l HWIO_MMSS_SMMU_MDPE_SMMUX_M2VCBR4_ADDR A:0xfd86f010
y.create.l HWIO_MMSS_SMMU_MDPE_SMMUX_M2VCBR5_ADDR A:0xfd86f014
y.create.l HWIO_MMSS_SMMU_MDPE_SMMUX_M2VCBR6_ADDR A:0xfd86f018
y.create.l HWIO_MMSS_SMMU_MDPE_SMMUX_M2VCBR7_ADDR A:0xfd86f01c
y.create.l HWIO_MMSS_SMMU_MDPE_SMMUX_M2VCBR8_ADDR A:0xfd86f020
y.create.l HWIO_MMSS_SMMU_MDPE_SMMUX_M2VCBR9_ADDR A:0xfd86f024
y.create.l HWIO_MMSS_SMMU_MDPE_SMMUX_CBACR0_ADDR A:0xfd86f800
y.create.l HWIO_MMSS_SMMU_MDPE_SMMUX_CBACR1_ADDR A:0xfd86f804
y.create.l HWIO_MMSS_SMMU_MDPE_SMMUX_CBACR2_ADDR A:0xfd86f808
y.create.l HWIO_MMSS_SMMU_MDPE_SMMUX_CBACR3_ADDR A:0xfd86f80c
y.create.l HWIO_MMSS_SMMU_MDPE_SMMUX_CBACR4_ADDR A:0xfd86f810
y.create.l HWIO_MMSS_SMMU_MDPE_SMMUX_CBACR5_ADDR A:0xfd86f814
y.create.l HWIO_MMSS_SMMU_MDPE_SMMUX_CBACR6_ADDR A:0xfd86f818
y.create.l HWIO_MMSS_SMMU_MDPE_SMMUX_CBACR7_ADDR A:0xfd86f81c
y.create.l HWIO_MMSS_SMMU_MDPE_SMMUX_CBACR8_ADDR A:0xfd86f820
y.create.l HWIO_MMSS_SMMU_MDPE_SMMUX_TLBRSW_ADDR A:0xfd86fe00
y.create.l HWIO_MMSS_SMMU_MDPE_SMMUX_TLBTR0_ADDR A:0xfd86fe80
y.create.l HWIO_MMSS_SMMU_MDPE_SMMUX_TLBTR1_ADDR A:0xfd86fe84
y.create.l HWIO_MMSS_SMMU_MDPE_SMMUX_TLBTR2_ADDR A:0xfd86fe88
y.create.l HWIO_MMSS_SMMU_MDPE_SMMUX_TESTBUSCR_ADDR A:0xfd86fe8c
y.create.l HWIO_MMSS_SMMU_MDPE_SMMUX_VR0_ADDR A:0xfd86fefc
y.create.l HWIO_MMSS_SMMU_MDPE_SMMUX_TLBIALL_ADDR A:0xfd86ff00
y.create.l HWIO_MMSS_SMMU_MDPE_SMMUX_TLBIVMID_ADDR A:0xfd86ff04
y.create.l HWIO_MMSS_SMMU_MDPE_SMMUX_CR_ADDR A:0xfd86ff80
y.create.l HWIO_MMSS_SMMU_MDPE_SMMUX_EAR_ADDR A:0xfd86ff84
y.create.l HWIO_MMSS_SMMU_MDPE_SMMUX_ESR_ADDR A:0xfd86ff88
y.create.l HWIO_MMSS_SMMU_MDPE_SMMUX_ESRRESTORE_ADDR A:0xfd86ff8c
y.create.l HWIO_MMSS_SMMU_MDPE_SMMUX_ESYNR0_ADDR A:0xfd86ff90
y.create.l HWIO_MMSS_SMMU_MDPE_SMMUX_ESYNR1_ADDR A:0xfd86ff94
y.create.l HWIO_MMSS_SMMU_MDPE_SMMUX_REV_ADDR A:0xfd86fff4
y.create.l HWIO_MMSS_SMMU_MDPE_SMMUX_IDR_ADDR A:0xfd86fff8
y.create.l HWIO_MMSS_SMMU_MDPE_SMMUX_RPU_ACR_ADDR A:0xfd86fffc
y.create.l HWIO_MMSS_SMMU_MDPE_SMMU_EMMC_ADDR A:0xfd86e000
y.create.l HWIO_MMSS_SMMU_MDPE_SMMU_EMCS_ADDR A:0xfd86e004
y.create.l HWIO_MMSS_SMMU_MDPE_SMMU_EMCC0_ADDR A:0xfd86e100
y.create.l HWIO_MMSS_SMMU_MDPE_SMMU_EMCC1_ADDR A:0xfd86e104
y.create.l HWIO_MMSS_SMMU_MDPE_SMMU_EMCC2_ADDR A:0xfd86e108
y.create.l HWIO_MMSS_SMMU_MDPE_SMMU_EMCC3_ADDR A:0xfd86e10c
y.create.l HWIO_MMSS_SMMU_MDPE_SMMU_EMC0_ADDR A:0xfd86e200
y.create.l HWIO_MMSS_SMMU_MDPE_SMMU_EMC1_ADDR A:0xfd86e204
y.create.l HWIO_MMSS_SMMU_MDPE_SMMU_EMC2_ADDR A:0xfd86e208
y.create.l HWIO_MMSS_SMMU_MDPE_SMMU_EMC3_ADDR A:0xfd86e20c
y.create.l HWIO_MMSS_SMMU_MDPS_SMMUX_CB0_SCTLR_ADDR A:0xfd870000
y.create.l HWIO_MMSS_SMMU_MDPS_SMMUX_CB1_SCTLR_ADDR A:0xfd871000
y.create.l HWIO_MMSS_SMMU_MDPS_SMMUX_CB0_ACTLR_ADDR A:0xfd870004
y.create.l HWIO_MMSS_SMMU_MDPS_SMMUX_CB1_ACTLR_ADDR A:0xfd871004
y.create.l HWIO_MMSS_SMMU_MDPS_SMMUX_CB0_CONTEXTIDR_ADDR A:0xfd870008
y.create.l HWIO_MMSS_SMMU_MDPS_SMMUX_CB1_CONTEXTIDR_ADDR A:0xfd871008
y.create.l HWIO_MMSS_SMMU_MDPS_SMMUX_CB0_TTBR0_ADDR A:0xfd870010
y.create.l HWIO_MMSS_SMMU_MDPS_SMMUX_CB1_TTBR0_ADDR A:0xfd871010
y.create.l HWIO_MMSS_SMMU_MDPS_SMMUX_CB0_TTBR1_ADDR A:0xfd870014
y.create.l HWIO_MMSS_SMMU_MDPS_SMMUX_CB1_TTBR1_ADDR A:0xfd871014
y.create.l HWIO_MMSS_SMMU_MDPS_SMMUX_CB0_TTBCR_ADDR A:0xfd870018
y.create.l HWIO_MMSS_SMMU_MDPS_SMMUX_CB1_TTBCR_ADDR A:0xfd871018
y.create.l HWIO_MMSS_SMMU_MDPS_SMMUX_CB0_PAR_ADDR A:0xfd87001c
y.create.l HWIO_MMSS_SMMU_MDPS_SMMUX_CB1_PAR_ADDR A:0xfd87101c
y.create.l HWIO_MMSS_SMMU_MDPS_SMMUX_CB0_FSR_ADDR A:0xfd870020
y.create.l HWIO_MMSS_SMMU_MDPS_SMMUX_CB1_FSR_ADDR A:0xfd871020
y.create.l HWIO_MMSS_SMMU_MDPS_SMMUX_CB0_FSRRESTORE_ADDR A:0xfd870024
y.create.l HWIO_MMSS_SMMU_MDPS_SMMUX_CB1_FSRRESTORE_ADDR A:0xfd871024
y.create.l HWIO_MMSS_SMMU_MDPS_SMMUX_CB0_FAR_ADDR A:0xfd870028
y.create.l HWIO_MMSS_SMMU_MDPS_SMMUX_CB1_FAR_ADDR A:0xfd871028
y.create.l HWIO_MMSS_SMMU_MDPS_SMMUX_CB0_FSYNR0_ADDR A:0xfd87002c
y.create.l HWIO_MMSS_SMMU_MDPS_SMMUX_CB1_FSYNR0_ADDR A:0xfd87102c
y.create.l HWIO_MMSS_SMMU_MDPS_SMMUX_CB0_FSYNR1_ADDR A:0xfd870030
y.create.l HWIO_MMSS_SMMU_MDPS_SMMUX_CB1_FSYNR1_ADDR A:0xfd871030
y.create.l HWIO_MMSS_SMMU_MDPS_SMMUX_CB0_PRRR_ADDR A:0xfd870034
y.create.l HWIO_MMSS_SMMU_MDPS_SMMUX_CB1_PRRR_ADDR A:0xfd871034
y.create.l HWIO_MMSS_SMMU_MDPS_SMMUX_CB0_NMRR_ADDR A:0xfd870038
y.create.l HWIO_MMSS_SMMU_MDPS_SMMUX_CB1_NMRR_ADDR A:0xfd871038
y.create.l HWIO_MMSS_SMMU_MDPS_SMMUX_CB0_TLBLKCR_ADDR A:0xfd87003c
y.create.l HWIO_MMSS_SMMU_MDPS_SMMUX_CB1_TLBLKCR_ADDR A:0xfd87103c
y.create.l HWIO_MMSS_SMMU_MDPS_SMMUX_CB0_V2PSR_ADDR A:0xfd870040
y.create.l HWIO_MMSS_SMMU_MDPS_SMMUX_CB1_V2PSR_ADDR A:0xfd871040
y.create.l HWIO_MMSS_SMMU_MDPS_SMMUX_CB0_TLBFLPTER_ADDR A:0xfd870044
y.create.l HWIO_MMSS_SMMU_MDPS_SMMUX_CB1_TLBFLPTER_ADDR A:0xfd871044
y.create.l HWIO_MMSS_SMMU_MDPS_SMMUX_CB0_TLBSLPTER_ADDR A:0xfd870048
y.create.l HWIO_MMSS_SMMU_MDPS_SMMUX_CB1_TLBSLPTER_ADDR A:0xfd871048
y.create.l HWIO_MMSS_SMMU_MDPS_SMMUX_CB0_BFBCR_ADDR A:0xfd87004c
y.create.l HWIO_MMSS_SMMU_MDPS_SMMUX_CB1_BFBCR_ADDR A:0xfd87104c
y.create.l HWIO_MMSS_SMMU_MDPS_SMMUX_CB0_TLBIALL_ADDR A:0xfd870800
y.create.l HWIO_MMSS_SMMU_MDPS_SMMUX_CB1_TLBIALL_ADDR A:0xfd871800
y.create.l HWIO_MMSS_SMMU_MDPS_SMMUX_CB0_TLBIASID_ADDR A:0xfd870804
y.create.l HWIO_MMSS_SMMU_MDPS_SMMUX_CB1_TLBIASID_ADDR A:0xfd871804
y.create.l HWIO_MMSS_SMMU_MDPS_SMMUX_CB0_TLBIVA_ADDR A:0xfd870808
y.create.l HWIO_MMSS_SMMU_MDPS_SMMUX_CB1_TLBIVA_ADDR A:0xfd871808
y.create.l HWIO_MMSS_SMMU_MDPS_SMMUX_CB0_TLBIVAA_ADDR A:0xfd87080c
y.create.l HWIO_MMSS_SMMU_MDPS_SMMUX_CB1_TLBIVAA_ADDR A:0xfd87180c
y.create.l HWIO_MMSS_SMMU_MDPS_SMMUX_CB0_V2PRR_ADDR A:0xfd870810
y.create.l HWIO_MMSS_SMMU_MDPS_SMMUX_CB1_V2PRR_ADDR A:0xfd871810
y.create.l HWIO_MMSS_SMMU_MDPS_SMMUX_CB0_V2PPW_ADDR A:0xfd870814
y.create.l HWIO_MMSS_SMMU_MDPS_SMMUX_CB1_V2PPW_ADDR A:0xfd871814
y.create.l HWIO_MMSS_SMMU_MDPS_SMMUX_CB0_V2PUR_ADDR A:0xfd870818
y.create.l HWIO_MMSS_SMMU_MDPS_SMMUX_CB1_V2PUR_ADDR A:0xfd871818
y.create.l HWIO_MMSS_SMMU_MDPS_SMMUX_CB0_V2PUW_ADDR A:0xfd87081c
y.create.l HWIO_MMSS_SMMU_MDPS_SMMUX_CB1_V2PUW_ADDR A:0xfd87181c
y.create.l HWIO_MMSS_SMMU_MDPS_SMMUX_CB0_RESUME_ADDR A:0xfd870820
y.create.l HWIO_MMSS_SMMU_MDPS_SMMUX_CB1_RESUME_ADDR A:0xfd871820
y.create.l HWIO_MMSS_SMMU_MDPS_SMMUX_M2VCBR0_ADDR A:0xfd87f000
y.create.l HWIO_MMSS_SMMU_MDPS_SMMUX_M2VCBR1_ADDR A:0xfd87f004
y.create.l HWIO_MMSS_SMMU_MDPS_SMMUX_M2VCBR2_ADDR A:0xfd87f008
y.create.l HWIO_MMSS_SMMU_MDPS_SMMUX_M2VCBR3_ADDR A:0xfd87f00c
y.create.l HWIO_MMSS_SMMU_MDPS_SMMUX_M2VCBR4_ADDR A:0xfd87f010
y.create.l HWIO_MMSS_SMMU_MDPS_SMMUX_M2VCBR5_ADDR A:0xfd87f014
y.create.l HWIO_MMSS_SMMU_MDPS_SMMUX_M2VCBR6_ADDR A:0xfd87f018
y.create.l HWIO_MMSS_SMMU_MDPS_SMMUX_M2VCBR7_ADDR A:0xfd87f01c
y.create.l HWIO_MMSS_SMMU_MDPS_SMMUX_M2VCBR8_ADDR A:0xfd87f020
y.create.l HWIO_MMSS_SMMU_MDPS_SMMUX_M2VCBR9_ADDR A:0xfd87f024
y.create.l HWIO_MMSS_SMMU_MDPS_SMMUX_CBACR0_ADDR A:0xfd87f800
y.create.l HWIO_MMSS_SMMU_MDPS_SMMUX_CBACR1_ADDR A:0xfd87f804
y.create.l HWIO_MMSS_SMMU_MDPS_SMMUX_CBACR2_ADDR A:0xfd87f808
y.create.l HWIO_MMSS_SMMU_MDPS_SMMUX_CBACR3_ADDR A:0xfd87f80c
y.create.l HWIO_MMSS_SMMU_MDPS_SMMUX_CBACR4_ADDR A:0xfd87f810
y.create.l HWIO_MMSS_SMMU_MDPS_SMMUX_CBACR5_ADDR A:0xfd87f814
y.create.l HWIO_MMSS_SMMU_MDPS_SMMUX_CBACR6_ADDR A:0xfd87f818
y.create.l HWIO_MMSS_SMMU_MDPS_SMMUX_CBACR7_ADDR A:0xfd87f81c
y.create.l HWIO_MMSS_SMMU_MDPS_SMMUX_CBACR8_ADDR A:0xfd87f820
y.create.l HWIO_MMSS_SMMU_MDPS_SMMUX_TLBRSW_ADDR A:0xfd87fe00
y.create.l HWIO_MMSS_SMMU_MDPS_SMMUX_TLBTR0_ADDR A:0xfd87fe80
y.create.l HWIO_MMSS_SMMU_MDPS_SMMUX_TLBTR1_ADDR A:0xfd87fe84
y.create.l HWIO_MMSS_SMMU_MDPS_SMMUX_TLBTR2_ADDR A:0xfd87fe88
y.create.l HWIO_MMSS_SMMU_MDPS_SMMUX_TESTBUSCR_ADDR A:0xfd87fe8c
y.create.l HWIO_MMSS_SMMU_MDPS_SMMUX_VR0_ADDR A:0xfd87fefc
y.create.l HWIO_MMSS_SMMU_MDPS_SMMUX_TLBIALL_ADDR A:0xfd87ff00
y.create.l HWIO_MMSS_SMMU_MDPS_SMMUX_TLBIVMID_ADDR A:0xfd87ff04
y.create.l HWIO_MMSS_SMMU_MDPS_SMMUX_CR_ADDR A:0xfd87ff80
y.create.l HWIO_MMSS_SMMU_MDPS_SMMUX_EAR_ADDR A:0xfd87ff84
y.create.l HWIO_MMSS_SMMU_MDPS_SMMUX_ESR_ADDR A:0xfd87ff88
y.create.l HWIO_MMSS_SMMU_MDPS_SMMUX_ESRRESTORE_ADDR A:0xfd87ff8c
y.create.l HWIO_MMSS_SMMU_MDPS_SMMUX_ESYNR0_ADDR A:0xfd87ff90
y.create.l HWIO_MMSS_SMMU_MDPS_SMMUX_ESYNR1_ADDR A:0xfd87ff94
y.create.l HWIO_MMSS_SMMU_MDPS_SMMUX_REV_ADDR A:0xfd87fff4
y.create.l HWIO_MMSS_SMMU_MDPS_SMMUX_IDR_ADDR A:0xfd87fff8
y.create.l HWIO_MMSS_SMMU_MDPS_SMMUX_RPU_ACR_ADDR A:0xfd87fffc
y.create.l HWIO_MMSS_SMMU_MDPS_SMMU_EMMC_ADDR A:0xfd87e000
y.create.l HWIO_MMSS_SMMU_MDPS_SMMU_EMCS_ADDR A:0xfd87e004
y.create.l HWIO_MMSS_SMMU_MDPS_SMMU_EMCC0_ADDR A:0xfd87e100
y.create.l HWIO_MMSS_SMMU_MDPS_SMMU_EMCC1_ADDR A:0xfd87e104
y.create.l HWIO_MMSS_SMMU_MDPS_SMMU_EMCC2_ADDR A:0xfd87e108
y.create.l HWIO_MMSS_SMMU_MDPS_SMMU_EMCC3_ADDR A:0xfd87e10c
y.create.l HWIO_MMSS_SMMU_MDPS_SMMU_EMC0_ADDR A:0xfd87e200
y.create.l HWIO_MMSS_SMMU_MDPS_SMMU_EMC1_ADDR A:0xfd87e204
y.create.l HWIO_MMSS_SMMU_MDPS_SMMU_EMC2_ADDR A:0xfd87e208
y.create.l HWIO_MMSS_SMMU_MDPS_SMMU_EMC3_ADDR A:0xfd87e20c
y.create.l HWIO_MMSS_SMMU_GFX_SMMUX_CB0_SCTLR_ADDR A:0xfd880000
y.create.l HWIO_MMSS_SMMU_GFX_SMMUX_CB1_SCTLR_ADDR A:0xfd881000
y.create.l HWIO_MMSS_SMMU_GFX_SMMUX_CB2_SCTLR_ADDR A:0xfd882000
y.create.l HWIO_MMSS_SMMU_GFX_SMMUX_CB0_ACTLR_ADDR A:0xfd880004
y.create.l HWIO_MMSS_SMMU_GFX_SMMUX_CB1_ACTLR_ADDR A:0xfd881004
y.create.l HWIO_MMSS_SMMU_GFX_SMMUX_CB2_ACTLR_ADDR A:0xfd882004
y.create.l HWIO_MMSS_SMMU_GFX_SMMUX_CB0_CONTEXTIDR_ADDR A:0xfd880008
y.create.l HWIO_MMSS_SMMU_GFX_SMMUX_CB1_CONTEXTIDR_ADDR A:0xfd881008
y.create.l HWIO_MMSS_SMMU_GFX_SMMUX_CB2_CONTEXTIDR_ADDR A:0xfd882008
y.create.l HWIO_MMSS_SMMU_GFX_SMMUX_CB0_TTBR0_ADDR A:0xfd880010
y.create.l HWIO_MMSS_SMMU_GFX_SMMUX_CB1_TTBR0_ADDR A:0xfd881010
y.create.l HWIO_MMSS_SMMU_GFX_SMMUX_CB2_TTBR0_ADDR A:0xfd882010
y.create.l HWIO_MMSS_SMMU_GFX_SMMUX_CB0_TTBR1_ADDR A:0xfd880014
y.create.l HWIO_MMSS_SMMU_GFX_SMMUX_CB1_TTBR1_ADDR A:0xfd881014
y.create.l HWIO_MMSS_SMMU_GFX_SMMUX_CB2_TTBR1_ADDR A:0xfd882014
y.create.l HWIO_MMSS_SMMU_GFX_SMMUX_CB0_TTBCR_ADDR A:0xfd880018
y.create.l HWIO_MMSS_SMMU_GFX_SMMUX_CB1_TTBCR_ADDR A:0xfd881018
y.create.l HWIO_MMSS_SMMU_GFX_SMMUX_CB2_TTBCR_ADDR A:0xfd882018
y.create.l HWIO_MMSS_SMMU_GFX_SMMUX_CB0_PAR_ADDR A:0xfd88001c
y.create.l HWIO_MMSS_SMMU_GFX_SMMUX_CB1_PAR_ADDR A:0xfd88101c
y.create.l HWIO_MMSS_SMMU_GFX_SMMUX_CB2_PAR_ADDR A:0xfd88201c
y.create.l HWIO_MMSS_SMMU_GFX_SMMUX_CB0_FSR_ADDR A:0xfd880020
y.create.l HWIO_MMSS_SMMU_GFX_SMMUX_CB1_FSR_ADDR A:0xfd881020
y.create.l HWIO_MMSS_SMMU_GFX_SMMUX_CB2_FSR_ADDR A:0xfd882020
y.create.l HWIO_MMSS_SMMU_GFX_SMMUX_CB0_FSRRESTORE_ADDR A:0xfd880024
y.create.l HWIO_MMSS_SMMU_GFX_SMMUX_CB1_FSRRESTORE_ADDR A:0xfd881024
y.create.l HWIO_MMSS_SMMU_GFX_SMMUX_CB2_FSRRESTORE_ADDR A:0xfd882024
y.create.l HWIO_MMSS_SMMU_GFX_SMMUX_CB0_FAR_ADDR A:0xfd880028
y.create.l HWIO_MMSS_SMMU_GFX_SMMUX_CB1_FAR_ADDR A:0xfd881028
y.create.l HWIO_MMSS_SMMU_GFX_SMMUX_CB2_FAR_ADDR A:0xfd882028
y.create.l HWIO_MMSS_SMMU_GFX_SMMUX_CB0_FSYNR0_ADDR A:0xfd88002c
y.create.l HWIO_MMSS_SMMU_GFX_SMMUX_CB1_FSYNR0_ADDR A:0xfd88102c
y.create.l HWIO_MMSS_SMMU_GFX_SMMUX_CB2_FSYNR0_ADDR A:0xfd88202c
y.create.l HWIO_MMSS_SMMU_GFX_SMMUX_CB0_FSYNR1_ADDR A:0xfd880030
y.create.l HWIO_MMSS_SMMU_GFX_SMMUX_CB1_FSYNR1_ADDR A:0xfd881030
y.create.l HWIO_MMSS_SMMU_GFX_SMMUX_CB2_FSYNR1_ADDR A:0xfd882030
y.create.l HWIO_MMSS_SMMU_GFX_SMMUX_CB0_PRRR_ADDR A:0xfd880034
y.create.l HWIO_MMSS_SMMU_GFX_SMMUX_CB1_PRRR_ADDR A:0xfd881034
y.create.l HWIO_MMSS_SMMU_GFX_SMMUX_CB2_PRRR_ADDR A:0xfd882034
y.create.l HWIO_MMSS_SMMU_GFX_SMMUX_CB0_NMRR_ADDR A:0xfd880038
y.create.l HWIO_MMSS_SMMU_GFX_SMMUX_CB1_NMRR_ADDR A:0xfd881038
y.create.l HWIO_MMSS_SMMU_GFX_SMMUX_CB2_NMRR_ADDR A:0xfd882038
y.create.l HWIO_MMSS_SMMU_GFX_SMMUX_CB0_TLBLKCR_ADDR A:0xfd88003c
y.create.l HWIO_MMSS_SMMU_GFX_SMMUX_CB1_TLBLKCR_ADDR A:0xfd88103c
y.create.l HWIO_MMSS_SMMU_GFX_SMMUX_CB2_TLBLKCR_ADDR A:0xfd88203c
y.create.l HWIO_MMSS_SMMU_GFX_SMMUX_CB0_V2PSR_ADDR A:0xfd880040
y.create.l HWIO_MMSS_SMMU_GFX_SMMUX_CB1_V2PSR_ADDR A:0xfd881040
y.create.l HWIO_MMSS_SMMU_GFX_SMMUX_CB2_V2PSR_ADDR A:0xfd882040
y.create.l HWIO_MMSS_SMMU_GFX_SMMUX_CB0_TLBFLPTER_ADDR A:0xfd880044
y.create.l HWIO_MMSS_SMMU_GFX_SMMUX_CB1_TLBFLPTER_ADDR A:0xfd881044
y.create.l HWIO_MMSS_SMMU_GFX_SMMUX_CB2_TLBFLPTER_ADDR A:0xfd882044
y.create.l HWIO_MMSS_SMMU_GFX_SMMUX_CB0_TLBSLPTER_ADDR A:0xfd880048
y.create.l HWIO_MMSS_SMMU_GFX_SMMUX_CB1_TLBSLPTER_ADDR A:0xfd881048
y.create.l HWIO_MMSS_SMMU_GFX_SMMUX_CB2_TLBSLPTER_ADDR A:0xfd882048
y.create.l HWIO_MMSS_SMMU_GFX_SMMUX_CB0_BFBCR_ADDR A:0xfd88004c
y.create.l HWIO_MMSS_SMMU_GFX_SMMUX_CB1_BFBCR_ADDR A:0xfd88104c
y.create.l HWIO_MMSS_SMMU_GFX_SMMUX_CB2_BFBCR_ADDR A:0xfd88204c
y.create.l HWIO_MMSS_SMMU_GFX_SMMUX_CB0_TLBIALL_ADDR A:0xfd880800
y.create.l HWIO_MMSS_SMMU_GFX_SMMUX_CB1_TLBIALL_ADDR A:0xfd881800
y.create.l HWIO_MMSS_SMMU_GFX_SMMUX_CB2_TLBIALL_ADDR A:0xfd882800
y.create.l HWIO_MMSS_SMMU_GFX_SMMUX_CB0_TLBIASID_ADDR A:0xfd880804
y.create.l HWIO_MMSS_SMMU_GFX_SMMUX_CB1_TLBIASID_ADDR A:0xfd881804
y.create.l HWIO_MMSS_SMMU_GFX_SMMUX_CB2_TLBIASID_ADDR A:0xfd882804
y.create.l HWIO_MMSS_SMMU_GFX_SMMUX_CB0_TLBIVA_ADDR A:0xfd880808
y.create.l HWIO_MMSS_SMMU_GFX_SMMUX_CB1_TLBIVA_ADDR A:0xfd881808
y.create.l HWIO_MMSS_SMMU_GFX_SMMUX_CB2_TLBIVA_ADDR A:0xfd882808
y.create.l HWIO_MMSS_SMMU_GFX_SMMUX_CB0_TLBIVAA_ADDR A:0xfd88080c
y.create.l HWIO_MMSS_SMMU_GFX_SMMUX_CB1_TLBIVAA_ADDR A:0xfd88180c
y.create.l HWIO_MMSS_SMMU_GFX_SMMUX_CB2_TLBIVAA_ADDR A:0xfd88280c
y.create.l HWIO_MMSS_SMMU_GFX_SMMUX_CB0_V2PRR_ADDR A:0xfd880810
y.create.l HWIO_MMSS_SMMU_GFX_SMMUX_CB1_V2PRR_ADDR A:0xfd881810
y.create.l HWIO_MMSS_SMMU_GFX_SMMUX_CB2_V2PRR_ADDR A:0xfd882810
y.create.l HWIO_MMSS_SMMU_GFX_SMMUX_CB0_V2PPW_ADDR A:0xfd880814
y.create.l HWIO_MMSS_SMMU_GFX_SMMUX_CB1_V2PPW_ADDR A:0xfd881814
y.create.l HWIO_MMSS_SMMU_GFX_SMMUX_CB2_V2PPW_ADDR A:0xfd882814
y.create.l HWIO_MMSS_SMMU_GFX_SMMUX_CB0_V2PUR_ADDR A:0xfd880818
y.create.l HWIO_MMSS_SMMU_GFX_SMMUX_CB1_V2PUR_ADDR A:0xfd881818
y.create.l HWIO_MMSS_SMMU_GFX_SMMUX_CB2_V2PUR_ADDR A:0xfd882818
y.create.l HWIO_MMSS_SMMU_GFX_SMMUX_CB0_V2PUW_ADDR A:0xfd88081c
y.create.l HWIO_MMSS_SMMU_GFX_SMMUX_CB1_V2PUW_ADDR A:0xfd88181c
y.create.l HWIO_MMSS_SMMU_GFX_SMMUX_CB2_V2PUW_ADDR A:0xfd88281c
y.create.l HWIO_MMSS_SMMU_GFX_SMMUX_CB0_RESUME_ADDR A:0xfd880820
y.create.l HWIO_MMSS_SMMU_GFX_SMMUX_CB1_RESUME_ADDR A:0xfd881820
y.create.l HWIO_MMSS_SMMU_GFX_SMMUX_CB2_RESUME_ADDR A:0xfd882820
y.create.l HWIO_MMSS_SMMU_GFX_SMMUX_M2VCBR0_ADDR A:0xfd88f000
y.create.l HWIO_MMSS_SMMU_GFX_SMMUX_M2VCBR1_ADDR A:0xfd88f004
y.create.l HWIO_MMSS_SMMU_GFX_SMMUX_M2VCBR2_ADDR A:0xfd88f008
y.create.l HWIO_MMSS_SMMU_GFX_SMMUX_M2VCBR3_ADDR A:0xfd88f00c
y.create.l HWIO_MMSS_SMMU_GFX_SMMUX_M2VCBR4_ADDR A:0xfd88f010
y.create.l HWIO_MMSS_SMMU_GFX_SMMUX_M2VCBR5_ADDR A:0xfd88f014
y.create.l HWIO_MMSS_SMMU_GFX_SMMUX_M2VCBR6_ADDR A:0xfd88f018
y.create.l HWIO_MMSS_SMMU_GFX_SMMUX_M2VCBR7_ADDR A:0xfd88f01c
y.create.l HWIO_MMSS_SMMU_GFX_SMMUX_M2VCBR8_ADDR A:0xfd88f020
y.create.l HWIO_MMSS_SMMU_GFX_SMMUX_M2VCBR9_ADDR A:0xfd88f024
y.create.l HWIO_MMSS_SMMU_GFX_SMMUX_CBACR0_ADDR A:0xfd88f800
y.create.l HWIO_MMSS_SMMU_GFX_SMMUX_CBACR1_ADDR A:0xfd88f804
y.create.l HWIO_MMSS_SMMU_GFX_SMMUX_CBACR2_ADDR A:0xfd88f808
y.create.l HWIO_MMSS_SMMU_GFX_SMMUX_CBACR3_ADDR A:0xfd88f80c
y.create.l HWIO_MMSS_SMMU_GFX_SMMUX_CBACR4_ADDR A:0xfd88f810
y.create.l HWIO_MMSS_SMMU_GFX_SMMUX_CBACR5_ADDR A:0xfd88f814
y.create.l HWIO_MMSS_SMMU_GFX_SMMUX_CBACR6_ADDR A:0xfd88f818
y.create.l HWIO_MMSS_SMMU_GFX_SMMUX_CBACR7_ADDR A:0xfd88f81c
y.create.l HWIO_MMSS_SMMU_GFX_SMMUX_CBACR8_ADDR A:0xfd88f820
y.create.l HWIO_MMSS_SMMU_GFX_SMMUX_TLBRSW_ADDR A:0xfd88fe00
y.create.l HWIO_MMSS_SMMU_GFX_SMMUX_TLBTR0_ADDR A:0xfd88fe80
y.create.l HWIO_MMSS_SMMU_GFX_SMMUX_TLBTR1_ADDR A:0xfd88fe84
y.create.l HWIO_MMSS_SMMU_GFX_SMMUX_TLBTR2_ADDR A:0xfd88fe88
y.create.l HWIO_MMSS_SMMU_GFX_SMMUX_TESTBUSCR_ADDR A:0xfd88fe8c
y.create.l HWIO_MMSS_SMMU_GFX_SMMUX_VR0_ADDR A:0xfd88fefc
y.create.l HWIO_MMSS_SMMU_GFX_SMMUX_TLBIALL_ADDR A:0xfd88ff00
y.create.l HWIO_MMSS_SMMU_GFX_SMMUX_TLBIVMID_ADDR A:0xfd88ff04
y.create.l HWIO_MMSS_SMMU_GFX_SMMUX_CR_ADDR A:0xfd88ff80
y.create.l HWIO_MMSS_SMMU_GFX_SMMUX_EAR_ADDR A:0xfd88ff84
y.create.l HWIO_MMSS_SMMU_GFX_SMMUX_ESR_ADDR A:0xfd88ff88
y.create.l HWIO_MMSS_SMMU_GFX_SMMUX_ESRRESTORE_ADDR A:0xfd88ff8c
y.create.l HWIO_MMSS_SMMU_GFX_SMMUX_ESYNR0_ADDR A:0xfd88ff90
y.create.l HWIO_MMSS_SMMU_GFX_SMMUX_ESYNR1_ADDR A:0xfd88ff94
y.create.l HWIO_MMSS_SMMU_GFX_SMMUX_REV_ADDR A:0xfd88fff4
y.create.l HWIO_MMSS_SMMU_GFX_SMMUX_IDR_ADDR A:0xfd88fff8
y.create.l HWIO_MMSS_SMMU_GFX_SMMUX_RPU_ACR_ADDR A:0xfd88fffc
y.create.l HWIO_MMSS_SMMU_GFX_SMMU_EMMC_ADDR A:0xfd88e000
y.create.l HWIO_MMSS_SMMU_GFX_SMMU_EMCS_ADDR A:0xfd88e004
y.create.l HWIO_MMSS_SMMU_GFX_SMMU_EMCC0_ADDR A:0xfd88e100
y.create.l HWIO_MMSS_SMMU_GFX_SMMU_EMCC1_ADDR A:0xfd88e104
y.create.l HWIO_MMSS_SMMU_GFX_SMMU_EMCC2_ADDR A:0xfd88e108
y.create.l HWIO_MMSS_SMMU_GFX_SMMU_EMCC3_ADDR A:0xfd88e10c
y.create.l HWIO_MMSS_SMMU_GFX_SMMU_EMC0_ADDR A:0xfd88e200
y.create.l HWIO_MMSS_SMMU_GFX_SMMU_EMC1_ADDR A:0xfd88e204
y.create.l HWIO_MMSS_SMMU_GFX_SMMU_EMC2_ADDR A:0xfd88e208
y.create.l HWIO_MMSS_SMMU_GFX_SMMU_EMC3_ADDR A:0xfd88e20c
y.create.l HWIO_MMSS_SMMU_VFE_SMMUX_CB0_SCTLR_ADDR A:0xfd890000
y.create.l HWIO_MMSS_SMMU_VFE_SMMUX_CB1_SCTLR_ADDR A:0xfd891000
y.create.l HWIO_MMSS_SMMU_VFE_SMMUX_CB0_ACTLR_ADDR A:0xfd890004
y.create.l HWIO_MMSS_SMMU_VFE_SMMUX_CB1_ACTLR_ADDR A:0xfd891004
y.create.l HWIO_MMSS_SMMU_VFE_SMMUX_CB0_CONTEXTIDR_ADDR A:0xfd890008
y.create.l HWIO_MMSS_SMMU_VFE_SMMUX_CB1_CONTEXTIDR_ADDR A:0xfd891008
y.create.l HWIO_MMSS_SMMU_VFE_SMMUX_CB0_TTBR0_ADDR A:0xfd890010
y.create.l HWIO_MMSS_SMMU_VFE_SMMUX_CB1_TTBR0_ADDR A:0xfd891010
y.create.l HWIO_MMSS_SMMU_VFE_SMMUX_CB0_TTBR1_ADDR A:0xfd890014
y.create.l HWIO_MMSS_SMMU_VFE_SMMUX_CB1_TTBR1_ADDR A:0xfd891014
y.create.l HWIO_MMSS_SMMU_VFE_SMMUX_CB0_TTBCR_ADDR A:0xfd890018
y.create.l HWIO_MMSS_SMMU_VFE_SMMUX_CB1_TTBCR_ADDR A:0xfd891018
y.create.l HWIO_MMSS_SMMU_VFE_SMMUX_CB0_PAR_ADDR A:0xfd89001c
y.create.l HWIO_MMSS_SMMU_VFE_SMMUX_CB1_PAR_ADDR A:0xfd89101c
y.create.l HWIO_MMSS_SMMU_VFE_SMMUX_CB0_FSR_ADDR A:0xfd890020
y.create.l HWIO_MMSS_SMMU_VFE_SMMUX_CB1_FSR_ADDR A:0xfd891020
y.create.l HWIO_MMSS_SMMU_VFE_SMMUX_CB0_FSRRESTORE_ADDR A:0xfd890024
y.create.l HWIO_MMSS_SMMU_VFE_SMMUX_CB1_FSRRESTORE_ADDR A:0xfd891024
y.create.l HWIO_MMSS_SMMU_VFE_SMMUX_CB0_FAR_ADDR A:0xfd890028
y.create.l HWIO_MMSS_SMMU_VFE_SMMUX_CB1_FAR_ADDR A:0xfd891028
y.create.l HWIO_MMSS_SMMU_VFE_SMMUX_CB0_FSYNR0_ADDR A:0xfd89002c
y.create.l HWIO_MMSS_SMMU_VFE_SMMUX_CB1_FSYNR0_ADDR A:0xfd89102c
y.create.l HWIO_MMSS_SMMU_VFE_SMMUX_CB0_FSYNR1_ADDR A:0xfd890030
y.create.l HWIO_MMSS_SMMU_VFE_SMMUX_CB1_FSYNR1_ADDR A:0xfd891030
y.create.l HWIO_MMSS_SMMU_VFE_SMMUX_CB0_PRRR_ADDR A:0xfd890034
y.create.l HWIO_MMSS_SMMU_VFE_SMMUX_CB1_PRRR_ADDR A:0xfd891034
y.create.l HWIO_MMSS_SMMU_VFE_SMMUX_CB0_NMRR_ADDR A:0xfd890038
y.create.l HWIO_MMSS_SMMU_VFE_SMMUX_CB1_NMRR_ADDR A:0xfd891038
y.create.l HWIO_MMSS_SMMU_VFE_SMMUX_CB0_TLBLKCR_ADDR A:0xfd89003c
y.create.l HWIO_MMSS_SMMU_VFE_SMMUX_CB1_TLBLKCR_ADDR A:0xfd89103c
y.create.l HWIO_MMSS_SMMU_VFE_SMMUX_CB0_V2PSR_ADDR A:0xfd890040
y.create.l HWIO_MMSS_SMMU_VFE_SMMUX_CB1_V2PSR_ADDR A:0xfd891040
y.create.l HWIO_MMSS_SMMU_VFE_SMMUX_CB0_TLBFLPTER_ADDR A:0xfd890044
y.create.l HWIO_MMSS_SMMU_VFE_SMMUX_CB1_TLBFLPTER_ADDR A:0xfd891044
y.create.l HWIO_MMSS_SMMU_VFE_SMMUX_CB0_TLBSLPTER_ADDR A:0xfd890048
y.create.l HWIO_MMSS_SMMU_VFE_SMMUX_CB1_TLBSLPTER_ADDR A:0xfd891048
y.create.l HWIO_MMSS_SMMU_VFE_SMMUX_CB0_BFBCR_ADDR A:0xfd89004c
y.create.l HWIO_MMSS_SMMU_VFE_SMMUX_CB1_BFBCR_ADDR A:0xfd89104c
y.create.l HWIO_MMSS_SMMU_VFE_SMMUX_CB0_TLBIALL_ADDR A:0xfd890800
y.create.l HWIO_MMSS_SMMU_VFE_SMMUX_CB1_TLBIALL_ADDR A:0xfd891800
y.create.l HWIO_MMSS_SMMU_VFE_SMMUX_CB0_TLBIASID_ADDR A:0xfd890804
y.create.l HWIO_MMSS_SMMU_VFE_SMMUX_CB1_TLBIASID_ADDR A:0xfd891804
y.create.l HWIO_MMSS_SMMU_VFE_SMMUX_CB0_TLBIVA_ADDR A:0xfd890808
y.create.l HWIO_MMSS_SMMU_VFE_SMMUX_CB1_TLBIVA_ADDR A:0xfd891808
y.create.l HWIO_MMSS_SMMU_VFE_SMMUX_CB0_TLBIVAA_ADDR A:0xfd89080c
y.create.l HWIO_MMSS_SMMU_VFE_SMMUX_CB1_TLBIVAA_ADDR A:0xfd89180c
y.create.l HWIO_MMSS_SMMU_VFE_SMMUX_CB0_V2PRR_ADDR A:0xfd890810
y.create.l HWIO_MMSS_SMMU_VFE_SMMUX_CB1_V2PRR_ADDR A:0xfd891810
y.create.l HWIO_MMSS_SMMU_VFE_SMMUX_CB0_V2PPW_ADDR A:0xfd890814
y.create.l HWIO_MMSS_SMMU_VFE_SMMUX_CB1_V2PPW_ADDR A:0xfd891814
y.create.l HWIO_MMSS_SMMU_VFE_SMMUX_CB0_V2PUR_ADDR A:0xfd890818
y.create.l HWIO_MMSS_SMMU_VFE_SMMUX_CB1_V2PUR_ADDR A:0xfd891818
y.create.l HWIO_MMSS_SMMU_VFE_SMMUX_CB0_V2PUW_ADDR A:0xfd89081c
y.create.l HWIO_MMSS_SMMU_VFE_SMMUX_CB1_V2PUW_ADDR A:0xfd89181c
y.create.l HWIO_MMSS_SMMU_VFE_SMMUX_CB0_RESUME_ADDR A:0xfd890820
y.create.l HWIO_MMSS_SMMU_VFE_SMMUX_CB1_RESUME_ADDR A:0xfd891820
y.create.l HWIO_MMSS_SMMU_VFE_SMMUX_M2VCBR0_ADDR A:0xfd89f000
y.create.l HWIO_MMSS_SMMU_VFE_SMMUX_M2VCBR1_ADDR A:0xfd89f004
y.create.l HWIO_MMSS_SMMU_VFE_SMMUX_M2VCBR2_ADDR A:0xfd89f008
y.create.l HWIO_MMSS_SMMU_VFE_SMMUX_M2VCBR3_ADDR A:0xfd89f00c
y.create.l HWIO_MMSS_SMMU_VFE_SMMUX_M2VCBR4_ADDR A:0xfd89f010
y.create.l HWIO_MMSS_SMMU_VFE_SMMUX_M2VCBR5_ADDR A:0xfd89f014
y.create.l HWIO_MMSS_SMMU_VFE_SMMUX_M2VCBR6_ADDR A:0xfd89f018
y.create.l HWIO_MMSS_SMMU_VFE_SMMUX_M2VCBR7_ADDR A:0xfd89f01c
y.create.l HWIO_MMSS_SMMU_VFE_SMMUX_M2VCBR8_ADDR A:0xfd89f020
y.create.l HWIO_MMSS_SMMU_VFE_SMMUX_M2VCBR9_ADDR A:0xfd89f024
y.create.l HWIO_MMSS_SMMU_VFE_SMMUX_CBACR0_ADDR A:0xfd89f800
y.create.l HWIO_MMSS_SMMU_VFE_SMMUX_CBACR1_ADDR A:0xfd89f804
y.create.l HWIO_MMSS_SMMU_VFE_SMMUX_CBACR2_ADDR A:0xfd89f808
y.create.l HWIO_MMSS_SMMU_VFE_SMMUX_CBACR3_ADDR A:0xfd89f80c
y.create.l HWIO_MMSS_SMMU_VFE_SMMUX_CBACR4_ADDR A:0xfd89f810
y.create.l HWIO_MMSS_SMMU_VFE_SMMUX_CBACR5_ADDR A:0xfd89f814
y.create.l HWIO_MMSS_SMMU_VFE_SMMUX_CBACR6_ADDR A:0xfd89f818
y.create.l HWIO_MMSS_SMMU_VFE_SMMUX_CBACR7_ADDR A:0xfd89f81c
y.create.l HWIO_MMSS_SMMU_VFE_SMMUX_CBACR8_ADDR A:0xfd89f820
y.create.l HWIO_MMSS_SMMU_VFE_SMMUX_TLBRSW_ADDR A:0xfd89fe00
y.create.l HWIO_MMSS_SMMU_VFE_SMMUX_TLBTR0_ADDR A:0xfd89fe80
y.create.l HWIO_MMSS_SMMU_VFE_SMMUX_TLBTR1_ADDR A:0xfd89fe84
y.create.l HWIO_MMSS_SMMU_VFE_SMMUX_TLBTR2_ADDR A:0xfd89fe88
y.create.l HWIO_MMSS_SMMU_VFE_SMMUX_TESTBUSCR_ADDR A:0xfd89fe8c
y.create.l HWIO_MMSS_SMMU_VFE_SMMUX_VR0_ADDR A:0xfd89fefc
y.create.l HWIO_MMSS_SMMU_VFE_SMMUX_TLBIALL_ADDR A:0xfd89ff00
y.create.l HWIO_MMSS_SMMU_VFE_SMMUX_TLBIVMID_ADDR A:0xfd89ff04
y.create.l HWIO_MMSS_SMMU_VFE_SMMUX_CR_ADDR A:0xfd89ff80
y.create.l HWIO_MMSS_SMMU_VFE_SMMUX_EAR_ADDR A:0xfd89ff84
y.create.l HWIO_MMSS_SMMU_VFE_SMMUX_ESR_ADDR A:0xfd89ff88
y.create.l HWIO_MMSS_SMMU_VFE_SMMUX_ESRRESTORE_ADDR A:0xfd89ff8c
y.create.l HWIO_MMSS_SMMU_VFE_SMMUX_ESYNR0_ADDR A:0xfd89ff90
y.create.l HWIO_MMSS_SMMU_VFE_SMMUX_ESYNR1_ADDR A:0xfd89ff94
y.create.l HWIO_MMSS_SMMU_VFE_SMMUX_REV_ADDR A:0xfd89fff4
y.create.l HWIO_MMSS_SMMU_VFE_SMMUX_IDR_ADDR A:0xfd89fff8
y.create.l HWIO_MMSS_SMMU_VFE_SMMUX_RPU_ACR_ADDR A:0xfd89fffc
y.create.l HWIO_MMSS_SMMU_VFE_SMMU_EMMC_ADDR A:0xfd89e000
y.create.l HWIO_MMSS_SMMU_VFE_SMMU_EMCS_ADDR A:0xfd89e004
y.create.l HWIO_MMSS_SMMU_VFE_SMMU_EMCC0_ADDR A:0xfd89e100
y.create.l HWIO_MMSS_SMMU_VFE_SMMU_EMCC1_ADDR A:0xfd89e104
y.create.l HWIO_MMSS_SMMU_VFE_SMMU_EMCC2_ADDR A:0xfd89e108
y.create.l HWIO_MMSS_SMMU_VFE_SMMU_EMCC3_ADDR A:0xfd89e10c
y.create.l HWIO_MMSS_SMMU_VFE_SMMU_EMC0_ADDR A:0xfd89e200
y.create.l HWIO_MMSS_SMMU_VFE_SMMU_EMC1_ADDR A:0xfd89e204
y.create.l HWIO_MMSS_SMMU_VFE_SMMU_EMC2_ADDR A:0xfd89e208
y.create.l HWIO_MMSS_SMMU_VFE_SMMU_EMC3_ADDR A:0xfd89e20c
y.create.l HWIO_MMSS_MMPLL0_PLL_MODE_ADDR A:0xfd8c0000
y.create.l HWIO_MMSS_MMPLL0_PLL_L_VAL_ADDR A:0xfd8c0004
y.create.l HWIO_MMSS_MMPLL0_PLL_M_VAL_ADDR A:0xfd8c0008
y.create.l HWIO_MMSS_MMPLL0_PLL_N_VAL_ADDR A:0xfd8c000c
y.create.l HWIO_MMSS_MMPLL0_PLL_USER_CTL_ADDR A:0xfd8c0010
y.create.l HWIO_MMSS_MMPLL0_PLL_CONFIG_CTL_ADDR A:0xfd8c0014
y.create.l HWIO_MMSS_MMPLL0_PLL_TEST_CTL_ADDR A:0xfd8c0018
y.create.l HWIO_MMSS_MMPLL0_PLL_STATUS_ADDR A:0xfd8c001c
y.create.l HWIO_MMSS_MMSS_PLL_VOTE_APCS_ADDR A:0xfd8c0100
y.create.l HWIO_MMSS_MMSS_SPDM_BCR_ADDR A:0xfd8c0200
y.create.l HWIO_MMSS_MMSS_SPDM_AXI_CBCR_ADDR A:0xfd8c0210
y.create.l HWIO_MMSS_MMSS_SPDM_VFE_CBCR_ADDR A:0xfd8c0218
y.create.l HWIO_MMSS_MMSS_SPDM_GFX3D_CBCR_ADDR A:0xfd8c022c
y.create.l HWIO_MMSS_MMSS_SPDM_AHB_CBCR_ADDR A:0xfd8c0230
y.create.l HWIO_MMSS_MMSS_SPDM_DSI_CBCR_ADDR A:0xfd8c0234
y.create.l HWIO_MMSS_MMSS_SPDM_CSI0_CBCR_ADDR A:0xfd8c023c
y.create.l HWIO_MMSS_MMSS_SPDM_RM_BCR_ADDR A:0xfd8c0300
y.create.l HWIO_MMSS_MMSS_SPDM_RM_AXI_CBCR_ADDR A:0xfd8c0304
y.create.l HWIO_MMSS_DSI_PCLK_CMD_RCGR_ADDR A:0xfd8c2000
y.create.l HWIO_MMSS_DSI_PCLK_CFG_RCGR_ADDR A:0xfd8c2004
y.create.l HWIO_MMSS_DSI_PCLK_M_ADDR A:0xfd8c2008
y.create.l HWIO_MMSS_DSI_PCLK_N_ADDR A:0xfd8c200c
y.create.l HWIO_MMSS_DSI_PCLK_D_ADDR A:0xfd8c2010
y.create.l HWIO_MMSS_DSI_CMD_RCGR_ADDR A:0xfd8c2020
y.create.l HWIO_MMSS_DSI_CFG_RCGR_ADDR A:0xfd8c2024
y.create.l HWIO_MMSS_DSI_M_ADDR A:0xfd8c2028
y.create.l HWIO_MMSS_DSI_N_ADDR A:0xfd8c202c
y.create.l HWIO_MMSS_DSI_D_ADDR A:0xfd8c2030
y.create.l HWIO_MMSS_MDP_VSYNC_CMD_RCGR_ADDR A:0xfd8c2080
y.create.l HWIO_MMSS_MDP_VSYNC_CFG_RCGR_ADDR A:0xfd8c2084
y.create.l HWIO_MMSS_DSI_BYTE_CMD_RCGR_ADDR A:0xfd8c2120
y.create.l HWIO_MMSS_DSI_BYTE_CFG_RCGR_ADDR A:0xfd8c2124
y.create.l HWIO_MMSS_DSI_ESC_CMD_RCGR_ADDR A:0xfd8c2160
y.create.l HWIO_MMSS_DSI_ESC_CFG_RCGR_ADDR A:0xfd8c2164
y.create.l HWIO_MMSS_DSI_BCR_ADDR A:0xfd8c2200
y.create.l HWIO_MMSS_DSI_AHB_BCR_ADDR A:0xfd8c220c
y.create.l HWIO_MMSS_MDP_LCDC_BCR_ADDR A:0xfd8c2218
y.create.l HWIO_MMSS_MDP_DSI_BCR_ADDR A:0xfd8c221c
y.create.l HWIO_MMSS_MDP_VSYNC_BCR_ADDR A:0xfd8c2220
y.create.l HWIO_MMSS_MDP_AXI_BCR_ADDR A:0xfd8c2224
y.create.l HWIO_MMSS_MDP_AHB_BCR_ADDR A:0xfd8c2228
y.create.l HWIO_MMSS_MDP_AXI_CBCR_ADDR A:0xfd8c2314
y.create.l HWIO_MMSS_MDP_VSYNC_CBCR_ADDR A:0xfd8c231c
y.create.l HWIO_MMSS_MDP_AHB_CBCR_ADDR A:0xfd8c2318
y.create.l HWIO_MMSS_DSI_PCLK_CBCR_ADDR A:0xfd8c233c
y.create.l HWIO_MMSS_MDP_LCDC_CBCR_ADDR A:0xfd8c2340
y.create.l HWIO_MMSS_MDP_DSI_CBCR_ADDR A:0xfd8c2320
y.create.l HWIO_MMSS_DSI_CBCR_ADDR A:0xfd8c2324
y.create.l HWIO_MMSS_DSI_BYTE_CBCR_ADDR A:0xfd8c2328
y.create.l HWIO_MMSS_DSI_ESC_CBCR_ADDR A:0xfd8c232c
y.create.l HWIO_MMSS_DSI_AHB_CBCR_ADDR A:0xfd8c2330
y.create.l HWIO_MMSS_CSI0PHYTIMER_CMD_RCGR_ADDR A:0xfd8c3000
y.create.l HWIO_MMSS_CSI0PHYTIMER_CFG_RCGR_ADDR A:0xfd8c3004
y.create.l HWIO_MMSS_CSI0PHYTIMER_CBCR_ADDR A:0xfd8c3024
y.create.l HWIO_MMSS_CSI1PHYTIMER_CMD_RCGR_ADDR A:0xfd8c3030
y.create.l HWIO_MMSS_CSI1PHYTIMER_CFG_RCGR_ADDR A:0xfd8c3034
y.create.l HWIO_MMSS_CSI1PHYTIMER_CBCR_ADDR A:0xfd8c3054
y.create.l HWIO_MMSS_CSI0_CMD_RCGR_ADDR A:0xfd8c3090
y.create.l HWIO_MMSS_CSI0_CFG_RCGR_ADDR A:0xfd8c3094
y.create.l HWIO_MMSS_CSI0_BCR_ADDR A:0xfd8c30b0
y.create.l HWIO_MMSS_CSI0_CBCR_ADDR A:0xfd8c30b4
y.create.l HWIO_MMSS_CSI_AHB_BCR_ADDR A:0xfd8c30b8
y.create.l HWIO_MMSS_CSI_AHB_CBCR_ADDR A:0xfd8c30bc
y.create.l HWIO_MMSS_CSI0PHY_BCR_ADDR A:0xfd8c30c0
y.create.l HWIO_MMSS_CSI0PHY_CBCR_ADDR A:0xfd8c30c4
y.create.l HWIO_MMSS_CSI0RDI_BCR_ADDR A:0xfd8c30d0
y.create.l HWIO_MMSS_CSI0RDI_CBCR_ADDR A:0xfd8c30d4
y.create.l HWIO_MMSS_CSI0PIX_BCR_ADDR A:0xfd8c30e0
y.create.l HWIO_MMSS_CSI0PIX_CBCR_ADDR A:0xfd8c30e4
y.create.l HWIO_MMSS_CSI1_CMD_RCGR_ADDR A:0xfd8c3100
y.create.l HWIO_MMSS_CSI1_CFG_RCGR_ADDR A:0xfd8c3104
y.create.l HWIO_MMSS_CSI1_BCR_ADDR A:0xfd8c3120
y.create.l HWIO_MMSS_CSI1_CBCR_ADDR A:0xfd8c3124
y.create.l HWIO_MMSS_CSI1PHY_BCR_ADDR A:0xfd8c3130
y.create.l HWIO_MMSS_CSI1PHY_CBCR_ADDR A:0xfd8c3134
y.create.l HWIO_MMSS_CSI1RDI_BCR_ADDR A:0xfd8c3140
y.create.l HWIO_MMSS_CSI1RDI_CBCR_ADDR A:0xfd8c3144
y.create.l HWIO_MMSS_CSI1PIX_BCR_ADDR A:0xfd8c3150
y.create.l HWIO_MMSS_CSI1PIX_CBCR_ADDR A:0xfd8c3154
y.create.l HWIO_MMSS_MCLK0_CMD_RCGR_ADDR A:0xfd8c3360
y.create.l HWIO_MMSS_MCLK0_CFG_RCGR_ADDR A:0xfd8c3364
y.create.l HWIO_MMSS_MCLK0_M_ADDR A:0xfd8c3368
y.create.l HWIO_MMSS_MCLK0_N_ADDR A:0xfd8c336c
y.create.l HWIO_MMSS_MCLK0_D_ADDR A:0xfd8c3370
y.create.l HWIO_MMSS_MCLK0_CBCR_ADDR A:0xfd8c3384
y.create.l HWIO_MMSS_MCLK1_CMD_RCGR_ADDR A:0xfd8c3390
y.create.l HWIO_MMSS_MCLK1_CFG_RCGR_ADDR A:0xfd8c3394
y.create.l HWIO_MMSS_MCLK1_M_ADDR A:0xfd8c3398
y.create.l HWIO_MMSS_MCLK1_N_ADDR A:0xfd8c339c
y.create.l HWIO_MMSS_MCLK1_D_ADDR A:0xfd8c33a0
y.create.l HWIO_MMSS_MCLK1_CBCR_ADDR A:0xfd8c33b4
y.create.l HWIO_MMSS_VFE_CMD_RCGR_ADDR A:0xfd8c3600
y.create.l HWIO_MMSS_VFE_CFG_RCGR_ADDR A:0xfd8c3604
y.create.l HWIO_MMSS_VFE_BCR_ADDR A:0xfd8c36a0
y.create.l HWIO_MMSS_VFE_AHB_BCR_ADDR A:0xfd8c36ac
y.create.l HWIO_MMSS_VFE_AXI_BCR_ADDR A:0xfd8c36b0
y.create.l HWIO_MMSS_VFE_GDSCR_ADDR A:0xfd8c36a4
y.create.l HWIO_MMSS_VFE_CBCR_ADDR A:0xfd8c36a8
y.create.l HWIO_MMSS_VFE_AHB_CBCR_ADDR A:0xfd8c36b8
y.create.l HWIO_MMSS_VFE_AXI_CBCR_ADDR A:0xfd8c36bc
y.create.l HWIO_MMSS_CSI_VFE_BCR_ADDR A:0xfd8c3700
y.create.l HWIO_MMSS_CSI_VFE_CBCR_ADDR A:0xfd8c3704
y.create.l HWIO_MMSS_CAMSS_MISC_ADDR A:0xfd8c3718
y.create.l HWIO_MMSS_GFX3D_CMD_RCGR_ADDR A:0xfd8c4000
y.create.l HWIO_MMSS_GFX3D_CFG_RCGR_ADDR A:0xfd8c4004
y.create.l HWIO_MMSS_OXILI_GFX3D_CBCR_ADDR A:0xfd8c4028
y.create.l HWIO_MMSS_OXILI_GFX3D_BCR_ADDR A:0xfd8c4030
y.create.l HWIO_MMSS_GMEM_GFX3D_BCR_ADDR A:0xfd8c4040
y.create.l HWIO_MMSS_OXILI_AHB_BCR_ADDR A:0xfd8c4044
y.create.l HWIO_MMSS_OXILI_GDSCR_ADDR A:0xfd8c4034
y.create.l HWIO_MMSS_GMEM_GFX3D_CBCR_ADDR A:0xfd8c4038
y.create.l HWIO_MMSS_OXILI_AHB_CBCR_ADDR A:0xfd8c403c
y.create.l HWIO_MMSS_MMPLL1_PLL_MODE_ADDR A:0xfd8c4100
y.create.l HWIO_MMSS_MMPLL1_PLL_L_VAL_ADDR A:0xfd8c4104
y.create.l HWIO_MMSS_MMPLL1_PLL_M_VAL_ADDR A:0xfd8c4108
y.create.l HWIO_MMSS_MMPLL1_PLL_N_VAL_ADDR A:0xfd8c410c
y.create.l HWIO_MMSS_MMPLL1_PLL_USER_CTL_ADDR A:0xfd8c4110
y.create.l HWIO_MMSS_MMPLL1_PLL_CONFIG_CTL_ADDR A:0xfd8c4114
y.create.l HWIO_MMSS_MMPLL1_PLL_TEST_CTL_ADDR A:0xfd8c4118
y.create.l HWIO_MMSS_MMPLL1_PLL_STATUS_ADDR A:0xfd8c411c
y.create.l HWIO_MMSS_MMSS_PLL_VOTE_RPM_ADDR A:0xfd8c4200
y.create.l HWIO_MMSS_AHB_CMD_RCGR_ADDR A:0xfd8c5000
y.create.l HWIO_MMSS_AHB_CFG_RCGR_ADDR A:0xfd8c5004
y.create.l HWIO_MMSS_MMSSNOCAHB_BCR_ADDR A:0xfd8c5020
y.create.l HWIO_MMSS_MMSSNOCAHB_BTO_BCR_ADDR A:0xfd8c5030
y.create.l HWIO_MMSS_MMSS_MISC_AHB_BCR_ADDR A:0xfd8c5034
y.create.l HWIO_MMSS_MMSS_MMSSNOC_AHB_CBCR_ADDR A:0xfd8c5024
y.create.l HWIO_MMSS_MMSS_MMSSNOC_BTO_AHB_CBCR_ADDR A:0xfd8c5028
y.create.l HWIO_MMSS_MMSS_MISC_AHB_CBCR_ADDR A:0xfd8c502c
y.create.l HWIO_MMSS_AXI_CMD_RCGR_ADDR A:0xfd8c5040
y.create.l HWIO_MMSS_AXI_CFG_RCGR_ADDR A:0xfd8c5044
y.create.l HWIO_MMSS_MMSSNOCAXI_BCR_ADDR A:0xfd8c5060
y.create.l HWIO_MMSS_MMSS_S0_AXI_CBCR_ADDR A:0xfd8c5064
y.create.l HWIO_MMSS_MMSS_MMSSNOC_AXI_CBCR_ADDR A:0xfd8c506c
y.create.l HWIO_MMSS_BIMC_GFX_CBCR_ADDR A:0xfd8c5094
y.create.l HWIO_MMSS_MMSS_SLEEPCLK_CBCR_ADDR A:0xfd8c5100
y.create.l HWIO_MMSS_MMSS_CXO_CBCR_ADDR A:0xfd8c5104
y.create.l HWIO_MMSS_QOS_CXO_MISC_ADDR A:0xfd8c50c0
y.create.l HWIO_MMSS_MMSS_DEBUG_CLK_CTL_ADDR A:0xfd8c0900
y.create.l HWIO_MMSS_MMSS_SPARE_FLOPS_ADDR A:0xfd8c0a00
y.create.l HWIO_MMSS_MDP_SYNC_CONFIG_0_ADDR A:0xfd900300
y.create.l HWIO_MMSS_MDP_SYNC_CONFIG_1_ADDR A:0xfd900304
y.create.l HWIO_MMSS_MDP_SYNC_CONFIG_2_ADDR A:0xfd900308
y.create.l HWIO_MMSS_MDP_SYNC_STATUS_0_ADDR A:0xfd90030c
y.create.l HWIO_MMSS_MDP_SYNC_STATUS_1_ADDR A:0xfd900310
y.create.l HWIO_MMSS_MDP_SYNC_STATUS_2_ADDR A:0xfd900314
y.create.l HWIO_MMSS_MDP_PRIMARY_VSYNC_OUT_CTRL_ADDR A:0xfd900318
y.create.l HWIO_MMSS_MDP_SECONDARY_VSYNC_OUT_CTRL_ADDR A:0xfd90031c
y.create.l HWIO_MMSS_MDP_EXTERNAL_VSYNC_OUT_CTRL_ADDR A:0xfd900320
y.create.l HWIO_MMSS_MDP_VSYNC_SEL_ADDR A:0xfd900324
y.create.l HWIO_MMSS_MDP_PRIM_VSYNC_INIT_VAL_ADDR A:0xfd900328
y.create.l HWIO_MMSS_MDP_SEC_VSYNC_INIT_VAL_ADDR A:0xfd90032c
y.create.l HWIO_MMSS_MDP_EXT_VSYNC_INIT_VAL_ADDR A:0xfd900330
y.create.l HWIO_MMSS_MDP_PRIM_VSYNC_OUT_VAL_ADDR A:0xfd900334
y.create.l HWIO_MMSS_MDP_SEC_VSYNC_OUT_VAL_ADDR A:0xfd900338
y.create.l HWIO_MMSS_MDP_EXT_VSYNC_OUT_VAL_ADDR A:0xfd90033c
y.create.l HWIO_MMSS_MDP_PRIM_INT_CNT_VAL_ADDR A:0xfd900340
y.create.l HWIO_MMSS_MDP_SEC_INT_CNT_VAL_ADDR A:0xfd900344
y.create.l HWIO_MMSS_MDP_EXT_INT_CNT_VAL_ADDR A:0xfd900348
y.create.l HWIO_MMSS_MDP_AUTOREFRESH_CONFIG_P_ADDR A:0xfd90034c
y.create.l HWIO_MMSS_MDP_AUTOREFRESH_CONFIG_S_ADDR A:0xfd900350
y.create.l HWIO_MMSS_MDP_QPIC_EOF_VAL_ADDR A:0xfd900354
y.create.l HWIO_MMSS_MDP_SYNC_THRESH_0_ADDR A:0xfd900200
y.create.l HWIO_MMSS_MDP_SYNC_THRESH_1_ADDR A:0xfd900204
y.create.l HWIO_MMSS_MDP_SYNC_THRESH_2_ADDR A:0xfd900208
y.create.l HWIO_MMSS_MDP_TEAR_CHECK_EN_ADDR A:0xfd90020c
y.create.l HWIO_MMSS_MDP_PRIM_START_POS_ADDR A:0xfd900210
y.create.l HWIO_MMSS_MDP_SEC_START_POS_ADDR A:0xfd900214
y.create.l HWIO_MMSS_MDP_EXT_START_POS_ADDR A:0xfd900218
y.create.l HWIO_MMSS_MDP_PRIMARY_RD_PTR_IRQ_ADDR A:0xfd90021c
y.create.l HWIO_MMSS_MDP_SECONDARY_RD_PTR_IRQ_ADDR A:0xfd900220
y.create.l HWIO_MMSS_MDP_EXTERNAL_RD_PTR_IRQ_ADDR A:0xfd900224
y.create.l HWIO_MMSS_MDP_INTR_ENABLE_ADDR A:0xfd900020
y.create.l HWIO_MMSS_MDP_INTR_STATUS_ADDR A:0xfd900024
y.create.l HWIO_MMSS_MDP_INTR_CLEAR_ADDR A:0xfd900028
y.create.l HWIO_MMSS_MDP_PPP_DL0_START_ADDR A:0xfd900030
y.create.l HWIO_MMSS_MDP_PPP_DL1_START_ADDR A:0xfd900034
y.create.l HWIO_MMSS_MDP_DISPLAY_STATUS_ADDR A:0xfd900038
y.create.l HWIO_MMSS_MDP_DMA_P_START_ADDR A:0xfd900044
y.create.l HWIO_MMSS_MDP_DMA_S_START_ADDR A:0xfd900048
y.create.l HWIO_MMSS_MDP_DMA_E_START_ADDR A:0xfd90004c
y.create.l HWIO_MMSS_MDP_HW_VERSION_ADDR A:0xfd900070
y.create.l HWIO_MMSS_MDP_SW_RESET_ADDR A:0xfd900074
y.create.l HWIO_MMSS_MDP_AXI_RD_ARB_CONFIG_ADDR A:0xfd900078
y.create.l HWIO_MMSS_MDP_SEL_CLK_OR_HCLK_TEST_BUS_ADDR A:0xfd90007c
y.create.l HWIO_MMSS_MDP_EBI2_LCD0_ADDR A:0xfd90003c
y.create.l HWIO_MMSS_MDP_EBI2_LCD1_ADDR A:0xfd900040
y.create.l HWIO_MMSS_MDP_EBI2_LCD0_YSTRIDE_ADDR A:0xfd900050
y.create.l HWIO_MMSS_MDP_EBI2_LCD1_YSTRIDE_ADDR A:0xfd900054
y.create.l HWIO_MMSS_MDP_EBI2_PORTMAP_MODE_ADDR A:0xfd90005c
y.create.l HWIO_MMSS_MDP_HALT_REQ_ACK_ADDR A:0xfd900060
y.create.l HWIO_MMSS_MDP_MDDI_PARAM_WR_SEL_ADDR A:0xfd900090
y.create.l HWIO_MMSS_MDP_MDDI_PARAM_ADDR A:0xfd900094
y.create.l HWIO_MMSS_MDP_CGC_EN_ADDR A:0xfd900100
y.create.l HWIO_MMSS_MDP_PPP_DL0_ADDR_ADDR A:0xfd910000
y.create.l HWIO_MMSS_MDP_PPP_DL1_ADDR_ADDR A:0xfd910004
y.create.l HWIO_MMSS_MDP_PPP_CMD_STATUS_ADDR A:0xfd910008
y.create.l HWIO_MMSS_MDP_PPP_PROFILE_EN_ADDR A:0xfd910010
y.create.l HWIO_MMSS_MDP_PPP_PROFILE_COUNT_ADDR A:0xfd910014
y.create.l HWIO_MMSS_MDP_PPP_CMD_MODE_ADDR A:0xfd910060
y.create.l HWIO_MMSS_MDP_PPP_SRC_SIZE_ADDR A:0xfd910108
y.create.l HWIO_MMSS_MDP_PPP_SRCP0_ADDR_ADDR A:0xfd91010c
y.create.l HWIO_MMSS_MDP_PPP_SRCP1_ADDR_ADDR A:0xfd910110
y.create.l HWIO_MMSS_MDP_PPP_SRCP3_ADDR_ADDR A:0xfd910118
y.create.l HWIO_MMSS_MDP_PPP_SRC_YSTRIDE1_ADDR A:0xfd91011c
y.create.l HWIO_MMSS_MDP_PPP_SRC_YSTRIDE2_ADDR A:0xfd910120
y.create.l HWIO_MMSS_MDP_PPP_SRC_FORMAT_ADDR A:0xfd910124
y.create.l HWIO_MMSS_MDP_PPP_SRC_UNPACK_PATTERN1_ADDR A:0xfd910128
y.create.l HWIO_MMSS_MDP_PPP_SRC_UNPACK_PATTERN2_ADDR A:0xfd91012c
y.create.l HWIO_MMSS_MDP_PPP_OP_MODE_ADDR A:0xfd910138
y.create.l HWIO_MMSS_MDP_PPP_SCALE_PHASEX_INIT_ADDR A:0xfd91013c
y.create.l HWIO_MMSS_MDP_PPP_SCALE_PHASEY_INIT_ADDR A:0xfd910140
y.create.l HWIO_MMSS_MDP_PPP_SCALE_PHASEX_STEP_ADDR A:0xfd910144
y.create.l HWIO_MMSS_MDP_PPP_SCALE_PHASEY_STEP_ADDR A:0xfd910148
y.create.l HWIO_MMSS_MDP_PPP_BLEND_PARAM_ADDR A:0xfd91014c
y.create.l HWIO_MMSS_MDP_PPP_OUT_FORMAT_ADDR A:0xfd910150
y.create.l HWIO_MMSS_MDP_PPP_OUT_PACK_PATTERN1_ADDR A:0xfd910154
y.create.l HWIO_MMSS_MDP_PPP_OUT_PACK_PATTERN2_ADDR A:0xfd910158
y.create.l HWIO_MMSS_MDP_PPP_OUT_SIZE_ADDR A:0xfd910164
y.create.l HWIO_MMSS_MDP_PPP_OUTP0_ADDR_ADDR A:0xfd910168
y.create.l HWIO_MMSS_MDP_PPP_OUTP1_ADDR_ADDR A:0xfd91016c
y.create.l HWIO_MMSS_MDP_PPP_OUTP3_ADDR_ADDR A:0xfd910174
y.create.l HWIO_MMSS_MDP_PPP_OUT_YSTRIDE1_ADDR A:0xfd910178
y.create.l HWIO_MMSS_MDP_PPP_OUT_YSTRIDE2_ADDR A:0xfd91017c
y.create.l HWIO_MMSS_MDP_PPP_OUT_XY_ADDR A:0xfd91019c
y.create.l HWIO_MMSS_MDP_PPP_SRC_EDGE_REP_ADDR A:0xfd9101b8
y.create.l HWIO_MMSS_MDP_PPP_BG_EDGE_REP_ADDR A:0xfd9101bc
y.create.l HWIO_MMSS_MDP_PPP_BGP0_ADDR_ADDR A:0xfd9101c0
y.create.l HWIO_MMSS_MDP_PPP_BGP1_ADDR_ADDR A:0xfd9101c4
y.create.l HWIO_MMSS_MDP_PPP_BGP3_ADDR_ADDR A:0xfd9101c8
y.create.l HWIO_MMSS_MDP_PPP_BG_YSTRIDE1_ADDR A:0xfd9101cc
y.create.l HWIO_MMSS_MDP_PPP_BG_YSTRIDE2_ADDR A:0xfd9101d0
y.create.l HWIO_MMSS_MDP_PPP_BG_FORMAT_ADDR A:0xfd9101d4
y.create.l HWIO_MMSS_MDP_PPP_BG_UNPACK_PATTERN1_ADDR A:0xfd9101d8
y.create.l HWIO_MMSS_MDP_PPP_BG_UNPACK_PATTERN2_ADDR A:0xfd9101dc
y.create.l HWIO_MMSS_MDP_PPP_TFETCH_TEST_MODE_ADDR A:0xfd920004
y.create.l HWIO_MMSS_MDP_PPP_TFETCH_STATUS_ADDR A:0xfd920008
y.create.l HWIO_MMSS_MDP_PPP_TFETCH_TILE_COUNT_ADDR A:0xfd920010
y.create.l HWIO_MMSS_MDP_PPP_TFETCH_FETCH_COUNT_ADDR A:0xfd920014
y.create.l HWIO_MMSS_MDP_PPP_TFETCH_CONSTANT_COLOR_ADDR A:0xfd920040
y.create.l HWIO_MMSS_MDP_PPP_CSC_BYPASS_ADDR A:0xfd940004
y.create.l HWIO_MMSS_MDP_PPP_CSC_PFMV0_ADDR A:0xfd940400
y.create.l HWIO_MMSS_MDP_PPP_CSC_PFMV1_ADDR A:0xfd940404
y.create.l HWIO_MMSS_MDP_PPP_CSC_PFMV2_ADDR A:0xfd940408
y.create.l HWIO_MMSS_MDP_PPP_CSC_PFMV3_ADDR A:0xfd94040c
y.create.l HWIO_MMSS_MDP_PPP_CSC_PFMV4_ADDR A:0xfd940410
y.create.l HWIO_MMSS_MDP_PPP_CSC_PFMV5_ADDR A:0xfd940414
y.create.l HWIO_MMSS_MDP_PPP_CSC_PFMV6_ADDR A:0xfd940418
y.create.l HWIO_MMSS_MDP_PPP_CSC_PFMV7_ADDR A:0xfd94041c
y.create.l HWIO_MMSS_MDP_PPP_CSC_PFMV8_ADDR A:0xfd940420
y.create.l HWIO_MMSS_MDP_PPP_CSC_PRMV0_ADDR A:0xfd940440
y.create.l HWIO_MMSS_MDP_PPP_CSC_PRMV1_ADDR A:0xfd940444
y.create.l HWIO_MMSS_MDP_PPP_CSC_PRMV2_ADDR A:0xfd940448
y.create.l HWIO_MMSS_MDP_PPP_CSC_PRMV3_ADDR A:0xfd94044c
y.create.l HWIO_MMSS_MDP_PPP_CSC_PRMV4_ADDR A:0xfd940450
y.create.l HWIO_MMSS_MDP_PPP_CSC_PRMV5_ADDR A:0xfd940454
y.create.l HWIO_MMSS_MDP_PPP_CSC_PRMV6_ADDR A:0xfd940458
y.create.l HWIO_MMSS_MDP_PPP_CSC_PRMV7_ADDR A:0xfd94045c
y.create.l HWIO_MMSS_MDP_PPP_CSC_PRMV8_ADDR A:0xfd940460
y.create.l HWIO_MMSS_MDP_PPP_CSC_SFMV0_ADDR A:0xfd940480
y.create.l HWIO_MMSS_MDP_PPP_CSC_SFMV1_ADDR A:0xfd940484
y.create.l HWIO_MMSS_MDP_PPP_CSC_SFMV2_ADDR A:0xfd940488
y.create.l HWIO_MMSS_MDP_PPP_CSC_SFMV3_ADDR A:0xfd94048c
y.create.l HWIO_MMSS_MDP_PPP_CSC_SFMV4_ADDR A:0xfd940490
y.create.l HWIO_MMSS_MDP_PPP_CSC_SFMV5_ADDR A:0xfd940494
y.create.l HWIO_MMSS_MDP_PPP_CSC_SFMV6_ADDR A:0xfd940498
y.create.l HWIO_MMSS_MDP_PPP_CSC_SFMV7_ADDR A:0xfd94049c
y.create.l HWIO_MMSS_MDP_PPP_CSC_SFMV8_ADDR A:0xfd9404a0
y.create.l HWIO_MMSS_MDP_PPP_CSC_SRMV0_ADDR A:0xfd9404c0
y.create.l HWIO_MMSS_MDP_PPP_CSC_SRMV1_ADDR A:0xfd9404c4
y.create.l HWIO_MMSS_MDP_PPP_CSC_SRMV2_ADDR A:0xfd9404c8
y.create.l HWIO_MMSS_MDP_PPP_CSC_SRMV3_ADDR A:0xfd9404cc
y.create.l HWIO_MMSS_MDP_PPP_CSC_SRMV4_ADDR A:0xfd9404d0
y.create.l HWIO_MMSS_MDP_PPP_CSC_SRMV5_ADDR A:0xfd9404d4
y.create.l HWIO_MMSS_MDP_PPP_CSC_SRMV6_ADDR A:0xfd9404d8
y.create.l HWIO_MMSS_MDP_PPP_CSC_SRMV7_ADDR A:0xfd9404dc
y.create.l HWIO_MMSS_MDP_PPP_CSC_SRMV8_ADDR A:0xfd9404e0
y.create.l HWIO_MMSS_MDP_PPP_CSC_PBV0_ADDR A:0xfd940500
y.create.l HWIO_MMSS_MDP_PPP_CSC_PBV1_ADDR A:0xfd940504
y.create.l HWIO_MMSS_MDP_PPP_CSC_PBV2_ADDR A:0xfd940508
y.create.l HWIO_MMSS_MDP_PPP_CSC_SBV0_ADDR A:0xfd940540
y.create.l HWIO_MMSS_MDP_PPP_CSC_SBV1_ADDR A:0xfd940544
y.create.l HWIO_MMSS_MDP_PPP_CSC_SBV2_ADDR A:0xfd940548
y.create.l HWIO_MMSS_MDP_PPP_CSC_PLV0_ADDR A:0xfd940580
y.create.l HWIO_MMSS_MDP_PPP_CSC_PLV1_ADDR A:0xfd940584
y.create.l HWIO_MMSS_MDP_PPP_CSC_PLV2_ADDR A:0xfd940588
y.create.l HWIO_MMSS_MDP_PPP_CSC_PLV3_ADDR A:0xfd94058c
y.create.l HWIO_MMSS_MDP_PPP_CSC_SLV0_ADDR A:0xfd9405c0
y.create.l HWIO_MMSS_MDP_PPP_CSC_SLV1_ADDR A:0xfd9405c4
y.create.l HWIO_MMSS_MDP_PPP_CSC_SLV2_ADDR A:0xfd9405c8
y.create.l HWIO_MMSS_MDP_PPP_CSC_SLV3_ADDR A:0xfd9405cc
y.create.l HWIO_MMSS_MDP_PPP_CSC_PRELT0_ADDR A:0xfd940800
y.create.l HWIO_MMSS_MDP_PPP_CSC_PRELT1_ADDR A:0xfd940804
y.create.l HWIO_MMSS_MDP_PPP_CSC_PRELT2_ADDR A:0xfd940808
y.create.l HWIO_MMSS_MDP_PPP_CSC_PRELT3_ADDR A:0xfd94080c
y.create.l HWIO_MMSS_MDP_PPP_CSC_PRELT4_ADDR A:0xfd940810
y.create.l HWIO_MMSS_MDP_PPP_CSC_PRELT5_ADDR A:0xfd940814
y.create.l HWIO_MMSS_MDP_PPP_CSC_PRELT6_ADDR A:0xfd940818
y.create.l HWIO_MMSS_MDP_PPP_CSC_PRELT7_ADDR A:0xfd94081c
y.create.l HWIO_MMSS_MDP_PPP_CSC_PRELT8_ADDR A:0xfd940820
y.create.l HWIO_MMSS_MDP_PPP_CSC_PRELT9_ADDR A:0xfd940824
y.create.l HWIO_MMSS_MDP_PPP_CSC_POSTLT0_ADDR A:0xfd940c00
y.create.l HWIO_MMSS_MDP_PPP_CSC_POSTLT1_ADDR A:0xfd940c04
y.create.l HWIO_MMSS_MDP_PPP_CSC_POSTLT2_ADDR A:0xfd940c08
y.create.l HWIO_MMSS_MDP_PPP_CSC_POSTLT3_ADDR A:0xfd940c0c
y.create.l HWIO_MMSS_MDP_PPP_CSC_POSTLT4_ADDR A:0xfd940c10
y.create.l HWIO_MMSS_MDP_PPP_CSC_POSTLT5_ADDR A:0xfd940c14
y.create.l HWIO_MMSS_MDP_PPP_CSC_POSTLT6_ADDR A:0xfd940c18
y.create.l HWIO_MMSS_MDP_PPP_CSC_POSTLT7_ADDR A:0xfd940c1c
y.create.l HWIO_MMSS_MDP_PPP_CSC_POSTLT8_ADDR A:0xfd940c20
y.create.l HWIO_MMSS_MDP_PPP_CSC_POSTLT9_ADDR A:0xfd940c24
y.create.l HWIO_MMSS_MDP_PPP_SCALE_COEFF_MSB0_ADDR A:0xfd950200
y.create.l HWIO_MMSS_MDP_PPP_SCALE_COEFF_MSB1_ADDR A:0xfd950204
y.create.l HWIO_MMSS_MDP_PPP_SCALE_COEFF_MSB2_ADDR A:0xfd950208
y.create.l HWIO_MMSS_MDP_PPP_SCALE_COEFF_MSB3_ADDR A:0xfd95020c
y.create.l HWIO_MMSS_MDP_PPP_SCALE_COEFF_MSB4_ADDR A:0xfd950210
y.create.l HWIO_MMSS_MDP_PPP_SCALE_COEFF_MSB5_ADDR A:0xfd950214
y.create.l HWIO_MMSS_MDP_PPP_SCALE_COEFF_MSB6_ADDR A:0xfd950218
y.create.l HWIO_MMSS_MDP_PPP_SCALE_COEFF_MSB7_ADDR A:0xfd95021c
y.create.l HWIO_MMSS_MDP_PPP_SCALE_COEFF_MSB8_ADDR A:0xfd950220
y.create.l HWIO_MMSS_MDP_PPP_SCALE_COEFF_MSB9_ADDR A:0xfd950224
y.create.l HWIO_MMSS_MDP_PPP_SCALE_COEFF_LSB_ADDR A:0xfd95fffc
y.create.l HWIO_MMSS_MDP_PPP_BLEND_COLOR3_OUT_ADDR A:0xfd970004
y.create.l HWIO_MMSS_MDP_PPP_BLEND_BG_ALPHA_SEL_ADDR A:0xfd970010
y.create.l HWIO_MMSS_MDP_DMA_P_CONFIG_ADDR A:0xfd990000
y.create.l HWIO_MMSS_MDP_DMA_P_SIZE_ADDR A:0xfd990004
y.create.l HWIO_MMSS_MDP_DMA_P_IBUF_ADDR_ADDR A:0xfd990008
y.create.l HWIO_MMSS_MDP_DMA_P_IBUF_Y_STRIDE_ADDR A:0xfd99000c
y.create.l HWIO_MMSS_MDP_DMA_P_OUT_XY_ADDR A:0xfd990010
y.create.l HWIO_MMSS_MDP_DMA_P_LINE_COUNT_ADDR A:0xfd990014
y.create.l HWIO_MMSS_MDP_DMA_P_LINE_IRQ_ADDR A:0xfd990018
y.create.l HWIO_MMSS_MDP_DMA_P_MASK_PATTERN_ADDR A:0xfd99001c
y.create.l HWIO_MMSS_MDP_DMA_P_PROFILE_EN_ADDR A:0xfd990020
y.create.l HWIO_MMSS_MDP_DMA_P_PROFILE_COUNT_ADDR A:0xfd990024
y.create.l HWIO_MMSS_MDP_DMA_P_CURSOR_FORMAT_ADDR A:0xfd990040
y.create.l HWIO_MMSS_MDP_DMA_P_CURSOR_SIZE_ADDR A:0xfd990044
y.create.l HWIO_MMSS_MDP_DMA_P_CURSOR_BUF_ADDR_ADDR A:0xfd990048
y.create.l HWIO_MMSS_MDP_DMA_P_CURSOR_POSITION_ADDR A:0xfd99004c
y.create.l HWIO_MMSS_MDP_DMA_P_CURSOR_BLEND_CONFIG_ADDR A:0xfd990060
y.create.l HWIO_MMSS_MDP_DMA_P_CURSOR_BLEND_PARAM_ADDR A:0xfd990064
y.create.l HWIO_MMSS_MDP_DMA_P_CURSOR_BLEND_TRANS_MASK_ADDR A:0xfd990068
y.create.l HWIO_MMSS_MDP_DMA_P_COLOR_CORRECT_CONFIG_ADDR A:0xfd990070
y.create.l HWIO_MMSS_MDP_DMA_P_CSC_BYPASS_ADDR A:0xfd993004
y.create.l HWIO_MMSS_MDP_DMA_P_CSC_MV10_ADDR A:0xfd993400
y.create.l HWIO_MMSS_MDP_DMA_P_CSC_MV11_ADDR A:0xfd993404
y.create.l HWIO_MMSS_MDP_DMA_P_CSC_MV12_ADDR A:0xfd993408
y.create.l HWIO_MMSS_MDP_DMA_P_CSC_MV13_ADDR A:0xfd99340c
y.create.l HWIO_MMSS_MDP_DMA_P_CSC_MV14_ADDR A:0xfd993410
y.create.l HWIO_MMSS_MDP_DMA_P_CSC_MV15_ADDR A:0xfd993414
y.create.l HWIO_MMSS_MDP_DMA_P_CSC_MV16_ADDR A:0xfd993418
y.create.l HWIO_MMSS_MDP_DMA_P_CSC_MV17_ADDR A:0xfd99341c
y.create.l HWIO_MMSS_MDP_DMA_P_CSC_MV18_ADDR A:0xfd993420
y.create.l HWIO_MMSS_MDP_DMA_P_CSC_MV20_ADDR A:0xfd993440
y.create.l HWIO_MMSS_MDP_DMA_P_CSC_MV21_ADDR A:0xfd993444
y.create.l HWIO_MMSS_MDP_DMA_P_CSC_MV22_ADDR A:0xfd993448
y.create.l HWIO_MMSS_MDP_DMA_P_CSC_MV23_ADDR A:0xfd99344c
y.create.l HWIO_MMSS_MDP_DMA_P_CSC_MV24_ADDR A:0xfd993450
y.create.l HWIO_MMSS_MDP_DMA_P_CSC_MV25_ADDR A:0xfd993454
y.create.l HWIO_MMSS_MDP_DMA_P_CSC_MV26_ADDR A:0xfd993458
y.create.l HWIO_MMSS_MDP_DMA_P_CSC_MV27_ADDR A:0xfd99345c
y.create.l HWIO_MMSS_MDP_DMA_P_CSC_MV28_ADDR A:0xfd993460
y.create.l HWIO_MMSS_MDP_DMA_P_CSC_PRE_BV10_ADDR A:0xfd993500
y.create.l HWIO_MMSS_MDP_DMA_P_CSC_PRE_BV11_ADDR A:0xfd993504
y.create.l HWIO_MMSS_MDP_DMA_P_CSC_PRE_BV12_ADDR A:0xfd993508
y.create.l HWIO_MMSS_MDP_DMA_P_CSC_PRE_BV20_ADDR A:0xfd993540
y.create.l HWIO_MMSS_MDP_DMA_P_CSC_PRE_BV21_ADDR A:0xfd993544
y.create.l HWIO_MMSS_MDP_DMA_P_CSC_PRE_BV22_ADDR A:0xfd993548
y.create.l HWIO_MMSS_MDP_DMA_P_CSC_POST_BV10_ADDR A:0xfd993580
y.create.l HWIO_MMSS_MDP_DMA_P_CSC_POST_BV11_ADDR A:0xfd993584
y.create.l HWIO_MMSS_MDP_DMA_P_CSC_POST_BV12_ADDR A:0xfd993588
y.create.l HWIO_MMSS_MDP_DMA_P_CSC_POST_BV20_ADDR A:0xfd9935c0
y.create.l HWIO_MMSS_MDP_DMA_P_CSC_POST_BV21_ADDR A:0xfd9935c4
y.create.l HWIO_MMSS_MDP_DMA_P_CSC_POST_BV22_ADDR A:0xfd9935c8
y.create.l HWIO_MMSS_MDP_DMA_P_CSC_PRE_LV10_ADDR A:0xfd993600
y.create.l HWIO_MMSS_MDP_DMA_P_CSC_PRE_LV11_ADDR A:0xfd993604
y.create.l HWIO_MMSS_MDP_DMA_P_CSC_PRE_LV12_ADDR A:0xfd993608
y.create.l HWIO_MMSS_MDP_DMA_P_CSC_PRE_LV13_ADDR A:0xfd99360c
y.create.l HWIO_MMSS_MDP_DMA_P_CSC_PRE_LV14_ADDR A:0xfd993610
y.create.l HWIO_MMSS_MDP_DMA_P_CSC_PRE_LV15_ADDR A:0xfd993614
y.create.l HWIO_MMSS_MDP_DMA_P_CSC_PRE_LV20_ADDR A:0xfd993640
y.create.l HWIO_MMSS_MDP_DMA_P_CSC_PRE_LV21_ADDR A:0xfd993644
y.create.l HWIO_MMSS_MDP_DMA_P_CSC_PRE_LV22_ADDR A:0xfd993648
y.create.l HWIO_MMSS_MDP_DMA_P_CSC_PRE_LV23_ADDR A:0xfd99364c
y.create.l HWIO_MMSS_MDP_DMA_P_CSC_PRE_LV24_ADDR A:0xfd993650
y.create.l HWIO_MMSS_MDP_DMA_P_CSC_PRE_LV25_ADDR A:0xfd993654
y.create.l HWIO_MMSS_MDP_DMA_P_CSC_POST_LV10_ADDR A:0xfd993680
y.create.l HWIO_MMSS_MDP_DMA_P_CSC_POST_LV11_ADDR A:0xfd993684
y.create.l HWIO_MMSS_MDP_DMA_P_CSC_POST_LV12_ADDR A:0xfd993688
y.create.l HWIO_MMSS_MDP_DMA_P_CSC_POST_LV13_ADDR A:0xfd99368c
y.create.l HWIO_MMSS_MDP_DMA_P_CSC_POST_LV14_ADDR A:0xfd993690
y.create.l HWIO_MMSS_MDP_DMA_P_CSC_POST_LV15_ADDR A:0xfd993694
y.create.l HWIO_MMSS_MDP_DMA_P_CSC_POST_LV20_ADDR A:0xfd9936c0
y.create.l HWIO_MMSS_MDP_DMA_P_CSC_POST_LV21_ADDR A:0xfd9936c4
y.create.l HWIO_MMSS_MDP_DMA_P_CSC_POST_LV22_ADDR A:0xfd9936c8
y.create.l HWIO_MMSS_MDP_DMA_P_CSC_POST_LV23_ADDR A:0xfd9936cc
y.create.l HWIO_MMSS_MDP_DMA_P_CSC_POST_LV24_ADDR A:0xfd9936d0
y.create.l HWIO_MMSS_MDP_DMA_P_CSC_POST_LV25_ADDR A:0xfd9936d4
y.create.l HWIO_MMSS_MDP_DMA_P_CSC_LUT10_ADDR A:0xfd993800
y.create.l HWIO_MMSS_MDP_DMA_P_CSC_LUT11_ADDR A:0xfd993804
y.create.l HWIO_MMSS_MDP_DMA_P_CSC_LUT12_ADDR A:0xfd993808
y.create.l HWIO_MMSS_MDP_DMA_P_CSC_LUT13_ADDR A:0xfd99380c
y.create.l HWIO_MMSS_MDP_DMA_P_CSC_LUT14_ADDR A:0xfd993810
y.create.l HWIO_MMSS_MDP_DMA_P_CSC_LUT15_ADDR A:0xfd993814
y.create.l HWIO_MMSS_MDP_DMA_P_CSC_LUT16_ADDR A:0xfd993818
y.create.l HWIO_MMSS_MDP_DMA_P_CSC_LUT17_ADDR A:0xfd99381c
y.create.l HWIO_MMSS_MDP_DMA_P_CSC_LUT18_ADDR A:0xfd993820
y.create.l HWIO_MMSS_MDP_DMA_P_CSC_LUT19_ADDR A:0xfd993824
y.create.l HWIO_MMSS_MDP_DMA_P_CSC_LUT20_ADDR A:0xfd993c00
y.create.l HWIO_MMSS_MDP_DMA_P_CSC_LUT21_ADDR A:0xfd993c04
y.create.l HWIO_MMSS_MDP_DMA_P_CSC_LUT22_ADDR A:0xfd993c08
y.create.l HWIO_MMSS_MDP_DMA_P_CSC_LUT23_ADDR A:0xfd993c0c
y.create.l HWIO_MMSS_MDP_DMA_P_CSC_LUT24_ADDR A:0xfd993c10
y.create.l HWIO_MMSS_MDP_DMA_P_CSC_LUT25_ADDR A:0xfd993c14
y.create.l HWIO_MMSS_MDP_DMA_P_CSC_LUT26_ADDR A:0xfd993c18
y.create.l HWIO_MMSS_MDP_DMA_P_CSC_LUT27_ADDR A:0xfd993c1c
y.create.l HWIO_MMSS_MDP_DMA_P_CSC_LUT28_ADDR A:0xfd993c20
y.create.l HWIO_MMSS_MDP_DMA_P_CSC_LUT29_ADDR A:0xfd993c24
y.create.l HWIO_MMSS_MDP_DMA_P_HIST_START_ADDR A:0xfd994000
y.create.l HWIO_MMSS_MDP_DMA_P_HIST_FRAME_CNT_ADDR A:0xfd994004
y.create.l HWIO_MMSS_MDP_DMA_P_HIST_BIT_MASK_ADDR A:0xfd994008
y.create.l HWIO_MMSS_MDP_DMA_P_HIST_RESET_SEQ_START_ADDR A:0xfd99400c
y.create.l HWIO_MMSS_MDP_DMA_P_HIST_CONTROL_ADDR A:0xfd994010
y.create.l HWIO_MMSS_MDP_DMA_P_HIST_INTR_STATUS_ADDR A:0xfd994014
y.create.l HWIO_MMSS_MDP_DMA_P_HIST_INTR_CLEAR_ADDR A:0xfd994018
y.create.l HWIO_MMSS_MDP_DMA_P_HIST_INTR_ENABLE_ADDR A:0xfd99401c
y.create.l HWIO_MMSS_MDP_DMA_P_HIST_STOP_REQ_ADDR A:0xfd994020
y.create.l HWIO_MMSS_MDP_DMA_P_HIST_CANCEL_REQ_ADDR A:0xfd994024
y.create.l HWIO_MMSS_MDP_DMA_P_HIST_EXTRA_INFO_0_ADDR A:0xfd994028
y.create.l HWIO_MMSS_MDP_DMA_P_HIST_EXTRA_INFO_1_ADDR A:0xfd99402c
y.create.l HWIO_MMSS_MDP_DMA_P_HIST_R_DATA0_ADDR A:0xfd994100
y.create.l HWIO_MMSS_MDP_DMA_P_HIST_R_DATA1_ADDR A:0xfd994104
y.create.l HWIO_MMSS_MDP_DMA_P_HIST_R_DATA2_ADDR A:0xfd994108
y.create.l HWIO_MMSS_MDP_DMA_P_HIST_R_DATA3_ADDR A:0xfd99410c
y.create.l HWIO_MMSS_MDP_DMA_P_HIST_R_DATA4_ADDR A:0xfd994110
y.create.l HWIO_MMSS_MDP_DMA_P_HIST_R_DATA5_ADDR A:0xfd994114
y.create.l HWIO_MMSS_MDP_DMA_P_HIST_R_DATA6_ADDR A:0xfd994118
y.create.l HWIO_MMSS_MDP_DMA_P_HIST_R_DATA7_ADDR A:0xfd99411c
y.create.l HWIO_MMSS_MDP_DMA_P_HIST_R_DATA8_ADDR A:0xfd994120
y.create.l HWIO_MMSS_MDP_DMA_P_HIST_R_DATA9_ADDR A:0xfd994124
y.create.l HWIO_MMSS_MDP_DMA_P_HIST_G_DATA0_ADDR A:0xfd994200
y.create.l HWIO_MMSS_MDP_DMA_P_HIST_G_DATA1_ADDR A:0xfd994204
y.create.l HWIO_MMSS_MDP_DMA_P_HIST_G_DATA2_ADDR A:0xfd994208
y.create.l HWIO_MMSS_MDP_DMA_P_HIST_G_DATA3_ADDR A:0xfd99420c
y.create.l HWIO_MMSS_MDP_DMA_P_HIST_G_DATA4_ADDR A:0xfd994210
y.create.l HWIO_MMSS_MDP_DMA_P_HIST_G_DATA5_ADDR A:0xfd994214
y.create.l HWIO_MMSS_MDP_DMA_P_HIST_G_DATA6_ADDR A:0xfd994218
y.create.l HWIO_MMSS_MDP_DMA_P_HIST_G_DATA7_ADDR A:0xfd99421c
y.create.l HWIO_MMSS_MDP_DMA_P_HIST_G_DATA8_ADDR A:0xfd994220
y.create.l HWIO_MMSS_MDP_DMA_P_HIST_G_DATA9_ADDR A:0xfd994224
y.create.l HWIO_MMSS_MDP_DMA_P_HIST_B_DATA0_ADDR A:0xfd994300
y.create.l HWIO_MMSS_MDP_DMA_P_HIST_B_DATA1_ADDR A:0xfd994304
y.create.l HWIO_MMSS_MDP_DMA_P_HIST_B_DATA2_ADDR A:0xfd994308
y.create.l HWIO_MMSS_MDP_DMA_P_HIST_B_DATA3_ADDR A:0xfd99430c
y.create.l HWIO_MMSS_MDP_DMA_P_HIST_B_DATA4_ADDR A:0xfd994310
y.create.l HWIO_MMSS_MDP_DMA_P_HIST_B_DATA5_ADDR A:0xfd994314
y.create.l HWIO_MMSS_MDP_DMA_P_HIST_B_DATA6_ADDR A:0xfd994318
y.create.l HWIO_MMSS_MDP_DMA_P_HIST_B_DATA7_ADDR A:0xfd99431c
y.create.l HWIO_MMSS_MDP_DMA_P_HIST_B_DATA8_ADDR A:0xfd994320
y.create.l HWIO_MMSS_MDP_DMA_P_HIST_B_DATA9_ADDR A:0xfd994324
y.create.l HWIO_MMSS_MDP_DMA_P_FETCH_CFG_ADDR A:0xfd990074
y.create.l HWIO_MMSS_MDP_DMA_P_PKR_ADDR_ADDR A:0xfd990078
y.create.l HWIO_MMSS_MDP_DMA_P_DCVS_CTRL_ADDR A:0xfd990080
y.create.l HWIO_MMSS_MDP_DMA_P_DCVS_STATUS_ADDR A:0xfd990084
y.create.l HWIO_MMSS_MDP_DMA_S_CONFIG_ADDR A:0xfd9a0000
y.create.l HWIO_MMSS_MDP_DMA_S_SIZE_ADDR A:0xfd9a0004
y.create.l HWIO_MMSS_MDP_DMA_S_IBUF_ADDR_ADDR A:0xfd9a0008
y.create.l HWIO_MMSS_MDP_DMA_S_IBUF_Y_STRIDE_ADDR A:0xfd9a000c
y.create.l HWIO_MMSS_MDP_DMA_S_OUT_XY_ADDR A:0xfd9a0010
y.create.l HWIO_MMSS_MDP_DMA_S_LINE_COUNT_ADDR A:0xfd9a0014
y.create.l HWIO_MMSS_MDP_DMA_S_LINE_IRQ_ADDR A:0xfd9a0018
y.create.l HWIO_MMSS_MDP_DMA_S_MASK_PATTERN_ADDR A:0xfd9a001c
y.create.l HWIO_MMSS_MDP_DMA_S_PROFILE_EN_ADDR A:0xfd9a0020
y.create.l HWIO_MMSS_MDP_DMA_S_PROFILE_COUNT_ADDR A:0xfd9a0024
y.create.l HWIO_MMSS_MDP_DMA_E_CONFIG_ADDR A:0xfd9b0000
y.create.l HWIO_MMSS_MDP_DMA_E_SIZE_ADDR A:0xfd9b0004
y.create.l HWIO_MMSS_MDP_DMA_E_IBUF_ADDR_ADDR A:0xfd9b0008
y.create.l HWIO_MMSS_MDP_DMA_E_IBUF_Y_STRIDE_ADDR A:0xfd9b000c
y.create.l HWIO_MMSS_MDP_DMA_E_OUT_XY_ADDR A:0xfd9b0010
y.create.l HWIO_MMSS_MDP_DMA_E_LINE_COUNT_ADDR A:0xfd9b0014
y.create.l HWIO_MMSS_MDP_DMA_E_LINE_IRQ_ADDR A:0xfd9b0018
y.create.l HWIO_MMSS_MDP_DMA_E_MASK_PATTERN_ADDR A:0xfd9b001c
y.create.l HWIO_MMSS_MDP_DMA_E_PROFILE_EN_ADDR A:0xfd9b0020
y.create.l HWIO_MMSS_MDP_DMA_E_PROFILE_COUNT_ADDR A:0xfd9b0024
y.create.l HWIO_MMSS_MDP_TV_OUT_CTL_ADDR A:0xfd9c0000
y.create.l HWIO_MMSS_MDP_TV_OUT_FIR_COEFF_ADDR A:0xfd9c0004
y.create.l HWIO_MMSS_MDP_TV_OUT_BUF_ADDR_ADDR A:0xfd9c0008
y.create.l HWIO_MMSS_MDP_TV_OUT_CC_DATA_ADDR A:0xfd9c000c
y.create.l HWIO_MMSS_MDP_TV_OUT_SOBEL_ADDR A:0xfd9c0010
y.create.l HWIO_MMSS_MDP_TV_OUT_Y_CLAMP_ADDR A:0xfd9c0018
y.create.l HWIO_MMSS_MDP_TV_OUT_CB_CLAMP_ADDR A:0xfd9c001c
y.create.l HWIO_MMSS_MDP_TV_OUT_CR_CLAMP_ADDR A:0xfd9c0020
y.create.l HWIO_MMSS_MDP_TV_OUT_STATUS_ADDR A:0xfd9c0100
y.create.l HWIO_MMSS_MDP_DTV_OUT_CONFIG_ADDR A:0xfd9c0200
y.create.l HWIO_MMSS_MDP_DTV_OUT_SIZE_ADDR A:0xfd9c0204
y.create.l HWIO_MMSS_MDP_DTV_OUT_IBUF_ADDR_ADDR A:0xfd9c0208
y.create.l HWIO_MMSS_MDP_DTV_OUT_IBUF_Y_STRIDE_ADDR A:0xfd9c020c
y.create.l HWIO_MMSS_MDP_DTV_OUT_Y_CLAMP_ADDR A:0xfd9c0210
y.create.l HWIO_MMSS_MDP_DTV_OUT_CB_CLAMP_ADDR A:0xfd9c0214
y.create.l HWIO_MMSS_MDP_DTV_OUT_CR_CLAMP_ADDR A:0xfd9c0218
y.create.l HWIO_MMSS_MDP_DTV_OUT_LINE_COUNT_ADDR A:0xfd9c021c
y.create.l HWIO_MMSS_MDP_DTV_OUT_LINE_IRQ_ADDR A:0xfd9c0220
y.create.l HWIO_MMSS_MDP_DTV_OUT_PROFILE_EN_ADDR A:0xfd9c0224
y.create.l HWIO_MMSS_MDP_DTV_OUT_PROFILE_COUNT_ADDR A:0xfd9c0228
y.create.l HWIO_MMSS_MDP_DTV_OUT_CYCLES_PER_LINE_ADDR A:0xfd9c022c
y.create.l HWIO_MMSS_MDP_DTV_OUT_PREFILL_LEVEL_ADDR A:0xfd9c0230
y.create.l HWIO_MMSS_MDP_DTV_OUT_WR_RD_PTR_DIFF_ADDR A:0xfd9c0234
y.create.l HWIO_MMSS_MDP_DTV_OUT_SRAM_ADDR_ADDR A:0xfd9c0238
y.create.l HWIO_MMSS_MDP_DTV_OUT_SRAM_WR_DATA_LSB_ADDR A:0xfd9c023c
y.create.l HWIO_MMSS_MDP_DTV_OUT_SRAM_WR_DATA_MSB_ADDR A:0xfd9c0240
y.create.l HWIO_MMSS_MDP_DTV_OUT_SRAM_RD_DATA_LSB_ADDR A:0xfd9c0244
y.create.l HWIO_MMSS_MDP_DTV_OUT_SRAM_RD_DATA_MSB_ADDR A:0xfd9c0248
y.create.l HWIO_MMSS_MDP_DTV_TGEN_MODE_ADDR A:0xfd9c8000
y.create.l HWIO_MMSS_MDP_DTV_TGEN_HSYNC_CTL_ADDR A:0xfd9c8004
y.create.l HWIO_MMSS_MDP_DTV_TGEN_VSYNC_PERIOD_ADDR A:0xfd9c8008
y.create.l HWIO_MMSS_MDP_DTV_TGEN_VSYNC_PULSE_WIDTH_ADDR A:0xfd9c800c
y.create.l HWIO_MMSS_MDP_DTV_TGEN_DISPLAY_HCTL_ADDR A:0xfd9c8010
y.create.l HWIO_MMSS_MDP_DTV_TGEN_DISPLAY_V_START_ADDR A:0xfd9c8014
y.create.l HWIO_MMSS_MDP_DTV_TGEN_DISPLAY_V_END_ADDR A:0xfd9c8018
y.create.l HWIO_MMSS_MDP_DTV_TGEN_ACTIVE_HCTL_ADDR A:0xfd9c801c
y.create.l HWIO_MMSS_MDP_DTV_TGEN_ACTIVE_V_START_ADDR A:0xfd9c8020
y.create.l HWIO_MMSS_MDP_DTV_TGEN_ACTIVE_V_END_ADDR A:0xfd9c8024
y.create.l HWIO_MMSS_MDP_DTV_TGEN_BORDER_CLR_ADDR A:0xfd9c8028
y.create.l HWIO_MMSS_MDP_DTV_TGEN_UNDERFLOW_CTL_ADDR A:0xfd9c802c
y.create.l HWIO_MMSS_MDP_DTV_TGEN_HSYNC_SKEW_ADDR A:0xfd9c8030
y.create.l HWIO_MMSS_MDP_DTV_TGEN_CTL_POLARITY_ADDR A:0xfd9c8034
y.create.l HWIO_MMSS_MDP_DTV_TGEN_TEST_CTL_ADDR A:0xfd9c8038
y.create.l HWIO_MMSS_MDP_DTV_TGEN_TEST_PATT_SIZE_ADDR A:0xfd9c803c
y.create.l HWIO_MMSS_MDP_DTV_TGEN_TPG_CLR0_ADDR A:0xfd9c8040
y.create.l HWIO_MMSS_MDP_DTV_TGEN_TPG_CLR1_ADDR A:0xfd9c8044
y.create.l HWIO_MMSS_MDP_DTV_TGEN_TPG_CLR2_ADDR A:0xfd9c8048
y.create.l HWIO_MMSS_MDP_DTV_TGEN_TPG_CLR3_ADDR A:0xfd9c804c
y.create.l HWIO_MMSS_MDP_DTV_TGEN_TPG_CLR4_ADDR A:0xfd9c8050
y.create.l HWIO_MMSS_MDP_DTV_TGEN_TPG_CLR5_ADDR A:0xfd9c8054
y.create.l HWIO_MMSS_MDP_DTV_TGEN_TPG_CLR6_ADDR A:0xfd9c8058
y.create.l HWIO_MMSS_MDP_DTV_TGEN_TPG_CLR7_ADDR A:0xfd9c805c
y.create.l HWIO_MMSS_MDP_TEST_MODE_CLK_ADDR A:0xfd9d0000
y.create.l HWIO_MMSS_MDP_TEST_MISR_RESET_CLK_ADDR A:0xfd9d0004
y.create.l HWIO_MMSS_MDP_TEST_EXPORT_MISR_CLK_ADDR A:0xfd9d0008
y.create.l HWIO_MMSS_MDP_TEST_MISR_CURR_VAL_CLK_ADDR A:0xfd9d000c
y.create.l HWIO_MMSS_MDP_TEST_MODE_HCLK_ADDR A:0xfd9d0100
y.create.l HWIO_MMSS_MDP_TEST_MISR_RESET_HCLK_ADDR A:0xfd9d0104
y.create.l HWIO_MMSS_MDP_TEST_EXPORT_MISR_HCLK_ADDR A:0xfd9d0108
y.create.l HWIO_MMSS_MDP_TEST_MISR_CURR_VAL_HCLK_ADDR A:0xfd9d010c
y.create.l HWIO_MMSS_MDP_TEST_MODE_DCLK_ADDR A:0xfd9d0200
y.create.l HWIO_MMSS_MDP_TEST_MISR_RESET_DCLK_ADDR A:0xfd9d0204
y.create.l HWIO_MMSS_MDP_TEST_EXPORT_MISR_DCLK_ADDR A:0xfd9d0208
y.create.l HWIO_MMSS_MDP_TEST_MISR_CURR_VAL_DCLK_ADDR A:0xfd9d020c
y.create.l HWIO_MMSS_MDP_TEST_CAPTURED_DCLK_ADDR A:0xfd9d0210
y.create.l HWIO_MMSS_MDP_TEST_MISR_CAPT_VAL_DCLK_ADDR A:0xfd9d0214
y.create.l HWIO_MMSS_MDP_TEST_MODE_TVCLK_ADDR A:0xfd9d0300
y.create.l HWIO_MMSS_MDP_TEST_MISR_RESET_TVCLK_ADDR A:0xfd9d0304
y.create.l HWIO_MMSS_MDP_TEST_EXPORT_MISR_TVCLK_ADDR A:0xfd9d0308
y.create.l HWIO_MMSS_MDP_TEST_MISR_CURR_VAL_TVCLK_ADDR A:0xfd9d030c
y.create.l HWIO_MMSS_MDP_TEST_CAPTURED_TVCLK_ADDR A:0xfd9d0310
y.create.l HWIO_MMSS_MDP_TEST_MISR_CAPT_VAL_TVCLK_ADDR A:0xfd9d0314
y.create.l HWIO_MMSS_MDP_TEST_MODE_DSI_PCLK_ADDR A:0xfd9d0400
y.create.l HWIO_MMSS_MDP_TEST_MISR_RESET_DSI_PCLK_ADDR A:0xfd9d0404
y.create.l HWIO_MMSS_MDP_TEST_EXPORT_MISR_DSI_PCLK_ADDR A:0xfd9d0408
y.create.l HWIO_MMSS_MDP_TEST_MISR_CURR_VAL_DSI_PCLK_ADDR A:0xfd9d040c
y.create.l HWIO_MMSS_MDP_TEST_CAPTURED_DSI_PCLK_ADDR A:0xfd9d0410
y.create.l HWIO_MMSS_MDP_TEST_MISR_CAPT_VAL_DSI_PCLK_ADDR A:0xfd9d0414
y.create.l HWIO_MMSS_MDP_TEST_MISR_TESTBUS_CAPT_VAL_ADDR A:0xfd9d0600
y.create.l HWIO_MMSS_MDP_LCDC_EN_ADDR A:0xfd9e0000
y.create.l HWIO_MMSS_MDP_LCDC_HSYNC_CTL_ADDR A:0xfd9e0004
y.create.l HWIO_MMSS_MDP_LCDC_VSYNC_PERIOD_ADDR A:0xfd9e0008
y.create.l HWIO_MMSS_MDP_LCDC_VSYNC_PULSE_WIDTH_ADDR A:0xfd9e000c
y.create.l HWIO_MMSS_MDP_LCDC_DISPLAY_HCTL_ADDR A:0xfd9e0010
y.create.l HWIO_MMSS_MDP_LCDC_DISPLAY_V_START_ADDR A:0xfd9e0014
y.create.l HWIO_MMSS_MDP_LCDC_DISPLAY_V_END_ADDR A:0xfd9e0018
y.create.l HWIO_MMSS_MDP_LCDC_ACTIVE_HCTL_ADDR A:0xfd9e001c
y.create.l HWIO_MMSS_MDP_LCDC_ACTIVE_V_START_ADDR A:0xfd9e0020
y.create.l HWIO_MMSS_MDP_LCDC_ACTIVE_V_END_ADDR A:0xfd9e0024
y.create.l HWIO_MMSS_MDP_LCDC_BORDER_CLR_ADDR A:0xfd9e0028
y.create.l HWIO_MMSS_MDP_LCDC_UNDERFLOW_CTL_ADDR A:0xfd9e002c
y.create.l HWIO_MMSS_MDP_LCDC_HSYNC_SKEW_ADDR A:0xfd9e0030
y.create.l HWIO_MMSS_MDP_LCDC_TEST_CTL_ADDR A:0xfd9e0034
y.create.l HWIO_MMSS_MDP_LCDC_CTL_POLARITY_ADDR A:0xfd9e0038
y.create.l HWIO_MMSS_MDP_LCDC_TEST_COL_VAR1_ADDR A:0xfd9e003c
y.create.l HWIO_MMSS_MDP_LCDC_TEST_COL_VAR2_ADDR A:0xfd9e0040
y.create.l HWIO_MMSS_MDP_LCDC_UFLOW_HIDING_CTL_ADDR A:0xfd9e0044
y.create.l HWIO_MMSS_MDP_LCDC_LOST_PIXEL_CNT_VALUE_ADDR A:0xfd9e0048
y.create.l HWIO_MMSS_MDP_DSI_VIDEO_EN_ADDR A:0xfd9f0000
y.create.l HWIO_MMSS_MDP_DSI_VIDEO_HSYNC_CTL_ADDR A:0xfd9f0004
y.create.l HWIO_MMSS_MDP_DSI_VIDEO_VSYNC_PERIOD_ADDR A:0xfd9f0008
y.create.l HWIO_MMSS_MDP_DSI_VIDEO_VSYNC_PULSE_WIDTH_ADDR A:0xfd9f000c
y.create.l HWIO_MMSS_MDP_DSI_VIDEO_DISPLAY_HCTL_ADDR A:0xfd9f0010
y.create.l HWIO_MMSS_MDP_DSI_VIDEO_DISPLAY_V_START_ADDR A:0xfd9f0014
y.create.l HWIO_MMSS_MDP_DSI_VIDEO_DISPLAY_V_END_ADDR A:0xfd9f0018
y.create.l HWIO_MMSS_MDP_DSI_VIDEO_ACTIVE_HCTL_ADDR A:0xfd9f001c
y.create.l HWIO_MMSS_MDP_DSI_VIDEO_ACTIVE_V_START_ADDR A:0xfd9f0020
y.create.l HWIO_MMSS_MDP_DSI_VIDEO_ACTIVE_V_END_ADDR A:0xfd9f0024
y.create.l HWIO_MMSS_MDP_DSI_VIDEO_BORDER_CLR_ADDR A:0xfd9f0028
y.create.l HWIO_MMSS_MDP_DSI_VIDEO_UNDERFLOW_CTL_ADDR A:0xfd9f002c
y.create.l HWIO_MMSS_MDP_DSI_VIDEO_HSYNC_SKEW_ADDR A:0xfd9f0030
y.create.l HWIO_MMSS_MDP_DSI_VIDEO_TEST_CTL_ADDR A:0xfd9f0034
y.create.l HWIO_MMSS_MDP_DSI_VIDEO_CTL_POLARITY_ADDR A:0xfd9f0038
y.create.l HWIO_MMSS_MDP_DSI_VIDEO_TEST_COL_VAR1_ADDR A:0xfd9f003c
y.create.l HWIO_MMSS_MDP_DSI_VIDEO_TEST_COL_VAR2_ADDR A:0xfd9f0040
y.create.l HWIO_MMSS_MDP_DSI_VIDEO_UFLOW_HIDING_CTL_ADDR A:0xfd9f0044
y.create.l HWIO_MMSS_MDP_DSI_VIDEO_LOST_PIXEL_CNT_VALUE_ADDR A:0xfd9f0048
y.create.l HWIO_MMSS_MDP_DSI_CMD_MODE_ID_MAP_ADDR A:0xfd9f1000
y.create.l HWIO_MMSS_MDP_DSI_CMD_MODE_TRIGGER_EN_ADDR A:0xfd9f1004
y.create.l HWIO_CSID_0_CSID_HW_VERSION_ADDR A:0xfda00000
y.create.l HWIO_CSID_0_CSID_CORE_CTRL_ADDR A:0xfda00004
y.create.l HWIO_CSID_0_CSID_RST_CMD_ADDR A:0xfda00008
y.create.l HWIO_CSID_0_CSID_CID_LUT_VC_0_ADDR A:0xfda0000c
y.create.l HWIO_CSID_0_CSID_CID_LUT_VC_1_ADDR A:0xfda00010
y.create.l HWIO_CSID_0_CSID_CID_LUT_VC_2_ADDR A:0xfda00014
y.create.l HWIO_CSID_0_CSID_CID_LUT_VC_3_ADDR A:0xfda00018
y.create.l HWIO_CSID_0_CSID_CID_0_CFG_ADDR A:0xfda0001c
y.create.l HWIO_CSID_0_CSID_CID_1_CFG_ADDR A:0xfda00020
y.create.l HWIO_CSID_0_CSID_CID_2_CFG_ADDR A:0xfda00024
y.create.l HWIO_CSID_0_CSID_CID_3_CFG_ADDR A:0xfda00028
y.create.l HWIO_CSID_0_CSID_CID_4_CFG_ADDR A:0xfda0002c
y.create.l HWIO_CSID_0_CSID_CID_5_CFG_ADDR A:0xfda00030
y.create.l HWIO_CSID_0_CSID_CID_6_CFG_ADDR A:0xfda00034
y.create.l HWIO_CSID_0_CSID_CID_7_CFG_ADDR A:0xfda00038
y.create.l HWIO_CSID_0_CSID_CID_8_CFG_ADDR A:0xfda0003c
y.create.l HWIO_CSID_0_CSID_CID_9_CFG_ADDR A:0xfda00040
y.create.l HWIO_CSID_0_CSID_IRQ_CLEAR_CMD_ADDR A:0xfda0005c
y.create.l HWIO_CSID_0_CSID_IRQ_MASK_ADDR A:0xfda00060
y.create.l HWIO_CSID_0_CSID_IRQ_STATUS_ADDR A:0xfda00064
y.create.l HWIO_CSID_0_CSID_CAPTURED_UNMAPPED_LONG_PKT_HDR_ADDR A:0xfda00068
y.create.l HWIO_CSID_0_CSID_CAPTURED_MMAPPED_LONG_PKT_HDR_ADDR A:0xfda0006c
y.create.l HWIO_CSID_0_CSID_CAPTURED_SHORT_PKT_ADDR A:0xfda00070
y.create.l HWIO_CSID_0_CSID_CAPTURED_LONG_PKT_HDR_ADDR A:0xfda00074
y.create.l HWIO_CSID_0_CSID_CAPTURED_LONG_PKT_FTR_ADDR A:0xfda00078
y.create.l HWIO_CSID_0_CSID_PIF_MISR_DL0_ADDR A:0xfda0007c
y.create.l HWIO_CSID_0_CSID_PIF_MISR_DL1_ADDR A:0xfda00080
y.create.l HWIO_CSID_0_CSID_PIF_MISR_DL2_ADDR A:0xfda00084
y.create.l HWIO_CSID_0_CSID_PIF_MISR_DL3_ADDR A:0xfda00088
y.create.l HWIO_CSID_0_CSID_STATS_TOTAL_PKTS_RCVD_ADDR A:0xfda0008c
y.create.l HWIO_CSID_0_CSID_STATS_ECC_ADDR A:0xfda00090
y.create.l HWIO_CSID_0_CSID_STATS_CRC_ADDR A:0xfda00094
y.create.l HWIO_CSID_0_CSID_TEST_BUS_CTRL_ADDR A:0xfda00098
y.create.l HWIO_CSID_0_CSID_TG_CTRL_ADDR A:0xfda0009c
y.create.l HWIO_CSID_0_CSID_TG_VC_CFG_ADDR A:0xfda000a0
y.create.l HWIO_CSID_0_CSID_TG_PAYLOAD_LFSR_SEED_ADDR A:0xfda000a4
y.create.l HWIO_CSID_0_CSID_TG_DT_0_CFG_0_ADDR A:0xfda000a8
y.create.l HWIO_CSID_0_CSID_TG_DT_1_CFG_0_ADDR A:0xfda000b4
y.create.l HWIO_CSID_0_CSID_TG_DT_2_CFG_0_ADDR A:0xfda000c0
y.create.l HWIO_CSID_0_CSID_TG_DT_3_CFG_0_ADDR A:0xfda000cc
y.create.l HWIO_CSID_0_CSID_TG_DT_0_CFG_1_ADDR A:0xfda000ac
y.create.l HWIO_CSID_0_CSID_TG_DT_1_CFG_1_ADDR A:0xfda000b8
y.create.l HWIO_CSID_0_CSID_TG_DT_2_CFG_1_ADDR A:0xfda000c4
y.create.l HWIO_CSID_0_CSID_TG_DT_3_CFG_1_ADDR A:0xfda000d0
y.create.l HWIO_CSID_0_CSID_TG_DT_0_CFG_2_ADDR A:0xfda000b0
y.create.l HWIO_CSID_0_CSID_TG_DT_1_CFG_2_ADDR A:0xfda000bc
y.create.l HWIO_CSID_0_CSID_TG_DT_2_CFG_2_ADDR A:0xfda000c8
y.create.l HWIO_CSID_0_CSID_TG_DT_3_CFG_2_ADDR A:0xfda000d4
y.create.l HWIO_CSID_0_CSID_SPARE_0_ADDR A:0xfda000d8
y.create.l HWIO_CSID_0_CSID_SPARE_1_ADDR A:0xfda000dc
y.create.l HWIO_CSID_1_CSID_HW_VERSION_ADDR A:0xfda00400
y.create.l HWIO_CSID_1_CSID_CORE_CTRL_ADDR A:0xfda00404
y.create.l HWIO_CSID_1_CSID_RST_CMD_ADDR A:0xfda00408
y.create.l HWIO_CSID_1_CSID_CID_LUT_VC_0_ADDR A:0xfda0040c
y.create.l HWIO_CSID_1_CSID_CID_LUT_VC_1_ADDR A:0xfda00410
y.create.l HWIO_CSID_1_CSID_CID_LUT_VC_2_ADDR A:0xfda00414
y.create.l HWIO_CSID_1_CSID_CID_LUT_VC_3_ADDR A:0xfda00418
y.create.l HWIO_CSID_1_CSID_CID_0_CFG_ADDR A:0xfda0041c
y.create.l HWIO_CSID_1_CSID_CID_1_CFG_ADDR A:0xfda00420
y.create.l HWIO_CSID_1_CSID_CID_2_CFG_ADDR A:0xfda00424
y.create.l HWIO_CSID_1_CSID_CID_3_CFG_ADDR A:0xfda00428
y.create.l HWIO_CSID_1_CSID_CID_4_CFG_ADDR A:0xfda0042c
y.create.l HWIO_CSID_1_CSID_CID_5_CFG_ADDR A:0xfda00430
y.create.l HWIO_CSID_1_CSID_CID_6_CFG_ADDR A:0xfda00434
y.create.l HWIO_CSID_1_CSID_CID_7_CFG_ADDR A:0xfda00438
y.create.l HWIO_CSID_1_CSID_CID_8_CFG_ADDR A:0xfda0043c
y.create.l HWIO_CSID_1_CSID_CID_9_CFG_ADDR A:0xfda00440
y.create.l HWIO_CSID_1_CSID_IRQ_CLEAR_CMD_ADDR A:0xfda0045c
y.create.l HWIO_CSID_1_CSID_IRQ_MASK_ADDR A:0xfda00460
y.create.l HWIO_CSID_1_CSID_IRQ_STATUS_ADDR A:0xfda00464
y.create.l HWIO_CSID_1_CSID_CAPTURED_UNMAPPED_LONG_PKT_HDR_ADDR A:0xfda00468
y.create.l HWIO_CSID_1_CSID_CAPTURED_MMAPPED_LONG_PKT_HDR_ADDR A:0xfda0046c
y.create.l HWIO_CSID_1_CSID_CAPTURED_SHORT_PKT_ADDR A:0xfda00470
y.create.l HWIO_CSID_1_CSID_CAPTURED_LONG_PKT_HDR_ADDR A:0xfda00474
y.create.l HWIO_CSID_1_CSID_CAPTURED_LONG_PKT_FTR_ADDR A:0xfda00478
y.create.l HWIO_CSID_1_CSID_PIF_MISR_DL0_ADDR A:0xfda0047c
y.create.l HWIO_CSID_1_CSID_PIF_MISR_DL1_ADDR A:0xfda00480
y.create.l HWIO_CSID_1_CSID_PIF_MISR_DL2_ADDR A:0xfda00484
y.create.l HWIO_CSID_1_CSID_PIF_MISR_DL3_ADDR A:0xfda00488
y.create.l HWIO_CSID_1_CSID_STATS_TOTAL_PKTS_RCVD_ADDR A:0xfda0048c
y.create.l HWIO_CSID_1_CSID_STATS_ECC_ADDR A:0xfda00490
y.create.l HWIO_CSID_1_CSID_STATS_CRC_ADDR A:0xfda00494
y.create.l HWIO_CSID_1_CSID_TEST_BUS_CTRL_ADDR A:0xfda00498
y.create.l HWIO_CSID_1_CSID_TG_CTRL_ADDR A:0xfda0049c
y.create.l HWIO_CSID_1_CSID_TG_VC_CFG_ADDR A:0xfda004a0
y.create.l HWIO_CSID_1_CSID_TG_PAYLOAD_LFSR_SEED_ADDR A:0xfda004a4
y.create.l HWIO_CSID_1_CSID_TG_DT_0_CFG_0_ADDR A:0xfda004a8
y.create.l HWIO_CSID_1_CSID_TG_DT_1_CFG_0_ADDR A:0xfda004b4
y.create.l HWIO_CSID_1_CSID_TG_DT_2_CFG_0_ADDR A:0xfda004c0
y.create.l HWIO_CSID_1_CSID_TG_DT_3_CFG_0_ADDR A:0xfda004cc
y.create.l HWIO_CSID_1_CSID_TG_DT_0_CFG_1_ADDR A:0xfda004ac
y.create.l HWIO_CSID_1_CSID_TG_DT_1_CFG_1_ADDR A:0xfda004b8
y.create.l HWIO_CSID_1_CSID_TG_DT_2_CFG_1_ADDR A:0xfda004c4
y.create.l HWIO_CSID_1_CSID_TG_DT_3_CFG_1_ADDR A:0xfda004d0
y.create.l HWIO_CSID_1_CSID_TG_DT_0_CFG_2_ADDR A:0xfda004b0
y.create.l HWIO_CSID_1_CSID_TG_DT_1_CFG_2_ADDR A:0xfda004bc
y.create.l HWIO_CSID_1_CSID_TG_DT_2_CFG_2_ADDR A:0xfda004c8
y.create.l HWIO_CSID_1_CSID_TG_DT_3_CFG_2_ADDR A:0xfda004d4
y.create.l HWIO_CSID_1_CSID_SPARE_0_ADDR A:0xfda004d8
y.create.l HWIO_CSID_1_CSID_SPARE_1_ADDR A:0xfda004dc
y.create.l HWIO_ISPIF_RST_CMD_ADDR A:0xfda00800
y.create.l HWIO_ISPIF_INTF_CMD_ADDR A:0xfda00804
y.create.l HWIO_ISPIF_CTRL_ADDR A:0xfda00808
y.create.l HWIO_ISPIF_INPUT_SEL_ADDR A:0xfda0080c
y.create.l HWIO_ISPIF_PIX_INTF_CID_MASK_ADDR A:0xfda00810
y.create.l HWIO_ISPIF_RDI_INTF_CID_MASK_ADDR A:0xfda00814
y.create.l HWIO_ISPIF_PIX_MISR_ADDR A:0xfda00818
y.create.l HWIO_ISPIF_VFE_RDI_MISR_0_ADDR A:0xfda0081c
y.create.l HWIO_ISPIF_VFE_RDI_MISR_1_ADDR A:0xfda00820
y.create.l HWIO_ISPIF_PIX_STATUS_ADDR A:0xfda00824
y.create.l HWIO_ISPIF_RDI_STATUS_ADDR A:0xfda00828
y.create.l HWIO_ISPIF_TEST_BUS_CTRL_ADDR A:0xfda0082c
y.create.l HWIO_ISPIF_INTF_CMD_1_ADDR A:0xfda00830
y.create.l HWIO_ISPIF_RDI_1_INTF_CID_MASK_ADDR A:0xfda0083c
y.create.l HWIO_ISPIF_RDI_2_INTF_CID_MASK_ADDR A:0xfda00844
y.create.l HWIO_ISPIF_VFE_RDI_1_MISR_0_ADDR A:0xfda0084c
y.create.l HWIO_ISPIF_VFE_RDI_1_MISR_1_ADDR A:0xfda00850
y.create.l HWIO_ISPIF_VFE_RDI_2_MISR_0_ADDR A:0xfda00858
y.create.l HWIO_ISPIF_VFE_RDI_2_MISR_1_ADDR A:0xfda0085c
y.create.l HWIO_ISPIF_RDI_1_STATUS_ADDR A:0xfda00864
y.create.l HWIO_ISPIF_RDI_2_STATUS_ADDR A:0xfda0086c
y.create.l HWIO_ISPIF_IRQ_MASK_ADDR A:0xfda00900
y.create.l HWIO_ISPIF_IRQ_CLEAR_ADDR A:0xfda00904
y.create.l HWIO_ISPIF_IRQ_STATUS_ADDR A:0xfda00908
y.create.l HWIO_ISPIF_IRQ_MASK_1_ADDR A:0xfda0090c
y.create.l HWIO_ISPIF_IRQ_CLEAR_1_ADDR A:0xfda00910
y.create.l HWIO_ISPIF_IRQ_STATUS_1_ADDR A:0xfda00914
y.create.l HWIO_ISPIF_IRQ_MASK_2_ADDR A:0xfda00918
y.create.l HWIO_ISPIF_IRQ_CLEAR_2_ADDR A:0xfda0091c
y.create.l HWIO_ISPIF_IRQ_STATUS_2_ADDR A:0xfda00920
y.create.l HWIO_ISPIF_IRQ_GLOBAL_CLEAR_CMD_ADDR A:0xfda00924
y.create.l HWIO_MMSS_OXILI_RBBM_HW_VERSION_ADDR A:0xfdc00000
y.create.l HWIO_MMSS_OXILI_RBBM_HW_RELEASE_ADDR A:0xfdc00004
y.create.l HWIO_MMSS_OXILI_RBBM_HW_CONFIGURATION_ADDR A:0xfdc00008
y.create.l HWIO_MMSS_OXILI_RBBM_CLOCK_CTL_ADDR A:0xfdc00040
y.create.l HWIO_MMSS_OXILI_RBBM_CLOCK_CTL1_ADDR A:0xfdc0004c
y.create.l HWIO_MMSS_OXILI_RBBM_CLOCK_STATUS_ADDR A:0xfdc00044
y.create.l HWIO_MMSS_OXILI_RBBM_SP_HYST_CNT_ADDR A:0xfdc00048
y.create.l HWIO_MMSS_OXILI_RBBM_SW_RESET_CMD_ADDR A:0xfdc00060
y.create.l HWIO_MMSS_OXILI_RBBM_AHB_CTL0_ADDR A:0xfdc00080
y.create.l HWIO_MMSS_OXILI_RBBM_AHB_CTL1_ADDR A:0xfdc00084
y.create.l HWIO_MMSS_OXILI_RBBM_AHB_CMD_ADDR A:0xfdc00088
y.create.l HWIO_MMSS_OXILI_RBBM_AHB_STATUS_ADDR A:0xfdc0008c
y.create.l HWIO_MMSS_OXILI_RBBM_AHB_TXFR_TIMEOUT_STATUS_ADDR A:0xfdc00090
y.create.l HWIO_MMSS_OXILI_RBBM_AHB_ME_SPLIT_STATUS_ADDR A:0xfdc00094
y.create.l HWIO_MMSS_OXILI_RBBM_AHB_PFP_SPLIT_STATUS_ADDR A:0xfdc00098
y.create.l HWIO_MMSS_OXILI_RBBM_AHB_ERROR_STATUS_ADDR A:0xfdc0009c
y.create.l HWIO_MMSS_OXILI_RBBM_RB_SUB_BLOCK_SEL_CTL_ADDR A:0xfdc000a4
y.create.l HWIO_MMSS_OXILI_RBBM_GFX_COPY_CMD_ADDR A:0xfdc000a8
y.create.l HWIO_MMSS_OXILI_RBBM_GFX_COPY_STATUS_ADDR A:0xfdc000ac
y.create.l HWIO_MMSS_OXILI_RBBM_RAM_ACC_63_32_ADDR A:0xfdc000b4
y.create.l HWIO_MMSS_OXILI_RBBM_GPR0_CTL_ADDR A:0xfdc000b8
y.create.l HWIO_MMSS_OXILI_RBBM_GPR1_CTL_ADDR A:0xfdc000bc
y.create.l HWIO_MMSS_OXILI_RBBM_STATUS_ADDR A:0xfdc000c0
y.create.l HWIO_MMSS_OXILI_RBBM_STATUS1_ADDR A:0xfdc000c4
y.create.l HWIO_MMSS_OXILI_RBBM_STATUS2_ADDR A:0xfdc000c8
y.create.l HWIO_MMSS_OXILI_RBBM_WAIT_IDLE_CLOCKS_CTL_ADDR A:0xfdc000cc
y.create.l HWIO_MMSS_OXILI_RBBM_WAIT_FOR_GPU_IDLE_CMD_ADDR A:0xfdc00100
y.create.l HWIO_MMSS_OXILI_RBBM_WAIT_UNTIL_CMD_ADDR A:0xfdc00104
y.create.l HWIO_MMSS_OXILI_RBBM_WAIT_UNTIL_CTL_ADDR A:0xfdc00108
y.create.l HWIO_MMSS_OXILI_RBBM_INTERFACE_HANG_INT_CTL_ADDR A:0xfdc00140
y.create.l HWIO_MMSS_OXILI_RBBM_INTERFACE_HANG_MASK_CTL0_ADDR A:0xfdc00144
y.create.l HWIO_MMSS_OXILI_RBBM_INTERFACE_HANG_MASK_CTL1_ADDR A:0xfdc00150
y.create.l HWIO_MMSS_OXILI_RBBM_INTERFACE_HANG_MASK_CTL2_ADDR A:0xfdc0015c
y.create.l HWIO_MMSS_OXILI_RBBM_INTERFACE_HANG_MASK_CTL3_ADDR A:0xfdc00168
y.create.l HWIO_MMSS_OXILI_RBBM_INTERFACE_SRDY_STATUS0_ADDR A:0xfdc00148
y.create.l HWIO_MMSS_OXILI_RBBM_INTERFACE_SRDY_STATUS1_ADDR A:0xfdc00154
y.create.l HWIO_MMSS_OXILI_RBBM_INTERFACE_SRDY_STATUS2_ADDR A:0xfdc00160
y.create.l HWIO_MMSS_OXILI_RBBM_INTERFACE_SRDY_STATUS3_ADDR A:0xfdc0016c
y.create.l HWIO_MMSS_OXILI_RBBM_INTERFACE_RRDY_STATUS0_ADDR A:0xfdc0014c
y.create.l HWIO_MMSS_OXILI_RBBM_INTERFACE_RRDY_STATUS1_ADDR A:0xfdc00158
y.create.l HWIO_MMSS_OXILI_RBBM_INTERFACE_RRDY_STATUS2_ADDR A:0xfdc00164
y.create.l HWIO_MMSS_OXILI_RBBM_INTERFACE_RRDY_STATUS3_ADDR A:0xfdc00170
y.create.l HWIO_MMSS_OXILI_RBBM_INT_SET_CMD_ADDR A:0xfdc00180
y.create.l HWIO_MMSS_OXILI_RBBM_INT_CLEAR_CMD_ADDR A:0xfdc00184
y.create.l HWIO_MMSS_OXILI_RBBM_INT_UNMASKED_STATUS_ADDR A:0xfdc00188
y.create.l HWIO_MMSS_OXILI_RBBM_INT_0_MASK_ADDR A:0xfdc0018c
y.create.l HWIO_MMSS_OXILI_RBBM_INT_0_STATUS_ADDR A:0xfdc00190
y.create.l HWIO_MMSS_OXILI_RBBM_INT_1_MASK_CTL_ADDR A:0xfdc00194
y.create.l HWIO_MMSS_OXILI_RBBM_INT_1_STATUS_ADDR A:0xfdc00198
y.create.l HWIO_MMSS_OXILI_RBBM_INT_2_MASK_ADDR A:0xfdc0019c
y.create.l HWIO_MMSS_OXILI_RBBM_INT_2_STATUS_ADDR A:0xfdc001a0
y.create.l HWIO_MMSS_OXILI_RBBM_INT_3_MASK_ADDR A:0xfdc001a4
y.create.l HWIO_MMSS_OXILI_RBBM_INT_3_STATUS_ADDR A:0xfdc001a8
y.create.l HWIO_MMSS_OXILI_RBBM_INT_4_MASK_ADDR A:0xfdc001ac
y.create.l HWIO_MMSS_OXILI_RBBM_INT_4_STATUS_ADDR A:0xfdc001b0
y.create.l HWIO_MMSS_OXILI_RBBM_PERFCTR_CTL_ADDR A:0xfdc00200
y.create.l HWIO_MMSS_OXILI_RBBM_PERFCTR_LOAD_CMD0_ADDR A:0xfdc00204
y.create.l HWIO_MMSS_OXILI_RBBM_PERFCTR_LOAD_CMD1_ADDR A:0xfdc00208
y.create.l HWIO_MMSS_OXILI_RBBM_PERFCTR_LOAD_VALUE_LO_ADDR A:0xfdc00210
y.create.l HWIO_MMSS_OXILI_RBBM_PERFCTR_LOAD_VALUE_HI_ADDR A:0xfdc00214
y.create.l HWIO_MMSS_OXILI_RBBM_PERFCTR_RBBM_0_SEL_ADDR A:0xfdc00218
y.create.l HWIO_MMSS_OXILI_RBBM_PERFCTR_RBBM_1_SEL_ADDR A:0xfdc0021c
y.create.l HWIO_MMSS_OXILI_RBBM_GPU_BUSY_MAKSED_ADDR A:0xfdc00220
y.create.l HWIO_MMSS_OXILI_RBBM_PERFCTR_CP_0_LO_ADDR A:0xfdc00240
y.create.l HWIO_MMSS_OXILI_RBBM_PERFCTR_CP_0_HI_ADDR A:0xfdc00244
y.create.l HWIO_MMSS_OXILI_RBBM_PERFCTR_RBBM_0_LO_ADDR A:0xfdc00248
y.create.l HWIO_MMSS_OXILI_RBBM_PERFCTR_RBBM_0_HI_ADDR A:0xfdc0024c
y.create.l HWIO_MMSS_OXILI_RBBM_PERFCTR_RBBM_1_LO_ADDR A:0xfdc00250
y.create.l HWIO_MMSS_OXILI_RBBM_PERFCTR_RBBM_1_HI_ADDR A:0xfdc00254
y.create.l HWIO_MMSS_OXILI_RBBM_PERFCTR_PC_0_LO_ADDR A:0xfdc00258
y.create.l HWIO_MMSS_OXILI_RBBM_PERFCTR_PC_0_HI_ADDR A:0xfdc0025c
y.create.l HWIO_MMSS_OXILI_RBBM_PERFCTR_PC_1_LO_ADDR A:0xfdc00260
y.create.l HWIO_MMSS_OXILI_RBBM_PERFCTR_PC_1_HI_ADDR A:0xfdc00264
y.create.l HWIO_MMSS_OXILI_RBBM_PERFCTR_PC_2_LO_ADDR A:0xfdc00268
y.create.l HWIO_MMSS_OXILI_RBBM_PERFCTR_PC_2_HI_ADDR A:0xfdc0026c
y.create.l HWIO_MMSS_OXILI_RBBM_PERFCTR_PC_3_LO_ADDR A:0xfdc00270
y.create.l HWIO_MMSS_OXILI_RBBM_PERFCTR_PC_3_HI_ADDR A:0xfdc00274
y.create.l HWIO_MMSS_OXILI_RBBM_PERFCTR_VFD_0_LO_ADDR A:0xfdc00278
y.create.l HWIO_MMSS_OXILI_RBBM_PERFCTR_VFD_0_HI_ADDR A:0xfdc0027c
y.create.l HWIO_MMSS_OXILI_RBBM_PERFCTR_VFD_1_LO_ADDR A:0xfdc00280
y.create.l HWIO_MMSS_OXILI_RBBM_PERFCTR_VFD_1_HI_ADDR A:0xfdc00284
y.create.l HWIO_MMSS_OXILI_RBBM_PERFCTR_HLSQ_0_LO_ADDR A:0xfdc00288
y.create.l HWIO_MMSS_OXILI_RBBM_PERFCTR_HLSQ_0_HI_ADDR A:0xfdc0028c
y.create.l HWIO_MMSS_OXILI_RBBM_PERFCTR_HLSQ_1_LO_ADDR A:0xfdc00290
y.create.l HWIO_MMSS_OXILI_RBBM_PERFCTR_HLSQ_1_HI_ADDR A:0xfdc00294
y.create.l HWIO_MMSS_OXILI_RBBM_PERFCTR_HLSQ_2_LO_ADDR A:0xfdc00298
y.create.l HWIO_MMSS_OXILI_RBBM_PERFCTR_HLSQ_2_HI_ADDR A:0xfdc0029c
y.create.l HWIO_MMSS_OXILI_RBBM_PERFCTR_HLSQ_3_LO_ADDR A:0xfdc002a0
y.create.l HWIO_MMSS_OXILI_RBBM_PERFCTR_HLSQ_3_HI_ADDR A:0xfdc002a4
y.create.l HWIO_MMSS_OXILI_RBBM_PERFCTR_HLSQ_4_LO_ADDR A:0xfdc002a8
y.create.l HWIO_MMSS_OXILI_RBBM_PERFCTR_HLSQ_4_HI_ADDR A:0xfdc002ac
y.create.l HWIO_MMSS_OXILI_RBBM_PERFCTR_HLSQ_5_LO_ADDR A:0xfdc002b0
y.create.l HWIO_MMSS_OXILI_RBBM_PERFCTR_HLSQ_5_HI_ADDR A:0xfdc002b4
y.create.l HWIO_MMSS_OXILI_RBBM_PERFCTR_VPC_0_LO_ADDR A:0xfdc002b8
y.create.l HWIO_MMSS_OXILI_RBBM_PERFCTR_VPC_0_HI_ADDR A:0xfdc002bc
y.create.l HWIO_MMSS_OXILI_RBBM_PERFCTR_VPC_1_LO_ADDR A:0xfdc002c0
y.create.l HWIO_MMSS_OXILI_RBBM_PERFCTR_VPC_1_HI_ADDR A:0xfdc002c4
y.create.l HWIO_MMSS_OXILI_RBBM_PERFCTR_TSE_0_LO_ADDR A:0xfdc002c8
y.create.l HWIO_MMSS_OXILI_RBBM_PERFCTR_TSE_0_HI_ADDR A:0xfdc002cc
y.create.l HWIO_MMSS_OXILI_RBBM_PERFCTR_TSE_1_LO_ADDR A:0xfdc002d0
y.create.l HWIO_MMSS_OXILI_RBBM_PERFCTR_TSE_1_HI_ADDR A:0xfdc002d4
y.create.l HWIO_MMSS_OXILI_RBBM_PERFCTR_RAS_0_LO_ADDR A:0xfdc002d8
y.create.l HWIO_MMSS_OXILI_RBBM_PERFCTR_RAS_0_HI_ADDR A:0xfdc002dc
y.create.l HWIO_MMSS_OXILI_RBBM_PERFCTR_RAS_1_LO_ADDR A:0xfdc002e0
y.create.l HWIO_MMSS_OXILI_RBBM_PERFCTR_RAS_1_HI_ADDR A:0xfdc002e4
y.create.l HWIO_MMSS_OXILI_RBBM_PERFCTR_UCHE_0_LO_ADDR A:0xfdc002e8
y.create.l HWIO_MMSS_OXILI_RBBM_PERFCTR_UCHE_0_HI_ADDR A:0xfdc002ec
y.create.l HWIO_MMSS_OXILI_RBBM_PERFCTR_UCHE_1_LO_ADDR A:0xfdc002f0
y.create.l HWIO_MMSS_OXILI_RBBM_PERFCTR_UCHE_1_HI_ADDR A:0xfdc002f4
y.create.l HWIO_MMSS_OXILI_RBBM_PERFCTR_UCHE_2_LO_ADDR A:0xfdc002f8
y.create.l HWIO_MMSS_OXILI_RBBM_PERFCTR_UCHE_2_HI_ADDR A:0xfdc002fc
y.create.l HWIO_MMSS_OXILI_RBBM_PERFCTR_UCHE_3_LO_ADDR A:0xfdc00300
y.create.l HWIO_MMSS_OXILI_RBBM_PERFCTR_UCHE_3_HI_ADDR A:0xfdc00304
y.create.l HWIO_MMSS_OXILI_RBBM_PERFCTR_UCHE_4_LO_ADDR A:0xfdc00308
y.create.l HWIO_MMSS_OXILI_RBBM_PERFCTR_UCHE_4_HI_ADDR A:0xfdc0030c
y.create.l HWIO_MMSS_OXILI_RBBM_PERFCTR_UCHE_5_LO_ADDR A:0xfdc00310
y.create.l HWIO_MMSS_OXILI_RBBM_PERFCTR_UCHE_5_HI_ADDR A:0xfdc00314
y.create.l HWIO_MMSS_OXILI_RBBM_PERFCTR_TP_0_LO_ADDR A:0xfdc00318
y.create.l HWIO_MMSS_OXILI_RBBM_PERFCTR_TP_0_HI_ADDR A:0xfdc0031c
y.create.l HWIO_MMSS_OXILI_RBBM_PERFCTR_TP_1_LO_ADDR A:0xfdc00320
y.create.l HWIO_MMSS_OXILI_RBBM_PERFCTR_TP_1_HI_ADDR A:0xfdc00324
y.create.l HWIO_MMSS_OXILI_RBBM_PERFCTR_TP_2_LO_ADDR A:0xfdc00328
y.create.l HWIO_MMSS_OXILI_RBBM_PERFCTR_TP_2_HI_ADDR A:0xfdc0032c
y.create.l HWIO_MMSS_OXILI_RBBM_PERFCTR_TP_3_LO_ADDR A:0xfdc00330
y.create.l HWIO_MMSS_OXILI_RBBM_PERFCTR_TP_3_HI_ADDR A:0xfdc00334
y.create.l HWIO_MMSS_OXILI_RBBM_PERFCTR_TP_4_LO_ADDR A:0xfdc00338
y.create.l HWIO_MMSS_OXILI_RBBM_PERFCTR_TP_4_HI_ADDR A:0xfdc0033c
y.create.l HWIO_MMSS_OXILI_RBBM_PERFCTR_TP_5_LO_ADDR A:0xfdc00340
y.create.l HWIO_MMSS_OXILI_RBBM_PERFCTR_TP_5_HI_ADDR A:0xfdc00344
y.create.l HWIO_MMSS_OXILI_RBBM_PERFCTR_SP_0_LO_ADDR A:0xfdc00348
y.create.l HWIO_MMSS_OXILI_RBBM_PERFCTR_SP_0_HI_ADDR A:0xfdc0034c
y.create.l HWIO_MMSS_OXILI_RBBM_PERFCTR_SP_1_LO_ADDR A:0xfdc00350
y.create.l HWIO_MMSS_OXILI_RBBM_PERFCTR_SP_1_HI_ADDR A:0xfdc00354
y.create.l HWIO_MMSS_OXILI_RBBM_PERFCTR_SP_2_LO_ADDR A:0xfdc00358
y.create.l HWIO_MMSS_OXILI_RBBM_PERFCTR_SP_2_HI_ADDR A:0xfdc0035c
y.create.l HWIO_MMSS_OXILI_RBBM_PERFCTR_SP_3_LO_ADDR A:0xfdc00360
y.create.l HWIO_MMSS_OXILI_RBBM_PERFCTR_SP_3_HI_ADDR A:0xfdc00364
y.create.l HWIO_MMSS_OXILI_RBBM_PERFCTR_SP_4_LO_ADDR A:0xfdc00368
y.create.l HWIO_MMSS_OXILI_RBBM_PERFCTR_SP_4_HI_ADDR A:0xfdc0036c
y.create.l HWIO_MMSS_OXILI_RBBM_PERFCTR_SP_5_LO_ADDR A:0xfdc00370
y.create.l HWIO_MMSS_OXILI_RBBM_PERFCTR_SP_5_HI_ADDR A:0xfdc00374
y.create.l HWIO_MMSS_OXILI_RBBM_PERFCTR_SP_6_LO_ADDR A:0xfdc00378
y.create.l HWIO_MMSS_OXILI_RBBM_PERFCTR_SP_6_HI_ADDR A:0xfdc0037c
y.create.l HWIO_MMSS_OXILI_RBBM_PERFCTR_SP_7_LO_ADDR A:0xfdc00380
y.create.l HWIO_MMSS_OXILI_RBBM_PERFCTR_SP_7_HI_ADDR A:0xfdc00384
y.create.l HWIO_MMSS_OXILI_RBBM_PERFCTR_RB_0_LO_ADDR A:0xfdc00388
y.create.l HWIO_MMSS_OXILI_RBBM_PERFCTR_RB_0_HI_ADDR A:0xfdc0038c
y.create.l HWIO_MMSS_OXILI_RBBM_PERFCTR_RB_1_LO_ADDR A:0xfdc00390
y.create.l HWIO_MMSS_OXILI_RBBM_PERFCTR_RB_1_HI_ADDR A:0xfdc00394
y.create.l HWIO_MMSS_OXILI_RBBM_RBBM_CTL_ADDR A:0xfdc00400
y.create.l HWIO_MMSS_OXILI_RBBM_PERFCTR_PWR_0_LO_ADDR A:0xfdc003a8
y.create.l HWIO_MMSS_OXILI_RBBM_PERFCTR_PWR_0_HI_ADDR A:0xfdc003ac
y.create.l HWIO_MMSS_OXILI_RBBM_PERFCTR_PWR_1_LO_ADDR A:0xfdc003b0
y.create.l HWIO_MMSS_OXILI_RBBM_PERFCTR_PWR_1_HI_ADDR A:0xfdc003b4
y.create.l HWIO_MMSS_OXILI_RBBM_AHB_DEBUG_CTL_ADDR A:0xfdc00440
y.create.l HWIO_MMSS_OXILI_RBBM_DEBUG_BUS_CTL_ADDR A:0xfdc00444
y.create.l HWIO_MMSS_OXILI_RBBM_DEBUG_BUS_DATA_STATUS_ADDR A:0xfdc00448
y.create.l HWIO_MMSS_OXILI_RBBM_DEBUG_BUS_EN_CTL0_ADDR A:0xfdc0044c
y.create.l HWIO_MMSS_OXILI_RBBM_DEBUG_BUS_EN_CTL1_ADDR A:0xfdc00450
y.create.l HWIO_MMSS_OXILI_RBBM_DEBUG_BUS_STB_CTL0_ADDR A:0xfdc00454
y.create.l HWIO_MMSS_OXILI_RBBM_DEBUG_BUS_STB_CTL1_ADDR A:0xfdc00458
y.create.l HWIO_MMSS_OXILI_RBBM_MISR_BUS_CTL_ADDR A:0xfdc0045c
y.create.l HWIO_MMSS_OXILI_RBBM_MISR_BUS_CNT_ADDR A:0xfdc00460
y.create.l HWIO_MMSS_OXILI_RBBM_MISR_SIG_LO_ADDR A:0xfdc00464
y.create.l HWIO_MMSS_OXILI_RBBM_MISR_SIG_HI_ADDR A:0xfdc00468
y.create.l HWIO_MMSS_OXILI_RBBM_MISR_BUS_STB_CTL0_ADDR A:0xfdc0046c
y.create.l HWIO_MMSS_OXILI_RBBM_MISR_BUS_STB_CTL1_ADDR A:0xfdc00470
y.create.l HWIO_MMSS_OXILI_RBBM_INT_TRACE_BUS_CTL_ADDR A:0xfdc00474
y.create.l HWIO_MMSS_OXILI_RBBM_EXT_TRACE_BUS_CTL_ADDR A:0xfdc00478
y.create.l HWIO_MMSS_OXILI_RBBM_EXT_TRACE_STOP_CNT_ADDR A:0xfdc0047c
y.create.l HWIO_MMSS_OXILI_RBBM_EXT_TRACE_START_CNT_ADDR A:0xfdc00480
y.create.l HWIO_MMSS_OXILI_RBBM_EXT_TRACE_PERIOD_CNT_ADDR A:0xfdc00484
y.create.l HWIO_MMSS_OXILI_RBBM_EXT_TRACE_CMD_ADDR A:0xfdc00488
y.create.l HWIO_MMSS_OXILI_RBBM_VBIF_DEBUG_CTL_ADDR A:0xfdc0048c
y.create.l HWIO_MMSS_OXILI_RBBM_VBIF_AXI_MN_HALTREQ_ADDR A:0xfdc00490
y.create.l HWIO_MMSS_OXILI_RBBM_VBIF_AXI_MN_HALTACK_ADDR A:0xfdc00494
y.create.l HWIO_MMSS_OXILI_CP_RB_BASE_ADDR A:0xfdc00700
y.create.l HWIO_MMSS_OXILI_CP_RB_CNTL_ADDR A:0xfdc00704
y.create.l HWIO_MMSS_OXILI_CP_RB_RPTR_ADDR_ADDR A:0xfdc0070c
y.create.l HWIO_MMSS_OXILI_CP_RB_RPTR_ADDR A:0xfdc00710
y.create.l HWIO_MMSS_OXILI_CP_RB_RPTR_WR_ADDR A:0xfdc0071c
y.create.l HWIO_MMSS_OXILI_CP_RB_WPTR_ADDR A:0xfdc00714
y.create.l HWIO_MMSS_OXILI_CP_IB1_BASE_ADDR A:0xfdc01160
y.create.l HWIO_MMSS_OXILI_CP_IB1_BUFSZ_ADDR A:0xfdc01164
y.create.l HWIO_MMSS_OXILI_CP_IB2_BASE_ADDR A:0xfdc01168
y.create.l HWIO_MMSS_OXILI_CP_IB2_BUFSZ_ADDR A:0xfdc0116c
y.create.l HWIO_MMSS_OXILI_CP_ST_BASE_ADDR A:0xfdc01134
y.create.l HWIO_MMSS_OXILI_CP_ST_BUFSZ_ADDR A:0xfdc01138
y.create.l HWIO_MMSS_OXILI_CP_QUEUE_THRESHOLDS_ADDR A:0xfdc00754
y.create.l HWIO_MMSS_OXILI_CP_MEQ_THRESHOLDS_ADDR A:0xfdc00758
y.create.l HWIO_MMSS_OXILI_CP_CSQ_AVAIL_ADDR A:0xfdc0075c
y.create.l HWIO_MMSS_OXILI_CP_STQ_AVAIL_ADDR A:0xfdc00760
y.create.l HWIO_MMSS_OXILI_CP_MEQ_AVAIL_ADDR A:0xfdc00764
y.create.l HWIO_MMSS_OXILI_CP_CSQ_RB_STAT_ADDR A:0xfdc007f4
y.create.l HWIO_MMSS_OXILI_CP_CSQ_IB1_STAT_ADDR A:0xfdc007f8
y.create.l HWIO_MMSS_OXILI_CP_CSQ_IB2_STAT_ADDR A:0xfdc007fc
y.create.l HWIO_MMSS_OXILI_CP_NON_PREFETCH_CNTRS_ADDR A:0xfdc01100
y.create.l HWIO_MMSS_OXILI_CP_STQ_ST_STAT_ADDR A:0xfdc0110c
y.create.l HWIO_MMSS_OXILI_CP_MEQ_STAT_ADDR A:0xfdc0113c
y.create.l HWIO_MMSS_OXILI_CP_MIU_TAG_STAT_ADDR A:0xfdc01148
y.create.l HWIO_MMSS_OXILI_CP_MEQ_ADDR_ADDR A:0xfdc00768
y.create.l HWIO_MMSS_OXILI_CP_MEQ_DATA_ADDR A:0xfdc0076c
y.create.l HWIO_MMSS_OXILI_CP_ROQ_ADDR_ADDR A:0xfdc00730
y.create.l HWIO_MMSS_OXILI_CP_ROQ_DATA_ADDR A:0xfdc00734
y.create.l HWIO_MMSS_OXILI_CP_WFI_PEND_CTR_ADDR A:0xfdc007d4
y.create.l HWIO_MMSS_OXILI_CP_ME_CNTL_ADDR A:0xfdc007d8
y.create.l HWIO_MMSS_OXILI_CP_ME_STATUS_ADDR A:0xfdc007dc
y.create.l HWIO_MMSS_OXILI_CP_ME_RAM_WADDR_ADDR A:0xfdc007e0
y.create.l HWIO_MMSS_OXILI_CP_ME_RAM_RADDR_ADDR A:0xfdc007e4
y.create.l HWIO_MMSS_OXILI_CP_ME_RAM_DATA_ADDR A:0xfdc007e8
y.create.l HWIO_MMSS_OXILI_CP_ME_RDADDR_ADDR A:0xfdc007a8
y.create.l HWIO_MMSS_OXILI_CP_DEBUG_ADDR A:0xfdc007f0
y.create.l HWIO_MMSS_OXILI_CP_ME_VS_EVENT_SRC_ADDR A:0xfdc01800
y.create.l HWIO_MMSS_OXILI_CP_ME_VS_EVENT_ADDR_ADDR A:0xfdc01804
y.create.l HWIO_MMSS_OXILI_CP_ME_VS_EVENT_DATA_ADDR A:0xfdc01808
y.create.l HWIO_MMSS_OXILI_CP_ME_PS_EVENT_SRC_ADDR A:0xfdc01814
y.create.l HWIO_MMSS_OXILI_CP_ME_PS_EVENT_ADDR_ADDR A:0xfdc01818
y.create.l HWIO_MMSS_OXILI_CP_ME_PS_EVENT_DATA_ADDR A:0xfdc0181c
y.create.l HWIO_MMSS_OXILI_CP_ME_CF_EVENT_SRC_ADDR A:0xfdc01828
y.create.l HWIO_MMSS_OXILI_CP_ME_CF_EVENT_ADDR_ADDR A:0xfdc0182c
y.create.l HWIO_MMSS_OXILI_CP_ME_CF_EVENT_DATA_ADDR A:0xfdc01830
y.create.l HWIO_MMSS_OXILI_CP_ME_NRT_ADDR_ADDR A:0xfdc01834
y.create.l HWIO_MMSS_OXILI_CP_ME_NRT_DATA_ADDR A:0xfdc01838
y.create.l HWIO_MMSS_OXILI_CP_ME_RB_DONE_SRC_ADDR A:0xfdc01848
y.create.l HWIO_MMSS_OXILI_CP_ME_RB_DONE_ADDR_ADDR A:0xfdc0184c
y.create.l HWIO_MMSS_OXILI_CP_ME_RB_DONE_DATA_ADDR A:0xfdc01850
y.create.l HWIO_MMSS_OXILI_CP_PFP_UCODE_ADDR_ADDR A:0xfdc00724
y.create.l HWIO_MMSS_OXILI_CP_PFP_UCODE_DATA_ADDR A:0xfdc00728
y.create.l HWIO_MMSS_OXILI_CP_PERFCOUNTER_SELECT_ADDR A:0xfdc01114
y.create.l HWIO_MMSS_OXILI_CP_BIN_MASK_LO_ADDR A:0xfdc01150
y.create.l HWIO_MMSS_OXILI_CP_BIN_MASK_HI_ADDR A:0xfdc01154
y.create.l HWIO_MMSS_OXILI_CP_BIN_SELECT_LO_ADDR A:0xfdc01158
y.create.l HWIO_MMSS_OXILI_CP_BIN_SELECT_HI_ADDR A:0xfdc0115c
y.create.l HWIO_MMSS_OXILI_CP_NV_FLAGS_0_ADDR A:0xfdc007b8
y.create.l HWIO_MMSS_OXILI_CP_NV_FLAGS_1_ADDR A:0xfdc007bc
y.create.l HWIO_MMSS_OXILI_CP_NV_FLAGS_2_ADDR A:0xfdc007c0
y.create.l HWIO_MMSS_OXILI_CP_NV_FLAGS_3_ADDR A:0xfdc007c4
y.create.l HWIO_MMSS_OXILI_CP_STATE_DEBUG_INDEX_ADDR A:0xfdc007b0
y.create.l HWIO_MMSS_OXILI_CP_STATE_DEBUG_DATA_ADDR A:0xfdc007b4
y.create.l HWIO_MMSS_OXILI_CP_STAT_ADDR A:0xfdc011fc
y.create.l HWIO_MMSS_OXILI_CP_ECO_CTRL_ADDR A:0xfdc011f0
y.create.l HWIO_MMSS_OXILI_CP_HW_FAULT_ADDR A:0xfdc01170
y.create.l HWIO_MMSS_OXILI_CP_AHB_FAULT_ADDR A:0xfdc01174
y.create.l HWIO_MMSS_OXILI_CP_PROTECT_CTRL_ADDR A:0xfdc01178
y.create.l HWIO_MMSS_OXILI_CP_PROTECT_STATUS_ADDR A:0xfdc0117c
y.create.l HWIO_MMSS_OXILI_CP_PROTECT_REG_0_ADDR A:0xfdc01180
y.create.l HWIO_MMSS_OXILI_CP_PROTECT_REG_1_ADDR A:0xfdc01184
y.create.l HWIO_MMSS_OXILI_CP_PROTECT_REG_2_ADDR A:0xfdc01188
y.create.l HWIO_MMSS_OXILI_CP_PROTECT_REG_3_ADDR A:0xfdc0118c
y.create.l HWIO_MMSS_OXILI_CP_PROTECT_REG_4_ADDR A:0xfdc01190
y.create.l HWIO_MMSS_OXILI_CP_PROTECT_REG_5_ADDR A:0xfdc01194
y.create.l HWIO_MMSS_OXILI_CP_PROTECT_REG_6_ADDR A:0xfdc01198
y.create.l HWIO_MMSS_OXILI_CP_PROTECT_REG_7_ADDR A:0xfdc0119c
y.create.l HWIO_MMSS_OXILI_CP_PROTECT_REG_8_ADDR A:0xfdc011a0
y.create.l HWIO_MMSS_OXILI_CP_PROTECT_REG_9_ADDR A:0xfdc011a4
y.create.l HWIO_MMSS_OXILI_CP_PROTECT_REG_A_ADDR A:0xfdc011a8
y.create.l HWIO_MMSS_OXILI_CP_PROTECT_REG_B_ADDR A:0xfdc011ac
y.create.l HWIO_MMSS_OXILI_CP_PROTECT_REG_C_ADDR A:0xfdc011b0
y.create.l HWIO_MMSS_OXILI_CP_PROTECT_REG_D_ADDR A:0xfdc011b4
y.create.l HWIO_MMSS_OXILI_CP_PROTECT_REG_E_ADDR A:0xfdc011b8
y.create.l HWIO_MMSS_OXILI_CP_PROTECT_REG_F_ADDR A:0xfdc011bc
y.create.l HWIO_MMSS_OXILI_CP_SCRATCH_UMASK_ADDR A:0xfdc00770
y.create.l HWIO_MMSS_OXILI_CP_SCRATCH_ADDR_ADDR A:0xfdc00774
y.create.l HWIO_MMSS_OXILI_CP_SCRATCH_REG0_ADDR A:0xfdc015e0
y.create.l HWIO_MMSS_OXILI_CP_SCRATCH_REG1_ADDR A:0xfdc015e4
y.create.l HWIO_MMSS_OXILI_CP_SCRATCH_REG2_ADDR A:0xfdc015e8
y.create.l HWIO_MMSS_OXILI_CP_SCRATCH_REG3_ADDR A:0xfdc015ec
y.create.l HWIO_MMSS_OXILI_CP_SCRATCH_REG4_ADDR A:0xfdc015f0
y.create.l HWIO_MMSS_OXILI_CP_SCRATCH_REG5_ADDR A:0xfdc015f4
y.create.l HWIO_MMSS_OXILI_CP_SCRATCH_REG6_ADDR A:0xfdc015f8
y.create.l HWIO_MMSS_OXILI_CP_SCRATCH_REG7_ADDR A:0xfdc015fc
y.create.l HWIO_MMSS_OXILI_PC_BINNING_ENABLE_ADDR A:0xfdc030f0
y.create.l HWIO_MMSS_OXILI_PC_PC_DRAWCALL_VIZ_CONTROL_ADDR A:0xfdc030f4
y.create.l HWIO_MMSS_OXILI_PC_PC_DEBUG_PRIM_STEP_CONTROL_ADDR A:0xfdc030f8
y.create.l HWIO_MMSS_OXILI_PC_PC_DEBUG_REG_ADDR A:0xfdc030fc
y.create.l HWIO_MMSS_OXILI_PC_PERFCOUNTER0_SELECT_ADDR A:0xfdc03120
y.create.l HWIO_MMSS_OXILI_PC_PERFCOUNTER1_SELECT_ADDR A:0xfdc03124
y.create.l HWIO_MMSS_OXILI_PC_PERFCOUNTER2_SELECT_ADDR A:0xfdc03128
y.create.l HWIO_MMSS_OXILI_PC_PERFCOUNTER3_SELECT_ADDR A:0xfdc0312c
y.create.l HWIO_MMSS_OXILI_PC_BIN_BASE_CTX_0_ADDR A:0xfdc08784
y.create.l HWIO_MMSS_OXILI_PC_BIN_SIZE_CTX_0_ADDR A:0xfdc08788
y.create.l HWIO_MMSS_OXILI_PC_DMA_BASE_CTX_0_ADDR A:0xfdc087e8
y.create.l HWIO_MMSS_OXILI_PC_DMA_SIZE_CTX_0_ADDR A:0xfdc087ec
y.create.l HWIO_MMSS_OXILI_PC_DRAW_INITIATOR_CTX_0_ADDR A:0xfdc087f0
y.create.l HWIO_MMSS_OXILI_PC_VSTREAM_CONTROL_CTX_0_ADDR A:0xfdc08790
y.create.l HWIO_MMSS_OXILI_PC_EVENT_INITIATOR_CTX_0_ADDR A:0xfdc087e4
y.create.l HWIO_MMSS_OXILI_PC_IMMED_DATA_CTX_0_ADDR A:0xfdc087f4
y.create.l HWIO_MMSS_OXILI_PC_PRE_DRAW_INITIATOR_CTX_0_ADDR A:0xfdc087f8
y.create.l HWIO_MMSS_OXILI_PC_PRE_DRAW_INITIATOR_SIZE_CTX_0_ADDR A:0xfdc087fc
y.create.l HWIO_MMSS_OXILI_PC_VERTEX_REUSE_BLOCK_CNTL_CTX_0_ADDR A:0xfdc087a8
y.create.l HWIO_MMSS_OXILI_PC_PRIM_VTX_CNTL_CTX_0_ADDR A:0xfdc087b0
y.create.l HWIO_MMSS_OXILI_PC_RESTART_INDEX_CTX_0_ADDR A:0xfdc087b4
y.create.l HWIO_MMSS_OXILI_PC_CL_EXE_INITIATOR_CTX_0_ADDR A:0xfdc087c0
y.create.l HWIO_MMSS_OXILI_PC_BIN_BASE_CTX_1_ADDR A:0xfdc09784
y.create.l HWIO_MMSS_OXILI_PC_BIN_SIZE_CTX_1_ADDR A:0xfdc09788
y.create.l HWIO_MMSS_OXILI_PC_DMA_BASE_CTX_1_ADDR A:0xfdc097e8
y.create.l HWIO_MMSS_OXILI_PC_DMA_SIZE_CTX_1_ADDR A:0xfdc097ec
y.create.l HWIO_MMSS_OXILI_PC_DRAW_INITIATOR_CTX_1_ADDR A:0xfdc097f0
y.create.l HWIO_MMSS_OXILI_PC_VSTREAM_CONTROL_CTX_1_ADDR A:0xfdc09790
y.create.l HWIO_MMSS_OXILI_PC_EVENT_INITIATOR_CTX_1_ADDR A:0xfdc097e4
y.create.l HWIO_MMSS_OXILI_PC_IMMED_DATA_CTX_1_ADDR A:0xfdc097f4
y.create.l HWIO_MMSS_OXILI_PC_PRE_DRAW_INITIATOR_CTX_1_ADDR A:0xfdc097f8
y.create.l HWIO_MMSS_OXILI_PC_PRE_DRAW_INITIATOR_SIZE_CTX_1_ADDR A:0xfdc097fc
y.create.l HWIO_MMSS_OXILI_PC_VERTEX_REUSE_BLOCK_CNTL_CTX_1_ADDR A:0xfdc097a8
y.create.l HWIO_MMSS_OXILI_PC_PRIM_VTX_CNTL_CTX_1_ADDR A:0xfdc097b0
y.create.l HWIO_MMSS_OXILI_PC_RESTART_INDEX_CTX_1_ADDR A:0xfdc097b4
y.create.l HWIO_MMSS_OXILI_PC_CL_EXE_INITIATOR_CTX_1_ADDR A:0xfdc097c0
y.create.l HWIO_MMSS_OXILI_GRAS_CL_USER_PLANE_X0_ADDR A:0xfdc03280
y.create.l HWIO_MMSS_OXILI_GRAS_CL_USER_PLANE_Y0_ADDR A:0xfdc03284
y.create.l HWIO_MMSS_OXILI_GRAS_CL_USER_PLANE_Z0_ADDR A:0xfdc03288
y.create.l HWIO_MMSS_OXILI_GRAS_CL_USER_PLANE_W0_ADDR A:0xfdc0328c
y.create.l HWIO_MMSS_OXILI_GRAS_CL_USER_PLANE_X1_ADDR A:0xfdc03290
y.create.l HWIO_MMSS_OXILI_GRAS_CL_USER_PLANE_Y1_ADDR A:0xfdc03294
y.create.l HWIO_MMSS_OXILI_GRAS_CL_USER_PLANE_Z1_ADDR A:0xfdc03298
y.create.l HWIO_MMSS_OXILI_GRAS_CL_USER_PLANE_W1_ADDR A:0xfdc0329c
y.create.l HWIO_MMSS_OXILI_GRAS_CL_USER_PLANE_X2_ADDR A:0xfdc032a0
y.create.l HWIO_MMSS_OXILI_GRAS_CL_USER_PLANE_Y2_ADDR A:0xfdc032a4
y.create.l HWIO_MMSS_OXILI_GRAS_CL_USER_PLANE_Z2_ADDR A:0xfdc032a8
y.create.l HWIO_MMSS_OXILI_GRAS_CL_USER_PLANE_W2_ADDR A:0xfdc032ac
y.create.l HWIO_MMSS_OXILI_GRAS_CL_USER_PLANE_X3_ADDR A:0xfdc032b0
y.create.l HWIO_MMSS_OXILI_GRAS_CL_USER_PLANE_Y3_ADDR A:0xfdc032b4
y.create.l HWIO_MMSS_OXILI_GRAS_CL_USER_PLANE_Z3_ADDR A:0xfdc032b8
y.create.l HWIO_MMSS_OXILI_GRAS_CL_USER_PLANE_W3_ADDR A:0xfdc032bc
y.create.l HWIO_MMSS_OXILI_GRAS_CL_USER_PLANE_X4_ADDR A:0xfdc032c0
y.create.l HWIO_MMSS_OXILI_GRAS_CL_USER_PLANE_Y4_ADDR A:0xfdc032c4
y.create.l HWIO_MMSS_OXILI_GRAS_CL_USER_PLANE_Z4_ADDR A:0xfdc032c8
y.create.l HWIO_MMSS_OXILI_GRAS_CL_USER_PLANE_W4_ADDR A:0xfdc032cc
y.create.l HWIO_MMSS_OXILI_GRAS_CL_USER_PLANE_X5_ADDR A:0xfdc032d0
y.create.l HWIO_MMSS_OXILI_GRAS_CL_USER_PLANE_Y5_ADDR A:0xfdc032d4
y.create.l HWIO_MMSS_OXILI_GRAS_CL_USER_PLANE_Z5_ADDR A:0xfdc032d8
y.create.l HWIO_MMSS_OXILI_GRAS_CL_USER_PLANE_W5_ADDR A:0xfdc032dc
y.create.l HWIO_MMSS_OXILI_GRAS_TSE_STATUS_ADDR A:0xfdc03200
y.create.l HWIO_MMSS_OXILI_GRAS_TSE_DEBUG_ECO_ADDR A:0xfdc03204
y.create.l HWIO_MMSS_OXILI_GRAS_SU_PERFCOUNTER0_SELECT_ADDR A:0xfdc03220
y.create.l HWIO_MMSS_OXILI_GRAS_SU_PERFCOUNTER1_SELECT_ADDR A:0xfdc03224
y.create.l HWIO_MMSS_OXILI_GRAS_SU_PERFCOUNTER2_SELECT_ADDR A:0xfdc03228
y.create.l HWIO_MMSS_OXILI_GRAS_SU_PERFCOUNTER3_SELECT_ADDR A:0xfdc0322c
y.create.l HWIO_MMSS_OXILI_GRAS_CL_CLIP_CNTL_CTX_0_ADDR A:0xfdc08100
y.create.l HWIO_MMSS_OXILI_GRAS_CL_GB_CLIP_ADJ_CTX_0_ADDR A:0xfdc08110
y.create.l HWIO_MMSS_OXILI_GRAS_CL_VPORT_XOFFSET_CTX_0_ADDR A:0xfdc08120
y.create.l HWIO_MMSS_OXILI_GRAS_CL_VPORT_XSCALE_CTX_0_ADDR A:0xfdc08124
y.create.l HWIO_MMSS_OXILI_GRAS_CL_VPORT_YOFFSET_CTX_0_ADDR A:0xfdc08128
y.create.l HWIO_MMSS_OXILI_GRAS_CL_VPORT_YSCALE_CTX_0_ADDR A:0xfdc0812c
y.create.l HWIO_MMSS_OXILI_GRAS_CL_VPORT_ZOFFSET_CTX_0_ADDR A:0xfdc08130
y.create.l HWIO_MMSS_OXILI_GRAS_CL_VPORT_ZSCALE_CTX_0_ADDR A:0xfdc08134
y.create.l HWIO_MMSS_OXILI_GRAS_SU_POINT_MINMAX_CTX_0_ADDR A:0xfdc081a0
y.create.l HWIO_MMSS_OXILI_GRAS_SU_POINT_SIZE_CTX_0_ADDR A:0xfdc081a4
y.create.l HWIO_MMSS_OXILI_GRAS_SU_POLY_OFFSET_OFFSET_CTX_0_ADDR A:0xfdc081b4
y.create.l HWIO_MMSS_OXILI_GRAS_SU_POLY_OFFSET_SCALE_CTX_0_ADDR A:0xfdc081b0
y.create.l HWIO_MMSS_OXILI_GRAS_SU_MODE_CONTROL_CTX_0_ADDR A:0xfdc081c0
y.create.l HWIO_MMSS_OXILI_GRAS_SC_CONTROL_CTX_0_ADDR A:0xfdc081c8
y.create.l HWIO_MMSS_OXILI_GRAS_SC_SCREEN_SCISSOR_TL_CTX_0_ADDR A:0xfdc081d0
y.create.l HWIO_MMSS_OXILI_GRAS_SC_SCREEN_SCISSOR_BR_CTX_0_ADDR A:0xfdc081d4
y.create.l HWIO_MMSS_OXILI_GRAS_SC_WINDOW_SCISSOR_BR_CTX_0_ADDR A:0xfdc081e8
y.create.l HWIO_MMSS_OXILI_GRAS_SC_WINDOW_SCISSOR_TL_CTX_0_ADDR A:0xfdc081e4
y.create.l HWIO_MMSS_OXILI_GRAS_CL_CLIP_CNTL_CTX_1_ADDR A:0xfdc09100
y.create.l HWIO_MMSS_OXILI_GRAS_CL_GB_CLIP_ADJ_CTX_1_ADDR A:0xfdc09110
y.create.l HWIO_MMSS_OXILI_GRAS_CL_VPORT_XOFFSET_CTX_1_ADDR A:0xfdc09120
y.create.l HWIO_MMSS_OXILI_GRAS_CL_VPORT_XSCALE_CTX_1_ADDR A:0xfdc09124
y.create.l HWIO_MMSS_OXILI_GRAS_CL_VPORT_YOFFSET_CTX_1_ADDR A:0xfdc09128
y.create.l HWIO_MMSS_OXILI_GRAS_CL_VPORT_YSCALE_CTX_1_ADDR A:0xfdc0912c
y.create.l HWIO_MMSS_OXILI_GRAS_CL_VPORT_ZOFFSET_CTX_1_ADDR A:0xfdc09130
y.create.l HWIO_MMSS_OXILI_GRAS_CL_VPORT_ZSCALE_CTX_1_ADDR A:0xfdc09134
y.create.l HWIO_MMSS_OXILI_GRAS_SU_POINT_MINMAX_CTX_1_ADDR A:0xfdc091a0
y.create.l HWIO_MMSS_OXILI_GRAS_SU_POINT_SIZE_CTX_1_ADDR A:0xfdc091a4
y.create.l HWIO_MMSS_OXILI_GRAS_SU_POLY_OFFSET_OFFSET_CTX_1_ADDR A:0xfdc091b4
y.create.l HWIO_MMSS_OXILI_GRAS_SU_POLY_OFFSET_SCALE_CTX_1_ADDR A:0xfdc091b0
y.create.l HWIO_MMSS_OXILI_GRAS_SU_MODE_CONTROL_CTX_1_ADDR A:0xfdc091c0
y.create.l HWIO_MMSS_OXILI_GRAS_SC_CONTROL_CTX_1_ADDR A:0xfdc091c8
y.create.l HWIO_MMSS_OXILI_GRAS_SC_SCREEN_SCISSOR_TL_CTX_1_ADDR A:0xfdc091d0
y.create.l HWIO_MMSS_OXILI_GRAS_SC_SCREEN_SCISSOR_BR_CTX_1_ADDR A:0xfdc091d4
y.create.l HWIO_MMSS_OXILI_GRAS_SC_WINDOW_SCISSOR_BR_CTX_1_ADDR A:0xfdc091e8
y.create.l HWIO_MMSS_OXILI_GRAS_SC_WINDOW_SCISSOR_TL_CTX_1_ADDR A:0xfdc091e4
y.create.l HWIO_MMSS_OXILI_HLSQ_PERFCOUNTER0_SELECT_REG_ADDR A:0xfdc03800
y.create.l HWIO_MMSS_OXILI_HLSQ_PERFCOUNTER1_SELECT_REG_ADDR A:0xfdc03804
y.create.l HWIO_MMSS_OXILI_HLSQ_PERFCOUNTER2_SELECT_REG_ADDR A:0xfdc03808
y.create.l HWIO_MMSS_OXILI_HLSQ_PERFCOUNTER3_SELECT_REG_ADDR A:0xfdc0380c
y.create.l HWIO_MMSS_OXILI_HLSQ_PERFCOUNTER4_SELECT_REG_ADDR A:0xfdc03810
y.create.l HWIO_MMSS_OXILI_HLSQ_PERFCOUNTER5_SELECT_REG_ADDR A:0xfdc03814
y.create.l HWIO_MMSS_OXILI_HLSQ_GLOBAL_MEM_LENGTH_REG_ADDR A:0xfdc03888
y.create.l HWIO_MMSS_OXILI_HLSQ_GLOBAL_MEM_ADDRESS_REG_ADDR A:0xfdc0388c
y.create.l HWIO_MMSS_OXILI_HLSQ_HLSQ_TIMEOUT_THRESHOLD_ADDR A:0xfdc03830
y.create.l HWIO_MMSS_OXILI_HLSQ_HLSQ_STAR_RDSEL_ADDR A:0xfdc03884
y.create.l HWIO_MMSS_OXILI_HLSQ_CONTROL_0_REG_CTX_0_ADDR A:0xfdc08800
y.create.l HWIO_MMSS_OXILI_HLSQ_CONTROL_1_REG_CTX_0_ADDR A:0xfdc08804
y.create.l HWIO_MMSS_OXILI_HLSQ_CONTROL_2_REG_CTX_0_ADDR A:0xfdc08808
y.create.l HWIO_MMSS_OXILI_HLSQ_CONTROL_3_REG_CTX_0_ADDR A:0xfdc0880c
y.create.l HWIO_MMSS_OXILI_HLSQ_VS_CONTROL_REG_CTX_0_ADDR A:0xfdc08810
y.create.l HWIO_MMSS_OXILI_HLSQ_FS_CONTROL_REG_CTX_0_ADDR A:0xfdc08814
y.create.l HWIO_MMSS_OXILI_HLSQ_CONST_VSPRESV_RANGE_REG_CTX_0_ADDR A:0xfdc08818
y.create.l HWIO_MMSS_OXILI_HLSQ_CONST_FSPRESV_RANGE_REG_CTX_0_ADDR A:0xfdc0881c
y.create.l HWIO_MMSS_OXILI_HLSQ_LOAD_CMD_0_REG_CTX_0_ADDR A:0xfdc08820
y.create.l HWIO_MMSS_OXILI_HLSQ_LOAD_CMD_1_REG_CTX_0_ADDR A:0xfdc08824
y.create.l HWIO_MMSS_OXILI_HLSQ_CL_NDRANGE_0_REG_CTX_0_ADDR A:0xfdc08828
y.create.l HWIO_MMSS_OXILI_HLSQ_CL_NDRANGE_1_REG_CTX_0_ADDR A:0xfdc0882c
y.create.l HWIO_MMSS_OXILI_HLSQ_CL_NDRANGE_2_REG_CTX_0_ADDR A:0xfdc08830
y.create.l HWIO_MMSS_OXILI_HLSQ_CL_NDRANGE_3_REG_CTX_0_ADDR A:0xfdc08834
y.create.l HWIO_MMSS_OXILI_HLSQ_CL_NDRANGE_4_REG_CTX_0_ADDR A:0xfdc08838
y.create.l HWIO_MMSS_OXILI_HLSQ_CL_NDRANGE_5_REG_CTX_0_ADDR A:0xfdc0883c
y.create.l HWIO_MMSS_OXILI_HLSQ_CL_NDRANGE_6_REG_CTX_0_ADDR A:0xfdc08840
y.create.l HWIO_MMSS_OXILI_HLSQ_CL_CONTROL_0_REG_CTX_0_ADDR A:0xfdc08844
y.create.l HWIO_MMSS_OXILI_HLSQ_CL_CONTROL_1_REG_CTX_0_ADDR A:0xfdc08848
y.create.l HWIO_MMSS_OXILI_HLSQ_CL_KERNEL_CONST_REG_CTX_0_ADDR A:0xfdc08850
y.create.l HWIO_MMSS_OXILI_HLSQ_CL_KERNEL_GROUP_X_REG_CTX_0_ADDR A:0xfdc08854
y.create.l HWIO_MMSS_OXILI_HLSQ_CL_KERNEL_GROUP_Y_REG_CTX_0_ADDR A:0xfdc08858
y.create.l HWIO_MMSS_OXILI_HLSQ_CL_KERNEL_GROUP_Z_REG_CTX_0_ADDR A:0xfdc0885c
y.create.l HWIO_MMSS_OXILI_HLSQ_CL_WG_OFFSET_REG_CTX_0_ADDR A:0xfdc08868
y.create.l HWIO_MMSS_OXILI_HLSQ_CONTROL_0_REG_CTX_1_ADDR A:0xfdc09800
y.create.l HWIO_MMSS_OXILI_HLSQ_CONTROL_1_REG_CTX_1_ADDR A:0xfdc09804
y.create.l HWIO_MMSS_OXILI_HLSQ_CONTROL_2_REG_CTX_1_ADDR A:0xfdc09808
y.create.l HWIO_MMSS_OXILI_HLSQ_CONTROL_3_REG_CTX_1_ADDR A:0xfdc0980c
y.create.l HWIO_MMSS_OXILI_HLSQ_VS_CONTROL_REG_CTX_1_ADDR A:0xfdc09810
y.create.l HWIO_MMSS_OXILI_HLSQ_FS_CONTROL_REG_CTX_1_ADDR A:0xfdc09814
y.create.l HWIO_MMSS_OXILI_HLSQ_CONST_VSPRESV_RANGE_REG_CTX_1_ADDR A:0xfdc09818
y.create.l HWIO_MMSS_OXILI_HLSQ_CONST_FSPRESV_RANGE_REG_CTX_1_ADDR A:0xfdc0981c
y.create.l HWIO_MMSS_OXILI_HLSQ_LOAD_CMD_0_REG_CTX_1_ADDR A:0xfdc09820
y.create.l HWIO_MMSS_OXILI_HLSQ_LOAD_CMD_1_REG_CTX_1_ADDR A:0xfdc09824
y.create.l HWIO_MMSS_OXILI_HLSQ_CL_NDRANGE_0_REG_CTX_1_ADDR A:0xfdc09828
y.create.l HWIO_MMSS_OXILI_HLSQ_CL_NDRANGE_1_REG_CTX_1_ADDR A:0xfdc0982c
y.create.l HWIO_MMSS_OXILI_HLSQ_CL_NDRANGE_2_REG_CTX_1_ADDR A:0xfdc09830
y.create.l HWIO_MMSS_OXILI_HLSQ_CL_NDRANGE_3_REG_CTX_1_ADDR A:0xfdc09834
y.create.l HWIO_MMSS_OXILI_HLSQ_CL_NDRANGE_4_REG_CTX_1_ADDR A:0xfdc09838
y.create.l HWIO_MMSS_OXILI_HLSQ_CL_NDRANGE_5_REG_CTX_1_ADDR A:0xfdc0983c
y.create.l HWIO_MMSS_OXILI_HLSQ_CL_NDRANGE_6_REG_CTX_1_ADDR A:0xfdc09840
y.create.l HWIO_MMSS_OXILI_HLSQ_CL_CONTROL_0_REG_CTX_1_ADDR A:0xfdc09844
y.create.l HWIO_MMSS_OXILI_HLSQ_CL_CONTROL_1_REG_CTX_1_ADDR A:0xfdc09848
y.create.l HWIO_MMSS_OXILI_HLSQ_CL_KERNEL_CONST_REG_CTX_1_ADDR A:0xfdc09850
y.create.l HWIO_MMSS_OXILI_HLSQ_CL_KERNEL_GROUP_X_REG_CTX_1_ADDR A:0xfdc09854
y.create.l HWIO_MMSS_OXILI_HLSQ_CL_KERNEL_GROUP_Y_REG_CTX_1_ADDR A:0xfdc09858
y.create.l HWIO_MMSS_OXILI_HLSQ_CL_KERNEL_GROUP_Z_REG_CTX_1_ADDR A:0xfdc0985c
y.create.l HWIO_MMSS_OXILI_HLSQ_CL_WG_OFFSET_REG_CTX_1_ADDR A:0xfdc09868
y.create.l HWIO_MMSS_OXILI_VFD_MODE_CONTROL_ADDR A:0xfdc0390c
y.create.l HWIO_MMSS_OXILI_VFD_STATUS_ADDR A:0xfdc03908
y.create.l HWIO_MMSS_OXILI_VFD_VFD_DEBUG_CONTROL_ADDR A:0xfdc03904
y.create.l HWIO_MMSS_OXILI_VFD_PERFCOUNTER0_SELECT_ADDR A:0xfdc03910
y.create.l HWIO_MMSS_OXILI_VFD_PERFCOUNTER1_SELECT_ADDR A:0xfdc03914
y.create.l HWIO_MMSS_OXILI_VFD_CONTROL_0_CTX_0_ADDR A:0xfdc08900
y.create.l HWIO_MMSS_OXILI_VFD_CONTROL_1_CTX_0_ADDR A:0xfdc08904
y.create.l HWIO_MMSS_OXILI_VFD_INDEX_MIN_CTX_0_ADDR A:0xfdc08908
y.create.l HWIO_MMSS_OXILI_VFD_INDEX_MAX_CTX_0_ADDR A:0xfdc0890c
y.create.l HWIO_MMSS_OXILI_VFD_INSTANCEID_OFFSET_CTX_0_ADDR A:0xfdc08910
y.create.l HWIO_MMSS_OXILI_VFD_INDEX_OFFSET_CTX_0_ADDR A:0xfdc08914
y.create.l HWIO_MMSS_OXILI_VFD_FETCH_INSTR_0_0_CTX_0_ADDR A:0xfdc08918
y.create.l HWIO_MMSS_OXILI_VFD_FETCH_INSTR_1_0_CTX_0_ADDR A:0xfdc0891c
y.create.l HWIO_MMSS_OXILI_VFD_FETCH_INSTR_0_1_CTX_0_ADDR A:0xfdc08920
y.create.l HWIO_MMSS_OXILI_VFD_FETCH_INSTR_1_1_CTX_0_ADDR A:0xfdc08924
y.create.l HWIO_MMSS_OXILI_VFD_FETCH_INSTR_0_2_CTX_0_ADDR A:0xfdc08928
y.create.l HWIO_MMSS_OXILI_VFD_FETCH_INSTR_1_2_CTX_0_ADDR A:0xfdc0892c
y.create.l HWIO_MMSS_OXILI_VFD_FETCH_INSTR_0_3_CTX_0_ADDR A:0xfdc08930
y.create.l HWIO_MMSS_OXILI_VFD_FETCH_INSTR_1_3_CTX_0_ADDR A:0xfdc08934
y.create.l HWIO_MMSS_OXILI_VFD_FETCH_INSTR_0_4_CTX_0_ADDR A:0xfdc08938
y.create.l HWIO_MMSS_OXILI_VFD_FETCH_INSTR_1_4_CTX_0_ADDR A:0xfdc0893c
y.create.l HWIO_MMSS_OXILI_VFD_FETCH_INSTR_0_5_CTX_0_ADDR A:0xfdc08940
y.create.l HWIO_MMSS_OXILI_VFD_FETCH_INSTR_1_5_CTX_0_ADDR A:0xfdc08944
y.create.l HWIO_MMSS_OXILI_VFD_FETCH_INSTR_0_6_CTX_0_ADDR A:0xfdc08948
y.create.l HWIO_MMSS_OXILI_VFD_FETCH_INSTR_1_6_CTX_0_ADDR A:0xfdc0894c
y.create.l HWIO_MMSS_OXILI_VFD_FETCH_INSTR_0_7_CTX_0_ADDR A:0xfdc08950
y.create.l HWIO_MMSS_OXILI_VFD_FETCH_INSTR_1_7_CTX_0_ADDR A:0xfdc08954
y.create.l HWIO_MMSS_OXILI_VFD_FETCH_INSTR_0_8_CTX_0_ADDR A:0xfdc08958
y.create.l HWIO_MMSS_OXILI_VFD_FETCH_INSTR_1_8_CTX_0_ADDR A:0xfdc0895c
y.create.l HWIO_MMSS_OXILI_VFD_FETCH_INSTR_0_9_CTX_0_ADDR A:0xfdc08960
y.create.l HWIO_MMSS_OXILI_VFD_FETCH_INSTR_1_9_CTX_0_ADDR A:0xfdc08964
y.create.l HWIO_MMSS_OXILI_VFD_FETCH_INSTR_0_A_CTX_0_ADDR A:0xfdc08968
y.create.l HWIO_MMSS_OXILI_VFD_FETCH_INSTR_1_A_CTX_0_ADDR A:0xfdc0896c
y.create.l HWIO_MMSS_OXILI_VFD_FETCH_INSTR_0_B_CTX_0_ADDR A:0xfdc08970
y.create.l HWIO_MMSS_OXILI_VFD_FETCH_INSTR_1_B_CTX_0_ADDR A:0xfdc08974
y.create.l HWIO_MMSS_OXILI_VFD_FETCH_INSTR_0_C_CTX_0_ADDR A:0xfdc08978
y.create.l HWIO_MMSS_OXILI_VFD_FETCH_INSTR_1_C_CTX_0_ADDR A:0xfdc0897c
y.create.l HWIO_MMSS_OXILI_VFD_FETCH_INSTR_0_D_CTX_0_ADDR A:0xfdc08980
y.create.l HWIO_MMSS_OXILI_VFD_FETCH_INSTR_1_D_CTX_0_ADDR A:0xfdc08984
y.create.l HWIO_MMSS_OXILI_VFD_FETCH_INSTR_0_E_CTX_0_ADDR A:0xfdc08988
y.create.l HWIO_MMSS_OXILI_VFD_FETCH_INSTR_1_E_CTX_0_ADDR A:0xfdc0898c
y.create.l HWIO_MMSS_OXILI_VFD_FETCH_INSTR_0_F_CTX_0_ADDR A:0xfdc08990
y.create.l HWIO_MMSS_OXILI_VFD_FETCH_INSTR_1_F_CTX_0_ADDR A:0xfdc08994
y.create.l HWIO_MMSS_OXILI_VFD_DECODE_INSTR_0_CTX_0_ADDR A:0xfdc08998
y.create.l HWIO_MMSS_OXILI_VFD_DECODE_INSTR_1_CTX_0_ADDR A:0xfdc0899c
y.create.l HWIO_MMSS_OXILI_VFD_DECODE_INSTR_2_CTX_0_ADDR A:0xfdc089a0
y.create.l HWIO_MMSS_OXILI_VFD_DECODE_INSTR_3_CTX_0_ADDR A:0xfdc089a4
y.create.l HWIO_MMSS_OXILI_VFD_DECODE_INSTR_4_CTX_0_ADDR A:0xfdc089a8
y.create.l HWIO_MMSS_OXILI_VFD_DECODE_INSTR_5_CTX_0_ADDR A:0xfdc089ac
y.create.l HWIO_MMSS_OXILI_VFD_DECODE_INSTR_6_CTX_0_ADDR A:0xfdc089b0
y.create.l HWIO_MMSS_OXILI_VFD_DECODE_INSTR_7_CTX_0_ADDR A:0xfdc089b4
y.create.l HWIO_MMSS_OXILI_VFD_DECODE_INSTR_8_CTX_0_ADDR A:0xfdc089b8
y.create.l HWIO_MMSS_OXILI_VFD_DECODE_INSTR_9_CTX_0_ADDR A:0xfdc089bc
y.create.l HWIO_MMSS_OXILI_VFD_DECODE_INSTR_10_CTX_0_ADDR A:0xfdc089c0
y.create.l HWIO_MMSS_OXILI_VFD_DECODE_INSTR_11_CTX_0_ADDR A:0xfdc089c4
y.create.l HWIO_MMSS_OXILI_VFD_DECODE_INSTR_12_CTX_0_ADDR A:0xfdc089c8
y.create.l HWIO_MMSS_OXILI_VFD_DECODE_INSTR_13_CTX_0_ADDR A:0xfdc089cc
y.create.l HWIO_MMSS_OXILI_VFD_DECODE_INSTR_14_CTX_0_ADDR A:0xfdc089d0
y.create.l HWIO_MMSS_OXILI_VFD_DECODE_INSTR_15_CTX_0_ADDR A:0xfdc089d4
y.create.l HWIO_MMSS_OXILI_VFD_DECODE_INSTR_16_CTX_0_ADDR A:0xfdc089d8
y.create.l HWIO_MMSS_OXILI_VFD_DECODE_INSTR_17_CTX_0_ADDR A:0xfdc089dc
y.create.l HWIO_MMSS_OXILI_VFD_DECODE_INSTR_18_CTX_0_ADDR A:0xfdc089e0
y.create.l HWIO_MMSS_OXILI_VFD_DECODE_INSTR_19_CTX_0_ADDR A:0xfdc089e4
y.create.l HWIO_MMSS_OXILI_VFD_DECODE_INSTR_20_CTX_0_ADDR A:0xfdc089e8
y.create.l HWIO_MMSS_OXILI_VFD_DECODE_INSTR_21_CTX_0_ADDR A:0xfdc089ec
y.create.l HWIO_MMSS_OXILI_VFD_DECODE_INSTR_22_CTX_0_ADDR A:0xfdc089f0
y.create.l HWIO_MMSS_OXILI_VFD_DECODE_INSTR_23_CTX_0_ADDR A:0xfdc089f4
y.create.l HWIO_MMSS_OXILI_VFD_VS_THREADING_THRESHOLD_CTX_0_ADDR A:0xfdc089f8
y.create.l HWIO_MMSS_OXILI_VFD_CONTROL_0_CTX_1_ADDR A:0xfdc09900
y.create.l HWIO_MMSS_OXILI_VFD_CONTROL_1_CTX_1_ADDR A:0xfdc09904
y.create.l HWIO_MMSS_OXILI_VFD_INDEX_MIN_CTX_1_ADDR A:0xfdc09908
y.create.l HWIO_MMSS_OXILI_VFD_INDEX_MAX_CTX_1_ADDR A:0xfdc0990c
y.create.l HWIO_MMSS_OXILI_VFD_INSTANCEID_OFFSET_CTX_1_ADDR A:0xfdc09910
y.create.l HWIO_MMSS_OXILI_VFD_INDEX_OFFSET_CTX_1_ADDR A:0xfdc09914
y.create.l HWIO_MMSS_OXILI_VFD_FETCH_INSTR_0_0_CTX_1_ADDR A:0xfdc09918
y.create.l HWIO_MMSS_OXILI_VFD_FETCH_INSTR_1_0_CTX_1_ADDR A:0xfdc0991c
y.create.l HWIO_MMSS_OXILI_VFD_FETCH_INSTR_0_1_CTX_1_ADDR A:0xfdc09920
y.create.l HWIO_MMSS_OXILI_VFD_FETCH_INSTR_1_1_CTX_1_ADDR A:0xfdc09924
y.create.l HWIO_MMSS_OXILI_VFD_FETCH_INSTR_0_2_CTX_1_ADDR A:0xfdc09928
y.create.l HWIO_MMSS_OXILI_VFD_FETCH_INSTR_1_2_CTX_1_ADDR A:0xfdc0992c
y.create.l HWIO_MMSS_OXILI_VFD_FETCH_INSTR_0_3_CTX_1_ADDR A:0xfdc09930
y.create.l HWIO_MMSS_OXILI_VFD_FETCH_INSTR_1_3_CTX_1_ADDR A:0xfdc09934
y.create.l HWIO_MMSS_OXILI_VFD_FETCH_INSTR_0_4_CTX_1_ADDR A:0xfdc09938
y.create.l HWIO_MMSS_OXILI_VFD_FETCH_INSTR_1_4_CTX_1_ADDR A:0xfdc0993c
y.create.l HWIO_MMSS_OXILI_VFD_FETCH_INSTR_0_5_CTX_1_ADDR A:0xfdc09940
y.create.l HWIO_MMSS_OXILI_VFD_FETCH_INSTR_1_5_CTX_1_ADDR A:0xfdc09944
y.create.l HWIO_MMSS_OXILI_VFD_FETCH_INSTR_0_6_CTX_1_ADDR A:0xfdc09948
y.create.l HWIO_MMSS_OXILI_VFD_FETCH_INSTR_1_6_CTX_1_ADDR A:0xfdc0994c
y.create.l HWIO_MMSS_OXILI_VFD_FETCH_INSTR_0_7_CTX_1_ADDR A:0xfdc09950
y.create.l HWIO_MMSS_OXILI_VFD_FETCH_INSTR_1_7_CTX_1_ADDR A:0xfdc09954
y.create.l HWIO_MMSS_OXILI_VFD_FETCH_INSTR_0_8_CTX_1_ADDR A:0xfdc09958
y.create.l HWIO_MMSS_OXILI_VFD_FETCH_INSTR_1_8_CTX_1_ADDR A:0xfdc0995c
y.create.l HWIO_MMSS_OXILI_VFD_FETCH_INSTR_0_9_CTX_1_ADDR A:0xfdc09960
y.create.l HWIO_MMSS_OXILI_VFD_FETCH_INSTR_1_9_CTX_1_ADDR A:0xfdc09964
y.create.l HWIO_MMSS_OXILI_VFD_FETCH_INSTR_0_A_CTX_1_ADDR A:0xfdc09968
y.create.l HWIO_MMSS_OXILI_VFD_FETCH_INSTR_1_A_CTX_1_ADDR A:0xfdc0996c
y.create.l HWIO_MMSS_OXILI_VFD_FETCH_INSTR_0_B_CTX_1_ADDR A:0xfdc09970
y.create.l HWIO_MMSS_OXILI_VFD_FETCH_INSTR_1_B_CTX_1_ADDR A:0xfdc09974
y.create.l HWIO_MMSS_OXILI_VFD_FETCH_INSTR_0_C_CTX_1_ADDR A:0xfdc09978
y.create.l HWIO_MMSS_OXILI_VFD_FETCH_INSTR_1_C_CTX_1_ADDR A:0xfdc0997c
y.create.l HWIO_MMSS_OXILI_VFD_FETCH_INSTR_0_D_CTX_1_ADDR A:0xfdc09980
y.create.l HWIO_MMSS_OXILI_VFD_FETCH_INSTR_1_D_CTX_1_ADDR A:0xfdc09984
y.create.l HWIO_MMSS_OXILI_VFD_FETCH_INSTR_0_E_CTX_1_ADDR A:0xfdc09988
y.create.l HWIO_MMSS_OXILI_VFD_FETCH_INSTR_1_E_CTX_1_ADDR A:0xfdc0998c
y.create.l HWIO_MMSS_OXILI_VFD_FETCH_INSTR_0_F_CTX_1_ADDR A:0xfdc09990
y.create.l HWIO_MMSS_OXILI_VFD_FETCH_INSTR_1_F_CTX_1_ADDR A:0xfdc09994
y.create.l HWIO_MMSS_OXILI_VFD_DECODE_INSTR_0_CTX_1_ADDR A:0xfdc09998
y.create.l HWIO_MMSS_OXILI_VFD_DECODE_INSTR_1_CTX_1_ADDR A:0xfdc0999c
y.create.l HWIO_MMSS_OXILI_VFD_DECODE_INSTR_2_CTX_1_ADDR A:0xfdc099a0
y.create.l HWIO_MMSS_OXILI_VFD_DECODE_INSTR_3_CTX_1_ADDR A:0xfdc099a4
y.create.l HWIO_MMSS_OXILI_VFD_DECODE_INSTR_4_CTX_1_ADDR A:0xfdc099a8
y.create.l HWIO_MMSS_OXILI_VFD_DECODE_INSTR_5_CTX_1_ADDR A:0xfdc099ac
y.create.l HWIO_MMSS_OXILI_VFD_DECODE_INSTR_6_CTX_1_ADDR A:0xfdc099b0
y.create.l HWIO_MMSS_OXILI_VFD_DECODE_INSTR_7_CTX_1_ADDR A:0xfdc099b4
y.create.l HWIO_MMSS_OXILI_VFD_DECODE_INSTR_8_CTX_1_ADDR A:0xfdc099b8
y.create.l HWIO_MMSS_OXILI_VFD_DECODE_INSTR_9_CTX_1_ADDR A:0xfdc099bc
y.create.l HWIO_MMSS_OXILI_VFD_DECODE_INSTR_10_CTX_1_ADDR A:0xfdc099c0
y.create.l HWIO_MMSS_OXILI_VFD_DECODE_INSTR_11_CTX_1_ADDR A:0xfdc099c4
y.create.l HWIO_MMSS_OXILI_VFD_DECODE_INSTR_12_CTX_1_ADDR A:0xfdc099c8
y.create.l HWIO_MMSS_OXILI_VFD_DECODE_INSTR_13_CTX_1_ADDR A:0xfdc099cc
y.create.l HWIO_MMSS_OXILI_VFD_DECODE_INSTR_14_CTX_1_ADDR A:0xfdc099d0
y.create.l HWIO_MMSS_OXILI_VFD_DECODE_INSTR_15_CTX_1_ADDR A:0xfdc099d4
y.create.l HWIO_MMSS_OXILI_VFD_DECODE_INSTR_16_CTX_1_ADDR A:0xfdc099d8
y.create.l HWIO_MMSS_OXILI_VFD_DECODE_INSTR_17_CTX_1_ADDR A:0xfdc099dc
y.create.l HWIO_MMSS_OXILI_VFD_DECODE_INSTR_18_CTX_1_ADDR A:0xfdc099e0
y.create.l HWIO_MMSS_OXILI_VFD_DECODE_INSTR_19_CTX_1_ADDR A:0xfdc099e4
y.create.l HWIO_MMSS_OXILI_VFD_DECODE_INSTR_20_CTX_1_ADDR A:0xfdc099e8
y.create.l HWIO_MMSS_OXILI_VFD_DECODE_INSTR_21_CTX_1_ADDR A:0xfdc099ec
y.create.l HWIO_MMSS_OXILI_VFD_DECODE_INSTR_22_CTX_1_ADDR A:0xfdc099f0
y.create.l HWIO_MMSS_OXILI_VFD_DECODE_INSTR_23_CTX_1_ADDR A:0xfdc099f4
y.create.l HWIO_MMSS_OXILI_VFD_VS_THREADING_THRESHOLD_CTX_1_ADDR A:0xfdc099f8
y.create.l HWIO_MMSS_OXILI_VPC_VPC_DEBUG_RAM_SEL_ADDR A:0xfdc03984
y.create.l HWIO_MMSS_OXILI_VPC_VPC_DEBUG_RAM_READ_ADDR A:0xfdc03988
y.create.l HWIO_MMSS_OXILI_VPC_VPC_DEBUG_ADDR A:0xfdc0398c
y.create.l HWIO_MMSS_OXILI_VPC_PERFCOUNTER0_SELECT_ADDR A:0xfdc03990
y.create.l HWIO_MMSS_OXILI_VPC_PERFCOUNTER1_SELECT_ADDR A:0xfdc03994
y.create.l HWIO_MMSS_OXILI_VPC_ATTR_CTX_0_ADDR A:0xfdc08a00
y.create.l HWIO_MMSS_OXILI_VPC_PACK_CTX_0_ADDR A:0xfdc08a04
y.create.l HWIO_MMSS_OXILI_VPC_VARYING_INTERP_MODE_0_CTX_0_ADDR A:0xfdc08a08
y.create.l HWIO_MMSS_OXILI_VPC_VARYING_INTERP_MODE_1_CTX_0_ADDR A:0xfdc08a0c
y.create.l HWIO_MMSS_OXILI_VPC_VARYING_INTERP_MODE_2_CTX_0_ADDR A:0xfdc08a10
y.create.l HWIO_MMSS_OXILI_VPC_VARYING_INTERP_MODE_3_CTX_0_ADDR A:0xfdc08a14
y.create.l HWIO_MMSS_OXILI_VPC_VARYING_PS_REPL_MODE_0_CTX_0_ADDR A:0xfdc08a18
y.create.l HWIO_MMSS_OXILI_VPC_VARYING_PS_REPL_MODE_1_CTX_0_ADDR A:0xfdc08a1c
y.create.l HWIO_MMSS_OXILI_VPC_VARYING_PS_REPL_MODE_2_CTX_0_ADDR A:0xfdc08a20
y.create.l HWIO_MMSS_OXILI_VPC_VARYING_PS_REPL_MODE_3_CTX_0_ADDR A:0xfdc08a24
y.create.l HWIO_MMSS_OXILI_VPC_VARY_CYLWRAP_ENABLE_0_CTX_0_ADDR A:0xfdc08a28
y.create.l HWIO_MMSS_OXILI_VPC_VARY_CYLWRAP_ENABLE_1_CTX_0_ADDR A:0xfdc08a2c
y.create.l HWIO_MMSS_OXILI_VPC_ATTR_CTX_1_ADDR A:0xfdc09a00
y.create.l HWIO_MMSS_OXILI_VPC_PACK_CTX_1_ADDR A:0xfdc09a04
y.create.l HWIO_MMSS_OXILI_VPC_VARYING_INTERP_MODE_0_CTX_1_ADDR A:0xfdc09a08
y.create.l HWIO_MMSS_OXILI_VPC_VARYING_INTERP_MODE_1_CTX_1_ADDR A:0xfdc09a0c
y.create.l HWIO_MMSS_OXILI_VPC_VARYING_INTERP_MODE_2_CTX_1_ADDR A:0xfdc09a10
y.create.l HWIO_MMSS_OXILI_VPC_VARYING_INTERP_MODE_3_CTX_1_ADDR A:0xfdc09a14
y.create.l HWIO_MMSS_OXILI_VPC_VARYING_PS_REPL_MODE_0_CTX_1_ADDR A:0xfdc09a18
y.create.l HWIO_MMSS_OXILI_VPC_VARYING_PS_REPL_MODE_1_CTX_1_ADDR A:0xfdc09a1c
y.create.l HWIO_MMSS_OXILI_VPC_VARYING_PS_REPL_MODE_2_CTX_1_ADDR A:0xfdc09a20
y.create.l HWIO_MMSS_OXILI_VPC_VARYING_PS_REPL_MODE_3_CTX_1_ADDR A:0xfdc09a24
y.create.l HWIO_MMSS_OXILI_VPC_VARY_CYLWRAP_ENABLE_0_CTX_1_ADDR A:0xfdc09a28
y.create.l HWIO_MMSS_OXILI_VPC_VARY_CYLWRAP_ENABLE_1_CTX_1_ADDR A:0xfdc09a2c
y.create.l HWIO_MMSS_OXILI_UCHE_MEM_RANGE_MIN_REG_ADDR A:0xfdc03a90
y.create.l HWIO_MMSS_OXILI_UCHE_MEM_RANGE_MAX_REG_ADDR A:0xfdc03a94
y.create.l HWIO_MMSS_OXILI_UCHE_CACHE_WAYS_VFD_REG_ADDR A:0xfdc03a98
y.create.l HWIO_MMSS_OXILI_UCHE_CACHE_WAYS_RB_REG_ADDR A:0xfdc03a9c
y.create.l HWIO_MMSS_OXILI_UCHE_CACHE_STATUS_REG_ADDR A:0xfdc03a00
y.create.l HWIO_MMSS_OXILI_UCHE_CACHE_DEBUG_ECO_ADDR A:0xfdc03a04
y.create.l HWIO_MMSS_OXILI_UCHE_CACHE_INVALIDATE0_REG_ADDR A:0xfdc03a80
y.create.l HWIO_MMSS_OXILI_UCHE_CACHE_INVALIDATE1_REG_ADDR A:0xfdc03a84
y.create.l HWIO_MMSS_OXILI_UCHE_CACHE_MODE_CONTROL_REG_ADDR A:0xfdc03a08
y.create.l HWIO_MMSS_OXILI_UCHE_PERFCOUNTER0_SELECT_REG_ADDR A:0xfdc03a10
y.create.l HWIO_MMSS_OXILI_UCHE_PERFCOUNTER1_SELECT_REG_ADDR A:0xfdc03a14
y.create.l HWIO_MMSS_OXILI_UCHE_PERFCOUNTER2_SELECT_REG_ADDR A:0xfdc03a18
y.create.l HWIO_MMSS_OXILI_UCHE_PERFCOUNTER3_SELECT_REG_ADDR A:0xfdc03a1c
y.create.l HWIO_MMSS_OXILI_UCHE_PERFCOUNTER4_SELECT_REG_ADDR A:0xfdc03a20
y.create.l HWIO_MMSS_OXILI_UCHE_PERFCOUNTER5_SELECT_REG_ADDR A:0xfdc03a24
y.create.l HWIO_MMSS_OXILI_SP_PERFCOUNTER0_SELECT_ADDR A:0xfdc03b10
y.create.l HWIO_MMSS_OXILI_SP_PERFCOUNTER1_SELECT_ADDR A:0xfdc03b14
y.create.l HWIO_MMSS_OXILI_SP_PERFCOUNTER2_SELECT_ADDR A:0xfdc03b18
y.create.l HWIO_MMSS_OXILI_SP_PERFCOUNTER3_SELECT_ADDR A:0xfdc03b1c
y.create.l HWIO_MMSS_OXILI_SP_PERFCOUNTER4_SELECT_ADDR A:0xfdc03b20
y.create.l HWIO_MMSS_OXILI_SP_PERFCOUNTER5_SELECT_ADDR A:0xfdc03b24
y.create.l HWIO_MMSS_OXILI_SP_PERFCOUNTER6_SELECT_ADDR A:0xfdc03b28
y.create.l HWIO_MMSS_OXILI_SP_PERFCOUNTER7_SELECT_ADDR A:0xfdc03b2c
y.create.l HWIO_MMSS_OXILI_SP_SP_MODE_CONTROL_ADDR A:0xfdc03b80
y.create.l HWIO_MMSS_OXILI_SP_SP_POWER_COUNTER_LOW_ADDR A:0xfdc03b90
y.create.l HWIO_MMSS_OXILI_SP_SP_POWER_COUNTER_HI_ADDR A:0xfdc03b94
y.create.l HWIO_MMSS_OXILI_SP_SP_VS_STATUS_ADDR A:0xfdc03b00
y.create.l HWIO_MMSS_OXILI_SP_SP_FS_STATUS_ADDR A:0xfdc03b04
y.create.l HWIO_MMSS_OXILI_SP_SP_DEBUG_ECO_ADDR A:0xfdc03b08
y.create.l HWIO_MMSS_OXILI_SP_SP_CTRL_REG_CTX_0_ADDR A:0xfdc08b00
y.create.l HWIO_MMSS_OXILI_SP_VS_CTRL_REG0_CTX_0_ADDR A:0xfdc08b10
y.create.l HWIO_MMSS_OXILI_SP_VS_CTRL_REG1_CTX_0_ADDR A:0xfdc08b14
y.create.l HWIO_MMSS_OXILI_SP_VS_PARAM_REG_CTX_0_ADDR A:0xfdc08b18
y.create.l HWIO_MMSS_OXILI_SP_VS_OUT_REG_0_CTX_0_ADDR A:0xfdc08b1c
y.create.l HWIO_MMSS_OXILI_SP_VS_OUT_REG_1_CTX_0_ADDR A:0xfdc08b20
y.create.l HWIO_MMSS_OXILI_SP_VS_OUT_REG_2_CTX_0_ADDR A:0xfdc08b24
y.create.l HWIO_MMSS_OXILI_SP_VS_OUT_REG_3_CTX_0_ADDR A:0xfdc08b28
y.create.l HWIO_MMSS_OXILI_SP_VS_OUT_REG_4_CTX_0_ADDR A:0xfdc08b2c
y.create.l HWIO_MMSS_OXILI_SP_VS_OUT_REG_5_CTX_0_ADDR A:0xfdc08b30
y.create.l HWIO_MMSS_OXILI_SP_VS_OUT_REG_6_CTX_0_ADDR A:0xfdc08b34
y.create.l HWIO_MMSS_OXILI_SP_VS_OUT_REG_7_CTX_0_ADDR A:0xfdc08b38
y.create.l HWIO_MMSS_OXILI_SP_VS_VPC_DST_REG_0_CTX_0_ADDR A:0xfdc08b40
y.create.l HWIO_MMSS_OXILI_SP_VS_VPC_DST_REG_1_CTX_0_ADDR A:0xfdc08b44
y.create.l HWIO_MMSS_OXILI_SP_VS_VPC_DST_REG_2_CTX_0_ADDR A:0xfdc08b48
y.create.l HWIO_MMSS_OXILI_SP_VS_VPC_DST_REG_3_CTX_0_ADDR A:0xfdc08b4c
y.create.l HWIO_MMSS_OXILI_SP_VS_OBJ_OFFSET_REG_CTX_0_ADDR A:0xfdc08b50
y.create.l HWIO_MMSS_OXILI_SP_VS_OBJ_START_REG_CTX_0_ADDR A:0xfdc08b54
y.create.l HWIO_MMSS_OXILI_SP_VS_PVT_MEM_PARAM_REG_CTX_0_ADDR A:0xfdc08b58
y.create.l HWIO_MMSS_OXILI_SP_VS_PVT_MEM_ADDR_REG_CTX_0_ADDR A:0xfdc08b5c
y.create.l HWIO_MMSS_OXILI_SP_VS_PVT_MEM_SIZE_REG_CTX_0_ADDR A:0xfdc08b60
y.create.l HWIO_MMSS_OXILI_SP_VS_LENGTH_REG_CTX_0_ADDR A:0xfdc08b7c
y.create.l HWIO_MMSS_OXILI_SP_FS_CTRL_REG0_CTX_0_ADDR A:0xfdc08b80
y.create.l HWIO_MMSS_OXILI_SP_FS_CTRL_REG1_CTX_0_ADDR A:0xfdc08b84
y.create.l HWIO_MMSS_OXILI_SP_FS_OBJ_OFFSET_REG_CTX_0_ADDR A:0xfdc08b88
y.create.l HWIO_MMSS_OXILI_SP_FS_OBJ_START_REG_CTX_0_ADDR A:0xfdc08b8c
y.create.l HWIO_MMSS_OXILI_SP_FS_PVT_MEM_PARAM_REG_CTX_0_ADDR A:0xfdc08b90
y.create.l HWIO_MMSS_OXILI_SP_FS_PVT_MEM_ADDR_REG_CTX_0_ADDR A:0xfdc08b94
y.create.l HWIO_MMSS_OXILI_SP_FS_PVT_MEM_SIZE_REG_CTX_0_ADDR A:0xfdc08b98
y.create.l HWIO_MMSS_OXILI_SP_FS_FLAT_SHAD_MODE_REG_0_CTX_0_ADDR A:0xfdc08ba0
y.create.l HWIO_MMSS_OXILI_SP_FS_FLAT_SHAD_MODE_REG_1_CTX_0_ADDR A:0xfdc08ba4
y.create.l HWIO_MMSS_OXILI_SP_FS_OUTPUT_REG_CTX_0_ADDR A:0xfdc08bb0
y.create.l HWIO_MMSS_OXILI_SP_FS_MRT_REG_0_CTX_0_ADDR A:0xfdc08bc0
y.create.l HWIO_MMSS_OXILI_SP_FS_MRT_REG_1_CTX_0_ADDR A:0xfdc08bc4
y.create.l HWIO_MMSS_OXILI_SP_FS_MRT_REG_2_CTX_0_ADDR A:0xfdc08bc8
y.create.l HWIO_MMSS_OXILI_SP_FS_MRT_REG_3_CTX_0_ADDR A:0xfdc08bcc
y.create.l HWIO_MMSS_OXILI_SP_FS_IMAGE_OUTPUT_REG_0_CTX_0_ADDR A:0xfdc08bd0
y.create.l HWIO_MMSS_OXILI_SP_FS_IMAGE_OUTPUT_REG_1_CTX_0_ADDR A:0xfdc08bd4
y.create.l HWIO_MMSS_OXILI_SP_FS_IMAGE_OUTPUT_REG_2_CTX_0_ADDR A:0xfdc08bd8
y.create.l HWIO_MMSS_OXILI_SP_FS_IMAGE_OUTPUT_REG_3_CTX_0_ADDR A:0xfdc08bdc
y.create.l HWIO_MMSS_OXILI_SP_FS_LENGTH_REG_CTX_0_ADDR A:0xfdc08bfc
y.create.l HWIO_MMSS_OXILI_SP_VS_INSTR_PORT_REG_CTX_0_ADDR A:0xfdc08c00
y.create.l HWIO_MMSS_OXILI_SP_FS_INSTR_PORT_REG_CTX_0_ADDR A:0xfdc08c10
y.create.l HWIO_MMSS_OXILI_SP_VS_CONST_PORT_REG_CTX_0_ADDR A:0xfdc08c20
y.create.l HWIO_MMSS_OXILI_SP_FS_CONST_PORT_REG_CTX_0_ADDR A:0xfdc08c30
y.create.l HWIO_MMSS_OXILI_SP_SP_CTRL_REG_CTX_1_ADDR A:0xfdc09b00
y.create.l HWIO_MMSS_OXILI_SP_VS_CTRL_REG0_CTX_1_ADDR A:0xfdc09b10
y.create.l HWIO_MMSS_OXILI_SP_VS_CTRL_REG1_CTX_1_ADDR A:0xfdc09b14
y.create.l HWIO_MMSS_OXILI_SP_VS_PARAM_REG_CTX_1_ADDR A:0xfdc09b18
y.create.l HWIO_MMSS_OXILI_SP_VS_OUT_REG_0_CTX_1_ADDR A:0xfdc09b1c
y.create.l HWIO_MMSS_OXILI_SP_VS_OUT_REG_1_CTX_1_ADDR A:0xfdc09b20
y.create.l HWIO_MMSS_OXILI_SP_VS_OUT_REG_2_CTX_1_ADDR A:0xfdc09b24
y.create.l HWIO_MMSS_OXILI_SP_VS_OUT_REG_3_CTX_1_ADDR A:0xfdc09b28
y.create.l HWIO_MMSS_OXILI_SP_VS_OUT_REG_4_CTX_1_ADDR A:0xfdc09b2c
y.create.l HWIO_MMSS_OXILI_SP_VS_OUT_REG_5_CTX_1_ADDR A:0xfdc09b30
y.create.l HWIO_MMSS_OXILI_SP_VS_OUT_REG_6_CTX_1_ADDR A:0xfdc09b34
y.create.l HWIO_MMSS_OXILI_SP_VS_OUT_REG_7_CTX_1_ADDR A:0xfdc09b38
y.create.l HWIO_MMSS_OXILI_SP_VS_VPC_DST_REG_0_CTX_1_ADDR A:0xfdc09b40
y.create.l HWIO_MMSS_OXILI_SP_VS_VPC_DST_REG_1_CTX_1_ADDR A:0xfdc09b44
y.create.l HWIO_MMSS_OXILI_SP_VS_VPC_DST_REG_2_CTX_1_ADDR A:0xfdc09b48
y.create.l HWIO_MMSS_OXILI_SP_VS_VPC_DST_REG_3_CTX_1_ADDR A:0xfdc09b4c
y.create.l HWIO_MMSS_OXILI_SP_VS_OBJ_OFFSET_REG_CTX_1_ADDR A:0xfdc09b50
y.create.l HWIO_MMSS_OXILI_SP_VS_OBJ_START_REG_CTX_1_ADDR A:0xfdc09b54
y.create.l HWIO_MMSS_OXILI_SP_VS_PVT_MEM_PARAM_REG_CTX_1_ADDR A:0xfdc09b58
y.create.l HWIO_MMSS_OXILI_SP_VS_PVT_MEM_ADDR_REG_CTX_1_ADDR A:0xfdc09b5c
y.create.l HWIO_MMSS_OXILI_SP_VS_PVT_MEM_SIZE_REG_CTX_1_ADDR A:0xfdc09b60
y.create.l HWIO_MMSS_OXILI_SP_VS_LENGTH_REG_CTX_1_ADDR A:0xfdc09b7c
y.create.l HWIO_MMSS_OXILI_SP_FS_CTRL_REG0_CTX_1_ADDR A:0xfdc09b80
y.create.l HWIO_MMSS_OXILI_SP_FS_CTRL_REG1_CTX_1_ADDR A:0xfdc09b84
y.create.l HWIO_MMSS_OXILI_SP_FS_OBJ_OFFSET_REG_CTX_1_ADDR A:0xfdc09b88
y.create.l HWIO_MMSS_OXILI_SP_FS_OBJ_START_REG_CTX_1_ADDR A:0xfdc09b8c
y.create.l HWIO_MMSS_OXILI_SP_FS_PVT_MEM_PARAM_REG_CTX_1_ADDR A:0xfdc09b90
y.create.l HWIO_MMSS_OXILI_SP_FS_PVT_MEM_ADDR_REG_CTX_1_ADDR A:0xfdc09b94
y.create.l HWIO_MMSS_OXILI_SP_FS_PVT_MEM_SIZE_REG_CTX_1_ADDR A:0xfdc09b98
y.create.l HWIO_MMSS_OXILI_SP_FS_FLAT_SHAD_MODE_REG_0_CTX_1_ADDR A:0xfdc09ba0
y.create.l HWIO_MMSS_OXILI_SP_FS_FLAT_SHAD_MODE_REG_1_CTX_1_ADDR A:0xfdc09ba4
y.create.l HWIO_MMSS_OXILI_SP_FS_OUTPUT_REG_CTX_1_ADDR A:0xfdc09bb0
y.create.l HWIO_MMSS_OXILI_SP_FS_MRT_REG_0_CTX_1_ADDR A:0xfdc09bc0
y.create.l HWIO_MMSS_OXILI_SP_FS_MRT_REG_1_CTX_1_ADDR A:0xfdc09bc4
y.create.l HWIO_MMSS_OXILI_SP_FS_MRT_REG_2_CTX_1_ADDR A:0xfdc09bc8
y.create.l HWIO_MMSS_OXILI_SP_FS_MRT_REG_3_CTX_1_ADDR A:0xfdc09bcc
y.create.l HWIO_MMSS_OXILI_SP_FS_IMAGE_OUTPUT_REG_0_CTX_1_ADDR A:0xfdc09bd0
y.create.l HWIO_MMSS_OXILI_SP_FS_IMAGE_OUTPUT_REG_1_CTX_1_ADDR A:0xfdc09bd4
y.create.l HWIO_MMSS_OXILI_SP_FS_IMAGE_OUTPUT_REG_2_CTX_1_ADDR A:0xfdc09bd8
y.create.l HWIO_MMSS_OXILI_SP_FS_IMAGE_OUTPUT_REG_3_CTX_1_ADDR A:0xfdc09bdc
y.create.l HWIO_MMSS_OXILI_SP_FS_LENGTH_REG_CTX_1_ADDR A:0xfdc09bfc
y.create.l HWIO_MMSS_OXILI_SP_VS_INSTR_PORT_REG_CTX_1_ADDR A:0xfdc09c00
y.create.l HWIO_MMSS_OXILI_SP_FS_INSTR_PORT_REG_CTX_1_ADDR A:0xfdc09c10
y.create.l HWIO_MMSS_OXILI_SP_VS_CONST_PORT_REG_CTX_1_ADDR A:0xfdc09c20
y.create.l HWIO_MMSS_OXILI_SP_FS_CONST_PORT_REG_CTX_1_ADDR A:0xfdc09c30
y.create.l HWIO_MMSS_OXILI_TPL1_TP_DEBUG_ECO_ADDR A:0xfdc03c00
y.create.l HWIO_MMSS_OXILI_TPL1_TP_STATUS0_ADDR A:0xfdc03c04
y.create.l HWIO_MMSS_OXILI_TPL1_TP_MODE_CONTROL_ADDR A:0xfdc03c0c
y.create.l HWIO_MMSS_OXILI_TPL1_TP_PERFCOUNTER0_SELECT_ADDR A:0xfdc03c10
y.create.l HWIO_MMSS_OXILI_TPL1_TP_PERFCOUNTER1_SELECT_ADDR A:0xfdc03c14
y.create.l HWIO_MMSS_OXILI_TPL1_TP_PERFCOUNTER2_SELECT_ADDR A:0xfdc03c18
y.create.l HWIO_MMSS_OXILI_TPL1_TP_PERFCOUNTER3_SELECT_ADDR A:0xfdc03c1c
y.create.l HWIO_MMSS_OXILI_TPL1_TP_PERFCOUNTER4_SELECT_ADDR A:0xfdc03c20
y.create.l HWIO_MMSS_OXILI_TPL1_TP_PERFCOUNTER5_SELECT_ADDR A:0xfdc03c24
y.create.l HWIO_MMSS_OXILI_TPL1_TP_VS_TEX_OFFSET_CTX_0_ADDR A:0xfdc08d00
y.create.l HWIO_MMSS_OXILI_TPL1_TP_FS_TEX_OFFSET_CTX_0_ADDR A:0xfdc08d08
y.create.l HWIO_MMSS_OXILI_TPL1_TP_VS_BORDER_COLOR_BASE_ADDR_CTX_0_ADDR A:0xfdc08d04
y.create.l HWIO_MMSS_OXILI_TPL1_TP_FS_BORDER_COLOR_BASE_ADDR_CTX_0_ADDR A:0xfdc08d0c
y.create.l HWIO_MMSS_OXILI_TPL1_TP_SAMPLER_0_CTX_0_ADDR A:0xfdc08d20
y.create.l HWIO_MMSS_OXILI_TPL1_TP_SAMPLER_1_CTX_0_ADDR A:0xfdc08d24
y.create.l HWIO_MMSS_OXILI_TPL1_TP_TEXMEM_OBJ_0_CTX_0_ADDR A:0xfdc08d40
y.create.l HWIO_MMSS_OXILI_TPL1_TP_TEXMEM_OBJ_1_CTX_0_ADDR A:0xfdc08d44
y.create.l HWIO_MMSS_OXILI_TPL1_TP_TEXMEM_OBJ_2_CTX_0_ADDR A:0xfdc08d48
y.create.l HWIO_MMSS_OXILI_TPL1_TP_TEXMEM_OBJ_3_CTX_0_ADDR A:0xfdc08d4c
y.create.l HWIO_MMSS_OXILI_TPL1_TP_TEXMEM_OBJ_4_CTX_0_ADDR A:0xfdc08d50
y.create.l HWIO_MMSS_OXILI_TPL1_TP_TEXMEM_OBJ_5_CTX_0_ADDR A:0xfdc08d54
y.create.l HWIO_MMSS_OXILI_TPL1_TP_TEXMEM_OBJ_6_CTX_0_ADDR A:0xfdc08d58
y.create.l HWIO_MMSS_OXILI_TPL1_MIPMAP_ADDR_PORT_REG_CTX_0_ADDR A:0xfdc08d80
y.create.l HWIO_MMSS_OXILI_TPL1_TP_VS_TEX_OFFSET_CTX_1_ADDR A:0xfdc09d00
y.create.l HWIO_MMSS_OXILI_TPL1_TP_FS_TEX_OFFSET_CTX_1_ADDR A:0xfdc09d08
y.create.l HWIO_MMSS_OXILI_TPL1_TP_VS_BORDER_COLOR_BASE_ADDR_CTX_1_ADDR A:0xfdc09d04
y.create.l HWIO_MMSS_OXILI_TPL1_TP_FS_BORDER_COLOR_BASE_ADDR_CTX_1_ADDR A:0xfdc09d0c
y.create.l HWIO_MMSS_OXILI_TPL1_TP_SAMPLER_0_CTX_1_ADDR A:0xfdc09d20
y.create.l HWIO_MMSS_OXILI_TPL1_TP_SAMPLER_1_CTX_1_ADDR A:0xfdc09d24
y.create.l HWIO_MMSS_OXILI_TPL1_TP_TEXMEM_OBJ_0_CTX_1_ADDR A:0xfdc09d40
y.create.l HWIO_MMSS_OXILI_TPL1_TP_TEXMEM_OBJ_1_CTX_1_ADDR A:0xfdc09d44
y.create.l HWIO_MMSS_OXILI_TPL1_TP_TEXMEM_OBJ_2_CTX_1_ADDR A:0xfdc09d48
y.create.l HWIO_MMSS_OXILI_TPL1_TP_TEXMEM_OBJ_3_CTX_1_ADDR A:0xfdc09d4c
y.create.l HWIO_MMSS_OXILI_TPL1_TP_TEXMEM_OBJ_4_CTX_1_ADDR A:0xfdc09d50
y.create.l HWIO_MMSS_OXILI_TPL1_TP_TEXMEM_OBJ_5_CTX_1_ADDR A:0xfdc09d54
y.create.l HWIO_MMSS_OXILI_TPL1_TP_TEXMEM_OBJ_6_CTX_1_ADDR A:0xfdc09d58
y.create.l HWIO_MMSS_OXILI_TPL1_MIPMAP_ADDR_PORT_REG_CTX_1_ADDR A:0xfdc09d80
y.create.l HWIO_MMSS_OXILI_RB_GMEM_BASE_ADDR_ADDR A:0xfdc03300
y.create.l HWIO_MMSS_OXILI_RB_DEBUG_ECO_CONTROLS_ADDR_ADDR A:0xfdc03304
y.create.l HWIO_MMSS_OXILI_RB_PERF_COUNTER0_SEL_ADDR A:0xfdc03318
y.create.l HWIO_MMSS_OXILI_RB_PERF_COUNTER1_SEL_ADDR A:0xfdc0331c
y.create.l HWIO_MMSS_OXILI_RB_FRAME_BUFFER_DIMENSION_ADDR A:0xfdc03380
y.create.l HWIO_MMSS_OXILI_RB_MARB_POWER_COUNTER_LOW_ADDR A:0xfdc03390
y.create.l HWIO_MMSS_OXILI_RB_MARB_POWER_COUNTER_HI_ADDR A:0xfdc03394
y.create.l HWIO_MMSS_OXILI_RB_MODE_CONTROL_CTX_0_ADDR A:0xfdc08300
y.create.l HWIO_MMSS_OXILI_RB_RENDER_CONTROL_CTX_0_ADDR A:0xfdc08304
y.create.l HWIO_MMSS_OXILI_RB_MSAA_CONTROL_CTX_0_ADDR A:0xfdc08308
y.create.l HWIO_MMSS_OXILI_RB_ALPHA_REFERENCE_CTX_0_ADDR A:0xfdc0830c
y.create.l HWIO_MMSS_OXILI_RB_MRT_CONTROL0_CTX_0_ADDR A:0xfdc08310
y.create.l HWIO_MMSS_OXILI_RB_MRT_CONTROL1_CTX_0_ADDR A:0xfdc08320
y.create.l HWIO_MMSS_OXILI_RB_MRT_CONTROL2_CTX_0_ADDR A:0xfdc08330
y.create.l HWIO_MMSS_OXILI_RB_MRT_CONTROL3_CTX_0_ADDR A:0xfdc08340
y.create.l HWIO_MMSS_OXILI_RB_MRT_BUF_INFO0_CTX_0_ADDR A:0xfdc08314
y.create.l HWIO_MMSS_OXILI_RB_MRT_BUF_INFO1_CTX_0_ADDR A:0xfdc08324
y.create.l HWIO_MMSS_OXILI_RB_MRT_BUF_INFO2_CTX_0_ADDR A:0xfdc08334
y.create.l HWIO_MMSS_OXILI_RB_MRT_BUF_INFO3_CTX_0_ADDR A:0xfdc08344
y.create.l HWIO_MMSS_OXILI_RB_MRT_BUF_BASE0_CTX_0_ADDR A:0xfdc08318
y.create.l HWIO_MMSS_OXILI_RB_MRT_BUF_BASE1_CTX_0_ADDR A:0xfdc08328
y.create.l HWIO_MMSS_OXILI_RB_MRT_BUF_BASE2_CTX_0_ADDR A:0xfdc08338
y.create.l HWIO_MMSS_OXILI_RB_MRT_BUF_BASE3_CTX_0_ADDR A:0xfdc08348
y.create.l HWIO_MMSS_OXILI_RB_MRT_BLEND_CONTROL0_CTX_0_ADDR A:0xfdc0831c
y.create.l HWIO_MMSS_OXILI_RB_MRT_BLEND_CONTROL1_CTX_0_ADDR A:0xfdc0832c
y.create.l HWIO_MMSS_OXILI_RB_MRT_BLEND_CONTROL2_CTX_0_ADDR A:0xfdc0833c
y.create.l HWIO_MMSS_OXILI_RB_MRT_BLEND_CONTROL3_CTX_0_ADDR A:0xfdc0834c
y.create.l HWIO_MMSS_OXILI_RB_BLEND_RED_CTX_0_ADDR A:0xfdc08390
y.create.l HWIO_MMSS_OXILI_RB_BLEND_GREEN_CTX_0_ADDR A:0xfdc08394
y.create.l HWIO_MMSS_OXILI_RB_BLEND_BLUE_CTX_0_ADDR A:0xfdc08398
y.create.l HWIO_MMSS_OXILI_RB_BLEND_ALPHA_CTX_0_ADDR A:0xfdc0839c
y.create.l HWIO_MMSS_OXILI_RB_CLEAR_COLOR_DW0_CTX_0_ADDR A:0xfdc083a0
y.create.l HWIO_MMSS_OXILI_RB_CLEAR_COLOR_DW1_CTX_0_ADDR A:0xfdc083a4
y.create.l HWIO_MMSS_OXILI_RB_CLEAR_COLOR_DW2_CTX_0_ADDR A:0xfdc083a8
y.create.l HWIO_MMSS_OXILI_RB_CLEAR_COLOR_DW3_CTX_0_ADDR A:0xfdc083ac
y.create.l HWIO_MMSS_OXILI_RB_COPY_CONTROL_CTX_0_ADDR A:0xfdc083b0
y.create.l HWIO_MMSS_OXILI_RB_COPY_DEST_BASE_CTX_0_ADDR A:0xfdc083b4
y.create.l HWIO_MMSS_OXILI_RB_COPY_DEST_PITCH_CTX_0_ADDR A:0xfdc083b8
y.create.l HWIO_MMSS_OXILI_RB_COPY_DEST_INFO_CTX_0_ADDR A:0xfdc083bc
y.create.l HWIO_MMSS_OXILI_RB_DEPTH_CONTROL_CTX_0_ADDR A:0xfdc08400
y.create.l HWIO_MMSS_OXILI_RB_DEPTH_CLEAR_CTX_0_ADDR A:0xfdc08404
y.create.l HWIO_MMSS_OXILI_RB_DEPTH_BUF_INFO_CTX_0_ADDR A:0xfdc08408
y.create.l HWIO_MMSS_OXILI_RB_DEPTH_BUF_PITCH_CTX_0_ADDR A:0xfdc0840c
y.create.l HWIO_MMSS_OXILI_RB_STENCIL_CONTROL_CTX_0_ADDR A:0xfdc08410
y.create.l HWIO_MMSS_OXILI_RB_STENCIL_CLEAR_CTX_0_ADDR A:0xfdc08414
y.create.l HWIO_MMSS_OXILI_RB_STENCIL_BUF_INFO_CTX_0_ADDR A:0xfdc08418
y.create.l HWIO_MMSS_OXILI_RB_STENCIL_BUF_PITCH_CTX_0_ADDR A:0xfdc0841c
y.create.l HWIO_MMSS_OXILI_RB_STENCIL_REF_MASK_CTX_0_ADDR A:0xfdc08420
y.create.l HWIO_MMSS_OXILI_RB_STENCIL_REF_MASK_BF_CTX_0_ADDR A:0xfdc08424
y.create.l HWIO_MMSS_OXILI_RB_LRZ_VSC_CONTROL_CTX_0_ADDR A:0xfdc08430
y.create.l HWIO_MMSS_OXILI_RB_WINDOW_OFFSET_CTX_0_ADDR A:0xfdc08438
y.create.l HWIO_MMSS_OXILI_RB_SAMPLE_COUNT_CONTROL_CTX_0_ADDR A:0xfdc08440
y.create.l HWIO_MMSS_OXILI_RB_SAMPLE_COUNT_ADDR_CTX_0_ADDR A:0xfdc08444
y.create.l HWIO_MMSS_OXILI_RB_Z_CLAMP_MIN_CTX_0_ADDR A:0xfdc08450
y.create.l HWIO_MMSS_OXILI_RB_Z_CLAMP_MAX_CTX_0_ADDR A:0xfdc08454
y.create.l HWIO_MMSS_OXILI_RB_MODE_CONTROL_CTX_1_ADDR A:0xfdc09300
y.create.l HWIO_MMSS_OXILI_RB_RENDER_CONTROL_CTX_1_ADDR A:0xfdc09304
y.create.l HWIO_MMSS_OXILI_RB_MSAA_CONTROL_CTX_1_ADDR A:0xfdc09308
y.create.l HWIO_MMSS_OXILI_RB_ALPHA_REFERENCE_CTX_1_ADDR A:0xfdc0930c
y.create.l HWIO_MMSS_OXILI_RB_MRT_CONTROL0_CTX_1_ADDR A:0xfdc09310
y.create.l HWIO_MMSS_OXILI_RB_MRT_CONTROL1_CTX_1_ADDR A:0xfdc09320
y.create.l HWIO_MMSS_OXILI_RB_MRT_CONTROL2_CTX_1_ADDR A:0xfdc09330
y.create.l HWIO_MMSS_OXILI_RB_MRT_CONTROL3_CTX_1_ADDR A:0xfdc09340
y.create.l HWIO_MMSS_OXILI_RB_MRT_BUF_INFO0_CTX_1_ADDR A:0xfdc09314
y.create.l HWIO_MMSS_OXILI_RB_MRT_BUF_INFO1_CTX_1_ADDR A:0xfdc09324
y.create.l HWIO_MMSS_OXILI_RB_MRT_BUF_INFO2_CTX_1_ADDR A:0xfdc09334
y.create.l HWIO_MMSS_OXILI_RB_MRT_BUF_INFO3_CTX_1_ADDR A:0xfdc09344
y.create.l HWIO_MMSS_OXILI_RB_MRT_BUF_BASE0_CTX_1_ADDR A:0xfdc09318
y.create.l HWIO_MMSS_OXILI_RB_MRT_BUF_BASE1_CTX_1_ADDR A:0xfdc09328
y.create.l HWIO_MMSS_OXILI_RB_MRT_BUF_BASE2_CTX_1_ADDR A:0xfdc09338
y.create.l HWIO_MMSS_OXILI_RB_MRT_BUF_BASE3_CTX_1_ADDR A:0xfdc09348
y.create.l HWIO_MMSS_OXILI_RB_MRT_BLEND_CONTROL0_CTX_1_ADDR A:0xfdc0931c
y.create.l HWIO_MMSS_OXILI_RB_MRT_BLEND_CONTROL1_CTX_1_ADDR A:0xfdc0932c
y.create.l HWIO_MMSS_OXILI_RB_MRT_BLEND_CONTROL2_CTX_1_ADDR A:0xfdc0933c
y.create.l HWIO_MMSS_OXILI_RB_MRT_BLEND_CONTROL3_CTX_1_ADDR A:0xfdc0934c
y.create.l HWIO_MMSS_OXILI_RB_BLEND_RED_CTX_1_ADDR A:0xfdc09390
y.create.l HWIO_MMSS_OXILI_RB_BLEND_GREEN_CTX_1_ADDR A:0xfdc09394
y.create.l HWIO_MMSS_OXILI_RB_BLEND_BLUE_CTX_1_ADDR A:0xfdc09398
y.create.l HWIO_MMSS_OXILI_RB_BLEND_ALPHA_CTX_1_ADDR A:0xfdc0939c
y.create.l HWIO_MMSS_OXILI_RB_CLEAR_COLOR_DW0_CTX_1_ADDR A:0xfdc093a0
y.create.l HWIO_MMSS_OXILI_RB_CLEAR_COLOR_DW1_CTX_1_ADDR A:0xfdc093a4
y.create.l HWIO_MMSS_OXILI_RB_CLEAR_COLOR_DW2_CTX_1_ADDR A:0xfdc093a8
y.create.l HWIO_MMSS_OXILI_RB_CLEAR_COLOR_DW3_CTX_1_ADDR A:0xfdc093ac
y.create.l HWIO_MMSS_OXILI_RB_COPY_CONTROL_CTX_1_ADDR A:0xfdc093b0
y.create.l HWIO_MMSS_OXILI_RB_COPY_DEST_BASE_CTX_1_ADDR A:0xfdc093b4
y.create.l HWIO_MMSS_OXILI_RB_COPY_DEST_PITCH_CTX_1_ADDR A:0xfdc093b8
y.create.l HWIO_MMSS_OXILI_RB_COPY_DEST_INFO_CTX_1_ADDR A:0xfdc093bc
y.create.l HWIO_MMSS_OXILI_RB_DEPTH_CONTROL_CTX_1_ADDR A:0xfdc09400
y.create.l HWIO_MMSS_OXILI_RB_DEPTH_CLEAR_CTX_1_ADDR A:0xfdc09404
y.create.l HWIO_MMSS_OXILI_RB_DEPTH_BUF_INFO_CTX_1_ADDR A:0xfdc09408
y.create.l HWIO_MMSS_OXILI_RB_DEPTH_BUF_PITCH_CTX_1_ADDR A:0xfdc0940c
y.create.l HWIO_MMSS_OXILI_RB_STENCIL_CONTROL_CTX_1_ADDR A:0xfdc09410
y.create.l HWIO_MMSS_OXILI_RB_STENCIL_CLEAR_CTX_1_ADDR A:0xfdc09414
y.create.l HWIO_MMSS_OXILI_RB_STENCIL_BUF_INFO_CTX_1_ADDR A:0xfdc09418
y.create.l HWIO_MMSS_OXILI_RB_STENCIL_BUF_PITCH_CTX_1_ADDR A:0xfdc0941c
y.create.l HWIO_MMSS_OXILI_RB_STENCIL_REF_MASK_CTX_1_ADDR A:0xfdc09420
y.create.l HWIO_MMSS_OXILI_RB_STENCIL_REF_MASK_BF_CTX_1_ADDR A:0xfdc09424
y.create.l HWIO_MMSS_OXILI_RB_LRZ_VSC_CONTROL_CTX_1_ADDR A:0xfdc09430
y.create.l HWIO_MMSS_OXILI_RB_WINDOW_OFFSET_CTX_1_ADDR A:0xfdc09438
y.create.l HWIO_MMSS_OXILI_RB_SAMPLE_COUNT_CONTROL_CTX_1_ADDR A:0xfdc09440
y.create.l HWIO_MMSS_OXILI_RB_SAMPLE_COUNT_ADDR_CTX_1_ADDR A:0xfdc09444
y.create.l HWIO_MMSS_OXILI_RB_Z_CLAMP_MIN_CTX_1_ADDR A:0xfdc09450
y.create.l HWIO_MMSS_OXILI_RB_Z_CLAMP_MAX_CTX_1_ADDR A:0xfdc09454
y.create.l HWIO_MMSS_OXILI_VSC_BIN_SIZE_ADDR A:0xfdc03004
y.create.l HWIO_MMSS_OXILI_VSC_PIPE_CONFIG_0_ADDR A:0xfdc03018
y.create.l HWIO_MMSS_OXILI_VSC_PIPE_CONFIG_1_ADDR A:0xfdc03024
y.create.l HWIO_MMSS_OXILI_VSC_PIPE_CONFIG_2_ADDR A:0xfdc03030
y.create.l HWIO_MMSS_OXILI_VSC_PIPE_CONFIG_3_ADDR A:0xfdc0303c
y.create.l HWIO_MMSS_OXILI_VSC_PIPE_CONFIG_4_ADDR A:0xfdc03048
y.create.l HWIO_MMSS_OXILI_VSC_PIPE_CONFIG_5_ADDR A:0xfdc03054
y.create.l HWIO_MMSS_OXILI_VSC_PIPE_CONFIG_6_ADDR A:0xfdc03060
y.create.l HWIO_MMSS_OXILI_VSC_PIPE_CONFIG_7_ADDR A:0xfdc0306c
y.create.l HWIO_MMSS_OXILI_VSC_PIPE_DATA_ADDRESS_0_ADDR A:0xfdc0301c
y.create.l HWIO_MMSS_OXILI_VSC_PIPE_DATA_ADDRESS_1_ADDR A:0xfdc03028
y.create.l HWIO_MMSS_OXILI_VSC_PIPE_DATA_ADDRESS_2_ADDR A:0xfdc03034
y.create.l HWIO_MMSS_OXILI_VSC_PIPE_DATA_ADDRESS_3_ADDR A:0xfdc03040
y.create.l HWIO_MMSS_OXILI_VSC_PIPE_DATA_ADDRESS_4_ADDR A:0xfdc0304c
y.create.l HWIO_MMSS_OXILI_VSC_PIPE_DATA_ADDRESS_5_ADDR A:0xfdc03058
y.create.l HWIO_MMSS_OXILI_VSC_PIPE_DATA_ADDRESS_6_ADDR A:0xfdc03064
y.create.l HWIO_MMSS_OXILI_VSC_PIPE_DATA_ADDRESS_7_ADDR A:0xfdc03070
y.create.l HWIO_MMSS_OXILI_VSC_PIPE_DATA_LENGTH_0_ADDR A:0xfdc03020
y.create.l HWIO_MMSS_OXILI_VSC_PIPE_DATA_LENGTH_1_ADDR A:0xfdc0302c
y.create.l HWIO_MMSS_OXILI_VSC_PIPE_DATA_LENGTH_2_ADDR A:0xfdc03038
y.create.l HWIO_MMSS_OXILI_VSC_PIPE_DATA_LENGTH_3_ADDR A:0xfdc03044
y.create.l HWIO_MMSS_OXILI_VSC_PIPE_DATA_LENGTH_4_ADDR A:0xfdc03050
y.create.l HWIO_MMSS_OXILI_VSC_PIPE_DATA_LENGTH_5_ADDR A:0xfdc0305c
y.create.l HWIO_MMSS_OXILI_VSC_PIPE_DATA_LENGTH_6_ADDR A:0xfdc03068
y.create.l HWIO_MMSS_OXILI_VSC_PIPE_DATA_LENGTH_7_ADDR A:0xfdc03074
y.create.l HWIO_MMSS_OXILI_VSC_SIZE_ADDRESS_ADDR A:0xfdc03008
y.create.l HWIO_MMSS_OXILI_VSC_VSC_DEBUG_CONTROL_CTX_0_ADDR A:0xfdc03460
y.create.l HWIO_MMSS_OXILI_VBIF_VERSION_ADDR A:0xfdc0c000
y.create.l HWIO_MMSS_OXILI_VBIF_FIXED_SORT_EN_ADDR A:0xfdc0c030
y.create.l HWIO_MMSS_OXILI_VBIF_FIXED_SORT_SEL0_ADDR A:0xfdc0c034
y.create.l HWIO_MMSS_OXILI_VBIF_FIXED_SORT_SEL1_ADDR A:0xfdc0c038
y.create.l HWIO_MMSS_OXILI_VBIF_ARANGE1_SORT_ADDR A:0xfdc0c03c
y.create.l HWIO_MMSS_OXILI_VBIF_ARANGE1_BASE_L_ADDR A:0xfdc0c040
y.create.l HWIO_MMSS_OXILI_VBIF_ARANGE1_BASE_H_ADDR A:0xfdc0c044
y.create.l HWIO_MMSS_OXILI_VBIF_ARANGE1_HIGH_L_ADDR A:0xfdc0c048
y.create.l HWIO_MMSS_OXILI_VBIF_ARANGE1_HIGH_H_ADDR A:0xfdc0c04c
y.create.l HWIO_MMSS_OXILI_VBIF_ARANGE2_SORT_ADDR A:0xfdc0c050
y.create.l HWIO_MMSS_OXILI_VBIF_ARANGE2_BASE_L_ADDR A:0xfdc0c060
y.create.l HWIO_MMSS_OXILI_VBIF_ARANGE2_BASE_H_ADDR A:0xfdc0c064
y.create.l HWIO_MMSS_OXILI_VBIF_ARANGE2_HIGH_L_ADDR A:0xfdc0c068
y.create.l HWIO_MMSS_OXILI_VBIF_ARANGE2_HIGH_H_ADDR A:0xfdc0c06c
y.create.l HWIO_MMSS_OXILI_VBIF_ABIT_SORT_ADDR A:0xfdc0c070
y.create.l HWIO_MMSS_OXILI_VBIF_ABIT_SORT_CONF_ADDR A:0xfdc0c074
y.create.l HWIO_MMSS_OXILI_VBIF_VA_ARANGE1_SORT_ADDR A:0xfdc0c080
y.create.l HWIO_MMSS_OXILI_VBIF_VA_ARANGE1_BASE_ADDR A:0xfdc0c084
y.create.l HWIO_MMSS_OXILI_VBIF_VA_ARANGE1_HIGH_ADDR A:0xfdc0c088
y.create.l HWIO_MMSS_OXILI_VBIF_VA_ARANGE2_SORT_ADDR A:0xfdc0c090
y.create.l HWIO_MMSS_OXILI_VBIF_VA_ARANGE2_BASE_ADDR A:0xfdc0c094
y.create.l HWIO_MMSS_OXILI_VBIF_VA_ARANGE2_HIGH_ADDR A:0xfdc0c098
y.create.l HWIO_MMSS_OXILI_VBIF_VA_ABIT_SORT_ADDR A:0xfdc0c0a0
y.create.l HWIO_MMSS_OXILI_VBIF_VA_ABIT_SORT_CONF_ADDR A:0xfdc0c0a4
y.create.l HWIO_MMSS_OXILI_VBIF_GATE_OFF_WRREQ_EN_ADDR A:0xfdc0c0a8
y.create.l HWIO_MMSS_OXILI_VBIF_IN_RD_LIM_CONF0_ADDR A:0xfdc0c0b0
y.create.l HWIO_MMSS_OXILI_VBIF_IN_RD_LIM_CONF1_ADDR A:0xfdc0c0b4
y.create.l HWIO_MMSS_OXILI_VBIF_IN_WR_LIM_CONF0_ADDR A:0xfdc0c0c0
y.create.l HWIO_MMSS_OXILI_VBIF_IN_WR_LIM_CONF1_ADDR A:0xfdc0c0c4
y.create.l HWIO_MMSS_OXILI_VBIF_OUT_RD_LIM_CONF0_ADDR A:0xfdc0c0d0
y.create.l HWIO_MMSS_OXILI_VBIF_OUT_WR_LIM_CONF0_ADDR A:0xfdc0c0d4
y.create.l HWIO_MMSS_OXILI_VBIF_DDR_OUT_MAX_BURST_ADDR A:0xfdc0c0d8
y.create.l HWIO_MMSS_OXILI_VBIF_ISO_SYNC_ADDR A:0xfdc0c0e0
y.create.l HWIO_MMSS_OXILI_VBIF_ARB_CTL_ADDR A:0xfdc0c0f0
y.create.l HWIO_MMSS_OXILI_VBIF_DDR_ARB_CONF0_ADDR A:0xfdc0c0f4
y.create.l HWIO_MMSS_OXILI_VBIF_FIXED_ARB_CONF0_ADDR A:0xfdc0c100
y.create.l HWIO_MMSS_OXILI_VBIF_OUT_AXI_AMEMTYPE_CONF0_ADDR A:0xfdc0c160
y.create.l HWIO_MMSS_OXILI_VBIF_OUT_AXI_APROTNS_ADDR A:0xfdc0c168
y.create.l HWIO_MMSS_OXILI_VBIF_OUT_AXI_AINST_ADDR A:0xfdc0c16c
y.create.l HWIO_MMSS_OXILI_VBIF_OUT_AXI_ASHARED_ADDR A:0xfdc0c170
y.create.l HWIO_MMSS_OXILI_VBIF_OUT_AXI_AINNERSHARED_ADDR A:0xfdc0c174
y.create.l HWIO_MMSS_OXILI_VBIF_OUT_AXI_AOOO_EN_ADDR A:0xfdc0c178
y.create.l HWIO_MMSS_OXILI_VBIF_OUT_AXI_AOOO_ADDR A:0xfdc0c17c
y.create.l HWIO_MMSS_OXILI_VBIF_OUT_AXI_ANOALLOCATE_ADDR A:0xfdc0c180
y.create.l HWIO_MMSS_OXILI_VBIF_WD_TIMEOUT_ADDR A:0xfdc0c184
y.create.l HWIO_MMSS_OXILI_VBIF_PND_ERR_ADDR A:0xfdc0c190
y.create.l HWIO_MMSS_OXILI_VBIF_SRC_ERR_ADDR A:0xfdc0c194
y.create.l HWIO_MMSS_OXILI_VBIF_ERR_MASK_ADDR A:0xfdc0c198
y.create.l HWIO_MMSS_OXILI_VBIF_ERR_CLR_ADDR A:0xfdc0c19c
y.create.l HWIO_MMSS_OXILI_VBIF_ERR_INFO_ADDR A:0xfdc0c1a0
y.create.l HWIO_MMSS_OXILI_VBIF_AXI_TEST_CTL_ADDR A:0xfdc0c1b0
y.create.l HWIO_MMSS_OXILI_VBIF_AXI_TEST_OUT_ADDR A:0xfdc0c1b4
y.create.l HWIO_MMSS_OXILI_VBIF_PERF_CNT_EN_ADDR A:0xfdc0c1c0
y.create.l HWIO_MMSS_OXILI_VBIF_PERF_CNT_CLR_ADDR A:0xfdc0c1c4
y.create.l HWIO_MMSS_OXILI_VBIF_PERF_CNT_SEL_ADDR A:0xfdc0c1c8
y.create.l HWIO_MMSS_OXILI_VBIF_PERF_CNT0_L_ADDR A:0xfdc0c1cc
y.create.l HWIO_MMSS_OXILI_VBIF_PERF_CNT0_H_ADDR A:0xfdc0c1d0
y.create.l HWIO_MMSS_OXILI_VBIF_PERF_CNT1_L_ADDR A:0xfdc0c1d4
y.create.l HWIO_MMSS_OXILI_VBIF_PERF_CNT1_H_ADDR A:0xfdc0c1d8
y.create.l HWIO_MMSS_OXILI_VBIF_PERF_PWR_CNT0_L_ADDR A:0xfdc0c1dc
y.create.l HWIO_MMSS_OXILI_VBIF_PERF_PWR_CNT0_H_ADDR A:0xfdc0c1e0
y.create.l HWIO_MMSS_OXILI_VBIF_PERF_PWR_CNT1_L_ADDR A:0xfdc0c1e4
y.create.l HWIO_MMSS_OXILI_VBIF_PERF_PWR_CNT1_H_ADDR A:0xfdc0c1e8
y.create.l HWIO_MMSS_OXILI_VBIF_PERF_PWR_CNT2_L_ADDR A:0xfdc0c1ec
y.create.l HWIO_MMSS_OXILI_VBIF_PERF_PWR_CNT2_H_ADDR A:0xfdc0c1f0
y.create.l HWIO_MMSS_A_VFE_VFE_HW_VERSION_ADDR A:0xfde00000
y.create.l HWIO_MMSS_A_VFE_VFE_GLOBAL_RESET_CMD_ADDR A:0xfde00004
y.create.l HWIO_MMSS_A_VFE_VFE_MODULE_RESET_ADDR A:0xfde00008
y.create.l HWIO_MMSS_A_VFE_VFE_CGC_OVERRIDE_ADDR A:0xfde0000c
y.create.l HWIO_MMSS_A_VFE_VFE_CGC_OVERRIDE_1_ADDR A:0xfde007b8
y.create.l HWIO_MMSS_A_VFE_VFE_MODULE_CFG_ADDR A:0xfde00010
y.create.l HWIO_MMSS_A_VFE_VFE_CFG_ADDR A:0xfde00014
y.create.l HWIO_MMSS_A_VFE_VFE_3D_CFG_ADDR A:0xfde00738
y.create.l HWIO_MMSS_A_VFE_VFE_3D_POST_SCALE_CFG_ADDR A:0xfde0073c
y.create.l HWIO_MMSS_A_VFE_VFE_IRQ_CMD_ADDR A:0xfde00018
y.create.l HWIO_MMSS_A_VFE_VFE_IRQ_MASK_0_ADDR A:0xfde0001c
y.create.l HWIO_MMSS_A_VFE_VFE_IRQ_MASK_1_ADDR A:0xfde00020
y.create.l HWIO_MMSS_A_VFE_VFE_IRQ_CLEAR_0_ADDR A:0xfde00024
y.create.l HWIO_MMSS_A_VFE_VFE_IRQ_CLEAR_1_ADDR A:0xfde00028
y.create.l HWIO_MMSS_A_VFE_VFE_IRQ_STATUS_0_ADDR A:0xfde0002c
y.create.l HWIO_MMSS_A_VFE_VFE_IRQ_STATUS_1_ADDR A:0xfde00030
y.create.l HWIO_MMSS_A_VFE_VFE_IRQ_COMPOSITE_MASK_ADDR A:0xfde00034
y.create.l HWIO_MMSS_A_VFE_VFE_VIOLATION_STATUS_ADDR A:0xfde007b4
y.create.l HWIO_MMSS_A_VFE_VFE_BUS_CMD_ADDR A:0xfde00038
y.create.l HWIO_MMSS_A_VFE_VFE_BUS_CFG_ADDR A:0xfde0003c
y.create.l HWIO_MMSS_A_VFE_VFE_BUS_IO_FORMAT_CFG_ADDR A:0xfde006f8
y.create.l HWIO_MMSS_A_VFE_VFE_BUS_XBAR_CFG_0_ADDR A:0xfde00040
y.create.l HWIO_MMSS_A_VFE_VFE_BUS_XBAR_CFG_1_ADDR A:0xfde00044
y.create.l HWIO_MMSS_A_VFE_VFE_BUS_WR_SKIP_CFG_ADDR A:0xfde00048
y.create.l HWIO_MMSS_A_VFE_VFE_BUS_IMAGE_MASTER_0_WR_CFG_ADDR A:0xfde0004c
y.create.l HWIO_MMSS_A_VFE_VFE_BUS_IMAGE_MASTER_0_WR_PING_ADDR_ADDR A:0xfde00050
y.create.l HWIO_MMSS_A_VFE_VFE_BUS_IMAGE_MASTER_0_WR_PONG_ADDR_ADDR A:0xfde00054
y.create.l HWIO_MMSS_A_VFE_VFE_BUS_IMAGE_MASTER_0_WR_UB_CFG_ADDR A:0xfde00058
y.create.l HWIO_MMSS_A_VFE_VFE_BUS_IMAGE_MASTER_0_WR_IMAGE_SIZE_ADDR A:0xfde0005c
y.create.l HWIO_MMSS_A_VFE_VFE_BUS_IMAGE_MASTER_0_WR_BUFFER_CFG_ADDR A:0xfde00060
y.create.l HWIO_MMSS_A_VFE_VFE_BUS_IMAGE_MASTER_1_WR_CFG_ADDR A:0xfde00064
y.create.l HWIO_MMSS_A_VFE_VFE_BUS_IMAGE_MASTER_1_WR_PING_ADDR_ADDR A:0xfde00068
y.create.l HWIO_MMSS_A_VFE_VFE_BUS_IMAGE_MASTER_1_WR_PONG_ADDR_ADDR A:0xfde0006c
y.create.l HWIO_MMSS_A_VFE_VFE_BUS_IMAGE_MASTER_1_WR_UB_CFG_ADDR A:0xfde00070
y.create.l HWIO_MMSS_A_VFE_VFE_BUS_IMAGE_MASTER_1_WR_IMAGE_SIZE_ADDR A:0xfde00074
y.create.l HWIO_MMSS_A_VFE_VFE_BUS_IMAGE_MASTER_1_WR_BUFFER_CFG_ADDR A:0xfde00078
y.create.l HWIO_MMSS_A_VFE_VFE_BUS_IMAGE_MASTER_2_WR_CFG_ADDR A:0xfde0007c
y.create.l HWIO_MMSS_A_VFE_VFE_BUS_IMAGE_MASTER_2_WR_PING_ADDR_ADDR A:0xfde00080
y.create.l HWIO_MMSS_A_VFE_VFE_BUS_IMAGE_MASTER_2_WR_PONG_ADDR_ADDR A:0xfde00084
y.create.l HWIO_MMSS_A_VFE_VFE_BUS_IMAGE_MASTER_2_WR_UB_CFG_ADDR A:0xfde00088
y.create.l HWIO_MMSS_A_VFE_VFE_BUS_IMAGE_MASTER_2_WR_IMAGE_SIZE_ADDR A:0xfde0008c
y.create.l HWIO_MMSS_A_VFE_VFE_BUS_IMAGE_MASTER_2_WR_BUFFER_CFG_ADDR A:0xfde00090
y.create.l HWIO_MMSS_A_VFE_VFE_BUS_IMAGE_MASTER_3_WR_CFG_ADDR A:0xfde00094
y.create.l HWIO_MMSS_A_VFE_VFE_BUS_IMAGE_MASTER_3_WR_PING_ADDR_ADDR A:0xfde00098
y.create.l HWIO_MMSS_A_VFE_VFE_BUS_IMAGE_MASTER_3_WR_PONG_ADDR_ADDR A:0xfde0009c
y.create.l HWIO_MMSS_A_VFE_VFE_BUS_IMAGE_MASTER_3_WR_UB_CFG_ADDR A:0xfde000a0
y.create.l HWIO_MMSS_A_VFE_VFE_BUS_IMAGE_MASTER_3_WR_IMAGE_SIZE_ADDR A:0xfde000a4
y.create.l HWIO_MMSS_A_VFE_VFE_BUS_IMAGE_MASTER_3_WR_BUFFER_CFG_ADDR A:0xfde000a8
y.create.l HWIO_MMSS_A_VFE_VFE_BUS_IMAGE_MASTER_4_WR_CFG_ADDR A:0xfde000ac
y.create.l HWIO_MMSS_A_VFE_VFE_BUS_IMAGE_MASTER_4_WR_PING_ADDR_ADDR A:0xfde000b0
y.create.l HWIO_MMSS_A_VFE_VFE_BUS_IMAGE_MASTER_4_WR_PONG_ADDR_ADDR A:0xfde000b4
y.create.l HWIO_MMSS_A_VFE_VFE_BUS_IMAGE_MASTER_4_WR_UB_CFG_ADDR A:0xfde000b8
y.create.l HWIO_MMSS_A_VFE_VFE_BUS_IMAGE_MASTER_4_WR_IMAGE_SIZE_ADDR A:0xfde000bc
y.create.l HWIO_MMSS_A_VFE_VFE_BUS_IMAGE_MASTER_4_WR_BUFFER_CFG_ADDR A:0xfde000c0
y.create.l HWIO_MMSS_A_VFE_VFE_BUS_IMAGE_MASTER_5_WR_CFG_ADDR A:0xfde000c4
y.create.l HWIO_MMSS_A_VFE_VFE_BUS_IMAGE_MASTER_5_WR_PING_ADDR_ADDR A:0xfde000c8
y.create.l HWIO_MMSS_A_VFE_VFE_BUS_IMAGE_MASTER_5_WR_PONG_ADDR_ADDR A:0xfde000cc
y.create.l HWIO_MMSS_A_VFE_VFE_BUS_IMAGE_MASTER_5_WR_UB_CFG_ADDR A:0xfde000d0
y.create.l HWIO_MMSS_A_VFE_VFE_BUS_IMAGE_MASTER_5_WR_IMAGE_SIZE_ADDR A:0xfde000d4
y.create.l HWIO_MMSS_A_VFE_VFE_BUS_IMAGE_MASTER_5_WR_BUFFER_CFG_ADDR A:0xfde000d8
y.create.l HWIO_MMSS_A_VFE_VFE_BUS_IMAGE_MASTER_6_WR_CFG_ADDR A:0xfde000dc
y.create.l HWIO_MMSS_A_VFE_VFE_BUS_IMAGE_MASTER_6_WR_PING_ADDR_ADDR A:0xfde000e0
y.create.l HWIO_MMSS_A_VFE_VFE_BUS_IMAGE_MASTER_6_WR_PONG_ADDR_ADDR A:0xfde000e4
y.create.l HWIO_MMSS_A_VFE_VFE_BUS_IMAGE_MASTER_6_WR_UB_CFG_ADDR A:0xfde000e8
y.create.l HWIO_MMSS_A_VFE_VFE_BUS_IMAGE_MASTER_6_WR_IMAGE_SIZE_ADDR A:0xfde000ec
y.create.l HWIO_MMSS_A_VFE_VFE_BUS_IMAGE_MASTER_6_WR_BUFFER_CFG_ADDR A:0xfde000f0
y.create.l HWIO_MMSS_A_VFE_VFE_BUS_STATS_AE_BG_WR_PING_ADDR_ADDR A:0xfde000f4
y.create.l HWIO_MMSS_A_VFE_VFE_BUS_STATS_AE_BG_WR_PONG_ADDR_ADDR A:0xfde000f8
y.create.l HWIO_MMSS_A_VFE_VFE_BUS_STATS_AE_BG_WR_UB_CFG_ADDR A:0xfde000fc
y.create.l HWIO_MMSS_A_VFE_VFE_BUS_STATS_AF_BF_WR_PING_ADDR_ADDR A:0xfde00100
y.create.l HWIO_MMSS_A_VFE_VFE_BUS_STATS_AF_BF_WR_PONG_ADDR_ADDR A:0xfde00104
y.create.l HWIO_MMSS_A_VFE_VFE_BUS_STATS_AF_BF_WR_UB_CFG_ADDR A:0xfde00108
y.create.l HWIO_MMSS_A_VFE_VFE_BUS_STATS_AWB_WR_PING_ADDR_ADDR A:0xfde0010c
y.create.l HWIO_MMSS_A_VFE_VFE_BUS_STATS_AWB_WR_PONG_ADDR_ADDR A:0xfde00110
y.create.l HWIO_MMSS_A_VFE_VFE_BUS_STATS_AWB_WR_UB_CFG_ADDR A:0xfde00114
y.create.l HWIO_MMSS_A_VFE_VFE_BUS_STATS_RS_WR_PING_ADDR_ADDR A:0xfde00118
y.create.l HWIO_MMSS_A_VFE_VFE_BUS_STATS_RS_WR_PONG_ADDR_ADDR A:0xfde0011c
y.create.l HWIO_MMSS_A_VFE_VFE_BUS_STATS_RS_WR_UB_CFG_ADDR A:0xfde00120
y.create.l HWIO_MMSS_A_VFE_VFE_BUS_STATS_CS_WR_PING_ADDR_ADDR A:0xfde00124
y.create.l HWIO_MMSS_A_VFE_VFE_BUS_STATS_CS_WR_PONG_ADDR_ADDR A:0xfde00128
y.create.l HWIO_MMSS_A_VFE_VFE_BUS_STATS_CS_WR_UB_CFG_ADDR A:0xfde0012c
y.create.l HWIO_MMSS_A_VFE_VFE_BUS_STATS_IHIST_WR_PING_ADDR_ADDR A:0xfde00130
y.create.l HWIO_MMSS_A_VFE_VFE_BUS_STATS_IHIST_WR_PONG_ADDR_ADDR A:0xfde00134
y.create.l HWIO_MMSS_A_VFE_VFE_BUS_STATS_IHIST_WR_UB_CFG_ADDR A:0xfde00138
y.create.l HWIO_MMSS_A_VFE_VFE_BUS_STATS_SKIN_BHIST_WR_PING_ADDR_ADDR A:0xfde0013c
y.create.l HWIO_MMSS_A_VFE_VFE_BUS_STATS_SKIN_BHIST_WR_PONG_ADDR_ADDR A:0xfde00140
y.create.l HWIO_MMSS_A_VFE_VFE_BUS_STATS_SKIN_BHIST_WR_UB_CFG_ADDR A:0xfde00144
y.create.l HWIO_MMSS_A_VFE_VFE_BUS_STRIPE_RD_ADDR_0_ADDR A:0xfde00148
y.create.l HWIO_MMSS_A_VFE_VFE_BUS_STRIPE_RD_ADDR_1_ADDR A:0xfde0014c
y.create.l HWIO_MMSS_A_VFE_VFE_BUS_STRIPE_RD_ADDR_2_ADDR A:0xfde00150
y.create.l HWIO_MMSS_A_VFE_VFE_BUS_STRIPE_RD_ADDR_3_ADDR A:0xfde00154
y.create.l HWIO_MMSS_A_VFE_VFE_BUS_STRIPE_RD_VSIZE_ADDR A:0xfde00158
y.create.l HWIO_MMSS_A_VFE_VFE_BUS_STRIPE_RD_HSIZE_ADDR A:0xfde0015c
y.create.l HWIO_MMSS_A_VFE_VFE_BUS_STRIPE_RD_BUFFER_CFG_ADDR A:0xfde00160
y.create.l HWIO_MMSS_A_VFE_VFE_BUS_STRIPE_RD_UNPACK_CFG_ADDR A:0xfde00164
y.create.l HWIO_MMSS_A_VFE_VFE_BUS_STRIPE_RD_UNPACK_ADDR A:0xfde00168
y.create.l HWIO_MMSS_A_VFE_VFE_BUS_STRIPE_RD_PAD_SIZE_ADDR A:0xfde0016c
y.create.l HWIO_MMSS_A_VFE_VFE_BUS_STRIPE_RD_PAD_L_UNPACK_ADDR A:0xfde00170
y.create.l HWIO_MMSS_A_VFE_VFE_BUS_STRIPE_RD_PAD_R_UNPACK_ADDR A:0xfde00174
y.create.l HWIO_MMSS_A_VFE_VFE_BUS_STRIPE_RD_PAD_TB_UNPACK_ADDR A:0xfde00178
y.create.l HWIO_MMSS_A_VFE_VFE_BUS_STRIPE_RD_CROP_WIDTH_CFG_ADDR A:0xfde0072c
y.create.l HWIO_MMSS_A_VFE_VFE_BUS_STRIPE_RD_CROP_HEIGHT_CFG_ADDR A:0xfde00730
y.create.l HWIO_MMSS_A_VFE_VFE_BUS_PING_PONG_IRQ_EN_ADDR A:0xfde0017c
y.create.l HWIO_MMSS_A_VFE_VFE_BUS_PING_PONG_STATUS_ADDR A:0xfde00180
y.create.l HWIO_MMSS_A_VFE_VFE_BUS_OPERATION_STATUS_ADDR A:0xfde00184
y.create.l HWIO_MMSS_A_VFE_VFE_BUS_PM_CMD_ADDR A:0xfde00188
y.create.l HWIO_MMSS_A_VFE_VFE_BUS_PM_CFG_ADDR A:0xfde0018c
y.create.l HWIO_MMSS_A_VFE_VFE_BUS_IMAGE_MASTER_0_WR_PM_STATS_0_ADDR A:0xfde00190
y.create.l HWIO_MMSS_A_VFE_VFE_BUS_IMAGE_MASTER_0_WR_PM_STATS_1_ADDR A:0xfde00194
y.create.l HWIO_MMSS_A_VFE_VFE_BUS_IMAGE_MASTER_1_WR_PM_STATS_0_ADDR A:0xfde00198
y.create.l HWIO_MMSS_A_VFE_VFE_BUS_IMAGE_MASTER_1_WR_PM_STATS_1_ADDR A:0xfde0019c
y.create.l HWIO_MMSS_A_VFE_VFE_BUS_IMAGE_MASTER_2_WR_PM_STATS_0_ADDR A:0xfde001a0
y.create.l HWIO_MMSS_A_VFE_VFE_BUS_IMAGE_MASTER_2_WR_PM_STATS_1_ADDR A:0xfde001a4
y.create.l HWIO_MMSS_A_VFE_VFE_BUS_IMAGE_MASTER_3_WR_PM_STATS_0_ADDR A:0xfde001a8
y.create.l HWIO_MMSS_A_VFE_VFE_BUS_IMAGE_MASTER_3_WR_PM_STATS_1_ADDR A:0xfde001ac
y.create.l HWIO_MMSS_A_VFE_VFE_BUS_IMAGE_MASTER_4_WR_PM_STATS_0_ADDR A:0xfde001b0
y.create.l HWIO_MMSS_A_VFE_VFE_BUS_IMAGE_MASTER_4_WR_PM_STATS_1_ADDR A:0xfde001b4
y.create.l HWIO_MMSS_A_VFE_VFE_BUS_IMAGE_MASTER_5_WR_PM_STATS_0_ADDR A:0xfde001b8
y.create.l HWIO_MMSS_A_VFE_VFE_BUS_IMAGE_MASTER_5_WR_PM_STATS_1_ADDR A:0xfde001bc
y.create.l HWIO_MMSS_A_VFE_VFE_BUS_IMAGE_MASTER_6_WR_PM_STATS_0_ADDR A:0xfde001c0
y.create.l HWIO_MMSS_A_VFE_VFE_BUS_IMAGE_MASTER_6_WR_PM_STATS_1_ADDR A:0xfde001c4
y.create.l HWIO_MMSS_A_VFE_VFE_BUS_MISR_CFG_ADDR A:0xfde001c8
y.create.l HWIO_MMSS_A_VFE_VFE_BUS_MISR_MAST_CFG_0_ADDR A:0xfde001cc
y.create.l HWIO_MMSS_A_VFE_VFE_BUS_MISR_MAST_CFG_1_ADDR A:0xfde001d0
y.create.l HWIO_MMSS_A_VFE_VFE_BUS_MISR_RD_VAL_ADDR A:0xfde001d4
y.create.l HWIO_MMSS_A_VFE_VFE_AXI_CMD_ADDR A:0xfde001d8
y.create.l HWIO_MMSS_A_VFE_VFE_AXI_CFG_ADDR A:0xfde00600
y.create.l HWIO_MMSS_A_VFE_VFE_AXI_STATUS_ADDR A:0xfde001dc
y.create.l HWIO_MMSS_A_VFE_VFE_PIXEL_IF_CFG_ADDR A:0xfde006fc
y.create.l HWIO_MMSS_A_VFE_VFE_RDI_CFG_0_ADDR A:0xfde00734
y.create.l HWIO_MMSS_A_VFE_VFE_RDI_CFG_1_ADDR A:0xfde007a4
y.create.l HWIO_MMSS_A_VFE_CAMIF_CMD_ADDR A:0xfde001e0
y.create.l HWIO_MMSS_A_VFE_CAMIF_CFG_ADDR A:0xfde001e4
y.create.l HWIO_MMSS_A_VFE_CAMIF_EFS_CFG_ADDR A:0xfde001e8
y.create.l HWIO_MMSS_A_VFE_CAMIF_FRAME_CFG_ADDR A:0xfde001ec
y.create.l HWIO_MMSS_A_VFE_CAMIF_WINDOW_WIDTH_CFG_ADDR A:0xfde001f0
y.create.l HWIO_MMSS_A_VFE_CAMIF_WINDOW_HEIGHT_CFG_ADDR A:0xfde001f4
y.create.l HWIO_MMSS_A_VFE_CAMIF_SUBSAMPLE_CFG_1_ADDR A:0xfde001f8
y.create.l HWIO_MMSS_A_VFE_CAMIF_SUBSAMPLE_CFG_2_ADDR A:0xfde001fc
y.create.l HWIO_MMSS_A_VFE_CAMIF_EPOCH_IRQ_ADDR A:0xfde00200
y.create.l HWIO_MMSS_A_VFE_CAMIF_STATUS_ADDR A:0xfde00204
y.create.l HWIO_MMSS_A_VFE_CAMIF_MISR_ADDR A:0xfde00208
y.create.l HWIO_MMSS_A_VFE_VFE_SYNC_TIMER_CMD_ADDR A:0xfde0020c
y.create.l HWIO_MMSS_A_VFE_VFE_SYNC_TIMER0_LINE_START_ADDR A:0xfde00210
y.create.l HWIO_MMSS_A_VFE_VFE_SYNC_TIMER0_PIXEL_START_ADDR A:0xfde00214
y.create.l HWIO_MMSS_A_VFE_VFE_SYNC_TIMER0_PIXEL_DURATION_ADDR A:0xfde00218
y.create.l HWIO_MMSS_A_VFE_VFE_SYNC_TIMER1_LINE_START_ADDR A:0xfde0021c
y.create.l HWIO_MMSS_A_VFE_VFE_SYNC_TIMER1_PIXEL_START_ADDR A:0xfde00220
y.create.l HWIO_MMSS_A_VFE_VFE_SYNC_TIMER1_PIXEL_DURATION_ADDR A:0xfde00224
y.create.l HWIO_MMSS_A_VFE_VFE_SYNC_TIMER2_LINE_START_ADDR A:0xfde00228
y.create.l HWIO_MMSS_A_VFE_VFE_SYNC_TIMER2_PIXEL_START_ADDR A:0xfde0022c
y.create.l HWIO_MMSS_A_VFE_VFE_SYNC_TIMER2_PIXEL_DURATION_ADDR A:0xfde00230
y.create.l HWIO_MMSS_A_VFE_VFE_SYNC_TIMER_POLARITY_ADDR A:0xfde00234
y.create.l HWIO_MMSS_A_VFE_VFE_ASYNC_TIMER_CMD_ADDR A:0xfde00238
y.create.l HWIO_MMSS_A_VFE_VFE_ASYNC_TIMER0_CFG_0_ADDR A:0xfde0023c
y.create.l HWIO_MMSS_A_VFE_VFE_ASYNC_TIMER0_CFG_1_ADDR A:0xfde00240
y.create.l HWIO_MMSS_A_VFE_VFE_ASYNC_TIMER1_CFG_0_ADDR A:0xfde00244
y.create.l HWIO_MMSS_A_VFE_VFE_ASYNC_TIMER1_CFG_1_ADDR A:0xfde00248
y.create.l HWIO_MMSS_A_VFE_VFE_ASYNC_TIMER2_CFG_0_ADDR A:0xfde0024c
y.create.l HWIO_MMSS_A_VFE_VFE_ASYNC_TIMER2_CFG_1_ADDR A:0xfde00250
y.create.l HWIO_MMSS_A_VFE_VFE_ASYNC_TIMER3_CFG_0_ADDR A:0xfde00254
y.create.l HWIO_MMSS_A_VFE_VFE_ASYNC_TIMER3_CFG_1_ADDR A:0xfde00258
y.create.l HWIO_MMSS_A_VFE_VFE_TIMER_SEL_ADDR A:0xfde0025c
y.create.l HWIO_MMSS_A_VFE_VFE_REG_UPDATE_CMD_ADDR A:0xfde00260
y.create.l HWIO_MMSS_A_VFE_VFE_BLACK_CFG_ADDR A:0xfde00264
y.create.l HWIO_MMSS_A_VFE_VFE_BLACK_INTERP_R_0_ADDR A:0xfde00268
y.create.l HWIO_MMSS_A_VFE_VFE_BLACK_INTERP_R_1_ADDR A:0xfde0026c
y.create.l HWIO_MMSS_A_VFE_VFE_BLACK_INTERP_R_2_ADDR A:0xfde00270
y.create.l HWIO_MMSS_A_VFE_VFE_BLACK_INTERP_R_3_ADDR A:0xfde0067c
y.create.l HWIO_MMSS_A_VFE_VFE_BLACK_INTERP_GB_0_ADDR A:0xfde00680
y.create.l HWIO_MMSS_A_VFE_VFE_BLACK_INTERP_GB_1_ADDR A:0xfde00684
y.create.l HWIO_MMSS_A_VFE_VFE_BLACK_INTERP_GB_2_ADDR A:0xfde00688
y.create.l HWIO_MMSS_A_VFE_VFE_BLACK_INTERP_GB_3_ADDR A:0xfde0068c
y.create.l HWIO_MMSS_A_VFE_VFE_BLACK_INTERP_B_0_ADDR A:0xfde00690
y.create.l HWIO_MMSS_A_VFE_VFE_BLACK_INTERP_B_1_ADDR A:0xfde00694
y.create.l HWIO_MMSS_A_VFE_VFE_BLACK_INTERP_B_2_ADDR A:0xfde00698
y.create.l HWIO_MMSS_A_VFE_VFE_BLACK_INTERP_B_3_ADDR A:0xfde0069c
y.create.l HWIO_MMSS_A_VFE_VFE_BLACK_INTERP_GR_0_ADDR A:0xfde006a0
y.create.l HWIO_MMSS_A_VFE_VFE_BLACK_INTERP_GR_1_ADDR A:0xfde006a4
y.create.l HWIO_MMSS_A_VFE_VFE_BLACK_INTERP_GR_2_ADDR A:0xfde006a8
y.create.l HWIO_MMSS_A_VFE_VFE_BLACK_INTERP_GR_3_ADDR A:0xfde006ac
y.create.l HWIO_MMSS_A_VFE_VFE_BLACK_RIGHT_INTERP_R_0_ADDR A:0xfde00740
y.create.l HWIO_MMSS_A_VFE_VFE_BLACK_RIGHT_INTERP_R_1_ADDR A:0xfde00744
y.create.l HWIO_MMSS_A_VFE_VFE_BLACK_RIGHT_INTERP_R_2_ADDR A:0xfde00748
y.create.l HWIO_MMSS_A_VFE_VFE_BLACK_RIGHT_INTERP_R_3_ADDR A:0xfde0074c
y.create.l HWIO_MMSS_A_VFE_VFE_BLACK_RIGHT_INTERP_GB_0_ADDR A:0xfde00750
y.create.l HWIO_MMSS_A_VFE_VFE_BLACK_RIGHT_INTERP_GB_1_ADDR A:0xfde00754
y.create.l HWIO_MMSS_A_VFE_VFE_BLACK_RIGHT_INTERP_GB_2_ADDR A:0xfde00758
y.create.l HWIO_MMSS_A_VFE_VFE_BLACK_RIGHT_INTERP_GB_3_ADDR A:0xfde0075c
y.create.l HWIO_MMSS_A_VFE_VFE_BLACK_RIGHT_INTERP_B_0_ADDR A:0xfde00760
y.create.l HWIO_MMSS_A_VFE_VFE_BLACK_RIGHT_INTERP_B_1_ADDR A:0xfde00764
y.create.l HWIO_MMSS_A_VFE_VFE_BLACK_RIGHT_INTERP_B_2_ADDR A:0xfde00768
y.create.l HWIO_MMSS_A_VFE_VFE_BLACK_RIGHT_INTERP_B_3_ADDR A:0xfde0076c
y.create.l HWIO_MMSS_A_VFE_VFE_BLACK_RIGHT_INTERP_GR_0_ADDR A:0xfde00770
y.create.l HWIO_MMSS_A_VFE_VFE_BLACK_RIGHT_INTERP_GR_1_ADDR A:0xfde00774
y.create.l HWIO_MMSS_A_VFE_VFE_BLACK_RIGHT_INTERP_GR_2_ADDR A:0xfde00780
y.create.l HWIO_MMSS_A_VFE_VFE_BLACK_RIGHT_INTERP_GR_3_ADDR A:0xfde0078c
y.create.l HWIO_MMSS_A_VFE_VFE_ROLLOFF_CFG_ADDR A:0xfde00274
y.create.l HWIO_MMSS_A_VFE_VFE_ROLLOFF_GRID_CFG_0_ADDR A:0xfde00278
y.create.l HWIO_MMSS_A_VFE_VFE_ROLLOFF_GRID_CFG_1_ADDR A:0xfde0027c
y.create.l HWIO_MMSS_A_VFE_VFE_ROLLOFF_RIGHT_GRID_CFG_0_ADDR A:0xfde00280
y.create.l HWIO_MMSS_A_VFE_VFE_ROLLOFF_RIGHT_GRID_CFG_1_ADDR A:0xfde007a8
y.create.l HWIO_MMSS_A_VFE_VFE_ROLLOFF_STRIPE_CFG_0_ADDR A:0xfde007ac
y.create.l HWIO_MMSS_A_VFE_VFE_ROLLOFF_STRIPE_CFG_1_ADDR A:0xfde007b0
y.create.l HWIO_MMSS_A_VFE_VFE_DEMUX_CFG_ADDR A:0xfde00284
y.create.l HWIO_MMSS_A_VFE_VFE_DEMUX_GAIN_0_ADDR A:0xfde00288
y.create.l HWIO_MMSS_A_VFE_VFE_DEMUX_GAIN_1_ADDR A:0xfde0028c
y.create.l HWIO_MMSS_A_VFE_VFE_DEMUX_RIGHT_GAIN_0_ADDR A:0xfde00790
y.create.l HWIO_MMSS_A_VFE_VFE_DEMUX_RIGHT_GAIN_1_ADDR A:0xfde0079c
y.create.l HWIO_MMSS_A_VFE_VFE_DEMUX_EVEN_CFG_ADDR A:0xfde00290
y.create.l HWIO_MMSS_A_VFE_VFE_DEMUX_ODD_CFG_ADDR A:0xfde00294
y.create.l HWIO_MMSS_A_VFE_VFE_DEMOSAIC_CFG_ADDR A:0xfde00298
y.create.l HWIO_MMSS_A_VFE_VFE_DEMOSAIC_DBPC_CFG_ADDR A:0xfde0029c
y.create.l HWIO_MMSS_A_VFE_VFE_DEMOSAIC_DBPC_OFFSET_CFG_0_ADDR A:0xfde002a0
y.create.l HWIO_MMSS_A_VFE_VFE_DEMOSAIC_DBPC_OFFSET_CFG_1_ADDR A:0xfde00604
y.create.l HWIO_MMSS_A_VFE_VFE_DEMOSAIC_DBPC_OFFSET_CFG_2_ADDR A:0xfde00608
y.create.l HWIO_MMSS_A_VFE_VFE_DEMOSAIC_DBCC_CFG_ADDR A:0xfde0060c
y.create.l HWIO_MMSS_A_VFE_VFE_DEMOSAIC_DBCC_OFFSET_CFG_0_ADDR A:0xfde00610
y.create.l HWIO_MMSS_A_VFE_VFE_DEMOSAIC_DBCC_OFFSET_CFG_1_ADDR A:0xfde00614
y.create.l HWIO_MMSS_A_VFE_VFE_DEMOSAIC_DBCC_OFFSET_CFG_2_ADDR A:0xfde00618
y.create.l HWIO_MMSS_A_VFE_VFE_DEMOSAIC_ABF_GREEN_CFG_0_ADDR A:0xfde002a4
y.create.l HWIO_MMSS_A_VFE_VFE_DEMOSAIC_ABF_GREEN_CFG_1_ADDR A:0xfde002a8
y.create.l HWIO_MMSS_A_VFE_VFE_DEMOSAIC_ABF_GREEN_CFG_2_ADDR A:0xfde002ac
y.create.l HWIO_MMSS_A_VFE_VFE_DEMOSAIC_ABF_GREEN_POS_LUT_0_ADDR A:0xfde002b0
y.create.l HWIO_MMSS_A_VFE_VFE_DEMOSAIC_ABF_GREEN_POS_LUT_1_ADDR A:0xfde002b4
y.create.l HWIO_MMSS_A_VFE_VFE_DEMOSAIC_ABF_GREEN_POS_LUT_2_ADDR A:0xfde002b8
y.create.l HWIO_MMSS_A_VFE_VFE_DEMOSAIC_ABF_GREEN_POS_LUT_3_ADDR A:0xfde002bc
y.create.l HWIO_MMSS_A_VFE_VFE_DEMOSAIC_ABF_GREEN_POS_LUT_4_ADDR A:0xfde002c0
y.create.l HWIO_MMSS_A_VFE_VFE_DEMOSAIC_ABF_GREEN_POS_LUT_5_ADDR A:0xfde002c4
y.create.l HWIO_MMSS_A_VFE_VFE_DEMOSAIC_ABF_GREEN_POS_LUT_6_ADDR A:0xfde002c8
y.create.l HWIO_MMSS_A_VFE_VFE_DEMOSAIC_ABF_GREEN_POS_LUT_7_ADDR A:0xfde002cc
y.create.l HWIO_MMSS_A_VFE_VFE_DEMOSAIC_ABF_GREEN_NEG_LUT_0_ADDR A:0xfde002d0
y.create.l HWIO_MMSS_A_VFE_VFE_DEMOSAIC_ABF_GREEN_NEG_LUT_1_ADDR A:0xfde002d4
y.create.l HWIO_MMSS_A_VFE_VFE_DEMOSAIC_ABF_GREEN_NEG_LUT_2_ADDR A:0xfde002d8
y.create.l HWIO_MMSS_A_VFE_VFE_DEMOSAIC_ABF_GREEN_NEG_LUT_3_ADDR A:0xfde002dc
y.create.l HWIO_MMSS_A_VFE_VFE_DEMOSAIC_ABF_BLUE_CFG_0_ADDR A:0xfde002e0
y.create.l HWIO_MMSS_A_VFE_VFE_DEMOSAIC_ABF_BLUE_CFG_1_ADDR A:0xfde002e4
y.create.l HWIO_MMSS_A_VFE_VFE_DEMOSAIC_ABF_BLUE_CFG_2_ADDR A:0xfde002e8
y.create.l HWIO_MMSS_A_VFE_VFE_DEMOSAIC_ABF_BLUE_POS_LUT_0_ADDR A:0xfde002ec
y.create.l HWIO_MMSS_A_VFE_VFE_DEMOSAIC_ABF_BLUE_POS_LUT_1_ADDR A:0xfde002f0
y.create.l HWIO_MMSS_A_VFE_VFE_DEMOSAIC_ABF_BLUE_POS_LUT_2_ADDR A:0xfde002f4
y.create.l HWIO_MMSS_A_VFE_VFE_DEMOSAIC_ABF_BLUE_POS_LUT_3_ADDR A:0xfde002f8
y.create.l HWIO_MMSS_A_VFE_VFE_DEMOSAIC_ABF_BLUE_POS_LUT_4_ADDR A:0xfde002fc
y.create.l HWIO_MMSS_A_VFE_VFE_DEMOSAIC_ABF_BLUE_POS_LUT_5_ADDR A:0xfde00300
y.create.l HWIO_MMSS_A_VFE_VFE_DEMOSAIC_ABF_BLUE_POS_LUT_6_ADDR A:0xfde00304
y.create.l HWIO_MMSS_A_VFE_VFE_DEMOSAIC_ABF_BLUE_POS_LUT_7_ADDR A:0xfde00308
y.create.l HWIO_MMSS_A_VFE_VFE_DEMOSAIC_ABF_BLUE_NEG_LUT_0_ADDR A:0xfde0030c
y.create.l HWIO_MMSS_A_VFE_VFE_DEMOSAIC_ABF_BLUE_NEG_LUT_1_ADDR A:0xfde00310
y.create.l HWIO_MMSS_A_VFE_VFE_DEMOSAIC_ABF_BLUE_NEG_LUT_2_ADDR A:0xfde00314
y.create.l HWIO_MMSS_A_VFE_VFE_DEMOSAIC_ABF_BLUE_NEG_LUT_3_ADDR A:0xfde00318
y.create.l HWIO_MMSS_A_VFE_VFE_DEMOSAIC_ABF_RED_CFG_0_ADDR A:0xfde0031c
y.create.l HWIO_MMSS_A_VFE_VFE_DEMOSAIC_ABF_RED_CFG_1_ADDR A:0xfde00320
y.create.l HWIO_MMSS_A_VFE_VFE_DEMOSAIC_ABF_RED_CFG_2_ADDR A:0xfde00324
y.create.l HWIO_MMSS_A_VFE_VFE_DEMOSAIC_ABF_RED_POS_LUT_0_ADDR A:0xfde00328
y.create.l HWIO_MMSS_A_VFE_VFE_DEMOSAIC_ABF_RED_POS_LUT_1_ADDR A:0xfde0032c
y.create.l HWIO_MMSS_A_VFE_VFE_DEMOSAIC_ABF_RED_POS_LUT_2_ADDR A:0xfde00330
y.create.l HWIO_MMSS_A_VFE_VFE_DEMOSAIC_ABF_RED_POS_LUT_3_ADDR A:0xfde00334
y.create.l HWIO_MMSS_A_VFE_VFE_DEMOSAIC_ABF_RED_POS_LUT_4_ADDR A:0xfde00338
y.create.l HWIO_MMSS_A_VFE_VFE_DEMOSAIC_ABF_RED_POS_LUT_5_ADDR A:0xfde0033c
y.create.l HWIO_MMSS_A_VFE_VFE_DEMOSAIC_ABF_RED_POS_LUT_6_ADDR A:0xfde00340
y.create.l HWIO_MMSS_A_VFE_VFE_DEMOSAIC_ABF_RED_POS_LUT_7_ADDR A:0xfde00344
y.create.l HWIO_MMSS_A_VFE_VFE_DEMOSAIC_ABF_RED_NEG_LUT_0_ADDR A:0xfde00348
y.create.l HWIO_MMSS_A_VFE_VFE_DEMOSAIC_ABF_RED_NEG_LUT_1_ADDR A:0xfde0034c
y.create.l HWIO_MMSS_A_VFE_VFE_DEMOSAIC_ABF_RED_NEG_LUT_2_ADDR A:0xfde00350
y.create.l HWIO_MMSS_A_VFE_VFE_DEMOSAIC_ABF_RED_NEG_LUT_3_ADDR A:0xfde00354
y.create.l HWIO_MMSS_A_VFE_VFE_DEMOSAIC_INTERP_WB_GAIN_0_ADDR A:0xfde0061c
y.create.l HWIO_MMSS_A_VFE_VFE_DEMOSAIC_INTERP_WB_GAIN_1_ADDR A:0xfde00620
y.create.l HWIO_MMSS_A_VFE_VFE_DEMOSAIC_INTERP_CLASSIFIER_0_ADDR A:0xfde00624
y.create.l HWIO_MMSS_A_VFE_VFE_DEMOSAIC_INTERP_CLASSIFIER_1_ADDR A:0xfde00628
y.create.l HWIO_MMSS_A_VFE_VFE_DEMOSAIC_INTERP_CLASSIFIER_2_ADDR A:0xfde0062c
y.create.l HWIO_MMSS_A_VFE_VFE_DEMOSAIC_INTERP_CLASSIFIER_3_ADDR A:0xfde00630
y.create.l HWIO_MMSS_A_VFE_VFE_DEMOSAIC_INTERP_CLASSIFIER_4_ADDR A:0xfde00634
y.create.l HWIO_MMSS_A_VFE_VFE_DEMOSAIC_INTERP_CLASSIFIER_5_ADDR A:0xfde00638
y.create.l HWIO_MMSS_A_VFE_VFE_DEMOSAIC_INTERP_CLASSIFIER_6_ADDR A:0xfde0063c
y.create.l HWIO_MMSS_A_VFE_VFE_DEMOSAIC_INTERP_CLASSIFIER_7_ADDR A:0xfde00640
y.create.l HWIO_MMSS_A_VFE_VFE_DEMOSAIC_INTERP_CLASSIFIER_8_ADDR A:0xfde00644
y.create.l HWIO_MMSS_A_VFE_VFE_DEMOSAIC_INTERP_CLASSIFIER_9_ADDR A:0xfde00648
y.create.l HWIO_MMSS_A_VFE_VFE_DEMOSAIC_INTERP_G_0_ADDR A:0xfde0066c
y.create.l HWIO_MMSS_A_VFE_VFE_DEMOSAIC_INTERP_G_1_ADDR A:0xfde00670
y.create.l HWIO_MMSS_A_VFE_VFE_DEMOSAIC_DBPC_STATS_ADDR A:0xfde00358
y.create.l HWIO_MMSS_A_VFE_VFE_DEMOSAIC_DBCC_STATS_0_ADDR A:0xfde00674
y.create.l HWIO_MMSS_A_VFE_VFE_DEMOSAIC_DBCC_STATS_1_ADDR A:0xfde00678
y.create.l HWIO_MMSS_A_VFE_VFE_CHROMA_UPSAMPLE_CFG_ADDR A:0xfde0035c
y.create.l HWIO_MMSS_A_VFE_VFE_CROP_WIDTH_CFG_ADDR A:0xfde00360
y.create.l HWIO_MMSS_A_VFE_VFE_CROP_HEIGHT_CFG_ADDR A:0xfde00364
y.create.l HWIO_MMSS_A_VFE_VFE_SCALE_CFG_ADDR A:0xfde00368
y.create.l HWIO_MMSS_A_VFE_VFE_SCALE_H_IMAGE_SIZE_CFG_ADDR A:0xfde0036c
y.create.l HWIO_MMSS_A_VFE_VFE_SCALE_H_PHASE_CFG_ADDR A:0xfde00370
y.create.l HWIO_MMSS_A_VFE_VFE_SCALE_H_STRIPE_CFG_ADDR A:0xfde00374
y.create.l HWIO_MMSS_A_VFE_VFE_SCALE_V_IMAGE_SIZE_CFG_ADDR A:0xfde00378
y.create.l HWIO_MMSS_A_VFE_VFE_SCALE_V_PHASE_CFG_ADDR A:0xfde0037c
y.create.l HWIO_MMSS_A_VFE_VFE_SCALE_V_STRIPE_CFG_ADDR A:0xfde00380
y.create.l HWIO_MMSS_A_VFE_VFE_WB_CFG_ADDR A:0xfde00384
y.create.l HWIO_MMSS_A_VFE_VFE_WB_RIGHT_CFG_ADDR A:0xfde007a0
y.create.l HWIO_MMSS_A_VFE_VFE_CLF_CFG_ADDR A:0xfde006b0
y.create.l HWIO_MMSS_A_VFE_VFE_CLF_LUMA_CFG_0_ADDR A:0xfde006b4
y.create.l HWIO_MMSS_A_VFE_VFE_CLF_LUMA_CFG_1_ADDR A:0xfde006b8
y.create.l HWIO_MMSS_A_VFE_VFE_CLF_LUMA_CFG_2_ADDR A:0xfde006bc
y.create.l HWIO_MMSS_A_VFE_VFE_CLF_LUMA_POS_LUT_0_ADDR A:0xfde006c0
y.create.l HWIO_MMSS_A_VFE_VFE_CLF_LUMA_POS_LUT_1_ADDR A:0xfde006c4
y.create.l HWIO_MMSS_A_VFE_VFE_CLF_LUMA_POS_LUT_2_ADDR A:0xfde006c8
y.create.l HWIO_MMSS_A_VFE_VFE_CLF_LUMA_POS_LUT_3_ADDR A:0xfde006cc
y.create.l HWIO_MMSS_A_VFE_VFE_CLF_LUMA_POS_LUT_4_ADDR A:0xfde006d0
y.create.l HWIO_MMSS_A_VFE_VFE_CLF_LUMA_POS_LUT_5_ADDR A:0xfde006d4
y.create.l HWIO_MMSS_A_VFE_VFE_CLF_LUMA_POS_LUT_6_ADDR A:0xfde006d8
y.create.l HWIO_MMSS_A_VFE_VFE_CLF_LUMA_POS_LUT_7_ADDR A:0xfde006dc
y.create.l HWIO_MMSS_A_VFE_VFE_CLF_LUMA_NEG_LUT_0_ADDR A:0xfde006e0
y.create.l HWIO_MMSS_A_VFE_VFE_CLF_LUMA_NEG_LUT_1_ADDR A:0xfde006e4
y.create.l HWIO_MMSS_A_VFE_VFE_CLF_LUMA_NEG_LUT_2_ADDR A:0xfde006e8
y.create.l HWIO_MMSS_A_VFE_VFE_CLF_LUMA_NEG_LUT_3_ADDR A:0xfde006ec
y.create.l HWIO_MMSS_A_VFE_VFE_CLF_CHROMA_COEFF_0_ADDR A:0xfde006f0
y.create.l HWIO_MMSS_A_VFE_VFE_CLF_CHROMA_COEFF_1_ADDR A:0xfde006f4
y.create.l HWIO_MMSS_A_VFE_VFE_COLOR_CORRECT_COEFF_0_ADDR A:0xfde00388
y.create.l HWIO_MMSS_A_VFE_VFE_COLOR_CORRECT_COEFF_1_ADDR A:0xfde0038c
y.create.l HWIO_MMSS_A_VFE_VFE_COLOR_CORRECT_COEFF_2_ADDR A:0xfde00390
y.create.l HWIO_MMSS_A_VFE_VFE_COLOR_CORRECT_COEFF_3_ADDR A:0xfde00394
y.create.l HWIO_MMSS_A_VFE_VFE_COLOR_CORRECT_COEFF_4_ADDR A:0xfde00398
y.create.l HWIO_MMSS_A_VFE_VFE_COLOR_CORRECT_COEFF_5_ADDR A:0xfde0039c
y.create.l HWIO_MMSS_A_VFE_VFE_COLOR_CORRECT_COEFF_6_ADDR A:0xfde003a0
y.create.l HWIO_MMSS_A_VFE_VFE_COLOR_CORRECT_COEFF_7_ADDR A:0xfde003a4
y.create.l HWIO_MMSS_A_VFE_VFE_COLOR_CORRECT_COEFF_8_ADDR A:0xfde003a8
y.create.l HWIO_MMSS_A_VFE_VFE_COLOR_CORRECT_OFFSET_0_ADDR A:0xfde003ac
y.create.l HWIO_MMSS_A_VFE_VFE_COLOR_CORRECT_OFFSET_1_ADDR A:0xfde003b0
y.create.l HWIO_MMSS_A_VFE_VFE_COLOR_CORRECT_OFFSET_2_ADDR A:0xfde003b4
y.create.l HWIO_MMSS_A_VFE_VFE_COLOR_CORRECT_COEFF_Q_ADDR A:0xfde003b8
y.create.l HWIO_MMSS_A_VFE_VFE_LUT_BANK_SEL_ADDR A:0xfde003bc
y.create.l HWIO_MMSS_A_VFE_VFE_LA_CFG_ADDR A:0xfde003c0
y.create.l HWIO_MMSS_A_VFE_VFE_COLOR_CONVERT_COEFF_0_ADDR A:0xfde003c4
y.create.l HWIO_MMSS_A_VFE_VFE_COLOR_CONVERT_COEFF_1_ADDR A:0xfde003c8
y.create.l HWIO_MMSS_A_VFE_VFE_COLOR_CONVERT_COEFF_2_ADDR A:0xfde003cc
y.create.l HWIO_MMSS_A_VFE_VFE_COLOR_CONVERT_OFFSET_ADDR A:0xfde003d0
y.create.l HWIO_MMSS_A_VFE_VFE_CHROMA_ENHAN_A_ADDR A:0xfde003d4
y.create.l HWIO_MMSS_A_VFE_VFE_CHROMA_ENHAN_B_ADDR A:0xfde003d8
y.create.l HWIO_MMSS_A_VFE_VFE_CHROMA_ENHAN_C_ADDR A:0xfde003dc
y.create.l HWIO_MMSS_A_VFE_VFE_CHROMA_ENHAN_D_ADDR A:0xfde003e0
y.create.l HWIO_MMSS_A_VFE_VFE_CHROMA_ENHAN_K_ADDR A:0xfde003e4
y.create.l HWIO_MMSS_A_VFE_VFE_CHROMA_SUPPRESS_CFG_0_ADDR A:0xfde003e8
y.create.l HWIO_MMSS_A_VFE_VFE_CHROMA_SUPPRESS_CFG_1_ADDR A:0xfde003ec
y.create.l HWIO_MMSS_A_VFE_VFE_CHROMA_SUPPRESS_CFG_2_ADDR A:0xfde003f0
y.create.l HWIO_MMSS_A_VFE_VFE_MCE_RED_CFG_0_ADDR A:0xfde003f4
y.create.l HWIO_MMSS_A_VFE_VFE_MCE_RED_CFG_1_ADDR A:0xfde003f8
y.create.l HWIO_MMSS_A_VFE_VFE_MCE_RED_CFG_2_ADDR A:0xfde003fc
y.create.l HWIO_MMSS_A_VFE_VFE_MCE_GREEN_CFG_0_ADDR A:0xfde00400
y.create.l HWIO_MMSS_A_VFE_VFE_MCE_GREEN_CFG_1_ADDR A:0xfde00404
y.create.l HWIO_MMSS_A_VFE_VFE_MCE_GREEN_CFG_2_ADDR A:0xfde00408
y.create.l HWIO_MMSS_A_VFE_VFE_MCE_BLUE_CFG_0_ADDR A:0xfde0040c
y.create.l HWIO_MMSS_A_VFE_VFE_MCE_BLUE_CFG_1_ADDR A:0xfde00410
y.create.l HWIO_MMSS_A_VFE_VFE_MCE_BLUE_CFG_2_ADDR A:0xfde00414
y.create.l HWIO_MMSS_A_VFE_VFE_SKIN_ENHAN_CR_COORD_0_ADDR A:0xfde00418
y.create.l HWIO_MMSS_A_VFE_VFE_SKIN_ENHAN_CR_COORD_1_ADDR A:0xfde0041c
y.create.l HWIO_MMSS_A_VFE_VFE_SKIN_ENHAN_CR_COORD_2_ADDR A:0xfde00420
y.create.l HWIO_MMSS_A_VFE_VFE_SKIN_ENHAN_CR_COORD_3_ADDR A:0xfde00424
y.create.l HWIO_MMSS_A_VFE_VFE_SKIN_ENHAN_CR_COORD_4_ADDR A:0xfde00428
y.create.l HWIO_MMSS_A_VFE_VFE_SKIN_ENHAN_CB_COORD_0_ADDR A:0xfde0042c
y.create.l HWIO_MMSS_A_VFE_VFE_SKIN_ENHAN_CB_COORD_1_ADDR A:0xfde00430
y.create.l HWIO_MMSS_A_VFE_VFE_SKIN_ENHAN_CB_COORD_2_ADDR A:0xfde00434
y.create.l HWIO_MMSS_A_VFE_VFE_SKIN_ENHAN_CB_COORD_3_ADDR A:0xfde00438
y.create.l HWIO_MMSS_A_VFE_VFE_SKIN_ENHAN_CB_COORD_4_ADDR A:0xfde0043c
y.create.l HWIO_MMSS_A_VFE_VFE_SKIN_ENHAN_CR_COEFF_0_ADDR A:0xfde00440
y.create.l HWIO_MMSS_A_VFE_VFE_SKIN_ENHAN_CR_COEFF_1_ADDR A:0xfde00444
y.create.l HWIO_MMSS_A_VFE_VFE_SKIN_ENHAN_CR_COEFF_2_ADDR A:0xfde00448
y.create.l HWIO_MMSS_A_VFE_VFE_SKIN_ENHAN_CR_COEFF_3_ADDR A:0xfde0044c
y.create.l HWIO_MMSS_A_VFE_VFE_SKIN_ENHAN_CR_COEFF_4_ADDR A:0xfde00450
y.create.l HWIO_MMSS_A_VFE_VFE_SKIN_ENHAN_CR_COEFF_5_ADDR A:0xfde00454
y.create.l HWIO_MMSS_A_VFE_VFE_SKIN_ENHAN_CB_COEFF_0_ADDR A:0xfde00458
y.create.l HWIO_MMSS_A_VFE_VFE_SKIN_ENHAN_CB_COEFF_1_ADDR A:0xfde0045c
y.create.l HWIO_MMSS_A_VFE_VFE_SKIN_ENHAN_CB_COEFF_2_ADDR A:0xfde00460
y.create.l HWIO_MMSS_A_VFE_VFE_SKIN_ENHAN_CB_COEFF_3_ADDR A:0xfde00464
y.create.l HWIO_MMSS_A_VFE_VFE_SKIN_ENHAN_CB_COEFF_4_ADDR A:0xfde00468
y.create.l HWIO_MMSS_A_VFE_VFE_SKIN_ENHAN_CB_COEFF_5_ADDR A:0xfde0046c
y.create.l HWIO_MMSS_A_VFE_VFE_SKIN_ENHAN_CR_OFFSET_0_ADDR A:0xfde00470
y.create.l HWIO_MMSS_A_VFE_VFE_SKIN_ENHAN_CR_OFFSET_1_ADDR A:0xfde00474
y.create.l HWIO_MMSS_A_VFE_VFE_SKIN_ENHAN_CR_OFFSET_2_ADDR A:0xfde00478
y.create.l HWIO_MMSS_A_VFE_VFE_SKIN_ENHAN_CR_OFFSET_3_ADDR A:0xfde0047c
y.create.l HWIO_MMSS_A_VFE_VFE_SKIN_ENHAN_CR_OFFSET_4_ADDR A:0xfde00480
y.create.l HWIO_MMSS_A_VFE_VFE_SKIN_ENHAN_CR_OFFSET_5_ADDR A:0xfde00484
y.create.l HWIO_MMSS_A_VFE_VFE_SKIN_ENHAN_CB_OFFSET_0_ADDR A:0xfde00488
y.create.l HWIO_MMSS_A_VFE_VFE_SKIN_ENHAN_CB_OFFSET_1_ADDR A:0xfde0048c
y.create.l HWIO_MMSS_A_VFE_VFE_SKIN_ENHAN_CB_OFFSET_2_ADDR A:0xfde00490
y.create.l HWIO_MMSS_A_VFE_VFE_SKIN_ENHAN_CB_OFFSET_3_ADDR A:0xfde00494
y.create.l HWIO_MMSS_A_VFE_VFE_SKIN_ENHAN_CB_OFFSET_4_ADDR A:0xfde00498
y.create.l HWIO_MMSS_A_VFE_VFE_SKIN_ENHAN_CB_OFFSET_5_ADDR A:0xfde0049c
y.create.l HWIO_MMSS_A_VFE_VFE_ASF_CFG_ADDR A:0xfde004a0
y.create.l HWIO_MMSS_A_VFE_VFE_ASF_SHARP_CFG_0_ADDR A:0xfde004a4
y.create.l HWIO_MMSS_A_VFE_VFE_ASF_SHARP_CFG_1_ADDR A:0xfde004a8
y.create.l HWIO_MMSS_A_VFE_VFE_ASF_SHARP_COEFF_0_ADDR A:0xfde004ac
y.create.l HWIO_MMSS_A_VFE_VFE_ASF_SHARP_COEFF_1_ADDR A:0xfde004b0
y.create.l HWIO_MMSS_A_VFE_VFE_ASF_SHARP_COEFF_2_ADDR A:0xfde004b4
y.create.l HWIO_MMSS_A_VFE_VFE_ASF_SHARP_COEFF_3_ADDR A:0xfde004b8
y.create.l HWIO_MMSS_A_VFE_VFE_ASF_SHARP_COEFF_4_ADDR A:0xfde004bc
y.create.l HWIO_MMSS_A_VFE_VFE_ASF_SHARP_COEFF_5_ADDR A:0xfde004c0
y.create.l HWIO_MMSS_A_VFE_VFE_ASF_MAX_EDGE_ADDR A:0xfde004c4
y.create.l HWIO_MMSS_A_VFE_VFE_ASF_CROP_WIDTH_CFG_ADDR A:0xfde004c8
y.create.l HWIO_MMSS_A_VFE_VFE_ASF_CROP_HEIGHT_CFG_ADDR A:0xfde004cc
y.create.l HWIO_MMSS_A_VFE_VFE_ASF_SPECIAL_EFX_CFG_ADDR A:0xfde005fc
y.create.l HWIO_MMSS_A_VFE_VFE_SCALE_Y_CFG_ADDR A:0xfde004d0
y.create.l HWIO_MMSS_A_VFE_VFE_SCALE_Y_H_IMAGE_SIZE_CFG_ADDR A:0xfde004d4
y.create.l HWIO_MMSS_A_VFE_VFE_SCALE_Y_H_PHASE_CFG_ADDR A:0xfde004d8
y.create.l HWIO_MMSS_A_VFE_VFE_SCALE_Y_V_IMAGE_SIZE_CFG_ADDR A:0xfde004dc
y.create.l HWIO_MMSS_A_VFE_VFE_SCALE_Y_V_PHASE_CFG_ADDR A:0xfde004e0
y.create.l HWIO_MMSS_A_VFE_VFE_SCALE_CBCR_CFG_ADDR A:0xfde004e4
y.create.l HWIO_MMSS_A_VFE_VFE_SCALE_CBCR_H_IMAGE_SIZE_CFG_ADDR A:0xfde004e8
y.create.l HWIO_MMSS_A_VFE_VFE_SCALE_CBCR_H_PHASE_CFG_ADDR A:0xfde004ec
y.create.l HWIO_MMSS_A_VFE_VFE_SCALE_CBCR_V_IMAGE_SIZE_CFG_ADDR A:0xfde004f0
y.create.l HWIO_MMSS_A_VFE_VFE_SCALE_CBCR_V_PHASE_CFG_ADDR A:0xfde004f4
y.create.l HWIO_MMSS_A_VFE_VFE_CHROMA_SUBSAMPLE_CFG_ADDR A:0xfde004f8
y.create.l HWIO_MMSS_A_VFE_VFE_CHROMA_SUB_CROP_WIDTH_CFG_ADDR A:0xfde004fc
y.create.l HWIO_MMSS_A_VFE_VFE_CHROMA_SUB_CROP_HEIGHT_CFG_ADDR A:0xfde00500
y.create.l HWIO_MMSS_A_VFE_VFE_FRAMEDROP_ENC_Y_CFG_ADDR A:0xfde00504
y.create.l HWIO_MMSS_A_VFE_VFE_FRAMEDROP_ENC_CBCR_CFG_ADDR A:0xfde00508
y.create.l HWIO_MMSS_A_VFE_VFE_FRAMEDROP_ENC_Y_PATTERN_ADDR A:0xfde0050c
y.create.l HWIO_MMSS_A_VFE_VFE_FRAMEDROP_ENC_CBCR_PATTERN_ADDR A:0xfde00510
y.create.l HWIO_MMSS_A_VFE_VFE_FRAMEDROP_VIEW_Y_CFG_ADDR A:0xfde00514
y.create.l HWIO_MMSS_A_VFE_VFE_FRAMEDROP_VIEW_CBCR_CFG_ADDR A:0xfde00518
y.create.l HWIO_MMSS_A_VFE_VFE_FRAMEDROP_VIEW_Y_PATTERN_ADDR A:0xfde0051c
y.create.l HWIO_MMSS_A_VFE_VFE_FRAMEDROP_VIEW_CBCR_PATTERN_ADDR A:0xfde00520
y.create.l HWIO_MMSS_A_VFE_VFE_CLAMP_MAX_CFG_ADDR A:0xfde00524
y.create.l HWIO_MMSS_A_VFE_VFE_CLAMP_MIN_CFG_ADDR A:0xfde00528
y.create.l HWIO_MMSS_A_VFE_VFE_REALIGN_BUF_CFG_ADDR A:0xfde0052c
y.create.l HWIO_MMSS_A_VFE_VFE_STATS_CFG_ADDR A:0xfde00530
y.create.l HWIO_MMSS_A_VFE_VFE_STATS_BG_RGN_OFFSET_CFG_ADDR A:0xfde00700
y.create.l HWIO_MMSS_A_VFE_VFE_STATS_BG_RGN_SIZE_CFG_ADDR A:0xfde00704
y.create.l HWIO_MMSS_A_VFE_VFE_STATS_BG_THRESHOLD_CFG_ADDR A:0xfde00708
y.create.l HWIO_MMSS_A_VFE_VFE_STATS_BF_RGN_OFFSET_CFG_ADDR A:0xfde0070c
y.create.l HWIO_MMSS_A_VFE_VFE_STATS_BF_RGN_SIZE_CFG_ADDR A:0xfde00710
y.create.l HWIO_MMSS_A_VFE_VFE_STATS_BF_FILTER_CFG_0_ADDR A:0xfde00714
y.create.l HWIO_MMSS_A_VFE_VFE_STATS_BF_FILTER_CFG_1_ADDR A:0xfde00718
y.create.l HWIO_MMSS_A_VFE_VFE_STATS_BF_FILTER_COEFF_0_ADDR A:0xfde0071c
y.create.l HWIO_MMSS_A_VFE_VFE_STATS_BF_FILTER_COEFF_1_ADDR A:0xfde00720
y.create.l HWIO_MMSS_A_VFE_VFE_STATS_BHIST_RGN_OFFSET_CFG_ADDR A:0xfde00724
y.create.l HWIO_MMSS_A_VFE_VFE_STATS_BHIST_RGN_SIZE_CFG_ADDR A:0xfde00728
y.create.l HWIO_MMSS_A_VFE_VFE_STATS_AE_RGN_OFFSET_CFG_ADDR A:0xfde00534
y.create.l HWIO_MMSS_A_VFE_VFE_STATS_AE_RGN_SIZE_CFG_ADDR A:0xfde00538
y.create.l HWIO_MMSS_A_VFE_VFE_STATS_AF_RGN_OFFSET_CFG_ADDR A:0xfde0053c
y.create.l HWIO_MMSS_A_VFE_VFE_STATS_AF_RGN_SIZE_CFG_ADDR A:0xfde00540
y.create.l HWIO_MMSS_A_VFE_VFE_STATS_AF_HPF_COEFF_0_ADDR A:0xfde00544
y.create.l HWIO_MMSS_A_VFE_VFE_STATS_AF_HPF_COEFF_1_ADDR A:0xfde00548
y.create.l HWIO_MMSS_A_VFE_VFE_STATS_AWB_RGN_OFFSET_CFG_ADDR A:0xfde0054c
y.create.l HWIO_MMSS_A_VFE_VFE_STATS_AWB_RGN_SIZE_CFG_ADDR A:0xfde00550
y.create.l HWIO_MMSS_A_VFE_VFE_STATS_AWB_SGW_CFG_ADDR A:0xfde00554
y.create.l HWIO_MMSS_A_VFE_VFE_STATS_AWB_AGW_CFG_0_ADDR A:0xfde00558
y.create.l HWIO_MMSS_A_VFE_VFE_STATS_AWB_AGW_CFG_1_ADDR A:0xfde0055c
y.create.l HWIO_MMSS_A_VFE_VFE_STATS_AWB_AGW_CFG_2_ADDR A:0xfde00560
y.create.l HWIO_MMSS_A_VFE_VFE_STATS_AWB_GX_CFG_0_ADDR A:0xfde00564
y.create.l HWIO_MMSS_A_VFE_VFE_STATS_AWB_GX_CFG_1_ADDR A:0xfde00568
y.create.l HWIO_MMSS_A_VFE_VFE_STATS_RS_RGN_OFFSET_CFG_ADDR A:0xfde0056c
y.create.l HWIO_MMSS_A_VFE_VFE_STATS_RS_RGN_SIZE_CFG_ADDR A:0xfde00570
y.create.l HWIO_MMSS_A_VFE_VFE_STATS_CS_RGN_OFFSET_CFG_ADDR A:0xfde00574
y.create.l HWIO_MMSS_A_VFE_VFE_STATS_CS_RGN_SIZE_CFG_ADDR A:0xfde00578
y.create.l HWIO_MMSS_A_VFE_VFE_STATS_IHIST_RGN_OFFSET_CFG_ADDR A:0xfde0057c
y.create.l HWIO_MMSS_A_VFE_VFE_STATS_IHIST_RGN_SIZE_CFG_ADDR A:0xfde00580
y.create.l HWIO_MMSS_A_VFE_VFE_STATS_SKIN_RGN_OFFSET_CFG_ADDR A:0xfde00584
y.create.l HWIO_MMSS_A_VFE_VFE_STATS_SKIN_RGN_SIZE_CFG_ADDR A:0xfde00588
y.create.l HWIO_MMSS_A_VFE_VFE_STATS_SKIN_HUE_CFG_ADDR A:0xfde0058c
y.create.l HWIO_MMSS_A_VFE_VFE_STATS_SKIN_Y_CFG_ADDR A:0xfde00590
y.create.l HWIO_MMSS_A_VFE_VFE_STATS_SKIN_CBCR_CFG_ADDR A:0xfde00594
y.create.l HWIO_MMSS_A_VFE_VFE_DMI_CFG_ADDR A:0xfde00598
y.create.l HWIO_MMSS_A_VFE_VFE_DMI_ADDR_ADDR A:0xfde0059c
y.create.l HWIO_MMSS_A_VFE_VFE_DMI_DATA_HI_ADDR A:0xfde005a0
y.create.l HWIO_MMSS_A_VFE_VFE_DMI_DATA_LO_ADDR A:0xfde005a4
y.create.l HWIO_MMSS_A_VFE_VFE_DMI_RAM_AUTO_LOAD_CMD_ADDR A:0xfde005a8
y.create.l HWIO_MMSS_A_VFE_VFE_DMI_RAM_AUTO_LOAD_STATUS_ADDR A:0xfde005ac
y.create.l HWIO_MMSS_A_VFE_VFE_DMI_RAM_AUTO_LOAD_CFG_ADDR A:0xfde005b0
y.create.l HWIO_MMSS_A_VFE_VFE_DMI_RAM_AUTO_LOAD_SEED_ADDR A:0xfde005b4
y.create.l HWIO_MMSS_A_VFE_VFE_TESTBUS_SEL_ADDR A:0xfde005b8
y.create.l HWIO_MMSS_A_VFE_VFE_TESTGEN_CFG_ADDR A:0xfde005bc
y.create.l HWIO_MMSS_A_VFE_VFE_SW_TESTGEN_CMD_ADDR A:0xfde005c0
y.create.l HWIO_MMSS_A_VFE_VFE_HW_TESTGEN_CMD_ADDR A:0xfde005c4
y.create.l HWIO_MMSS_A_VFE_VFE_HW_TESTGEN_CFG_ADDR A:0xfde005c8
y.create.l HWIO_MMSS_A_VFE_VFE_HW_TESTGEN_IMAGE_CFG_ADDR A:0xfde005cc
y.create.l HWIO_MMSS_A_VFE_VFE_HW_TESTGEN_SOF_OFFSET_CFG_ADDR A:0xfde005d0
y.create.l HWIO_MMSS_A_VFE_VFE_HW_TESTGEN_EOF_NOFFSET_CFG_ADDR A:0xfde005d4
y.create.l HWIO_MMSS_A_VFE_VFE_HW_TESTGEN_SOL_OFFSET_CFG_ADDR A:0xfde005d8
y.create.l HWIO_MMSS_A_VFE_VFE_HW_TESTGEN_EOL_NOFFSET_CFG_ADDR A:0xfde005dc
y.create.l HWIO_MMSS_A_VFE_VFE_HW_TESTGEN_HBI_CFG_ADDR A:0xfde005e0
y.create.l HWIO_MMSS_A_VFE_VFE_HW_TESTGEN_VBL_CFG_ADDR A:0xfde005e4
y.create.l HWIO_MMSS_A_VFE_VFE_HW_TESTGEN_COLOR_BARS_CFG_ADDR A:0xfde005f0
y.create.l HWIO_MMSS_A_VFE_VFE_HW_TESTGEN_RANDOM_CFG_ADDR A:0xfde005f4
y.create.l HWIO_MMSS_A_VFE_VFE_SPARE_ADDR A:0xfde005f8
y.create.l HWIO_MMSS_A_VFE_CE_VFE_CE_CLOCK_CONFIG_ADDR A:0xfde00f60
y.create.l HWIO_MMSS_A_VFE_CE_VFE_CE_SW_RESET_ADDR A:0xfde00f64
y.create.l HWIO_MMSS_A_VFE_CE_VFE_CE_ENABLE_ADDR A:0xfde00f68
y.create.l HWIO_MMSS_A_VFE_CE_VFE_CE_CMD_BUFFER_ENABLE_ADDR A:0xfde00f6c
y.create.l HWIO_MMSS_A_VFE_CE_VFE_CE_CMD_BUFFER_A_ADDR_ADDR A:0xfde00f70
y.create.l HWIO_MMSS_A_VFE_CE_VFE_CE_CMD_BUFFER_B_ADDR_ADDR A:0xfde00f74
y.create.l HWIO_MMSS_A_VFE_CE_VFE_CE_INTR_STATUS_ADDR A:0xfde00f78
y.create.l HWIO_MMSS_A_VFE_CE_VFE_CE_INTR_CLEAR_ADDR A:0xfde00f7c
y.create.l HWIO_MMSS_A_VFE_CE_VFE_CE_BUFFER_STATUS_ADDR A:0xfde00f80
y.create.l HWIO_MMSS_A_VFE_CE_VFE_CE_STATE_STATUS_ADDR A:0xfde00f84
y.create.l HWIO_MMSS_A_VFE_CE_VFE_CE_CURRENT_PTR_ADDR A:0xfde00f88
y.create.l HWIO_MMSS_A_VFE_CE_VFE_CE_PING_PONG_BUF_COUNT_ADDR A:0xfde00f8c
y.create.l HWIO_MMSS_A_VFE_CE_VFE_CE_CYCLE_COUNT_ADDR A:0xfde00f90
y.create.l HWIO_MMSS_A_VFE_CE_VFE_CE_MAX_PING_PONG_BUF_CYCLE_COUNT_ADDR A:0xfde00f94
y.create.l HWIO_MMSS_A_VFE_CE_VFE_CE_CMD_COUNT_ADDR A:0xfde00f98
y.create.l HWIO_MMSS_A_VFE_CE_VFE_CE_CMD_BUF_CYC_COUNT_ADDR A:0xfde00f9c
y.create.l HWIO_MMSS_A_VFE_CE_VFE_CE_PENDING_COMMAND_ADDR A:0xfde00fa0
y.create.l HWIO_MMSS_A_VFE_CE_VFE_CE_PENDING_CMD_DATA1_ADDR A:0xfde00fa4
y.create.l HWIO_MMSS_A_VFE_CE_VFE_CE_PENDING_CMD_DATA2_ADDR A:0xfde00fa8
y.create.l HWIO_MMSS_A_VFE_CE_VFE_CE_PENDING_CMD_DATA3_ADDR A:0xfde00fac
y.create.l HWIO_MMSS_A_VFE_CE_VFE_CE_EXE_COMMAND_ADDR A:0xfde00fb0
y.create.l HWIO_MMSS_A_VFE_CE_VFE_CE_EXE_CMD_DATA1_ADDR A:0xfde00fb4
y.create.l HWIO_MMSS_A_VFE_CE_VFE_CE_EXE_CMD_DATA2_ADDR A:0xfde00fb8
y.create.l HWIO_MMSS_A_VFE_CE_VFE_CE_EXE_CMD_DATA3_ADDR A:0xfde00fbc
y.create.l HWIO_MMSS_A_VFE_CE_VFE_CE_TESTBUS_OBSERVE_ADDR A:0xfde00fc0
y.create.l HWIO_MMSS_A_VFE_CE_VFE_CE_TEST_BUS_SEL_ADDR A:0xfde00fc4
y.create.l HWIO_MMSS_A_VFE_CE_VFE_CE_EXECUTE_NEXT_CMD_ADDR A:0xfde00fc8
y.create.l HWIO_MMSS_A_VFE_CE_VFE_CE_AXI_RD_THROTTLE_DIS_ADDR A:0xfde00fcc
y.create.l HWIO_MMSS_A_VFE_CE_VFE_CE_ARB_OVERRIDE_ADDR A:0xfde00fd0
y.create.l HWIO_MMSS_A_VFE_CE_VFE_CE_SPARE_ADDR A:0xfde00fd4
y.create.l HWIO_MMSS_A_VFE_CE_STATS_VFE_CE_PING_PONG_BUF_COUNT_STAT_ADDR A:0xfde00fe0
y.create.l HWIO_MMSS_A_VFE_CE_STATS_VFE_CE_CYCLE_COUNT_STAT_ADDR A:0xfde00fe4
y.create.l HWIO_MMSS_A_VFE_CE_STATS_VFE_CE_MAX_PING_PONG_BUF_CYCLE_COUNT_STAT_ADDR A:0xfde00fe8
y.create.l HWIO_MMSS_A_VFE_CE_STATS_VFE_CE_CMD_COUNT_STAT_ADDR A:0xfde00fec
y.create.l HWIO_MMSS_A_VFE_CE_STATS_VFE_CE_CMD_BUF_CYC_COUNT_STAT_ADDR A:0xfde00ff0
y.create.l HWIO_MNOC_OBS_ID_COREID_ADDR A:0xfc478000
y.create.l HWIO_MNOC_OBS_ID_REVISIONID_ADDR A:0xfc478004
y.create.l HWIO_MNOC_OBS_ERRCTL_ADDR A:0xfc478008
y.create.l HWIO_MNOC_OBS_ERRSTATUS_ADDR A:0xfc47800c
y.create.l HWIO_MNOC_OBS_ERRLOG0_ADDR A:0xfc478010
y.create.l HWIO_MNOC_OBS_ERRLOG1_ADDR A:0xfc478014
y.create.l HWIO_MNOC_OBS_ERRLOG2_ADDR A:0xfc478018
y.create.l HWIO_MNOC_OBS_ERRLOG3_ADDR A:0xfc47801c
y.create.l HWIO_MNOC_OBS_ERRLOG5_ADDR A:0xfc478024
y.create.l HWIO_MNOC_OBS_DBG_ID_COREID_ADDR A:0xfc478080
y.create.l HWIO_MNOC_OBS_DBG_ID_REVISIONID_ADDR A:0xfc478084
y.create.l HWIO_MNOC_OBS_DBG_ATBID_ADDR A:0xfc478088
y.create.l HWIO_MNOC_MDPS_TFILT_ID_COREID_ADDR A:0xfc479100
y.create.l HWIO_MNOC_MDPS_TFILT_ID_REVISIONID_ADDR A:0xfc479104
y.create.l HWIO_MNOC_MDPS_TFILT_MODE_ADDR A:0xfc479108
y.create.l HWIO_MNOC_MDPS_TFILT_ADDRBASE_LOW_ADDR A:0xfc47910c
y.create.l HWIO_MNOC_MDPS_TFILT_ADDRBASE_HIGH_ADDR A:0xfc479110
y.create.l HWIO_MNOC_MDPS_TFILT_ADDRWINDOWSIZE_ADDR A:0xfc479114
y.create.l HWIO_MNOC_MDPS_TFILT_SRCIDBASE_ADDR A:0xfc479118
y.create.l HWIO_MNOC_MDPS_TFILT_SRCIDMASK_ADDR A:0xfc47911c
y.create.l HWIO_MNOC_MDPS_TFILT_OPCODE_ADDR A:0xfc479120
y.create.l HWIO_MNOC_TPRB0_TPROF_ID_COREID_ADDR A:0xfc479200
y.create.l HWIO_MNOC_TPRB0_TPROF_ID_REVISIONID_ADDR A:0xfc479204
y.create.l HWIO_MNOC_TPRB0_TPROF_EN_ADDR A:0xfc479208
y.create.l HWIO_MNOC_TPRB0_TPROF_MODE_ADDR A:0xfc47920c
y.create.l HWIO_MNOC_TPRB0_TPROF_OBSERVEDSEL_0_ADDR A:0xfc479210
y.create.l HWIO_MNOC_TPRB0_TPROF_OBSERVEDSEL_1_ADDR A:0xfc479214
y.create.l HWIO_MNOC_TPRB0_TPROF_NTENURELINES_0_ADDR A:0xfc479220
y.create.l HWIO_MNOC_TPRB0_TPROF_THRESHOLDS_0_0_ADDR A:0xfc47922c
y.create.l HWIO_MNOC_TPRB0_TPROF_THRESHOLDS_0_1_ADDR A:0xfc479230
y.create.l HWIO_MNOC_TPRB0_TPROF_THRESHOLDS_0_2_ADDR A:0xfc479234
y.create.l HWIO_MNOC_TPRB0_TPROF_THRESHOLDS_1_0_ADDR A:0xfc47923c
y.create.l HWIO_MNOC_TPRB0_TPROF_THRESHOLDS_1_1_ADDR A:0xfc479240
y.create.l HWIO_MNOC_TPRB0_TPROF_THRESHOLDS_1_2_ADDR A:0xfc479244
y.create.l HWIO_MNOC_TPRB0_TPROF_OVERFLOWSTATUS_ADDR A:0xfc47926c
y.create.l HWIO_MNOC_TPRB0_TPROF_OVERFLOWRESET_ADDR A:0xfc479270
y.create.l HWIO_MNOC_TPRB0_TPROF_PENDINGEVENTMODE_ADDR A:0xfc479274
y.create.l HWIO_MNOC_TPRB0_TPROF_PRESCALER_ADDR A:0xfc479278
y.create.l HWIO_MNOC_VFE_TFILT_ID_COREID_ADDR A:0xfc479280
y.create.l HWIO_MNOC_VFE_TFILT_ID_REVISIONID_ADDR A:0xfc479284
y.create.l HWIO_MNOC_VFE_TFILT_MODE_ADDR A:0xfc479288
y.create.l HWIO_MNOC_VFE_TFILT_ADDRBASE_LOW_ADDR A:0xfc47928c
y.create.l HWIO_MNOC_VFE_TFILT_ADDRBASE_HIGH_ADDR A:0xfc479290
y.create.l HWIO_MNOC_VFE_TFILT_ADDRWINDOWSIZE_ADDR A:0xfc479294
y.create.l HWIO_MNOC_VFE_TFILT_SRCIDBASE_ADDR A:0xfc479298
y.create.l HWIO_MNOC_VFE_TFILT_SRCIDMASK_ADDR A:0xfc47929c
y.create.l HWIO_MNOC_VFE_TFILT_OPCODE_ADDR A:0xfc4792a0
y.create.l HWIO_MNOC_MDPE_TFILT_ID_COREID_ADDR A:0xfc479300
y.create.l HWIO_MNOC_MDPE_TFILT_ID_REVISIONID_ADDR A:0xfc479304
y.create.l HWIO_MNOC_MDPE_TFILT_MODE_ADDR A:0xfc479308
y.create.l HWIO_MNOC_MDPE_TFILT_ADDRBASE_LOW_ADDR A:0xfc47930c
y.create.l HWIO_MNOC_MDPE_TFILT_ADDRBASE_HIGH_ADDR A:0xfc479310
y.create.l HWIO_MNOC_MDPE_TFILT_ADDRWINDOWSIZE_ADDR A:0xfc479314
y.create.l HWIO_MNOC_MDPE_TFILT_SRCIDBASE_ADDR A:0xfc479318
y.create.l HWIO_MNOC_MDPE_TFILT_SRCIDMASK_ADDR A:0xfc47931c
y.create.l HWIO_MNOC_MDPE_TFILT_OPCODE_ADDR A:0xfc479320
y.create.l HWIO_MNOC_TPRB0_SPROF_ID_COREID_ADDR A:0xfc47a000
y.create.l HWIO_MNOC_TPRB0_SPROF_ID_REVISIONID_ADDR A:0xfc47a004
y.create.l HWIO_MNOC_TPRB0_SPROF_MAINCTL_ADDR A:0xfc47a008
y.create.l HWIO_MNOC_TPRB0_SPROF_CFGCTL_ADDR A:0xfc47a00c
y.create.l HWIO_MNOC_TPRB0_SPROF_STATPERIOD_ADDR A:0xfc47a024
y.create.l HWIO_MNOC_TPRB0_SPROF_STATGO_ADDR A:0xfc47a028
y.create.l HWIO_MNOC_TPRB0_SPROF_STATALARMMIN_ADDR A:0xfc47a02c
y.create.l HWIO_MNOC_TPRB0_SPROF_STATALARMMAX_ADDR A:0xfc47a030
y.create.l HWIO_MNOC_TPRB0_SPROF_STATALARMSTATUS_ADDR A:0xfc47a034
y.create.l HWIO_MNOC_TPRB0_SPROF_STATALARMCLR_ADDR A:0xfc47a038
y.create.l HWIO_MNOC_TPRB0_SPROF_COUNTERS_0_SRC_ADDR A:0xfc47a138
y.create.l HWIO_MNOC_TPRB0_SPROF_COUNTERS_0_ALARMMODE_ADDR A:0xfc47a13c
y.create.l HWIO_MNOC_TPRB0_SPROF_COUNTERS_0_VAL_ADDR A:0xfc47a140
y.create.l HWIO_MNOC_TPRB0_SPROF_COUNTERS_1_SRC_ADDR A:0xfc47a14c
y.create.l HWIO_MNOC_TPRB0_SPROF_COUNTERS_1_ALARMMODE_ADDR A:0xfc47a150
y.create.l HWIO_MNOC_TPRB0_SPROF_COUNTERS_1_VAL_ADDR A:0xfc47a154
y.create.l HWIO_MNOC_TPRB0_SPROF_COUNTERS_2_SRC_ADDR A:0xfc47a160
y.create.l HWIO_MNOC_TPRB0_SPROF_COUNTERS_2_ALARMMODE_ADDR A:0xfc47a164
y.create.l HWIO_MNOC_TPRB0_SPROF_COUNTERS_2_VAL_ADDR A:0xfc47a168
y.create.l HWIO_MNOC_TPRB0_SPROF_COUNTERS_3_SRC_ADDR A:0xfc47a174
y.create.l HWIO_MNOC_TPRB0_SPROF_COUNTERS_3_ALARMMODE_ADDR A:0xfc47a178
y.create.l HWIO_MNOC_TPRB0_SPROF_COUNTERS_3_VAL_ADDR A:0xfc47a17c
y.create.l HWIO_MNOC_TPRB0_SPROF_COUNTERS_4_SRC_ADDR A:0xfc47a188
y.create.l HWIO_MNOC_TPRB0_SPROF_COUNTERS_4_ALARMMODE_ADDR A:0xfc47a18c
y.create.l HWIO_MNOC_TPRB0_SPROF_COUNTERS_4_VAL_ADDR A:0xfc47a190
y.create.l HWIO_MNOC_TPRB0_SPROF_COUNTERS_5_SRC_ADDR A:0xfc47a19c
y.create.l HWIO_MNOC_TPRB0_SPROF_COUNTERS_5_ALARMMODE_ADDR A:0xfc47a1a0
y.create.l HWIO_MNOC_TPRB0_SPROF_COUNTERS_5_VAL_ADDR A:0xfc47a1a4
y.create.l HWIO_MNOC_TPRB0_SPROF_COUNTERS_6_SRC_ADDR A:0xfc47a1b0
y.create.l HWIO_MNOC_TPRB0_SPROF_COUNTERS_6_ALARMMODE_ADDR A:0xfc47a1b4
y.create.l HWIO_MNOC_TPRB0_SPROF_COUNTERS_6_VAL_ADDR A:0xfc47a1b8
y.create.l HWIO_MNOC_TPRB0_SPROF_COUNTERS_7_SRC_ADDR A:0xfc47a1c4
y.create.l HWIO_MNOC_TPRB0_SPROF_COUNTERS_7_ALARMMODE_ADDR A:0xfc47a1c8
y.create.l HWIO_MNOC_TPRB0_SPROF_COUNTERS_7_VAL_ADDR A:0xfc47a1cc
y.create.l HWIO_MNOC_TPRB0_SPROF_COUNTERS_8_SRC_ADDR A:0xfc47a1d8
y.create.l HWIO_MNOC_TPRB0_SPROF_COUNTERS_8_ALARMMODE_ADDR A:0xfc47a1dc
y.create.l HWIO_MNOC_TPRB0_SPROF_COUNTERS_8_VAL_ADDR A:0xfc47a1e0
y.create.l HWIO_MNOC_TPRB0_SPROF_COUNTERS_9_SRC_ADDR A:0xfc47a1ec
y.create.l HWIO_MNOC_TPRB0_SPROF_COUNTERS_9_ALARMMODE_ADDR A:0xfc47a1f0
y.create.l HWIO_MNOC_TPRB0_SPROF_COUNTERS_9_VAL_ADDR A:0xfc47a1f4
y.create.l HWIO_MNOC_TPRB0_SPROF_COUNTERS_10_SRC_ADDR A:0xfc47a200
y.create.l HWIO_MNOC_TPRB0_SPROF_COUNTERS_10_ALARMMODE_ADDR A:0xfc47a204
y.create.l HWIO_MNOC_TPRB0_SPROF_COUNTERS_10_VAL_ADDR A:0xfc47a208
y.create.l HWIO_MNOC_TPRB0_SPROF_COUNTERS_11_SRC_ADDR A:0xfc47a214
y.create.l HWIO_MNOC_TPRB0_SPROF_COUNTERS_11_ALARMMODE_ADDR A:0xfc47a218
y.create.l HWIO_MNOC_TPRB0_SPROF_COUNTERS_11_VAL_ADDR A:0xfc47a21c
y.create.l HWIO_MNOC_TPRB0_SPROF_COUNTERS_12_SRC_ADDR A:0xfc47a228
y.create.l HWIO_MNOC_TPRB0_SPROF_COUNTERS_12_ALARMMODE_ADDR A:0xfc47a22c
y.create.l HWIO_MNOC_TPRB0_SPROF_COUNTERS_12_VAL_ADDR A:0xfc47a230
y.create.l HWIO_MNOC_TPRB0_SPROF_COUNTERS_13_SRC_ADDR A:0xfc47a23c
y.create.l HWIO_MNOC_TPRB0_SPROF_COUNTERS_13_ALARMMODE_ADDR A:0xfc47a240
y.create.l HWIO_MNOC_TPRB0_SPROF_COUNTERS_13_VAL_ADDR A:0xfc47a244
y.create.l HWIO_MNOC_TPRB0_SPROF_COUNTERS_14_SRC_ADDR A:0xfc47a250
y.create.l HWIO_MNOC_TPRB0_SPROF_COUNTERS_14_ALARMMODE_ADDR A:0xfc47a254
y.create.l HWIO_MNOC_TPRB0_SPROF_COUNTERS_14_VAL_ADDR A:0xfc47a258
y.create.l HWIO_MNOC_TPRB0_SPROF_COUNTERS_15_SRC_ADDR A:0xfc47a264
y.create.l HWIO_MNOC_TPRB0_SPROF_COUNTERS_15_ALARMMODE_ADDR A:0xfc47a268
y.create.l HWIO_MNOC_TPRB0_SPROF_COUNTERS_15_VAL_ADDR A:0xfc47a26c
y.create.l HWIO_MNOC_MDPS_QOS_ID_COREID_ADDR A:0xfc47b000
y.create.l HWIO_MNOC_MDPS_QOS_ID_REVISIONID_ADDR A:0xfc47b004
y.create.l HWIO_MNOC_MDPS_QOS_PRIORITY_ADDR A:0xfc47b008
y.create.l HWIO_MNOC_MDPS_QOS_MODE_ADDR A:0xfc47b00c
y.create.l HWIO_MNOC_MDPS_QOS_BANDWIDTH_ADDR A:0xfc47b010
y.create.l HWIO_MNOC_MDPS_QOS_SATURATION_ADDR A:0xfc47b014
y.create.l HWIO_MNOC_VFE_QOS_ID_COREID_ADDR A:0xfc47b100
y.create.l HWIO_MNOC_VFE_QOS_ID_REVISIONID_ADDR A:0xfc47b104
y.create.l HWIO_MNOC_VFE_QOS_PRIORITY_ADDR A:0xfc47b108
y.create.l HWIO_MNOC_VFE_QOS_MODE_ADDR A:0xfc47b10c
y.create.l HWIO_MNOC_VFE_QOS_BANDWIDTH_ADDR A:0xfc47b110
y.create.l HWIO_MNOC_VFE_QOS_SATURATION_ADDR A:0xfc47b114
y.create.l HWIO_MNOC_MDPE_QOS_ID_COREID_ADDR A:0xfc47b380
y.create.l HWIO_MNOC_MDPE_QOS_ID_REVISIONID_ADDR A:0xfc47b384
y.create.l HWIO_MNOC_MDPE_QOS_PRIORITY_ADDR A:0xfc47b388
y.create.l HWIO_MNOC_MDPE_QOS_MODE_ADDR A:0xfc47b38c
y.create.l HWIO_MNOC_MDPE_QOS_BANDWIDTH_ADDR A:0xfc47b390
y.create.l HWIO_MNOC_MDPE_QOS_SATURATION_ADDR A:0xfc47b394
y.create.l HWIO_MPM2_MPM_PMIC_VDD_ON_CFG_1_ADDR A:0xfc4a0000
y.create.l HWIO_MPM2_MPM_PMIC_VDD_ON_CFG_2_ADDR A:0xfc4a0004
y.create.l HWIO_MPM2_MPM_PMIC_VDD_ON_CFG_3_ADDR A:0xfc4a0008
y.create.l HWIO_MPM2_MPM_PMIC_VDD_ON_CFG_4_ADDR A:0xfc4a000c
y.create.l HWIO_MPM2_MPM_PMIC_VDD_ON_CFG_5_ADDR A:0xfc4a0010
y.create.l HWIO_MPM2_MPM_PMIC_VDD_ON_CFG_6_ADDR A:0xfc4a0014
y.create.l HWIO_MPM2_MPM_PMIC_VDD_ON_CFG_7_ADDR A:0xfc4a0018
y.create.l HWIO_MPM2_MPM_PMIC_VDD_ON_CFG_8_ADDR A:0xfc4a001c
y.create.l HWIO_MPM2_MPM_PMIC_VDD_ON_CFG_9_ADDR A:0xfc4a0020
y.create.l HWIO_MPM2_MPM_PMIC_VDD_ON_CFG_10_ADDR A:0xfc4a0024
y.create.l HWIO_MPM2_MPM_PMIC_VDD_ON_CFG_11_ADDR A:0xfc4a0028
y.create.l HWIO_MPM2_MPM_PMIC_VDD_ON_CFG_12_ADDR A:0xfc4a002c
y.create.l HWIO_MPM2_MPM_PMIC_VDD_OFF_CFG_1_ADDR A:0xfc4a0030
y.create.l HWIO_MPM2_MPM_PMIC_VDD_OFF_CFG_2_ADDR A:0xfc4a0034
y.create.l HWIO_MPM2_MPM_PMIC_VDD_OFF_CFG_3_ADDR A:0xfc4a0038
y.create.l HWIO_MPM2_MPM_PMIC_VDD_OFF_CFG_4_ADDR A:0xfc4a003c
y.create.l HWIO_MPM2_MPM_PMIC_VDD_OFF_CFG_5_ADDR A:0xfc4a0040
y.create.l HWIO_MPM2_MPM_PMIC_VDD_OFF_CFG_6_ADDR A:0xfc4a0044
y.create.l HWIO_MPM2_MPM_PMIC_VDD_OFF_CFG_7_ADDR A:0xfc4a0048
y.create.l HWIO_MPM2_MPM_PMIC_VDD_OFF_CFG_8_ADDR A:0xfc4a004c
y.create.l HWIO_MPM2_MPM_PMIC_VDD_OFF_CFG_9_ADDR A:0xfc4a0050
y.create.l HWIO_MPM2_MPM_PMIC_VDD_OFF_CFG_10_ADDR A:0xfc4a0054
y.create.l HWIO_MPM2_MPM_PMIC_VDD_OFF_CFG_11_ADDR A:0xfc4a0058
y.create.l HWIO_MPM2_MPM_PMIC_VDD_OFF_CFG_12_ADDR A:0xfc4a005c
y.create.l HWIO_MPM2_MPM_SPMI_CMD_CFG_ADDR A:0xfc4a0060
y.create.l HWIO_MPM2_MPM_SPMI_CDIV_CNTRL_ADDR A:0xfc4a0064
y.create.l HWIO_MPM2_MPM_CXO_CTRL_ADDR A:0xfc4a0068
y.create.l HWIO_MPM2_MPM_PXO_OSC_CTRL_ADDR A:0xfc4a006c
y.create.l HWIO_MPM2_MPM_LOW_POWER_CFG_ADDR A:0xfc4a0070
y.create.l HWIO_MPM2_MPM_LOW_POWER_STATUS_ADDR A:0xfc4a0074
y.create.l HWIO_MPM2_MPM_CXO_POWER_RAMPUP_TIME_ADDR A:0xfc4a0078
y.create.l HWIO_MPM2_MPM_PXO_WARMUP_TIME_ADDR A:0xfc4a007c
y.create.l HWIO_MPM2_MPM_HARDWARE_RESTORED_ADDR A:0xfc4a0080
y.create.l HWIO_MPM2_MPM_INT_CLEAR_1_ADDR A:0xfc4a0084
y.create.l HWIO_MPM2_MPM_INT_CLEAR_2_ADDR A:0xfc4a0088
y.create.l HWIO_MPM2_MPM_INT_EN_1_ADDR A:0xfc4a008c
y.create.l HWIO_MPM2_MPM_INT_EN_2_ADDR A:0xfc4a0090
y.create.l HWIO_MPM2_MPM_INT_POLARITY_1_ADDR A:0xfc4a0094
y.create.l HWIO_MPM2_MPM_INT_POLARITY_2_ADDR A:0xfc4a0098
y.create.l HWIO_MPM2_MPM_DETECT_CTL_1_ADDR A:0xfc4a009c
y.create.l HWIO_MPM2_MPM_DETECT_CTL_2_ADDR A:0xfc4a00a0
y.create.l HWIO_MPM2_MPM_DETECT_CTL_3_ADDR A:0xfc4a00a4
y.create.l HWIO_MPM2_MPM_DETECT_CTL_4_ADDR A:0xfc4a00a8
y.create.l HWIO_MPM2_MPM_INT_STATUS_1_ADDR A:0xfc4a00ac
y.create.l HWIO_MPM2_MPM_INT_STATUS_2_ADDR A:0xfc4a00b0
y.create.l HWIO_MPM2_MPM_INT_WKUP_CLK_SEL_1_ADDR A:0xfc4a00b4
y.create.l HWIO_MPM2_MPM_INT_WKUP_CLK_SEL_2_ADDR A:0xfc4a00b8
y.create.l HWIO_MPM2_MPM_DEBUG_BUS_EN_ADDR A:0xfc4a00bc
y.create.l HWIO_MPM2_MPM_PEN_DEBOUNCE_CTL_ADDR A:0xfc4a00c0
y.create.l HWIO_MPM2_MPM_WARM_BOOT_CFG_ADDR A:0xfc4a00c4
y.create.l HWIO_MPM2_MPM_REG0_FILE_ADDR A:0xfc4a00c8
y.create.l HWIO_MPM2_MPM_REG1_FILE_ADDR A:0xfc4a00cc
y.create.l HWIO_MPM2_MPM_REG2_FILE_ADDR A:0xfc4a00d0
y.create.l HWIO_MPM2_MPM_REG3_FILE_ADDR A:0xfc4a00d4
y.create.l HWIO_MPM2_MPM_REG4_FILE_ADDR A:0xfc4a00d8
y.create.l HWIO_MPM2_MPM_REG5_FILE_ADDR A:0xfc4a00dc
y.create.l HWIO_MPM2_MPM_REG6_FILE_ADDR A:0xfc4a00e0
y.create.l HWIO_MPM2_MPM_REG7_FILE_ADDR A:0xfc4a00e4
y.create.l HWIO_MPM2_MPM_REG8_FILE_ADDR A:0xfc4a00e8
y.create.l HWIO_MPM2_MPM_CNTR_CLK_CONTROL_ADDR A:0xfc4a00ec
y.create.l HWIO_MPM2_MPM_CNTR_FRAC_ADDR A:0xfc4a00f0
y.create.l HWIO_MPM2_MPM_CNTR_INCR_DATA_ADDR A:0xfc4a00f4
y.create.l HWIO_MPM2_MPM_HW_ID_ADDR A:0xfc4a00f8
y.create.l HWIO_MPM2_MPM_CONTROL_CNTCR_ADDR A:0xfc4a1000
y.create.l HWIO_MPM2_MPM_CONTROL_CNTSR_ADDR A:0xfc4a1004
y.create.l HWIO_MPM2_MPM_CONTROL_CNTCV_LO_ADDR A:0xfc4a1008
y.create.l HWIO_MPM2_MPM_CONTROL_CNTCV_HI_ADDR A:0xfc4a100c
y.create.l HWIO_MPM2_MPM_CONTROL_CNTFID0_ADDR A:0xfc4a1020
y.create.l HWIO_MPM2_MPM_CONTROL_ID_ADDR A:0xfc4a1fd0
y.create.l HWIO_MPM2_MPM_READ_CNTCV_LO_ADDR A:0xfc4a2000
y.create.l HWIO_MPM2_MPM_READ_CNTCV_HI_ADDR A:0xfc4a2004
y.create.l HWIO_MPM2_MPM_READ_ID_ADDR A:0xfc4a2fd0
y.create.l HWIO_MPM2_MPM_SLEEP_TIMETICK_COUNT_VAL_ADDR A:0xfc4a3000
y.create.l HWIO_MPM2_QTMR_AC_CNTFRQ_ADDR A:0xfc4a4000
y.create.l HWIO_MPM2_QTMR_AC_CNTSR_ADDR A:0xfc4a4004
y.create.l HWIO_MPM2_QTMR_AC_CNTTID_ADDR A:0xfc4a4008
y.create.l HWIO_MPM2_QTMR_AC_CNTACR_0_ADDR A:0xfc4a4040
y.create.l HWIO_MPM2_QTMR_AC_CNTVOFF_LO_0_ADDR A:0xfc4a4080
y.create.l HWIO_MPM2_QTMR_AC_CNTVOFF_HI_0_ADDR A:0xfc4a4084
y.create.l HWIO_MPM2_QTMR_AC_CFG_ADDR A:0xfc4a4fc0
y.create.l HWIO_MPM2_QTMR_AC_VERSION_ADDR A:0xfc4a4fd0
y.create.l HWIO_MPM2_QTMR_V1_CNTPCT_LO_ADDR A:0xfc4a5000
y.create.l HWIO_MPM2_QTMR_V1_CNTPCT_HI_ADDR A:0xfc4a5004
y.create.l HWIO_MPM2_QTMR_V1_CNTVCT_LO_ADDR A:0xfc4a5008
y.create.l HWIO_MPM2_QTMR_V1_CNTVCT_HI_ADDR A:0xfc4a500c
y.create.l HWIO_MPM2_QTMR_V1_CNTFRQ_ADDR A:0xfc4a5010
y.create.l HWIO_MPM2_QTMR_V1_CNTPL0ACR_ADDR A:0xfc4a5014
y.create.l HWIO_MPM2_QTMR_V1_CNTVOFF_LO_ADDR A:0xfc4a5018
y.create.l HWIO_MPM2_QTMR_V1_CNTVOFF_HI_ADDR A:0xfc4a501c
y.create.l HWIO_MPM2_QTMR_V1_CNTP_CVAL_LO_ADDR A:0xfc4a5020
y.create.l HWIO_MPM2_QTMR_V1_CNTP_CVAL_HI_ADDR A:0xfc4a5024
y.create.l HWIO_MPM2_QTMR_V1_CNTP_TVAL_ADDR A:0xfc4a5028
y.create.l HWIO_MPM2_QTMR_V1_CNTP_CTL_ADDR A:0xfc4a502c
y.create.l HWIO_MPM2_QTMR_V1_CNTV_CVAL_LO_ADDR A:0xfc4a5030
y.create.l HWIO_MPM2_QTMR_V1_CNTV_CVAL_HI_ADDR A:0xfc4a5034
y.create.l HWIO_MPM2_QTMR_V1_CNTV_TVAL_ADDR A:0xfc4a5038
y.create.l HWIO_MPM2_QTMR_V1_CNTV_CTL_ADDR A:0xfc4a503c
y.create.l HWIO_MPM2_QTMR_V1_VERSION_ADDR A:0xfc4a5fd0
y.create.l HWIO_MPM2_MPM_TSYNC_CTL_ADDR A:0xfc4a6000
y.create.l HWIO_MPM2_MPM_TSYNC_CMD_ADDR A:0xfc4a6004
y.create.l HWIO_MPM2_MPM_TSYNC_START_ADDR A:0xfc4a6008
y.create.l HWIO_MPM2_MPM_TSYNC_START_PHASE_ADDR A:0xfc4a600c
y.create.l HWIO_MPM2_MPM_TSYNC_PERIOD_ADDR A:0xfc4a6010
y.create.l HWIO_MPM2_MPM_TSYNC_PERIOD_PHASE_ADDR A:0xfc4a6014
y.create.l HWIO_MPM2_MPM_TSYNC_STATUS_TIME_ADDR A:0xfc4a6018
y.create.l HWIO_MPM2_MPM_TSYNC_STATUS_PHASE_ADDR A:0xfc4a601c
y.create.l HWIO_MPM2_MPM_GRFC_CXO_EN_ADDR A:0xfc4a6020
y.create.l HWIO_MPM2_XPU_SCR_ADDR A:0xfc4a7000
y.create.l HWIO_MPM2_XPU_SWDR_ADDR A:0xfc4a7004
y.create.l HWIO_MPM2_XPU_SEAR0_ADDR A:0xfc4a7040
y.create.l HWIO_MPM2_XPU_SESR_ADDR A:0xfc4a7048
y.create.l HWIO_MPM2_XPU_SESRRESTORE_ADDR A:0xfc4a704c
y.create.l HWIO_MPM2_XPU_SESYNR0_ADDR A:0xfc4a7050
y.create.l HWIO_MPM2_XPU_SESYNR1_ADDR A:0xfc4a7054
y.create.l HWIO_MPM2_XPU_SESYNR2_ADDR A:0xfc4a7058
y.create.l HWIO_MPM2_XPU_MCR_ADDR A:0xfc4a7100
y.create.l HWIO_MPM2_XPU_MEAR0_ADDR A:0xfc4a7140
y.create.l HWIO_MPM2_XPU_MESR_ADDR A:0xfc4a7148
y.create.l HWIO_MPM2_XPU_MESRRESTORE_ADDR A:0xfc4a714c
y.create.l HWIO_MPM2_XPU_MESYNR0_ADDR A:0xfc4a7150
y.create.l HWIO_MPM2_XPU_MESYNR1_ADDR A:0xfc4a7154
y.create.l HWIO_MPM2_XPU_MESYNR2_ADDR A:0xfc4a7158
y.create.l HWIO_MPM2_XPU_CR_ADDR A:0xfc4a7080
y.create.l HWIO_MPM2_XPU_RPU_ACR0_ADDR A:0xfc4a70a0
y.create.l HWIO_MPM2_XPU_EAR0_ADDR A:0xfc4a70c0
y.create.l HWIO_MPM2_XPU_ESR_ADDR A:0xfc4a70c8
y.create.l HWIO_MPM2_XPU_ESRRESTORE_ADDR A:0xfc4a70cc
y.create.l HWIO_MPM2_XPU_ESYNR0_ADDR A:0xfc4a70d0
y.create.l HWIO_MPM2_XPU_ESYNR1_ADDR A:0xfc4a70d4
y.create.l HWIO_MPM2_XPU_ESYNR2_ADDR A:0xfc4a70d8
y.create.l HWIO_MPM2_XPU_IDR0_ADDR A:0xfc4a7074
y.create.l HWIO_MPM2_XPU_IDR1_ADDR A:0xfc4a7078
y.create.l HWIO_MPM2_XPU_REV_ADDR A:0xfc4a707c
y.create.l HWIO_MPM2_XPU_RG0_RACR0_ADDR A:0xfc4a7200
y.create.l HWIO_MPM2_XPU_RG1_RACR0_ADDR A:0xfc4a7280
y.create.l HWIO_MPM2_XPU_RG2_RACR0_ADDR A:0xfc4a7300
y.create.l HWIO_MPM2_XPU_RG3_RACR0_ADDR A:0xfc4a7380
y.create.l HWIO_MPM2_XPU_RG4_RACR0_ADDR A:0xfc4a7400
y.create.l HWIO_MPM2_XPU_RG5_RACR0_ADDR A:0xfc4a7480
y.create.l HWIO_MPM2_XPU_RG6_RACR0_ADDR A:0xfc4a7500
y.create.l HWIO_MPM2_XPU_RG7_RACR0_ADDR A:0xfc4a7580
y.create.l HWIO_MPM2_XPU_RG8_RACR0_ADDR A:0xfc4a7600
y.create.l HWIO_MPM2_XPU_RG9_RACR0_ADDR A:0xfc4a7680
y.create.l HWIO_MPM2_XPU_RG0_SCR_ADDR A:0xfc4a7250
y.create.l HWIO_MPM2_XPU_RG1_SCR_ADDR A:0xfc4a72d0
y.create.l HWIO_MPM2_XPU_RG2_SCR_ADDR A:0xfc4a7350
y.create.l HWIO_MPM2_XPU_RG3_SCR_ADDR A:0xfc4a73d0
y.create.l HWIO_MPM2_XPU_RG4_SCR_ADDR A:0xfc4a7450
y.create.l HWIO_MPM2_XPU_RG5_SCR_ADDR A:0xfc4a74d0
y.create.l HWIO_MPM2_XPU_RG6_SCR_ADDR A:0xfc4a7550
y.create.l HWIO_MPM2_XPU_RG7_SCR_ADDR A:0xfc4a75d0
y.create.l HWIO_MPM2_XPU_RG8_SCR_ADDR A:0xfc4a7650
y.create.l HWIO_MPM2_XPU_RG9_SCR_ADDR A:0xfc4a76d0
y.create.l HWIO_MPM2_XPU_RG0_MCR_ADDR A:0xfc4a7254
y.create.l HWIO_MPM2_XPU_RG1_MCR_ADDR A:0xfc4a72d4
y.create.l HWIO_MPM2_XPU_RG2_MCR_ADDR A:0xfc4a7354
y.create.l HWIO_MPM2_XPU_RG3_MCR_ADDR A:0xfc4a73d4
y.create.l HWIO_MPM2_XPU_RG4_MCR_ADDR A:0xfc4a7454
y.create.l HWIO_MPM2_XPU_RG5_MCR_ADDR A:0xfc4a74d4
y.create.l HWIO_MPM2_XPU_RG6_MCR_ADDR A:0xfc4a7554
y.create.l HWIO_MPM2_XPU_RG7_MCR_ADDR A:0xfc4a75d4
y.create.l HWIO_MPM2_XPU_RG8_MCR_ADDR A:0xfc4a7654
y.create.l HWIO_MPM2_XPU_RG9_MCR_ADDR A:0xfc4a76d4
y.create.l HWIO_MPM2_TSENS_CTRL_ADDR A:0xfc4a8000
y.create.l HWIO_MPM2_TSENS_TEST_CTRL_ADDR A:0xfc4a8004
y.create.l HWIO_MPM2_TSENS_S0_MIN_MAX_STATUS_CTRL_ADDR A:0xfc4a8008
y.create.l HWIO_MPM2_TSENS_S1_MIN_MAX_STATUS_CTRL_ADDR A:0xfc4a800c
y.create.l HWIO_MPM2_TSENS_S2_MIN_MAX_STATUS_CTRL_ADDR A:0xfc4a8010
y.create.l HWIO_MPM2_TSENS_S3_MIN_MAX_STATUS_CTRL_ADDR A:0xfc4a8014
y.create.l HWIO_MPM2_TSENS_S4_MIN_MAX_STATUS_CTRL_ADDR A:0xfc4a8018
y.create.l HWIO_MPM2_TSENS_S5_MIN_MAX_STATUS_CTRL_ADDR A:0xfc4a801c
y.create.l HWIO_MPM2_TSENS_S6_MIN_MAX_STATUS_CTRL_ADDR A:0xfc4a8020
y.create.l HWIO_MPM2_TSENS_S7_MIN_MAX_STATUS_CTRL_ADDR A:0xfc4a8024
y.create.l HWIO_MPM2_TSENS_S8_MIN_MAX_STATUS_CTRL_ADDR A:0xfc4a8028
y.create.l HWIO_MPM2_TSENS_S9_MIN_MAX_STATUS_CTRL_ADDR A:0xfc4a802c
y.create.l HWIO_MPM2_TSENS_GLOBAL_CONFIG_ADDR A:0xfc4a8034
y.create.l HWIO_MPM2_TSENS_S0_MAIN_CONFIG_ADDR A:0xfc4a8038
y.create.l HWIO_MPM2_TSENS_S1_REMOTE_CONFIG_ADDR A:0xfc4a8040
y.create.l HWIO_MPM2_TSENS_S2_REMOTE_CONFIG_ADDR A:0xfc4a8044
y.create.l HWIO_MPM2_TSENS_S3_REMOTE_CONFIG_ADDR A:0xfc4a8048
y.create.l HWIO_MPM2_TSENS_S4_REMOTE_CONFIG_ADDR A:0xfc4a804c
y.create.l HWIO_MPM2_TSENS_S5_REMOTE_CONFIG_ADDR A:0xfc4a8050
y.create.l HWIO_MPM2_TSENS_S6_REMOTE_CONFIG_ADDR A:0xfc4a8054
y.create.l HWIO_MPM2_TSENS_S7_REMOTE_CONFIG_ADDR A:0xfc4a8058
y.create.l HWIO_MPM2_TSENS_S8_REMOTE_CONFIG_ADDR A:0xfc4a805c
y.create.l HWIO_MPM2_TSENS_S9_REMOTE_CONFIG_ADDR A:0xfc4a8060
y.create.l HWIO_MPM2_TSENS_S10_REMOTE_CONFIG_ADDR A:0xfc4a8064
y.create.l HWIO_MPM2_TSENS_UPPER_LOWER_INTERRUPT_CTRL_ADDR A:0xfc4a9000
y.create.l HWIO_MPM2_TSENS_S0_UPPER_LOWER_STATUS_CTRL_ADDR A:0xfc4a9004
y.create.l HWIO_MPM2_TSENS_S1_UPPER_LOWER_STATUS_CTRL_ADDR A:0xfc4a9008
y.create.l HWIO_MPM2_TSENS_S2_UPPER_LOWER_STATUS_CTRL_ADDR A:0xfc4a900c
y.create.l HWIO_MPM2_TSENS_S3_UPPER_LOWER_STATUS_CTRL_ADDR A:0xfc4a9010
y.create.l HWIO_MPM2_TSENS_S4_UPPER_LOWER_STATUS_CTRL_ADDR A:0xfc4a9014
y.create.l HWIO_MPM2_TSENS_S5_UPPER_LOWER_STATUS_CTRL_ADDR A:0xfc4a9018
y.create.l HWIO_MPM2_TSENS_S6_UPPER_LOWER_STATUS_CTRL_ADDR A:0xfc4a901c
y.create.l HWIO_MPM2_TSENS_S7_UPPER_LOWER_STATUS_CTRL_ADDR A:0xfc4a9020
y.create.l HWIO_MPM2_TSENS_S8_UPPER_LOWER_STATUS_CTRL_ADDR A:0xfc4a9024
y.create.l HWIO_MPM2_TSENS_S9_UPPER_LOWER_STATUS_CTRL_ADDR A:0xfc4a9028
y.create.l HWIO_MPM2_TSENS_S0_STATUS_ADDR A:0xfc4a9030
y.create.l HWIO_MPM2_TSENS_S1_STATUS_ADDR A:0xfc4a9034
y.create.l HWIO_MPM2_TSENS_S2_STATUS_ADDR A:0xfc4a9038
y.create.l HWIO_MPM2_TSENS_S3_STATUS_ADDR A:0xfc4a903c
y.create.l HWIO_MPM2_TSENS_S4_STATUS_ADDR A:0xfc4a9040
y.create.l HWIO_MPM2_TSENS_S5_STATUS_ADDR A:0xfc4a9044
y.create.l HWIO_MPM2_TSENS_S6_STATUS_ADDR A:0xfc4a9048
y.create.l HWIO_MPM2_TSENS_S7_STATUS_ADDR A:0xfc4a904c
y.create.l HWIO_MPM2_TSENS_S8_STATUS_ADDR A:0xfc4a9050
y.create.l HWIO_MPM2_TSENS_S9_STATUS_ADDR A:0xfc4a9054
y.create.l HWIO_MPM2_TSENS_TRDY_ADDR A:0xfc4a905c
y.create.l HWIO_MPM2_WDOG_RESET_REG_ADDR A:0xfc4aa000
y.create.l HWIO_MPM2_WDOG_CTL_REG_ADDR A:0xfc4aa004
y.create.l HWIO_MPM2_WDOG_STATUS_REG_ADDR A:0xfc4aa008
y.create.l HWIO_MPM2_WDOG_BARK_VAL_REG_ADDR A:0xfc4aa00c
y.create.l HWIO_MPM2_WDOG_BITE_VAL_REG_ADDR A:0xfc4aa010
y.create.l HWIO_MPM2_MPM_PS_HOLD_ADDR A:0xfc4ab000
y.create.l HWIO_MSS_XPU_SCR_ADDR A:0xfc800000
y.create.l HWIO_MSS_XPU_SWDR_ADDR A:0xfc800004
y.create.l HWIO_MSS_XPU_SEAR0_ADDR A:0xfc800040
y.create.l HWIO_MSS_XPU_SESR_ADDR A:0xfc800048
y.create.l HWIO_MSS_XPU_SESRRESTORE_ADDR A:0xfc80004c
y.create.l HWIO_MSS_XPU_SESYNR0_ADDR A:0xfc800050
y.create.l HWIO_MSS_XPU_SESYNR1_ADDR A:0xfc800054
y.create.l HWIO_MSS_XPU_SESYNR2_ADDR A:0xfc800058
y.create.l HWIO_MSS_XPU_MCR_ADDR A:0xfc800100
y.create.l HWIO_MSS_XPU_MEAR0_ADDR A:0xfc800140
y.create.l HWIO_MSS_XPU_MESR_ADDR A:0xfc800148
y.create.l HWIO_MSS_XPU_MESRRESTORE_ADDR A:0xfc80014c
y.create.l HWIO_MSS_XPU_MESYNR0_ADDR A:0xfc800150
y.create.l HWIO_MSS_XPU_MESYNR1_ADDR A:0xfc800154
y.create.l HWIO_MSS_XPU_MESYNR2_ADDR A:0xfc800158
y.create.l HWIO_MSS_XPU_CR_ADDR A:0xfc800080
y.create.l HWIO_MSS_XPU_RPU_ACR0_ADDR A:0xfc8000a0
y.create.l HWIO_MSS_XPU_EAR0_ADDR A:0xfc8000c0
y.create.l HWIO_MSS_XPU_ESR_ADDR A:0xfc8000c8
y.create.l HWIO_MSS_XPU_ESRRESTORE_ADDR A:0xfc8000cc
y.create.l HWIO_MSS_XPU_ESYNR0_ADDR A:0xfc8000d0
y.create.l HWIO_MSS_XPU_ESYNR1_ADDR A:0xfc8000d4
y.create.l HWIO_MSS_XPU_ESYNR2_ADDR A:0xfc8000d8
y.create.l HWIO_MSS_XPU_IDR0_ADDR A:0xfc800074
y.create.l HWIO_MSS_XPU_IDR1_ADDR A:0xfc800078
y.create.l HWIO_MSS_XPU_REV_ADDR A:0xfc80007c
y.create.l HWIO_MSS_XPU_RG0_RACR0_ADDR A:0xfc800200
y.create.l HWIO_MSS_XPU_RG1_RACR0_ADDR A:0xfc800280
y.create.l HWIO_MSS_XPU_RG2_RACR0_ADDR A:0xfc800300
y.create.l HWIO_MSS_XPU_RG3_RACR0_ADDR A:0xfc800380
y.create.l HWIO_MSS_XPU_RG4_RACR0_ADDR A:0xfc800400
y.create.l HWIO_MSS_XPU_RG0_SCR_ADDR A:0xfc800250
y.create.l HWIO_MSS_XPU_RG1_SCR_ADDR A:0xfc8002d0
y.create.l HWIO_MSS_XPU_RG2_SCR_ADDR A:0xfc800350
y.create.l HWIO_MSS_XPU_RG3_SCR_ADDR A:0xfc8003d0
y.create.l HWIO_MSS_XPU_RG4_SCR_ADDR A:0xfc800450
y.create.l HWIO_MSS_XPU_RG0_MCR_ADDR A:0xfc800254
y.create.l HWIO_MSS_XPU_RG1_MCR_ADDR A:0xfc8002d4
y.create.l HWIO_MSS_XPU_RG2_MCR_ADDR A:0xfc800354
y.create.l HWIO_MSS_XPU_RG3_MCR_ADDR A:0xfc8003d4
y.create.l HWIO_MSS_XPU_RG4_MCR_ADDR A:0xfc800454
y.create.l HWIO_MSS_MODEM_VMIDMT_SCR0_ADDR A:0xfc808000
y.create.l HWIO_MSS_MODEM_VMIDMT_SCR1_ADDR A:0xfc808004
y.create.l HWIO_MSS_MODEM_VMIDMT_SCR2_ADDR A:0xfc808008
y.create.l HWIO_MSS_MODEM_VMIDMT_SACR_ADDR A:0xfc808010
y.create.l HWIO_MSS_MODEM_VMIDMT_SIDR0_ADDR A:0xfc808020
y.create.l HWIO_MSS_MODEM_VMIDMT_SIDR1_ADDR A:0xfc808024
y.create.l HWIO_MSS_MODEM_VMIDMT_SIDR2_ADDR A:0xfc808028
y.create.l HWIO_MSS_MODEM_VMIDMT_SIDR4_ADDR A:0xfc808030
y.create.l HWIO_MSS_MODEM_VMIDMT_SIDR5_ADDR A:0xfc808034
y.create.l HWIO_MSS_MODEM_VMIDMT_SIDR7_ADDR A:0xfc80803c
y.create.l HWIO_MSS_MODEM_VMIDMT_SGFAR0_ADDR A:0xfc808040
y.create.l HWIO_MSS_MODEM_VMIDMT_SGFSR_ADDR A:0xfc808048
y.create.l HWIO_MSS_MODEM_VMIDMT_SGFSRRESTORE_ADDR A:0xfc80804c
y.create.l HWIO_MSS_MODEM_VMIDMT_SGFSYNDR0_ADDR A:0xfc808050
y.create.l HWIO_MSS_MODEM_VMIDMT_SGFSYNDR1_ADDR A:0xfc808054
y.create.l HWIO_MSS_MODEM_VMIDMT_SGFSYNDR2_ADDR A:0xfc808058
y.create.l HWIO_MSS_MODEM_VMIDMT_VMIDMTSCR0_ADDR A:0xfc808090
y.create.l HWIO_MSS_MODEM_VMIDMT_CR0_ADDR A:0xfc808000
y.create.l HWIO_MSS_MODEM_VMIDMT_CR2_ADDR A:0xfc808008
y.create.l HWIO_MSS_MODEM_VMIDMT_ACR_ADDR A:0xfc808010
y.create.l HWIO_MSS_MODEM_VMIDMT_IDR0_ADDR A:0xfc808020
y.create.l HWIO_MSS_MODEM_VMIDMT_IDR1_ADDR A:0xfc808024
y.create.l HWIO_MSS_MODEM_VMIDMT_IDR2_ADDR A:0xfc808028
y.create.l HWIO_MSS_MODEM_VMIDMT_IDR4_ADDR A:0xfc808030
y.create.l HWIO_MSS_MODEM_VMIDMT_IDR5_ADDR A:0xfc808034
y.create.l HWIO_MSS_MODEM_VMIDMT_IDR7_ADDR A:0xfc80803c
y.create.l HWIO_MSS_MODEM_VMIDMT_GFAR0_ADDR A:0xfc808040
y.create.l HWIO_MSS_MODEM_VMIDMT_GFSR_ADDR A:0xfc808048
y.create.l HWIO_MSS_MODEM_VMIDMT_GFSRRESTORE_ADDR A:0xfc80804c
y.create.l HWIO_MSS_MODEM_VMIDMT_GFSYNDR0_ADDR A:0xfc808050
y.create.l HWIO_MSS_MODEM_VMIDMT_GFSYNDR1_ADDR A:0xfc808054
y.create.l HWIO_MSS_MODEM_VMIDMT_GFSYNDR2_ADDR A:0xfc808058
y.create.l HWIO_MSS_MODEM_VMIDMT_VMIDMTCR0_ADDR A:0xfc808090
y.create.l HWIO_MSS_MODEM_VMIDMT_VMIDMTACR_ADDR A:0xfc80809c
y.create.l HWIO_MSS_MODEM_VMIDMT_NSCR0_ADDR A:0xfc808400
y.create.l HWIO_MSS_MODEM_VMIDMT_NSCR2_ADDR A:0xfc808408
y.create.l HWIO_MSS_MODEM_VMIDMT_NSACR_ADDR A:0xfc808410
y.create.l HWIO_MSS_MODEM_VMIDMT_NSGFAR0_ADDR A:0xfc808440
y.create.l HWIO_MSS_MODEM_VMIDMT_NSGFSR_ADDR A:0xfc808448
y.create.l HWIO_MSS_MODEM_VMIDMT_NSGFSRRESTORE_ADDR A:0xfc80844c
y.create.l HWIO_MSS_MODEM_VMIDMT_NSGFSYNDR0_ADDR A:0xfc808450
y.create.l HWIO_MSS_MODEM_VMIDMT_NSGFSYNDR1_ADDR A:0xfc808454
y.create.l HWIO_MSS_MODEM_VMIDMT_NSGFSYNDR2_ADDR A:0xfc808458
y.create.l HWIO_MSS_MODEM_VMIDMT_NSVMIDMTCR0_ADDR A:0xfc808490
y.create.l HWIO_MSS_MODEM_VMIDMT_SSDR0_ADDR A:0xfc808080
y.create.l HWIO_MSS_MODEM_VMIDMT_S2VR0_ADDR A:0xfc808c00
y.create.l HWIO_MSS_MODEM_VMIDMT_S2VR1_ADDR A:0xfc808c04
y.create.l HWIO_MSS_MODEM_VMIDMT_AS2VR0_ADDR A:0xfc808e00
y.create.l HWIO_MSS_MODEM_VMIDMT_AS2VR1_ADDR A:0xfc808e04
y.create.l HWIO_MSS_NAV_VMIDMT_SCR0_ADDR A:0xfc810000
y.create.l HWIO_MSS_NAV_VMIDMT_SCR1_ADDR A:0xfc810004
y.create.l HWIO_MSS_NAV_VMIDMT_SCR2_ADDR A:0xfc810008
y.create.l HWIO_MSS_NAV_VMIDMT_SACR_ADDR A:0xfc810010
y.create.l HWIO_MSS_NAV_VMIDMT_SIDR0_ADDR A:0xfc810020
y.create.l HWIO_MSS_NAV_VMIDMT_SIDR1_ADDR A:0xfc810024
y.create.l HWIO_MSS_NAV_VMIDMT_SIDR2_ADDR A:0xfc810028
y.create.l HWIO_MSS_NAV_VMIDMT_SIDR4_ADDR A:0xfc810030
y.create.l HWIO_MSS_NAV_VMIDMT_SIDR5_ADDR A:0xfc810034
y.create.l HWIO_MSS_NAV_VMIDMT_SIDR7_ADDR A:0xfc81003c
y.create.l HWIO_MSS_NAV_VMIDMT_SGFAR0_ADDR A:0xfc810040
y.create.l HWIO_MSS_NAV_VMIDMT_SGFSR_ADDR A:0xfc810048
y.create.l HWIO_MSS_NAV_VMIDMT_SGFSRRESTORE_ADDR A:0xfc81004c
y.create.l HWIO_MSS_NAV_VMIDMT_SGFSYNDR0_ADDR A:0xfc810050
y.create.l HWIO_MSS_NAV_VMIDMT_SGFSYNDR1_ADDR A:0xfc810054
y.create.l HWIO_MSS_NAV_VMIDMT_SGFSYNDR2_ADDR A:0xfc810058
y.create.l HWIO_MSS_NAV_VMIDMT_VMIDMTSCR0_ADDR A:0xfc810090
y.create.l HWIO_MSS_NAV_VMIDMT_CR0_ADDR A:0xfc810000
y.create.l HWIO_MSS_NAV_VMIDMT_CR2_ADDR A:0xfc810008
y.create.l HWIO_MSS_NAV_VMIDMT_ACR_ADDR A:0xfc810010
y.create.l HWIO_MSS_NAV_VMIDMT_IDR0_ADDR A:0xfc810020
y.create.l HWIO_MSS_NAV_VMIDMT_IDR1_ADDR A:0xfc810024
y.create.l HWIO_MSS_NAV_VMIDMT_IDR2_ADDR A:0xfc810028
y.create.l HWIO_MSS_NAV_VMIDMT_IDR4_ADDR A:0xfc810030
y.create.l HWIO_MSS_NAV_VMIDMT_IDR5_ADDR A:0xfc810034
y.create.l HWIO_MSS_NAV_VMIDMT_IDR7_ADDR A:0xfc81003c
y.create.l HWIO_MSS_NAV_VMIDMT_GFAR0_ADDR A:0xfc810040
y.create.l HWIO_MSS_NAV_VMIDMT_GFSR_ADDR A:0xfc810048
y.create.l HWIO_MSS_NAV_VMIDMT_GFSRRESTORE_ADDR A:0xfc81004c
y.create.l HWIO_MSS_NAV_VMIDMT_GFSYNDR0_ADDR A:0xfc810050
y.create.l HWIO_MSS_NAV_VMIDMT_GFSYNDR1_ADDR A:0xfc810054
y.create.l HWIO_MSS_NAV_VMIDMT_GFSYNDR2_ADDR A:0xfc810058
y.create.l HWIO_MSS_NAV_VMIDMT_VMIDMTCR0_ADDR A:0xfc810090
y.create.l HWIO_MSS_NAV_VMIDMT_VMIDMTACR_ADDR A:0xfc81009c
y.create.l HWIO_MSS_NAV_VMIDMT_NSCR0_ADDR A:0xfc810400
y.create.l HWIO_MSS_NAV_VMIDMT_NSCR2_ADDR A:0xfc810408
y.create.l HWIO_MSS_NAV_VMIDMT_NSACR_ADDR A:0xfc810410
y.create.l HWIO_MSS_NAV_VMIDMT_NSGFAR0_ADDR A:0xfc810440
y.create.l HWIO_MSS_NAV_VMIDMT_NSGFSR_ADDR A:0xfc810448
y.create.l HWIO_MSS_NAV_VMIDMT_NSGFSRRESTORE_ADDR A:0xfc81044c
y.create.l HWIO_MSS_NAV_VMIDMT_NSGFSYNDR0_ADDR A:0xfc810450
y.create.l HWIO_MSS_NAV_VMIDMT_NSGFSYNDR1_ADDR A:0xfc810454
y.create.l HWIO_MSS_NAV_VMIDMT_NSGFSYNDR2_ADDR A:0xfc810458
y.create.l HWIO_MSS_NAV_VMIDMT_NSVMIDMTCR0_ADDR A:0xfc810490
y.create.l HWIO_MSS_NAV_VMIDMT_SSDR0_ADDR A:0xfc810080
y.create.l HWIO_MSS_NAV_VMIDMT_S2VR0_ADDR A:0xfc810c00
y.create.l HWIO_MSS_NAV_VMIDMT_AS2VR0_ADDR A:0xfc810e00
y.create.l HWIO_MSS_Q6_VMIDMT_SCR0_ADDR A:0xfc818000
y.create.l HWIO_MSS_Q6_VMIDMT_SCR1_ADDR A:0xfc818004
y.create.l HWIO_MSS_Q6_VMIDMT_SCR2_ADDR A:0xfc818008
y.create.l HWIO_MSS_Q6_VMIDMT_SACR_ADDR A:0xfc818010
y.create.l HWIO_MSS_Q6_VMIDMT_SIDR0_ADDR A:0xfc818020
y.create.l HWIO_MSS_Q6_VMIDMT_SIDR1_ADDR A:0xfc818024
y.create.l HWIO_MSS_Q6_VMIDMT_SIDR2_ADDR A:0xfc818028
y.create.l HWIO_MSS_Q6_VMIDMT_SIDR4_ADDR A:0xfc818030
y.create.l HWIO_MSS_Q6_VMIDMT_SIDR5_ADDR A:0xfc818034
y.create.l HWIO_MSS_Q6_VMIDMT_SIDR7_ADDR A:0xfc81803c
y.create.l HWIO_MSS_Q6_VMIDMT_SGFAR0_ADDR A:0xfc818040
y.create.l HWIO_MSS_Q6_VMIDMT_SGFSR_ADDR A:0xfc818048
y.create.l HWIO_MSS_Q6_VMIDMT_SGFSRRESTORE_ADDR A:0xfc81804c
y.create.l HWIO_MSS_Q6_VMIDMT_SGFSYNDR0_ADDR A:0xfc818050
y.create.l HWIO_MSS_Q6_VMIDMT_SGFSYNDR1_ADDR A:0xfc818054
y.create.l HWIO_MSS_Q6_VMIDMT_SGFSYNDR2_ADDR A:0xfc818058
y.create.l HWIO_MSS_Q6_VMIDMT_VMIDMTSCR0_ADDR A:0xfc818090
y.create.l HWIO_MSS_Q6_VMIDMT_CR0_ADDR A:0xfc818000
y.create.l HWIO_MSS_Q6_VMIDMT_CR2_ADDR A:0xfc818008
y.create.l HWIO_MSS_Q6_VMIDMT_ACR_ADDR A:0xfc818010
y.create.l HWIO_MSS_Q6_VMIDMT_IDR0_ADDR A:0xfc818020
y.create.l HWIO_MSS_Q6_VMIDMT_IDR1_ADDR A:0xfc818024
y.create.l HWIO_MSS_Q6_VMIDMT_IDR2_ADDR A:0xfc818028
y.create.l HWIO_MSS_Q6_VMIDMT_IDR4_ADDR A:0xfc818030
y.create.l HWIO_MSS_Q6_VMIDMT_IDR5_ADDR A:0xfc818034
y.create.l HWIO_MSS_Q6_VMIDMT_IDR7_ADDR A:0xfc81803c
y.create.l HWIO_MSS_Q6_VMIDMT_GFAR0_ADDR A:0xfc818040
y.create.l HWIO_MSS_Q6_VMIDMT_GFSR_ADDR A:0xfc818048
y.create.l HWIO_MSS_Q6_VMIDMT_GFSRRESTORE_ADDR A:0xfc81804c
y.create.l HWIO_MSS_Q6_VMIDMT_GFSYNDR0_ADDR A:0xfc818050
y.create.l HWIO_MSS_Q6_VMIDMT_GFSYNDR1_ADDR A:0xfc818054
y.create.l HWIO_MSS_Q6_VMIDMT_GFSYNDR2_ADDR A:0xfc818058
y.create.l HWIO_MSS_Q6_VMIDMT_VMIDMTCR0_ADDR A:0xfc818090
y.create.l HWIO_MSS_Q6_VMIDMT_VMIDMTACR_ADDR A:0xfc81809c
y.create.l HWIO_MSS_Q6_VMIDMT_NSCR0_ADDR A:0xfc818400
y.create.l HWIO_MSS_Q6_VMIDMT_NSCR2_ADDR A:0xfc818408
y.create.l HWIO_MSS_Q6_VMIDMT_NSACR_ADDR A:0xfc818410
y.create.l HWIO_MSS_Q6_VMIDMT_NSGFAR0_ADDR A:0xfc818440
y.create.l HWIO_MSS_Q6_VMIDMT_NSGFSR_ADDR A:0xfc818448
y.create.l HWIO_MSS_Q6_VMIDMT_NSGFSRRESTORE_ADDR A:0xfc81844c
y.create.l HWIO_MSS_Q6_VMIDMT_NSGFSYNDR0_ADDR A:0xfc818450
y.create.l HWIO_MSS_Q6_VMIDMT_NSGFSYNDR1_ADDR A:0xfc818454
y.create.l HWIO_MSS_Q6_VMIDMT_NSGFSYNDR2_ADDR A:0xfc818458
y.create.l HWIO_MSS_Q6_VMIDMT_NSVMIDMTCR0_ADDR A:0xfc818490
y.create.l HWIO_MSS_Q6_VMIDMT_SSDR0_ADDR A:0xfc818080
y.create.l HWIO_MSS_Q6_VMIDMT_S2VR0_ADDR A:0xfc818c00
y.create.l HWIO_MSS_Q6_VMIDMT_AS2VR0_ADDR A:0xfc818e00
y.create.l HWIO_MSS_RELAY_MSG_BUFFER_00_ADDR A:0xfc820000
y.create.l HWIO_MSS_RELAY_MSG_BUFFER_01_ADDR A:0xfc820004
y.create.l HWIO_MSS_RELAY_MSG_BUFFER_02_ADDR A:0xfc820008
y.create.l HWIO_MSS_RELAY_MSG_BUFFER_03_ADDR A:0xfc82000c
y.create.l HWIO_MSS_RELAY_MSG_BUFFER_04_ADDR A:0xfc820010
y.create.l HWIO_MSS_RELAY_MSG_BUFFER_05_ADDR A:0xfc820014
y.create.l HWIO_MSS_RELAY_MSG_BUFFER_06_ADDR A:0xfc820018
y.create.l HWIO_MSS_RELAY_MSG_BUFFER_07_ADDR A:0xfc82001c
y.create.l HWIO_MSS_RELAY_MSG_BUFFER_08_ADDR A:0xfc820020
y.create.l HWIO_MSS_BAM_CTRL_ADDR A:0xfc834000
y.create.l HWIO_MSS_BAM_REVISION_ADDR A:0xfc834004
y.create.l HWIO_MSS_BAM_SW_VERSION_ADDR A:0xfc834080
y.create.l HWIO_MSS_BAM_NUM_PIPES_ADDR A:0xfc83403c
y.create.l HWIO_MSS_BAM_TIMER_ADDR A:0xfc834040
y.create.l HWIO_MSS_BAM_TIMER_CTRL_ADDR A:0xfc834044
y.create.l HWIO_MSS_BAM_DESC_CNT_TRSHLD_ADDR A:0xfc834008
y.create.l HWIO_MSS_BAM_IRQ_SRCS_ADDR A:0xfc83400c
y.create.l HWIO_MSS_BAM_IRQ_SRCS_MSK_ADDR A:0xfc834010
y.create.l HWIO_MSS_BAM_IRQ_SRCS_UNMASKED_ADDR A:0xfc834030
y.create.l HWIO_MSS_BAM_IRQ_STTS_ADDR A:0xfc834014
y.create.l HWIO_MSS_BAM_IRQ_CLR_ADDR A:0xfc834018
y.create.l HWIO_MSS_BAM_IRQ_EN_ADDR A:0xfc83401c
y.create.l HWIO_MSS_BAM_AHB_MASTER_ERR_CTRLS_ADDR A:0xfc834024
y.create.l HWIO_MSS_BAM_AHB_MASTER_ERR_ADDR_ADDR A:0xfc834028
y.create.l HWIO_MSS_BAM_AHB_MASTER_ERR_DATA_ADDR A:0xfc83402c
y.create.l HWIO_MSS_BAM_TRUST_REG_ADDR A:0xfc834070
y.create.l HWIO_MSS_BAM_TEST_BUS_SEL_ADDR A:0xfc834074
y.create.l HWIO_MSS_BAM_TEST_BUS_REG_ADDR A:0xfc834078
y.create.l HWIO_MSS_BAM_CNFG_BITS_ADDR A:0xfc83407c
y.create.l HWIO_MSS_BAM_IRQ_SRCS_EE0_ADDR A:0xfc834800
y.create.l HWIO_MSS_BAM_IRQ_SRCS_EE1_ADDR A:0xfc834880
y.create.l HWIO_MSS_BAM_IRQ_SRCS_EE2_ADDR A:0xfc834900
y.create.l HWIO_MSS_BAM_IRQ_SRCS_EE3_ADDR A:0xfc834980
y.create.l HWIO_MSS_BAM_IRQ_SRCS_EE4_ADDR A:0xfc834a00
y.create.l HWIO_MSS_BAM_IRQ_SRCS_EE5_ADDR A:0xfc834a80
y.create.l HWIO_MSS_BAM_IRQ_SRCS_EE6_ADDR A:0xfc834b00
y.create.l HWIO_MSS_BAM_IRQ_SRCS_EE7_ADDR A:0xfc834b80
y.create.l HWIO_MSS_BAM_IRQ_SRCS_MSK_EE0_ADDR A:0xfc834804
y.create.l HWIO_MSS_BAM_IRQ_SRCS_MSK_EE1_ADDR A:0xfc834884
y.create.l HWIO_MSS_BAM_IRQ_SRCS_MSK_EE2_ADDR A:0xfc834904
y.create.l HWIO_MSS_BAM_IRQ_SRCS_MSK_EE3_ADDR A:0xfc834984
y.create.l HWIO_MSS_BAM_IRQ_SRCS_MSK_EE4_ADDR A:0xfc834a04
y.create.l HWIO_MSS_BAM_IRQ_SRCS_MSK_EE5_ADDR A:0xfc834a84
y.create.l HWIO_MSS_BAM_IRQ_SRCS_MSK_EE6_ADDR A:0xfc834b04
y.create.l HWIO_MSS_BAM_IRQ_SRCS_MSK_EE7_ADDR A:0xfc834b84
y.create.l HWIO_MSS_BAM_IRQ_SRCS_UNMASKED_EE0_ADDR A:0xfc834808
y.create.l HWIO_MSS_BAM_IRQ_SRCS_UNMASKED_EE1_ADDR A:0xfc834888
y.create.l HWIO_MSS_BAM_IRQ_SRCS_UNMASKED_EE2_ADDR A:0xfc834908
y.create.l HWIO_MSS_BAM_IRQ_SRCS_UNMASKED_EE3_ADDR A:0xfc834988
y.create.l HWIO_MSS_BAM_IRQ_SRCS_UNMASKED_EE4_ADDR A:0xfc834a08
y.create.l HWIO_MSS_BAM_IRQ_SRCS_UNMASKED_EE5_ADDR A:0xfc834a88
y.create.l HWIO_MSS_BAM_IRQ_SRCS_UNMASKED_EE6_ADDR A:0xfc834b08
y.create.l HWIO_MSS_BAM_IRQ_SRCS_UNMASKED_EE7_ADDR A:0xfc834b88
y.create.l HWIO_MSS_BAM_P_CTRL0_ADDR A:0xfc835000
y.create.l HWIO_MSS_BAM_P_CTRL1_ADDR A:0xfc836000
y.create.l HWIO_MSS_BAM_P_CTRL2_ADDR A:0xfc837000
y.create.l HWIO_MSS_BAM_P_CTRL3_ADDR A:0xfc838000
y.create.l HWIO_MSS_BAM_P_CTRL4_ADDR A:0xfc839000
y.create.l HWIO_MSS_BAM_P_CTRL5_ADDR A:0xfc83a000
y.create.l HWIO_MSS_BAM_P_RST0_ADDR A:0xfc835004
y.create.l HWIO_MSS_BAM_P_RST1_ADDR A:0xfc836004
y.create.l HWIO_MSS_BAM_P_RST2_ADDR A:0xfc837004
y.create.l HWIO_MSS_BAM_P_RST3_ADDR A:0xfc838004
y.create.l HWIO_MSS_BAM_P_RST4_ADDR A:0xfc839004
y.create.l HWIO_MSS_BAM_P_RST5_ADDR A:0xfc83a004
y.create.l HWIO_MSS_BAM_P_HALT0_ADDR A:0xfc835008
y.create.l HWIO_MSS_BAM_P_HALT1_ADDR A:0xfc836008
y.create.l HWIO_MSS_BAM_P_HALT2_ADDR A:0xfc837008
y.create.l HWIO_MSS_BAM_P_HALT3_ADDR A:0xfc838008
y.create.l HWIO_MSS_BAM_P_HALT4_ADDR A:0xfc839008
y.create.l HWIO_MSS_BAM_P_HALT5_ADDR A:0xfc83a008
y.create.l HWIO_MSS_BAM_P_TRUST_REG0_ADDR A:0xfc835030
y.create.l HWIO_MSS_BAM_P_TRUST_REG1_ADDR A:0xfc836030
y.create.l HWIO_MSS_BAM_P_TRUST_REG2_ADDR A:0xfc837030
y.create.l HWIO_MSS_BAM_P_TRUST_REG3_ADDR A:0xfc838030
y.create.l HWIO_MSS_BAM_P_TRUST_REG4_ADDR A:0xfc839030
y.create.l HWIO_MSS_BAM_P_TRUST_REG5_ADDR A:0xfc83a030
y.create.l HWIO_MSS_BAM_P_IRQ_STTS0_ADDR A:0xfc835010
y.create.l HWIO_MSS_BAM_P_IRQ_STTS1_ADDR A:0xfc836010
y.create.l HWIO_MSS_BAM_P_IRQ_STTS2_ADDR A:0xfc837010
y.create.l HWIO_MSS_BAM_P_IRQ_STTS3_ADDR A:0xfc838010
y.create.l HWIO_MSS_BAM_P_IRQ_STTS4_ADDR A:0xfc839010
y.create.l HWIO_MSS_BAM_P_IRQ_STTS5_ADDR A:0xfc83a010
y.create.l HWIO_MSS_BAM_P_IRQ_CLR0_ADDR A:0xfc835014
y.create.l HWIO_MSS_BAM_P_IRQ_CLR1_ADDR A:0xfc836014
y.create.l HWIO_MSS_BAM_P_IRQ_CLR2_ADDR A:0xfc837014
y.create.l HWIO_MSS_BAM_P_IRQ_CLR3_ADDR A:0xfc838014
y.create.l HWIO_MSS_BAM_P_IRQ_CLR4_ADDR A:0xfc839014
y.create.l HWIO_MSS_BAM_P_IRQ_CLR5_ADDR A:0xfc83a014
y.create.l HWIO_MSS_BAM_P_IRQ_EN0_ADDR A:0xfc835018
y.create.l HWIO_MSS_BAM_P_IRQ_EN1_ADDR A:0xfc836018
y.create.l HWIO_MSS_BAM_P_IRQ_EN2_ADDR A:0xfc837018
y.create.l HWIO_MSS_BAM_P_IRQ_EN3_ADDR A:0xfc838018
y.create.l HWIO_MSS_BAM_P_IRQ_EN4_ADDR A:0xfc839018
y.create.l HWIO_MSS_BAM_P_IRQ_EN5_ADDR A:0xfc83a018
y.create.l HWIO_MSS_BAM_P_TIMER0_ADDR A:0xfc83501c
y.create.l HWIO_MSS_BAM_P_TIMER1_ADDR A:0xfc83601c
y.create.l HWIO_MSS_BAM_P_TIMER2_ADDR A:0xfc83701c
y.create.l HWIO_MSS_BAM_P_TIMER3_ADDR A:0xfc83801c
y.create.l HWIO_MSS_BAM_P_TIMER4_ADDR A:0xfc83901c
y.create.l HWIO_MSS_BAM_P_TIMER5_ADDR A:0xfc83a01c
y.create.l HWIO_MSS_BAM_P_TIMER_CTRL0_ADDR A:0xfc835020
y.create.l HWIO_MSS_BAM_P_TIMER_CTRL1_ADDR A:0xfc836020
y.create.l HWIO_MSS_BAM_P_TIMER_CTRL2_ADDR A:0xfc837020
y.create.l HWIO_MSS_BAM_P_TIMER_CTRL3_ADDR A:0xfc838020
y.create.l HWIO_MSS_BAM_P_TIMER_CTRL4_ADDR A:0xfc839020
y.create.l HWIO_MSS_BAM_P_TIMER_CTRL5_ADDR A:0xfc83a020
y.create.l HWIO_MSS_BAM_P_PRDCR_SDBND0_ADDR A:0xfc835024
y.create.l HWIO_MSS_BAM_P_PRDCR_SDBND1_ADDR A:0xfc836024
y.create.l HWIO_MSS_BAM_P_PRDCR_SDBND2_ADDR A:0xfc837024
y.create.l HWIO_MSS_BAM_P_PRDCR_SDBND3_ADDR A:0xfc838024
y.create.l HWIO_MSS_BAM_P_PRDCR_SDBND4_ADDR A:0xfc839024
y.create.l HWIO_MSS_BAM_P_PRDCR_SDBND5_ADDR A:0xfc83a024
y.create.l HWIO_MSS_BAM_P_CNSMR_SDBND0_ADDR A:0xfc835028
y.create.l HWIO_MSS_BAM_P_CNSMR_SDBND1_ADDR A:0xfc836028
y.create.l HWIO_MSS_BAM_P_CNSMR_SDBND2_ADDR A:0xfc837028
y.create.l HWIO_MSS_BAM_P_CNSMR_SDBND3_ADDR A:0xfc838028
y.create.l HWIO_MSS_BAM_P_CNSMR_SDBND4_ADDR A:0xfc839028
y.create.l HWIO_MSS_BAM_P_CNSMR_SDBND5_ADDR A:0xfc83a028
y.create.l HWIO_MSS_BAM_P_EVNT_DEST_ADDR0_ADDR A:0xfc83582c
y.create.l HWIO_MSS_BAM_P_EVNT_DEST_ADDR1_ADDR A:0xfc83682c
y.create.l HWIO_MSS_BAM_P_EVNT_DEST_ADDR2_ADDR A:0xfc83782c
y.create.l HWIO_MSS_BAM_P_EVNT_DEST_ADDR3_ADDR A:0xfc83882c
y.create.l HWIO_MSS_BAM_P_EVNT_DEST_ADDR4_ADDR A:0xfc83982c
y.create.l HWIO_MSS_BAM_P_EVNT_DEST_ADDR5_ADDR A:0xfc83a82c
y.create.l HWIO_MSS_BAM_P_EVNT_REG0_ADDR A:0xfc835818
y.create.l HWIO_MSS_BAM_P_EVNT_REG1_ADDR A:0xfc836818
y.create.l HWIO_MSS_BAM_P_EVNT_REG2_ADDR A:0xfc837818
y.create.l HWIO_MSS_BAM_P_EVNT_REG3_ADDR A:0xfc838818
y.create.l HWIO_MSS_BAM_P_EVNT_REG4_ADDR A:0xfc839818
y.create.l HWIO_MSS_BAM_P_EVNT_REG5_ADDR A:0xfc83a818
y.create.l HWIO_MSS_BAM_P_SW_OFSTS0_ADDR A:0xfc835800
y.create.l HWIO_MSS_BAM_P_SW_OFSTS1_ADDR A:0xfc836800
y.create.l HWIO_MSS_BAM_P_SW_OFSTS2_ADDR A:0xfc837800
y.create.l HWIO_MSS_BAM_P_SW_OFSTS3_ADDR A:0xfc838800
y.create.l HWIO_MSS_BAM_P_SW_OFSTS4_ADDR A:0xfc839800
y.create.l HWIO_MSS_BAM_P_SW_OFSTS5_ADDR A:0xfc83a800
y.create.l HWIO_MSS_BAM_P_DATA_FIFO_ADDR0_ADDR A:0xfc835824
y.create.l HWIO_MSS_BAM_P_DATA_FIFO_ADDR1_ADDR A:0xfc836824
y.create.l HWIO_MSS_BAM_P_DATA_FIFO_ADDR2_ADDR A:0xfc837824
y.create.l HWIO_MSS_BAM_P_DATA_FIFO_ADDR3_ADDR A:0xfc838824
y.create.l HWIO_MSS_BAM_P_DATA_FIFO_ADDR4_ADDR A:0xfc839824
y.create.l HWIO_MSS_BAM_P_DATA_FIFO_ADDR5_ADDR A:0xfc83a824
y.create.l HWIO_MSS_BAM_P_DESC_FIFO_ADDR0_ADDR A:0xfc83581c
y.create.l HWIO_MSS_BAM_P_DESC_FIFO_ADDR1_ADDR A:0xfc83681c
y.create.l HWIO_MSS_BAM_P_DESC_FIFO_ADDR2_ADDR A:0xfc83781c
y.create.l HWIO_MSS_BAM_P_DESC_FIFO_ADDR3_ADDR A:0xfc83881c
y.create.l HWIO_MSS_BAM_P_DESC_FIFO_ADDR4_ADDR A:0xfc83981c
y.create.l HWIO_MSS_BAM_P_DESC_FIFO_ADDR5_ADDR A:0xfc83a81c
y.create.l HWIO_MSS_BAM_P_EVNT_GEN_TRSHLD0_ADDR A:0xfc835828
y.create.l HWIO_MSS_BAM_P_EVNT_GEN_TRSHLD1_ADDR A:0xfc836828
y.create.l HWIO_MSS_BAM_P_EVNT_GEN_TRSHLD2_ADDR A:0xfc837828
y.create.l HWIO_MSS_BAM_P_EVNT_GEN_TRSHLD3_ADDR A:0xfc838828
y.create.l HWIO_MSS_BAM_P_EVNT_GEN_TRSHLD4_ADDR A:0xfc839828
y.create.l HWIO_MSS_BAM_P_EVNT_GEN_TRSHLD5_ADDR A:0xfc83a828
y.create.l HWIO_MSS_BAM_P_FIFO_SIZES0_ADDR A:0xfc835820
y.create.l HWIO_MSS_BAM_P_FIFO_SIZES1_ADDR A:0xfc836820
y.create.l HWIO_MSS_BAM_P_FIFO_SIZES2_ADDR A:0xfc837820
y.create.l HWIO_MSS_BAM_P_FIFO_SIZES3_ADDR A:0xfc838820
y.create.l HWIO_MSS_BAM_P_FIFO_SIZES4_ADDR A:0xfc839820
y.create.l HWIO_MSS_BAM_P_FIFO_SIZES5_ADDR A:0xfc83a820
y.create.l HWIO_MSS_BAM_P_RETR_CNTXT_0_ADDR A:0xfc835834
y.create.l HWIO_MSS_BAM_P_RETR_CNTXT_1_ADDR A:0xfc836834
y.create.l HWIO_MSS_BAM_P_RETR_CNTXT_2_ADDR A:0xfc837834
y.create.l HWIO_MSS_BAM_P_RETR_CNTXT_3_ADDR A:0xfc838834
y.create.l HWIO_MSS_BAM_P_RETR_CNTXT_4_ADDR A:0xfc839834
y.create.l HWIO_MSS_BAM_P_RETR_CNTXT_5_ADDR A:0xfc83a834
y.create.l HWIO_MSS_BAM_P_SI_CNTXT_0_ADDR A:0xfc835838
y.create.l HWIO_MSS_BAM_P_SI_CNTXT_1_ADDR A:0xfc836838
y.create.l HWIO_MSS_BAM_P_SI_CNTXT_2_ADDR A:0xfc837838
y.create.l HWIO_MSS_BAM_P_SI_CNTXT_3_ADDR A:0xfc838838
y.create.l HWIO_MSS_BAM_P_SI_CNTXT_4_ADDR A:0xfc839838
y.create.l HWIO_MSS_BAM_P_SI_CNTXT_5_ADDR A:0xfc83a838
y.create.l HWIO_MSS_BAM_P_DF_CNTXT_0_ADDR A:0xfc835830
y.create.l HWIO_MSS_BAM_P_DF_CNTXT_1_ADDR A:0xfc836830
y.create.l HWIO_MSS_BAM_P_DF_CNTXT_2_ADDR A:0xfc837830
y.create.l HWIO_MSS_BAM_P_DF_CNTXT_3_ADDR A:0xfc838830
y.create.l HWIO_MSS_BAM_P_DF_CNTXT_4_ADDR A:0xfc839830
y.create.l HWIO_MSS_BAM_P_DF_CNTXT_5_ADDR A:0xfc83a830
y.create.l HWIO_MSS_BAM_P_AU_PSM_CNTXT_1_0_ADDR A:0xfc835804
y.create.l HWIO_MSS_BAM_P_AU_PSM_CNTXT_1_1_ADDR A:0xfc836804
y.create.l HWIO_MSS_BAM_P_AU_PSM_CNTXT_1_2_ADDR A:0xfc837804
y.create.l HWIO_MSS_BAM_P_AU_PSM_CNTXT_1_3_ADDR A:0xfc838804
y.create.l HWIO_MSS_BAM_P_AU_PSM_CNTXT_1_4_ADDR A:0xfc839804
y.create.l HWIO_MSS_BAM_P_AU_PSM_CNTXT_1_5_ADDR A:0xfc83a804
y.create.l HWIO_MSS_BAM_P_PSM_CNTXT_2_0_ADDR A:0xfc835808
y.create.l HWIO_MSS_BAM_P_PSM_CNTXT_2_1_ADDR A:0xfc836808
y.create.l HWIO_MSS_BAM_P_PSM_CNTXT_2_2_ADDR A:0xfc837808
y.create.l HWIO_MSS_BAM_P_PSM_CNTXT_2_3_ADDR A:0xfc838808
y.create.l HWIO_MSS_BAM_P_PSM_CNTXT_2_4_ADDR A:0xfc839808
y.create.l HWIO_MSS_BAM_P_PSM_CNTXT_2_5_ADDR A:0xfc83a808
y.create.l HWIO_MSS_BAM_P_PSM_CNTXT_3_0_ADDR A:0xfc83580c
y.create.l HWIO_MSS_BAM_P_PSM_CNTXT_3_1_ADDR A:0xfc83680c
y.create.l HWIO_MSS_BAM_P_PSM_CNTXT_3_2_ADDR A:0xfc83780c
y.create.l HWIO_MSS_BAM_P_PSM_CNTXT_3_3_ADDR A:0xfc83880c
y.create.l HWIO_MSS_BAM_P_PSM_CNTXT_3_4_ADDR A:0xfc83980c
y.create.l HWIO_MSS_BAM_P_PSM_CNTXT_3_5_ADDR A:0xfc83a80c
y.create.l HWIO_MSS_BAM_P_PSM_CNTXT_4_0_ADDR A:0xfc835810
y.create.l HWIO_MSS_BAM_P_PSM_CNTXT_4_1_ADDR A:0xfc836810
y.create.l HWIO_MSS_BAM_P_PSM_CNTXT_4_2_ADDR A:0xfc837810
y.create.l HWIO_MSS_BAM_P_PSM_CNTXT_4_3_ADDR A:0xfc838810
y.create.l HWIO_MSS_BAM_P_PSM_CNTXT_4_4_ADDR A:0xfc839810
y.create.l HWIO_MSS_BAM_P_PSM_CNTXT_4_5_ADDR A:0xfc83a810
y.create.l HWIO_MSS_BAM_P_PSM_CNTXT_5_0_ADDR A:0xfc835814
y.create.l HWIO_MSS_BAM_P_PSM_CNTXT_5_1_ADDR A:0xfc836814
y.create.l HWIO_MSS_BAM_P_PSM_CNTXT_5_2_ADDR A:0xfc837814
y.create.l HWIO_MSS_BAM_P_PSM_CNTXT_5_3_ADDR A:0xfc838814
y.create.l HWIO_MSS_BAM_P_PSM_CNTXT_5_4_ADDR A:0xfc839814
y.create.l HWIO_MSS_BAM_P_PSM_CNTXT_5_5_ADDR A:0xfc83a814
y.create.l HWIO_MSS_QDSP6SS_VERSION_ADDR A:0xfc880000
y.create.l HWIO_MSS_QDSP6SS_RST_EVB_ADDR A:0xfc880010
y.create.l HWIO_MSS_QDSP6SS_RESET_ADDR A:0xfc880014
y.create.l HWIO_MSS_QDSP6SS_DBG_CFG_ADDR A:0xfc880018
y.create.l HWIO_MSS_QDSP6SS_GFMUX_CTL_ADDR A:0xfc880020
y.create.l HWIO_MSS_QDSP6SS_GFMUX_STATUS_ADDR A:0xfc880024
y.create.l HWIO_MSS_QDSP6SS_PWR_CTL_ADDR A:0xfc880030
y.create.l HWIO_MSS_QDSP6SS_CGC_OVERRIDE_ADDR A:0xfc880034
y.create.l HWIO_MSS_QDSP6SS_NMI_ADDR A:0xfc880040
y.create.l HWIO_MSS_QDSP6SS_NMI_STATUS_ADDR A:0xfc880044
y.create.l HWIO_MSS_QDSP6SS_LDO_CFG0_ADDR A:0xfc880050
y.create.l HWIO_MSS_QDSP6SS_LDO_CFG1_ADDR A:0xfc880054
y.create.l HWIO_MSS_QDSP6SS_LDO_CFG2_ADDR A:0xfc880058
y.create.l HWIO_MSS_QDSP6SS_LDO_VREF_SET_ADDR A:0xfc88005c
y.create.l HWIO_MSS_QDSP6SS_STRAP_TCM_ADDR A:0xfc880100
y.create.l HWIO_MSS_QDSP6SS_STRAP_AHBUPPER_ADDR A:0xfc880104
y.create.l HWIO_MSS_QDSP6SS_STRAP_AHBLOWER_ADDR A:0xfc880108
y.create.l HWIO_MSS_QDSP6SS_STRAP_ACC_ADDR A:0xfc880110
y.create.l HWIO_MSS_QDSP6SS_DCC_CTRL_ADDR A:0xfc880114
y.create.l HWIO_MSS_QDSP6SS_EXT_WAKEUP_ADDR A:0xfc881000
y.create.l HWIO_MSS_QDSP6SS_EXT_PD_ADDR A:0xfc881004
y.create.l HWIO_MSS_QDSP6SS_FLL_CTL_ADDR A:0xfc881010
y.create.l HWIO_MSS_QDSP6SS_FLL_STATUS_ADDR A:0xfc881014
y.create.l HWIO_MSS_QDSP6SS_TEST_BUS_CTL_ADDR A:0xfc882000
y.create.l HWIO_MSS_QDSP6SS_TEST_BUS_VALUE_ADDR A:0xfc882004
y.create.l HWIO_MSS_QDSP6SS_TEST_BUS_WDATA_ADDR A:0xfc882008
y.create.l HWIO_MSS_QDSP6SS_PWRDBG_CTL_ADDR A:0xfc88200c
y.create.l HWIO_MSS_QDSP6SS_TEST_CLK_CTL_ADDR A:0xfc882010
y.create.l HWIO_MSS_QDSP6SS_PWRDBG_STATUS_ADDR A:0xfc882014
y.create.l HWIO_MSS_QDSP6SS_LDO_ATEST_ADDR A:0xfc882018
y.create.l HWIO_MSS_QDSP6SS_LDO_DAC_STATUS_ADDR A:0xfc88201c
y.create.l HWIO_MSS_QDSP6SS_ZMEAS_CONFIG_ADDR A:0xfc882020
y.create.l HWIO_QDSP6SS_INSTANCE_ID_ADDR A:0xfc900000
y.create.l HWIO_QDSP6SS_IDLT_MATCH_VAL_ADDR A:0xfc901000
y.create.l HWIO_QDSP6SS_IDLT_COUNT_VAL_ADDR A:0xfc901004
y.create.l HWIO_QDSP6SS_IDLT_ENABLE_ADDR A:0xfc901008
y.create.l HWIO_QDSP6SS_IDLT_SYNC_STATUS_ADDR A:0xfc90100c
y.create.l HWIO_QDSP6SS_WDOG_RESET_ADDR A:0xfc902000
y.create.l HWIO_QDSP6SS_WDOG_CTL_ADDR A:0xfc902004
y.create.l HWIO_QDSP6SS_WDOG_STATUS_ADDR A:0xfc902008
y.create.l HWIO_QDSP6SS_WDOG_BARK_TIME_ADDR A:0xfc90200c
y.create.l HWIO_QDSP6SS_WDOG_BITE_TIME_ADDR A:0xfc902010
y.create.l HWIO_QDSP6SS_WDOG_NMI_TIME_ADDR A:0xfc902014
y.create.l HWIO_QDSP6SS_WDOG_TEST_LOAD_ADDR A:0xfc902018
y.create.l HWIO_QDSP6SS_WDOG_TEST_ADDR A:0xfc90201c
y.create.l HWIO_QDSP6SS_IPC_ADDR A:0xfc905000
y.create.l HWIO_QDSP6SS_L1_IRQ_BACKUP_EN_ADDR A:0xfc905010
y.create.l HWIO_QDSP6SS_PD_HS_START_ADDR A:0xfc90700c
y.create.l HWIO_QDSP6SS_PD_HS_DONE_ADDR A:0xfc907010
y.create.l HWIO_QDSP6SS_PU_HS_START_ADDR A:0xfc907014
y.create.l HWIO_QDSP6SS_SLPC_CFG_ADDR A:0xfc90701c
y.create.l HWIO_QDSP6SS_SLPC_STATUS_ADDR A:0xfc907020
y.create.l HWIO_QDSP6SS_SPMCTL_EN_ARES_ADDR A:0xfc907024
y.create.l HWIO_QDSP6SS_SPMCTL_EN_CLAMP_ADDR A:0xfc907028
y.create.l HWIO_QDSP6SS_SPMCTL_EN_CLK_ADDR A:0xfc90702c
y.create.l HWIO_QDSP6SS_SPMCTL_EN_MEM_ADDR A:0xfc907030
y.create.l HWIO_QDSP6SS_SPMCTL_EN_BHS_ADDR A:0xfc907034
y.create.l HWIO_QDSP6SS_SPMCTL_EN_LDO_ADDR A:0xfc907038
y.create.l HWIO_QDSP6SS_SPMCTL_EN_EXT_ADDR A:0xfc90703c
y.create.l HWIO_QDSP6SS_L2VIC_VID_ADDR A:0xfc910000
y.create.l HWIO_QDSP6SS_L2VIC_INT_ENABLE0_ADDR A:0xfc910100
y.create.l HWIO_QDSP6SS_L2VIC_INT_ENABLE1_ADDR A:0xfc910104
y.create.l HWIO_QDSP6SS_L2VIC_INT_ENABLE2_ADDR A:0xfc910108
y.create.l HWIO_QDSP6SS_L2VIC_INT_ENABLE3_ADDR A:0xfc91010c
y.create.l HWIO_QDSP6SS_L2VIC_INT_ENABLE4_ADDR A:0xfc910110
y.create.l HWIO_QDSP6SS_L2VIC_INT_ENABLE5_ADDR A:0xfc910114
y.create.l HWIO_QDSP6SS_L2VIC_INT_ENABLE6_ADDR A:0xfc910118
y.create.l HWIO_QDSP6SS_L2VIC_INT_ENABLE7_ADDR A:0xfc91011c
y.create.l HWIO_QDSP6SS_L2VIC_INT_ENABLE8_ADDR A:0xfc910120
y.create.l HWIO_QDSP6SS_L2VIC_INT_ENABLE9_ADDR A:0xfc910124
y.create.l HWIO_QDSP6SS_L2VIC_INT_ENABLE_CLEAR0_ADDR A:0xfc910180
y.create.l HWIO_QDSP6SS_L2VIC_INT_ENABLE_CLEAR1_ADDR A:0xfc910184
y.create.l HWIO_QDSP6SS_L2VIC_INT_ENABLE_CLEAR2_ADDR A:0xfc910188
y.create.l HWIO_QDSP6SS_L2VIC_INT_ENABLE_CLEAR3_ADDR A:0xfc91018c
y.create.l HWIO_QDSP6SS_L2VIC_INT_ENABLE_CLEAR4_ADDR A:0xfc910190
y.create.l HWIO_QDSP6SS_L2VIC_INT_ENABLE_CLEAR5_ADDR A:0xfc910194
y.create.l HWIO_QDSP6SS_L2VIC_INT_ENABLE_CLEAR6_ADDR A:0xfc910198
y.create.l HWIO_QDSP6SS_L2VIC_INT_ENABLE_CLEAR7_ADDR A:0xfc91019c
y.create.l HWIO_QDSP6SS_L2VIC_INT_ENABLE_CLEAR8_ADDR A:0xfc9101a0
y.create.l HWIO_QDSP6SS_L2VIC_INT_ENABLE_CLEAR9_ADDR A:0xfc9101a4
y.create.l HWIO_QDSP6SS_L2VIC_INT_ENABLE_SET0_ADDR A:0xfc910200
y.create.l HWIO_QDSP6SS_L2VIC_INT_ENABLE_SET1_ADDR A:0xfc910204
y.create.l HWIO_QDSP6SS_L2VIC_INT_ENABLE_SET2_ADDR A:0xfc910208
y.create.l HWIO_QDSP6SS_L2VIC_INT_ENABLE_SET3_ADDR A:0xfc91020c
y.create.l HWIO_QDSP6SS_L2VIC_INT_ENABLE_SET4_ADDR A:0xfc910210
y.create.l HWIO_QDSP6SS_L2VIC_INT_ENABLE_SET5_ADDR A:0xfc910214
y.create.l HWIO_QDSP6SS_L2VIC_INT_ENABLE_SET6_ADDR A:0xfc910218
y.create.l HWIO_QDSP6SS_L2VIC_INT_ENABLE_SET7_ADDR A:0xfc91021c
y.create.l HWIO_QDSP6SS_L2VIC_INT_ENABLE_SET8_ADDR A:0xfc910220
y.create.l HWIO_QDSP6SS_L2VIC_INT_ENABLE_SET9_ADDR A:0xfc910224
y.create.l HWIO_QDSP6SS_L2VIC_INT_TYPE0_ADDR A:0xfc910280
y.create.l HWIO_QDSP6SS_L2VIC_INT_TYPE1_ADDR A:0xfc910284
y.create.l HWIO_QDSP6SS_L2VIC_INT_TYPE2_ADDR A:0xfc910288
y.create.l HWIO_QDSP6SS_L2VIC_INT_TYPE3_ADDR A:0xfc91028c
y.create.l HWIO_QDSP6SS_L2VIC_INT_TYPE4_ADDR A:0xfc910290
y.create.l HWIO_QDSP6SS_L2VIC_INT_TYPE5_ADDR A:0xfc910294
y.create.l HWIO_QDSP6SS_L2VIC_INT_TYPE6_ADDR A:0xfc910298
y.create.l HWIO_QDSP6SS_L2VIC_INT_TYPE7_ADDR A:0xfc91029c
y.create.l HWIO_QDSP6SS_L2VIC_INT_TYPE8_ADDR A:0xfc9102a0
y.create.l HWIO_QDSP6SS_L2VIC_INT_TYPE9_ADDR A:0xfc9102a4
y.create.l HWIO_QDSP6SS_L2VIC_INT_STATUS0_ADDR A:0xfc910380
y.create.l HWIO_QDSP6SS_L2VIC_INT_STATUS1_ADDR A:0xfc910384
y.create.l HWIO_QDSP6SS_L2VIC_INT_STATUS2_ADDR A:0xfc910388
y.create.l HWIO_QDSP6SS_L2VIC_INT_STATUS3_ADDR A:0xfc91038c
y.create.l HWIO_QDSP6SS_L2VIC_INT_STATUS4_ADDR A:0xfc910390
y.create.l HWIO_QDSP6SS_L2VIC_INT_STATUS5_ADDR A:0xfc910394
y.create.l HWIO_QDSP6SS_L2VIC_INT_STATUS6_ADDR A:0xfc910398
y.create.l HWIO_QDSP6SS_L2VIC_INT_STATUS7_ADDR A:0xfc91039c
y.create.l HWIO_QDSP6SS_L2VIC_INT_STATUS8_ADDR A:0xfc9103a0
y.create.l HWIO_QDSP6SS_L2VIC_INT_STATUS9_ADDR A:0xfc9103a4
y.create.l HWIO_QDSP6SS_L2VIC_INT_CLEAR0_ADDR A:0xfc910400
y.create.l HWIO_QDSP6SS_L2VIC_INT_CLEAR1_ADDR A:0xfc910404
y.create.l HWIO_QDSP6SS_L2VIC_INT_CLEAR2_ADDR A:0xfc910408
y.create.l HWIO_QDSP6SS_L2VIC_INT_CLEAR3_ADDR A:0xfc91040c
y.create.l HWIO_QDSP6SS_L2VIC_INT_CLEAR4_ADDR A:0xfc910410
y.create.l HWIO_QDSP6SS_L2VIC_INT_CLEAR5_ADDR A:0xfc910414
y.create.l HWIO_QDSP6SS_L2VIC_INT_CLEAR6_ADDR A:0xfc910418
y.create.l HWIO_QDSP6SS_L2VIC_INT_CLEAR7_ADDR A:0xfc91041c
y.create.l HWIO_QDSP6SS_L2VIC_INT_CLEAR8_ADDR A:0xfc910420
y.create.l HWIO_QDSP6SS_L2VIC_INT_CLEAR9_ADDR A:0xfc910424
y.create.l HWIO_QDSP6SS_L2VIC_SOFT_INT0_ADDR A:0xfc910480
y.create.l HWIO_QDSP6SS_L2VIC_SOFT_INT1_ADDR A:0xfc910484
y.create.l HWIO_QDSP6SS_L2VIC_SOFT_INT2_ADDR A:0xfc910488
y.create.l HWIO_QDSP6SS_L2VIC_SOFT_INT3_ADDR A:0xfc91048c
y.create.l HWIO_QDSP6SS_L2VIC_SOFT_INT4_ADDR A:0xfc910490
y.create.l HWIO_QDSP6SS_L2VIC_SOFT_INT5_ADDR A:0xfc910494
y.create.l HWIO_QDSP6SS_L2VIC_SOFT_INT6_ADDR A:0xfc910498
y.create.l HWIO_QDSP6SS_L2VIC_SOFT_INT7_ADDR A:0xfc91049c
y.create.l HWIO_QDSP6SS_L2VIC_SOFT_INT8_ADDR A:0xfc9104a0
y.create.l HWIO_QDSP6SS_L2VIC_SOFT_INT9_ADDR A:0xfc9104a4
y.create.l HWIO_QDSP6SS_L2VIC_INT_PENDING0_ADDR A:0xfc910500
y.create.l HWIO_QDSP6SS_L2VIC_INT_PENDING1_ADDR A:0xfc910504
y.create.l HWIO_QDSP6SS_L2VIC_INT_PENDING2_ADDR A:0xfc910508
y.create.l HWIO_QDSP6SS_L2VIC_INT_PENDING3_ADDR A:0xfc91050c
y.create.l HWIO_QDSP6SS_L2VIC_INT_PENDING4_ADDR A:0xfc910510
y.create.l HWIO_QDSP6SS_L2VIC_INT_PENDING5_ADDR A:0xfc910514
y.create.l HWIO_QDSP6SS_L2VIC_INT_PENDING6_ADDR A:0xfc910518
y.create.l HWIO_QDSP6SS_L2VIC_INT_PENDING7_ADDR A:0xfc91051c
y.create.l HWIO_QDSP6SS_L2VIC_INT_PENDING8_ADDR A:0xfc910520
y.create.l HWIO_QDSP6SS_L2VIC_INT_PENDING9_ADDR A:0xfc910524
y.create.l HWIO_QDSP6SS_QTMR_AC_CNTFRQ_ADDR A:0xfc920000
y.create.l HWIO_QDSP6SS_QTMR_AC_CNTSR_ADDR A:0xfc920004
y.create.l HWIO_QDSP6SS_QTMR_AC_CNTTID_ADDR A:0xfc920008
y.create.l HWIO_QDSP6SS_QTMR_AC_CNTACR_0_ADDR A:0xfc920040
y.create.l HWIO_QDSP6SS_QTMR_AC_CNTACR_1_ADDR A:0xfc920044
y.create.l HWIO_QDSP6SS_QTMR_AC_CNTACR_2_ADDR A:0xfc920048
y.create.l HWIO_QDSP6SS_QTMR_AC_CNTVOFF_LO_0_ADDR A:0xfc920080
y.create.l HWIO_QDSP6SS_QTMR_AC_CNTVOFF_LO_1_ADDR A:0xfc920088
y.create.l HWIO_QDSP6SS_QTMR_AC_CNTVOFF_LO_2_ADDR A:0xfc920090
y.create.l HWIO_QDSP6SS_QTMR_AC_CNTVOFF_HI_0_ADDR A:0xfc920084
y.create.l HWIO_QDSP6SS_QTMR_AC_CNTVOFF_HI_1_ADDR A:0xfc92008c
y.create.l HWIO_QDSP6SS_QTMR_AC_CNTVOFF_HI_2_ADDR A:0xfc920094
y.create.l HWIO_QDSP6SS_QTMR_AC_CFG_ADDR A:0xfc920fc0
y.create.l HWIO_QDSP6SS_QTMR_AC_VERSION_ADDR A:0xfc920fd0
y.create.l HWIO_QDSP6SS_QTMR_V1_CNTPCT_LO_0_ADDR A:0xfc921000
y.create.l HWIO_QDSP6SS_QTMR_V1_CNTPCT_HI_0_ADDR A:0xfc921004
y.create.l HWIO_QDSP6SS_QTMR_V1_CNTVCT_LO_0_ADDR A:0xfc921008
y.create.l HWIO_QDSP6SS_QTMR_V1_CNTVCT_HI_0_ADDR A:0xfc92100c
y.create.l HWIO_QDSP6SS_QTMR_V1_CNTFRQ_0_ADDR A:0xfc921010
y.create.l HWIO_QDSP6SS_QTMR_V1_CNTPL0ACR_0_ADDR A:0xfc921014
y.create.l HWIO_QDSP6SS_QTMR_V1_CNTVOFF_LO_0_ADDR A:0xfc921018
y.create.l HWIO_QDSP6SS_QTMR_V1_CNTVOFF_HI_0_ADDR A:0xfc92101c
y.create.l HWIO_QDSP6SS_QTMR_V1_CNTP_CVAL_LO_0_ADDR A:0xfc921020
y.create.l HWIO_QDSP6SS_QTMR_V1_CNTP_CVAL_HI_0_ADDR A:0xfc921024
y.create.l HWIO_QDSP6SS_QTMR_V1_CNTP_TVAL_0_ADDR A:0xfc921028
y.create.l HWIO_QDSP6SS_QTMR_V1_CNTP_CTL_0_ADDR A:0xfc92102c
y.create.l HWIO_QDSP6SS_QTMR_V1_CNTV_CVAL_LO_0_ADDR A:0xfc921030
y.create.l HWIO_QDSP6SS_QTMR_V1_CNTV_CVAL_HI_0_ADDR A:0xfc921034
y.create.l HWIO_QDSP6SS_QTMR_V1_CNTV_TVAL_0_ADDR A:0xfc921038
y.create.l HWIO_QDSP6SS_QTMR_V1_CNTV_CTL_0_ADDR A:0xfc92103c
y.create.l HWIO_QDSP6SS_QTMR_V1_VERSION_0_ADDR A:0xfc921fd0
y.create.l HWIO_QDSP6SS_QTMR_V1_CNTPCT_LO_1_ADDR A:0xfc922000
y.create.l HWIO_QDSP6SS_QTMR_V1_CNTPCT_HI_1_ADDR A:0xfc922004
y.create.l HWIO_QDSP6SS_QTMR_V1_CNTVCT_LO_1_ADDR A:0xfc922008
y.create.l HWIO_QDSP6SS_QTMR_V1_CNTVCT_HI_1_ADDR A:0xfc92200c
y.create.l HWIO_QDSP6SS_QTMR_V1_CNTFRQ_1_ADDR A:0xfc922010
y.create.l HWIO_QDSP6SS_QTMR_V1_CNTPL0ACR_1_ADDR A:0xfc922014
y.create.l HWIO_QDSP6SS_QTMR_V1_CNTVOFF_LO_1_ADDR A:0xfc922018
y.create.l HWIO_QDSP6SS_QTMR_V1_CNTVOFF_HI_1_ADDR A:0xfc92201c
y.create.l HWIO_QDSP6SS_QTMR_V1_CNTP_CVAL_LO_1_ADDR A:0xfc922020
y.create.l HWIO_QDSP6SS_QTMR_V1_CNTP_CVAL_HI_1_ADDR A:0xfc922024
y.create.l HWIO_QDSP6SS_QTMR_V1_CNTP_TVAL_1_ADDR A:0xfc922028
y.create.l HWIO_QDSP6SS_QTMR_V1_CNTP_CTL_1_ADDR A:0xfc92202c
y.create.l HWIO_QDSP6SS_QTMR_V1_CNTV_CVAL_LO_1_ADDR A:0xfc922030
y.create.l HWIO_QDSP6SS_QTMR_V1_CNTV_CVAL_HI_1_ADDR A:0xfc922034
y.create.l HWIO_QDSP6SS_QTMR_V1_CNTV_TVAL_1_ADDR A:0xfc922038
y.create.l HWIO_QDSP6SS_QTMR_V1_CNTV_CTL_1_ADDR A:0xfc92203c
y.create.l HWIO_QDSP6SS_QTMR_V1_VERSION_1_ADDR A:0xfc922fd0
y.create.l HWIO_QDSP6SS_QTMR_V1_CNTPCT_LO_2_ADDR A:0xfc923000
y.create.l HWIO_QDSP6SS_QTMR_V1_CNTPCT_HI_2_ADDR A:0xfc923004
y.create.l HWIO_QDSP6SS_QTMR_V1_CNTVCT_LO_2_ADDR A:0xfc923008
y.create.l HWIO_QDSP6SS_QTMR_V1_CNTVCT_HI_2_ADDR A:0xfc92300c
y.create.l HWIO_QDSP6SS_QTMR_V1_CNTFRQ_2_ADDR A:0xfc923010
y.create.l HWIO_QDSP6SS_QTMR_V1_CNTPL0ACR_2_ADDR A:0xfc923014
y.create.l HWIO_QDSP6SS_QTMR_V1_CNTVOFF_LO_2_ADDR A:0xfc923018
y.create.l HWIO_QDSP6SS_QTMR_V1_CNTVOFF_HI_2_ADDR A:0xfc92301c
y.create.l HWIO_QDSP6SS_QTMR_V1_CNTP_CVAL_LO_2_ADDR A:0xfc923020
y.create.l HWIO_QDSP6SS_QTMR_V1_CNTP_CVAL_HI_2_ADDR A:0xfc923024
y.create.l HWIO_QDSP6SS_QTMR_V1_CNTP_TVAL_2_ADDR A:0xfc923028
y.create.l HWIO_QDSP6SS_QTMR_V1_CNTP_CTL_2_ADDR A:0xfc92302c
y.create.l HWIO_QDSP6SS_QTMR_V1_CNTV_CVAL_LO_2_ADDR A:0xfc923030
y.create.l HWIO_QDSP6SS_QTMR_V1_CNTV_CVAL_HI_2_ADDR A:0xfc923034
y.create.l HWIO_QDSP6SS_QTMR_V1_CNTV_TVAL_2_ADDR A:0xfc923038
y.create.l HWIO_QDSP6SS_QTMR_V1_CNTV_CTL_2_ADDR A:0xfc92303c
y.create.l HWIO_QDSP6SS_QTMR_V1_VERSION_2_ADDR A:0xfc923fd0
y.create.l HWIO_QDSP6SS_SAW2_SECURE_ADDR A:0xfc930000
y.create.l HWIO_QDSP6SS_SAW2_ID_ADDR A:0xfc930004
y.create.l HWIO_QDSP6SS_SAW2_CFG_ADDR A:0xfc930008
y.create.l HWIO_QDSP6SS_SAW2_SPM_STS_ADDR A:0xfc93000c
y.create.l HWIO_QDSP6SS_SAW2_AVS_STS_ADDR A:0xfc930010
y.create.l HWIO_QDSP6SS_SAW2_PMIC_STS_ADDR A:0xfc930014
y.create.l HWIO_QDSP6SS_SAW2_RST_ADDR A:0xfc930018
y.create.l HWIO_QDSP6SS_SAW2_VCTL_ADDR A:0xfc93001c
y.create.l HWIO_QDSP6SS_SAW2_AVS_CTL_ADDR A:0xfc930020
y.create.l HWIO_QDSP6SS_SAW2_AVS_LIMIT_ADDR A:0xfc930024
y.create.l HWIO_QDSP6SS_SAW2_AVS_DLY_ADDR A:0xfc930028
y.create.l HWIO_QDSP6SS_SAW2_AVS_HYSTERESIS_ADDR A:0xfc93002c
y.create.l HWIO_QDSP6SS_SAW2_SPM_CTL_ADDR A:0xfc930030
y.create.l HWIO_QDSP6SS_SAW2_SPM_DLY_ADDR A:0xfc930034
y.create.l HWIO_QDSP6SS_SAW2_SPM_SLP_SEQ_ENTRY_0_ADDR A:0xfc930080
y.create.l HWIO_QDSP6SS_SAW2_SPM_SLP_SEQ_ENTRY_1_ADDR A:0xfc930084
y.create.l HWIO_QDSP6SS_SAW2_SPM_SLP_SEQ_ENTRY_2_ADDR A:0xfc930088
y.create.l HWIO_QDSP6SS_SAW2_SPM_SLP_SEQ_ENTRY_3_ADDR A:0xfc93008c
y.create.l HWIO_QDSP6SS_SAW2_SPM_SLP_SEQ_ENTRY_4_ADDR A:0xfc930090
y.create.l HWIO_QDSP6SS_SAW2_SPM_SLP_SEQ_ENTRY_5_ADDR A:0xfc930094
y.create.l HWIO_QDSP6SS_SAW2_SPM_SLP_SEQ_ENTRY_6_ADDR A:0xfc930098
y.create.l HWIO_QDSP6SS_SAW2_SPM_SLP_SEQ_ENTRY_7_ADDR A:0xfc93009c
y.create.l HWIO_QDSP6SS_SAW2_SPM_SLP_SEQ_ENTRY_8_ADDR A:0xfc9300a0
y.create.l HWIO_QDSP6SS_SAW2_SPM_SLP_SEQ_ENTRY_9_ADDR A:0xfc9300a4
y.create.l HWIO_QDSP6SS_SAW2_SPM_PMIC_DATA_0_ADDR A:0xfc930040
y.create.l HWIO_QDSP6SS_SAW2_SPM_PMIC_DATA_1_ADDR A:0xfc930044
y.create.l HWIO_QDSP6SS_SAW2_SPM_PMIC_DATA_2_ADDR A:0xfc930048
y.create.l HWIO_QDSP6SS_SAW2_VERSION_ADDR A:0xfc930fd0
y.create.l HWIO_MSS_ENABLE_ADDR A:0xfc980000
y.create.l HWIO_MSS_CLAMP_MEM_ADDR A:0xfc980004
y.create.l HWIO_MSS_CLAMP_IO_ADDR A:0xfc980008
y.create.l HWIO_MSS_BUS_AHB2AHB_CFG_ADDR A:0xfc98000c
y.create.l HWIO_MSS_BUS_MAXI2AXI_CFG_ADDR A:0xfc980010
y.create.l HWIO_MSS_CUSTOM_MEM_ARRSTBYN_ADDR A:0xfc980014
y.create.l HWIO_MSS_ANALOG_IP_TEST_CTL_ADDR A:0xfc980018
y.create.l HWIO_MSS_ATB_ID_ADDR A:0xfc98001c
y.create.l HWIO_MSS_DBG_BUS_CTL_ADDR A:0xfc980020
y.create.l HWIO_MSS_AHB_ACCESS_ERR_IRQ_EN_ADDR A:0xfc980024
y.create.l HWIO_MSS_AHB_ACCESS_ERR_IRQ_STATUS_ADDR A:0xfc980028
y.create.l HWIO_MSS_AHB_ACCESS_ERR_IRQ_CLR_ADDR A:0xfc98002c
y.create.l HWIO_MSS_BUS_CTL_CFG_ADDR A:0xfc980030
y.create.l HWIO_MSS_RELAY_MSG_SHADOW0_ADDR A:0xfc980034
y.create.l HWIO_MSS_RELAY_MSG_SHADOW1_ADDR A:0xfc980038
y.create.l HWIO_MSS_RELAY_MSG_SHADOW2_ADDR A:0xfc98003c
y.create.l HWIO_MSS_RELAY_MSG_SHADOW3_ADDR A:0xfc980040
y.create.l HWIO_MSS_RELAY_MSG_SHADOW4_ADDR A:0xfc980044
y.create.l HWIO_MSS_RELAY_MSG_SHADOW5_ADDR A:0xfc980048
y.create.l HWIO_MSS_RELAY_MSG_SHADOW6_ADDR A:0xfc98004c
y.create.l HWIO_MSS_RELAY_MSG_SHADOW7_ADDR A:0xfc980050
y.create.l HWIO_MSS_RELAY_MSG_SHADOW8_ADDR A:0xfc980054
y.create.l HWIO_MSS_MSA_ADDR A:0xfc980058
y.create.l HWIO_MSS_HW_VERSION_ADDR A:0xfc98005c
y.create.l HWIO_MSS_DIME_MEM_SLP_CNTL_ADDR A:0xfc980060
y.create.l HWIO_MSS_CLOCK_SPDM_MON_ADDR A:0xfc980064
y.create.l HWIO_MSS_BBRX0_MUX_SEL_ADDR A:0xfc980068
y.create.l HWIO_MSS_BBRX1_MUX_SEL_ADDR A:0xfc98006c
y.create.l HWIO_MSS_DEBUG_CLOCK_CTL_ADDR A:0xfc980078
y.create.l HWIO_MSS_BBRX_EXT_CLOCK_MUX_SEL_ADDR A:0xfc98007c
y.create.l HWIO_MSS_GNSSADC_BIST_CONFIG_ADDR A:0xfc980084
y.create.l HWIO_MSS_GNSSADC_BIST_STATUS_1_ADDR A:0xfc980088
y.create.l HWIO_MSS_GNSSADC_BIST_STATUS_2_ADDR A:0xfc98008c
y.create.l HWIO_MSS_GNSSADC_BIST_STATUS_3_ADDR A:0xfc980090
y.create.l HWIO_MSS_BBRX_CTL_ADDR A:0xfc980094
y.create.l HWIO_MSS_DEBUG_CTL_ADDR A:0xfc980098
y.create.l HWIO_MSS_MPLL1_MODE_ADDR A:0xfc981020
y.create.l HWIO_MSS_MPLL1_L_VAL_ADDR A:0xfc981024
y.create.l HWIO_MSS_MPLL1_M_VAL_ADDR A:0xfc981028
y.create.l HWIO_MSS_MPLL1_N_VAL_ADDR A:0xfc98102c
y.create.l HWIO_MSS_MPLL1_USER_CTL_ADDR A:0xfc981030
y.create.l HWIO_MSS_MPLL1_CONFIG_CTL_ADDR A:0xfc981034
y.create.l HWIO_MSS_MPLL1_TEST_CTL_ADDR A:0xfc981038
y.create.l HWIO_MSS_MPLL1_STATUS_ADDR A:0xfc98103c
y.create.l HWIO_MSS_MPLL2_MODE_ADDR A:0xfc981040
y.create.l HWIO_MSS_MPLL2_L_VAL_ADDR A:0xfc981044
y.create.l HWIO_MSS_MPLL2_M_VAL_ADDR A:0xfc981048
y.create.l HWIO_MSS_MPLL2_N_VAL_ADDR A:0xfc98104c
y.create.l HWIO_MSS_MPLL2_USER_CTL_ADDR A:0xfc981050
y.create.l HWIO_MSS_MPLL2_CONFIG_CTL_ADDR A:0xfc981054
y.create.l HWIO_MSS_MPLL2_TEST_CTL_ADDR A:0xfc981058
y.create.l HWIO_MSS_MPLL2_STATUS_ADDR A:0xfc98105c
y.create.l HWIO_MSS_UIM0_BCR_ADDR A:0xfc981060
y.create.l HWIO_MSS_UIM1_BCR_ADDR A:0xfc981064
y.create.l HWIO_MSS_Q6SS_BCR_ADDR A:0xfc981068
y.create.l HWIO_MSS_NC_HM_BCR_ADDR A:0xfc98106c
y.create.l HWIO_MSS_UIM0_CBCR_ADDR A:0xfc981078
y.create.l HWIO_MSS_UIM1_CBCR_ADDR A:0xfc98107c
y.create.l HWIO_MSS_XO_UIM0_CBCR_ADDR A:0xfc981080
y.create.l HWIO_MSS_XO_UIM1_CBCR_ADDR A:0xfc981084
y.create.l HWIO_MSS_XO_MODEM_CBCR_ADDR A:0xfc981088
y.create.l HWIO_MSS_XO_Q6_CBCR_ADDR A:0xfc98108c
y.create.l HWIO_MSS_BUS_UIM0_CBCR_ADDR A:0xfc981090
y.create.l HWIO_MSS_BUS_UIM1_CBCR_ADDR A:0xfc981094
y.create.l HWIO_MSS_BUS_CSR_CBCR_ADDR A:0xfc981098
y.create.l HWIO_MSS_BUS_BRIDGE_CBCR_ADDR A:0xfc98109c
y.create.l HWIO_MSS_BUS_MODEM_CBCR_ADDR A:0xfc9810a0
y.create.l HWIO_MSS_BUS_Q6_CBCR_ADDR A:0xfc9810a4
y.create.l HWIO_MSS_BUS_NC_HM_BRIDGE_CBCR_ADDR A:0xfc9810a8
y.create.l HWIO_MSS_BUS_CRYPTO_CBCR_ADDR A:0xfc9810ac
y.create.l HWIO_MSS_BUS_NAV_CBCR_ADDR A:0xfc9810b0
y.create.l HWIO_MSS_BUS_NC_HM_BRIDGE_CX_CBCR_ADDR A:0xfc9810b4
y.create.l HWIO_MSS_BUS_ATB_CBCR_ADDR A:0xfc9810b8
y.create.l HWIO_MSS_BUS_SLAVE_TIMEOUT_CBCR_ADDR A:0xfc9810c4
y.create.l HWIO_MSS_BUS_COMBODAC_COMP_CBCR_ADDR A:0xfc9810cc
y.create.l HWIO_MSS_MODEM_CFG_AHB_CBCR_ADDR A:0xfc9810d4
y.create.l HWIO_MSS_MODEM_SNOC_AXI_CBCR_ADDR A:0xfc9810d8
y.create.l HWIO_MSS_NAV_SNOC_AXI_CBCR_ADDR A:0xfc9810dc
y.create.l HWIO_MSS_VMIDMT_SNOC_AXI_CBCR_ADDR A:0xfc9810e0
y.create.l HWIO_MSS_MPLL2_MAIN_MODEM_CBCR_ADDR A:0xfc9810e4
y.create.l HWIO_MSS_MPLL1_MAIN_CBCR_ADDR A:0xfc9810e8
y.create.l HWIO_MSS_MPLL1_MAIN_BUS_CBCR_ADDR A:0xfc9810ec
y.create.l HWIO_MSS_MPLL1_EARLY_DIV5_CBCR_ADDR A:0xfc9810f0
y.create.l HWIO_MSS_MPLL1_EARLY_DIV3_CBCR_ADDR A:0xfc9810f4
y.create.l HWIO_MSS_SLEEP_Q6_CBCR_ADDR A:0xfc9810fc
y.create.l HWIO_MSS_MPLL1_OUT_EARLY_DIV3_CBCR_ADDR A:0xfc981100
y.create.l HWIO_MSS_MPLL1_OUT_EARLY_DIV5_CBCR_ADDR A:0xfc981104
y.create.l HWIO_MSS_BUS_CMD_RCGR_ADDR A:0xfc981108
y.create.l HWIO_MSS_BUS_CFG_RCGR_ADDR A:0xfc98110c
y.create.l HWIO_MSS_Q6_CMD_RCGR_ADDR A:0xfc981110
y.create.l HWIO_MSS_Q6_CFG_RCGR_ADDR A:0xfc981114
y.create.l HWIO_MSS_UIM_CMD_RCGR_ADDR A:0xfc981118
y.create.l HWIO_MSS_UIM_CFG_RCGR_ADDR A:0xfc98111c
y.create.l HWIO_MSS_BBRX0_CBCR_ADDR A:0xfc981120
y.create.l HWIO_MSS_BBRX1_CBCR_ADDR A:0xfc981124
y.create.l HWIO_MSS_RESERVE_01_ADDR A:0xfc981130
y.create.l HWIO_MSS_RESERVE_02_ADDR A:0xfc981134
y.create.l HWIO_MSS_BBRX0_MISC_ADDR A:0xfc981138
y.create.l HWIO_MSS_BBRX1_MISC_ADDR A:0xfc98113c
y.create.l HWIO_MSS_UIM0_MND_CMD_RCGR_ADDR A:0xfc981150
y.create.l HWIO_MSS_UIM0_MND_CFG_RCGR_ADDR A:0xfc981154
y.create.l HWIO_MSS_UIM0_MND_M_ADDR A:0xfc981158
y.create.l HWIO_MSS_UIM0_MND_N_ADDR A:0xfc98115c
y.create.l HWIO_MSS_UIM0_MND_D_ADDR A:0xfc981160
y.create.l HWIO_MSS_UIM1_MND_CMD_RCGR_ADDR A:0xfc981164
y.create.l HWIO_MSS_UIM1_MND_CFG_RCGR_ADDR A:0xfc981168
y.create.l HWIO_MSS_UIM1_MND_M_ADDR A:0xfc98116c
y.create.l HWIO_MSS_UIM1_MND_N_ADDR A:0xfc981170
y.create.l HWIO_MSS_UIM1_MND_D_ADDR A:0xfc981174
y.create.l HWIO_MSS_UIM2_BCR_ADDR A:0xfc981178
y.create.l HWIO_MSS_UIM2_CBCR_ADDR A:0xfc98117c
y.create.l HWIO_MSS_XO_UIM2_CBCR_ADDR A:0xfc981180
y.create.l HWIO_MSS_BUS_UIM2_CBCR_ADDR A:0xfc981184
y.create.l HWIO_MSS_UIM2_MND_CMD_RCGR_ADDR A:0xfc981188
y.create.l HWIO_MSS_UIM2_MND_CFG_RCGR_ADDR A:0xfc98118c
y.create.l HWIO_MSS_UIM2_MND_M_ADDR A:0xfc981190
y.create.l HWIO_MSS_UIM2_MND_N_ADDR A:0xfc981194
y.create.l HWIO_MSS_UIM2_MND_D_ADDR A:0xfc981198
y.create.l HWIO_MSS_TCSR_ACC_SEL_ADDR A:0xfc98f000
y.create.l HWIO_MSS_UIM0_UART_DM_MR1_ADDR A:0xfc990000
y.create.l HWIO_MSS_UIM0_UART_DM_MR2_ADDR A:0xfc990004
y.create.l HWIO_MSS_UIM0_UART_DM_CSR_SR_DEPRECATED_ADDR A:0xfc990008
y.create.l HWIO_MSS_UIM0_UART_DM_CR_MISR_DEPRECATED_ADDR A:0xfc990010
y.create.l HWIO_MSS_UIM0_UART_DM_IMR_ISR_DEPRECATED_ADDR A:0xfc990014
y.create.l HWIO_MSS_UIM0_UART_DM_IPR_ADDR A:0xfc990018
y.create.l HWIO_MSS_UIM0_UART_DM_TFWR_ADDR A:0xfc99001c
y.create.l HWIO_MSS_UIM0_UART_DM_RFWR_ADDR A:0xfc990020
y.create.l HWIO_MSS_UIM0_UART_DM_HCR_ADDR A:0xfc990024
y.create.l HWIO_MSS_UIM0_UART_DM_DMRX_ADDR A:0xfc990034
y.create.l HWIO_MSS_UIM0_UART_DM_IRDA_RX_TOTAL_SNAP_DEPRECATED_ADDR A:0xfc990038
y.create.l HWIO_MSS_UIM0_UART_DM_DMEN_ADDR A:0xfc99003c
y.create.l HWIO_MSS_UIM0_UART_DM_NO_CHARS_FOR_TX_ADDR A:0xfc990040
y.create.l HWIO_MSS_UIM0_UART_DM_BADR_ADDR A:0xfc990044
y.create.l HWIO_MSS_UIM0_UART_DM_TESTSL_ADDR A:0xfc990048
y.create.l HWIO_MSS_UIM0_UART_DM_TXFS_ADDR A:0xfc99004c
y.create.l HWIO_MSS_UIM0_UART_DM_RXFS_ADDR A:0xfc990050
y.create.l HWIO_MSS_UIM0_UART_DM_MISR_MODE_ADDR A:0xfc990060
y.create.l HWIO_MSS_UIM0_UART_DM_MISR_RESET_ADDR A:0xfc990064
y.create.l HWIO_MSS_UIM0_UART_DM_MISR_EXPORT_ADDR A:0xfc990068
y.create.l HWIO_MSS_UIM0_UART_DM_MISR_VAL_ADDR A:0xfc99006c
y.create.l HWIO_MSS_UIM0_UART_DM_TF_RF_DEPRECATED_ADDR A:0xfc990070
y.create.l HWIO_MSS_UIM0_UART_DM_TF_RF_2_DEPRECATED_ADDR A:0xfc990074
y.create.l HWIO_MSS_UIM0_UART_DM_TF_RF_3_DEPRECATED_ADDR A:0xfc990078
y.create.l HWIO_MSS_UIM0_UART_DM_TF_RF_4_DEPRECATED_ADDR A:0xfc99007c
y.create.l HWIO_MSS_UIM0_UART_DM_SIM_CFG_ADDR A:0xfc990080
y.create.l HWIO_MSS_UIM0_UART_DM_TEST_WR_ADDR_ADDR A:0xfc990084
y.create.l HWIO_MSS_UIM0_UART_DM_TEST_WR_DATA_ADDR A:0xfc990088
y.create.l HWIO_MSS_UIM0_UART_DM_TEST_RD_ADDR_ADDR A:0xfc99008c
y.create.l HWIO_MSS_UIM0_UART_DM_TEST_RD_DATA_ADDR A:0xfc990090
y.create.l HWIO_MSS_UIM0_UART_DM_CSR_ADDR A:0xfc9900a0
y.create.l HWIO_MSS_UIM0_UART_DM_SR_ADDR A:0xfc9900a4
y.create.l HWIO_MSS_UIM0_UART_DM_CR_ADDR A:0xfc9900a8
y.create.l HWIO_MSS_UIM0_UART_DM_MISR_ADDR A:0xfc9900ac
y.create.l HWIO_MSS_UIM0_UART_DM_IMR_ADDR A:0xfc9900b0
y.create.l HWIO_MSS_UIM0_UART_DM_ISR_ADDR A:0xfc9900b4
y.create.l HWIO_MSS_UIM0_UART_DM_IRDA_ADDR A:0xfc9900b8
y.create.l HWIO_MSS_UIM0_UART_DM_RX_TOTAL_SNAP_ADDR A:0xfc9900bc
y.create.l HWIO_MSS_UIM0_UART_DM_WWT_TIMEOUT_ADDR A:0xfc9900c0
y.create.l HWIO_MSS_UIM0_UART_DM_CLK_CTRL_ADDR A:0xfc9900c4
y.create.l HWIO_MSS_UIM0_UART_DM_BCR_ADDR A:0xfc9900c8
y.create.l HWIO_MSS_UIM0_UART_DM_RX_TRANS_CTRL_ADDR A:0xfc9900cc
y.create.l HWIO_MSS_UIM0_UART_DM_DMRX_DBG_ADDR A:0xfc9900d0
y.create.l HWIO_MSS_UIM0_UART_DM_FSM_STATUS_ADDR A:0xfc9900d4
y.create.l HWIO_MSS_UIM0_UART_DM_HW_VERSION_ADDR A:0xfc9900d8
y.create.l HWIO_MSS_UIM0_UART_DM_GENERICS_ADDR A:0xfc9900dc
y.create.l HWIO_MSS_UIM0_UART_DM_TF_ADDR A:0xfc990100
y.create.l HWIO_MSS_UIM0_UART_DM_TF_2_ADDR A:0xfc990104
y.create.l HWIO_MSS_UIM0_UART_DM_TF_3_ADDR A:0xfc990108
y.create.l HWIO_MSS_UIM0_UART_DM_TF_4_ADDR A:0xfc99010c
y.create.l HWIO_MSS_UIM0_UART_DM_TF_5_ADDR A:0xfc990110
y.create.l HWIO_MSS_UIM0_UART_DM_TF_6_ADDR A:0xfc990114
y.create.l HWIO_MSS_UIM0_UART_DM_TF_7_ADDR A:0xfc990118
y.create.l HWIO_MSS_UIM0_UART_DM_TF_8_ADDR A:0xfc99011c
y.create.l HWIO_MSS_UIM0_UART_DM_TF_9_ADDR A:0xfc990120
y.create.l HWIO_MSS_UIM0_UART_DM_TF_10_ADDR A:0xfc990124
y.create.l HWIO_MSS_UIM0_UART_DM_TF_11_ADDR A:0xfc990128
y.create.l HWIO_MSS_UIM0_UART_DM_TF_12_ADDR A:0xfc99012c
y.create.l HWIO_MSS_UIM0_UART_DM_TF_13_ADDR A:0xfc990130
y.create.l HWIO_MSS_UIM0_UART_DM_TF_14_ADDR A:0xfc990134
y.create.l HWIO_MSS_UIM0_UART_DM_TF_15_ADDR A:0xfc990138
y.create.l HWIO_MSS_UIM0_UART_DM_TF_16_ADDR A:0xfc99013c
y.create.l HWIO_MSS_UIM0_UART_DM_RF_ADDR A:0xfc990140
y.create.l HWIO_MSS_UIM0_UART_DM_RF_2_ADDR A:0xfc990144
y.create.l HWIO_MSS_UIM0_UART_DM_RF_3_ADDR A:0xfc990148
y.create.l HWIO_MSS_UIM0_UART_DM_RF_4_ADDR A:0xfc99014c
y.create.l HWIO_MSS_UIM0_UART_DM_RF_5_ADDR A:0xfc990150
y.create.l HWIO_MSS_UIM0_UART_DM_RF_6_ADDR A:0xfc990154
y.create.l HWIO_MSS_UIM0_UART_DM_RF_7_ADDR A:0xfc990158
y.create.l HWIO_MSS_UIM0_UART_DM_RF_8_ADDR A:0xfc99015c
y.create.l HWIO_MSS_UIM0_UART_DM_RF_9_ADDR A:0xfc990160
y.create.l HWIO_MSS_UIM0_UART_DM_RF_10_ADDR A:0xfc990164
y.create.l HWIO_MSS_UIM0_UART_DM_RF_11_ADDR A:0xfc990168
y.create.l HWIO_MSS_UIM0_UART_DM_RF_12_ADDR A:0xfc99016c
y.create.l HWIO_MSS_UIM0_UART_DM_RF_13_ADDR A:0xfc990170
y.create.l HWIO_MSS_UIM0_UART_DM_RF_14_ADDR A:0xfc990174
y.create.l HWIO_MSS_UIM0_UART_DM_RF_15_ADDR A:0xfc990178
y.create.l HWIO_MSS_UIM0_UART_DM_RF_16_ADDR A:0xfc99017c
y.create.l HWIO_MSS_UIM0_UART_DM_UIM_CFG_ADDR A:0xfc990180
y.create.l HWIO_MSS_UIM0_UART_DM_UIM_CMD_ADDR A:0xfc990184
y.create.l HWIO_MSS_UIM0_UART_DM_UIM_IO_STATUS_ADDR A:0xfc990188
y.create.l HWIO_MSS_UIM0_UART_DM_UIM_IRQ_ISR_ADDR A:0xfc99018c
y.create.l HWIO_MSS_UIM0_UART_DM_UIM_IRQ_MISR_ADDR A:0xfc990190
y.create.l HWIO_MSS_UIM0_UART_DM_UIM_IRQ_CLR_ADDR A:0xfc990194
y.create.l HWIO_MSS_UIM0_UART_DM_UIM_IRQ_IMR_ADDR A:0xfc990198
y.create.l HWIO_MSS_UIM0_UART_DM_UIM_IRQ_IMR_SET_ADDR A:0xfc99019c
y.create.l HWIO_MSS_UIM0_UART_DM_UIM_IRQ_IMR_CLR_ADDR A:0xfc9901a0
y.create.l HWIO_MSS_UIM1_UART_DM_MR1_ADDR A:0xfc998000
y.create.l HWIO_MSS_UIM1_UART_DM_MR2_ADDR A:0xfc998004
y.create.l HWIO_MSS_UIM1_UART_DM_CSR_SR_DEPRECATED_ADDR A:0xfc998008
y.create.l HWIO_MSS_UIM1_UART_DM_CR_MISR_DEPRECATED_ADDR A:0xfc998010
y.create.l HWIO_MSS_UIM1_UART_DM_IMR_ISR_DEPRECATED_ADDR A:0xfc998014
y.create.l HWIO_MSS_UIM1_UART_DM_IPR_ADDR A:0xfc998018
y.create.l HWIO_MSS_UIM1_UART_DM_TFWR_ADDR A:0xfc99801c
y.create.l HWIO_MSS_UIM1_UART_DM_RFWR_ADDR A:0xfc998020
y.create.l HWIO_MSS_UIM1_UART_DM_HCR_ADDR A:0xfc998024
y.create.l HWIO_MSS_UIM1_UART_DM_DMRX_ADDR A:0xfc998034
y.create.l HWIO_MSS_UIM1_UART_DM_IRDA_RX_TOTAL_SNAP_DEPRECATED_ADDR A:0xfc998038
y.create.l HWIO_MSS_UIM1_UART_DM_DMEN_ADDR A:0xfc99803c
y.create.l HWIO_MSS_UIM1_UART_DM_NO_CHARS_FOR_TX_ADDR A:0xfc998040
y.create.l HWIO_MSS_UIM1_UART_DM_BADR_ADDR A:0xfc998044
y.create.l HWIO_MSS_UIM1_UART_DM_TESTSL_ADDR A:0xfc998048
y.create.l HWIO_MSS_UIM1_UART_DM_TXFS_ADDR A:0xfc99804c
y.create.l HWIO_MSS_UIM1_UART_DM_RXFS_ADDR A:0xfc998050
y.create.l HWIO_MSS_UIM1_UART_DM_MISR_MODE_ADDR A:0xfc998060
y.create.l HWIO_MSS_UIM1_UART_DM_MISR_RESET_ADDR A:0xfc998064
y.create.l HWIO_MSS_UIM1_UART_DM_MISR_EXPORT_ADDR A:0xfc998068
y.create.l HWIO_MSS_UIM1_UART_DM_MISR_VAL_ADDR A:0xfc99806c
y.create.l HWIO_MSS_UIM1_UART_DM_TF_RF_DEPRECATED_ADDR A:0xfc998070
y.create.l HWIO_MSS_UIM1_UART_DM_TF_RF_2_DEPRECATED_ADDR A:0xfc998074
y.create.l HWIO_MSS_UIM1_UART_DM_TF_RF_3_DEPRECATED_ADDR A:0xfc998078
y.create.l HWIO_MSS_UIM1_UART_DM_TF_RF_4_DEPRECATED_ADDR A:0xfc99807c
y.create.l HWIO_MSS_UIM1_UART_DM_SIM_CFG_ADDR A:0xfc998080
y.create.l HWIO_MSS_UIM1_UART_DM_TEST_WR_ADDR_ADDR A:0xfc998084
y.create.l HWIO_MSS_UIM1_UART_DM_TEST_WR_DATA_ADDR A:0xfc998088
y.create.l HWIO_MSS_UIM1_UART_DM_TEST_RD_ADDR_ADDR A:0xfc99808c
y.create.l HWIO_MSS_UIM1_UART_DM_TEST_RD_DATA_ADDR A:0xfc998090
y.create.l HWIO_MSS_UIM1_UART_DM_CSR_ADDR A:0xfc9980a0
y.create.l HWIO_MSS_UIM1_UART_DM_SR_ADDR A:0xfc9980a4
y.create.l HWIO_MSS_UIM1_UART_DM_CR_ADDR A:0xfc9980a8
y.create.l HWIO_MSS_UIM1_UART_DM_MISR_ADDR A:0xfc9980ac
y.create.l HWIO_MSS_UIM1_UART_DM_IMR_ADDR A:0xfc9980b0
y.create.l HWIO_MSS_UIM1_UART_DM_ISR_ADDR A:0xfc9980b4
y.create.l HWIO_MSS_UIM1_UART_DM_IRDA_ADDR A:0xfc9980b8
y.create.l HWIO_MSS_UIM1_UART_DM_RX_TOTAL_SNAP_ADDR A:0xfc9980bc
y.create.l HWIO_MSS_UIM1_UART_DM_WWT_TIMEOUT_ADDR A:0xfc9980c0
y.create.l HWIO_MSS_UIM1_UART_DM_CLK_CTRL_ADDR A:0xfc9980c4
y.create.l HWIO_MSS_UIM1_UART_DM_BCR_ADDR A:0xfc9980c8
y.create.l HWIO_MSS_UIM1_UART_DM_RX_TRANS_CTRL_ADDR A:0xfc9980cc
y.create.l HWIO_MSS_UIM1_UART_DM_DMRX_DBG_ADDR A:0xfc9980d0
y.create.l HWIO_MSS_UIM1_UART_DM_FSM_STATUS_ADDR A:0xfc9980d4
y.create.l HWIO_MSS_UIM1_UART_DM_HW_VERSION_ADDR A:0xfc9980d8
y.create.l HWIO_MSS_UIM1_UART_DM_GENERICS_ADDR A:0xfc9980dc
y.create.l HWIO_MSS_UIM1_UART_DM_TF_ADDR A:0xfc998100
y.create.l HWIO_MSS_UIM1_UART_DM_TF_2_ADDR A:0xfc998104
y.create.l HWIO_MSS_UIM1_UART_DM_TF_3_ADDR A:0xfc998108
y.create.l HWIO_MSS_UIM1_UART_DM_TF_4_ADDR A:0xfc99810c
y.create.l HWIO_MSS_UIM1_UART_DM_TF_5_ADDR A:0xfc998110
y.create.l HWIO_MSS_UIM1_UART_DM_TF_6_ADDR A:0xfc998114
y.create.l HWIO_MSS_UIM1_UART_DM_TF_7_ADDR A:0xfc998118
y.create.l HWIO_MSS_UIM1_UART_DM_TF_8_ADDR A:0xfc99811c
y.create.l HWIO_MSS_UIM1_UART_DM_TF_9_ADDR A:0xfc998120
y.create.l HWIO_MSS_UIM1_UART_DM_TF_10_ADDR A:0xfc998124
y.create.l HWIO_MSS_UIM1_UART_DM_TF_11_ADDR A:0xfc998128
y.create.l HWIO_MSS_UIM1_UART_DM_TF_12_ADDR A:0xfc99812c
y.create.l HWIO_MSS_UIM1_UART_DM_TF_13_ADDR A:0xfc998130
y.create.l HWIO_MSS_UIM1_UART_DM_TF_14_ADDR A:0xfc998134
y.create.l HWIO_MSS_UIM1_UART_DM_TF_15_ADDR A:0xfc998138
y.create.l HWIO_MSS_UIM1_UART_DM_TF_16_ADDR A:0xfc99813c
y.create.l HWIO_MSS_UIM1_UART_DM_RF_ADDR A:0xfc998140
y.create.l HWIO_MSS_UIM1_UART_DM_RF_2_ADDR A:0xfc998144
y.create.l HWIO_MSS_UIM1_UART_DM_RF_3_ADDR A:0xfc998148
y.create.l HWIO_MSS_UIM1_UART_DM_RF_4_ADDR A:0xfc99814c
y.create.l HWIO_MSS_UIM1_UART_DM_RF_5_ADDR A:0xfc998150
y.create.l HWIO_MSS_UIM1_UART_DM_RF_6_ADDR A:0xfc998154
y.create.l HWIO_MSS_UIM1_UART_DM_RF_7_ADDR A:0xfc998158
y.create.l HWIO_MSS_UIM1_UART_DM_RF_8_ADDR A:0xfc99815c
y.create.l HWIO_MSS_UIM1_UART_DM_RF_9_ADDR A:0xfc998160
y.create.l HWIO_MSS_UIM1_UART_DM_RF_10_ADDR A:0xfc998164
y.create.l HWIO_MSS_UIM1_UART_DM_RF_11_ADDR A:0xfc998168
y.create.l HWIO_MSS_UIM1_UART_DM_RF_12_ADDR A:0xfc99816c
y.create.l HWIO_MSS_UIM1_UART_DM_RF_13_ADDR A:0xfc998170
y.create.l HWIO_MSS_UIM1_UART_DM_RF_14_ADDR A:0xfc998174
y.create.l HWIO_MSS_UIM1_UART_DM_RF_15_ADDR A:0xfc998178
y.create.l HWIO_MSS_UIM1_UART_DM_RF_16_ADDR A:0xfc99817c
y.create.l HWIO_MSS_UIM1_UART_DM_UIM_CFG_ADDR A:0xfc998180
y.create.l HWIO_MSS_UIM1_UART_DM_UIM_CMD_ADDR A:0xfc998184
y.create.l HWIO_MSS_UIM1_UART_DM_UIM_IO_STATUS_ADDR A:0xfc998188
y.create.l HWIO_MSS_UIM1_UART_DM_UIM_IRQ_ISR_ADDR A:0xfc99818c
y.create.l HWIO_MSS_UIM1_UART_DM_UIM_IRQ_MISR_ADDR A:0xfc998190
y.create.l HWIO_MSS_UIM1_UART_DM_UIM_IRQ_CLR_ADDR A:0xfc998194
y.create.l HWIO_MSS_UIM1_UART_DM_UIM_IRQ_IMR_ADDR A:0xfc998198
y.create.l HWIO_MSS_UIM1_UART_DM_UIM_IRQ_IMR_SET_ADDR A:0xfc99819c
y.create.l HWIO_MSS_UIM1_UART_DM_UIM_IRQ_IMR_CLR_ADDR A:0xfc9981a0
y.create.l HWIO_MSS_UIM2_UART_DM_MR1_ADDR A:0xfc9a8000
y.create.l HWIO_MSS_UIM2_UART_DM_MR2_ADDR A:0xfc9a8004
y.create.l HWIO_MSS_UIM2_UART_DM_CSR_SR_DEPRECATED_ADDR A:0xfc9a8008
y.create.l HWIO_MSS_UIM2_UART_DM_CR_MISR_DEPRECATED_ADDR A:0xfc9a8010
y.create.l HWIO_MSS_UIM2_UART_DM_IMR_ISR_DEPRECATED_ADDR A:0xfc9a8014
y.create.l HWIO_MSS_UIM2_UART_DM_IPR_ADDR A:0xfc9a8018
y.create.l HWIO_MSS_UIM2_UART_DM_TFWR_ADDR A:0xfc9a801c
y.create.l HWIO_MSS_UIM2_UART_DM_RFWR_ADDR A:0xfc9a8020
y.create.l HWIO_MSS_UIM2_UART_DM_HCR_ADDR A:0xfc9a8024
y.create.l HWIO_MSS_UIM2_UART_DM_DMRX_ADDR A:0xfc9a8034
y.create.l HWIO_MSS_UIM2_UART_DM_IRDA_RX_TOTAL_SNAP_DEPRECATED_ADDR A:0xfc9a8038
y.create.l HWIO_MSS_UIM2_UART_DM_DMEN_ADDR A:0xfc9a803c
y.create.l HWIO_MSS_UIM2_UART_DM_NO_CHARS_FOR_TX_ADDR A:0xfc9a8040
y.create.l HWIO_MSS_UIM2_UART_DM_BADR_ADDR A:0xfc9a8044
y.create.l HWIO_MSS_UIM2_UART_DM_TESTSL_ADDR A:0xfc9a8048
y.create.l HWIO_MSS_UIM2_UART_DM_TXFS_ADDR A:0xfc9a804c
y.create.l HWIO_MSS_UIM2_UART_DM_RXFS_ADDR A:0xfc9a8050
y.create.l HWIO_MSS_UIM2_UART_DM_MISR_MODE_ADDR A:0xfc9a8060
y.create.l HWIO_MSS_UIM2_UART_DM_MISR_RESET_ADDR A:0xfc9a8064
y.create.l HWIO_MSS_UIM2_UART_DM_MISR_EXPORT_ADDR A:0xfc9a8068
y.create.l HWIO_MSS_UIM2_UART_DM_MISR_VAL_ADDR A:0xfc9a806c
y.create.l HWIO_MSS_UIM2_UART_DM_TF_RF_DEPRECATED_ADDR A:0xfc9a8070
y.create.l HWIO_MSS_UIM2_UART_DM_TF_RF_2_DEPRECATED_ADDR A:0xfc9a8074
y.create.l HWIO_MSS_UIM2_UART_DM_TF_RF_3_DEPRECATED_ADDR A:0xfc9a8078
y.create.l HWIO_MSS_UIM2_UART_DM_TF_RF_4_DEPRECATED_ADDR A:0xfc9a807c
y.create.l HWIO_MSS_UIM2_UART_DM_SIM_CFG_ADDR A:0xfc9a8080
y.create.l HWIO_MSS_UIM2_UART_DM_TEST_WR_ADDR_ADDR A:0xfc9a8084
y.create.l HWIO_MSS_UIM2_UART_DM_TEST_WR_DATA_ADDR A:0xfc9a8088
y.create.l HWIO_MSS_UIM2_UART_DM_TEST_RD_ADDR_ADDR A:0xfc9a808c
y.create.l HWIO_MSS_UIM2_UART_DM_TEST_RD_DATA_ADDR A:0xfc9a8090
y.create.l HWIO_MSS_UIM2_UART_DM_CSR_ADDR A:0xfc9a80a0
y.create.l HWIO_MSS_UIM2_UART_DM_SR_ADDR A:0xfc9a80a4
y.create.l HWIO_MSS_UIM2_UART_DM_CR_ADDR A:0xfc9a80a8
y.create.l HWIO_MSS_UIM2_UART_DM_MISR_ADDR A:0xfc9a80ac
y.create.l HWIO_MSS_UIM2_UART_DM_IMR_ADDR A:0xfc9a80b0
y.create.l HWIO_MSS_UIM2_UART_DM_ISR_ADDR A:0xfc9a80b4
y.create.l HWIO_MSS_UIM2_UART_DM_IRDA_ADDR A:0xfc9a80b8
y.create.l HWIO_MSS_UIM2_UART_DM_RX_TOTAL_SNAP_ADDR A:0xfc9a80bc
y.create.l HWIO_MSS_UIM2_UART_DM_WWT_TIMEOUT_ADDR A:0xfc9a80c0
y.create.l HWIO_MSS_UIM2_UART_DM_CLK_CTRL_ADDR A:0xfc9a80c4
y.create.l HWIO_MSS_UIM2_UART_DM_BCR_ADDR A:0xfc9a80c8
y.create.l HWIO_MSS_UIM2_UART_DM_RX_TRANS_CTRL_ADDR A:0xfc9a80cc
y.create.l HWIO_MSS_UIM2_UART_DM_DMRX_DBG_ADDR A:0xfc9a80d0
y.create.l HWIO_MSS_UIM2_UART_DM_FSM_STATUS_ADDR A:0xfc9a80d4
y.create.l HWIO_MSS_UIM2_UART_DM_HW_VERSION_ADDR A:0xfc9a80d8
y.create.l HWIO_MSS_UIM2_UART_DM_GENERICS_ADDR A:0xfc9a80dc
y.create.l HWIO_MSS_UIM2_UART_DM_TF_ADDR A:0xfc9a8100
y.create.l HWIO_MSS_UIM2_UART_DM_TF_2_ADDR A:0xfc9a8104
y.create.l HWIO_MSS_UIM2_UART_DM_TF_3_ADDR A:0xfc9a8108
y.create.l HWIO_MSS_UIM2_UART_DM_TF_4_ADDR A:0xfc9a810c
y.create.l HWIO_MSS_UIM2_UART_DM_TF_5_ADDR A:0xfc9a8110
y.create.l HWIO_MSS_UIM2_UART_DM_TF_6_ADDR A:0xfc9a8114
y.create.l HWIO_MSS_UIM2_UART_DM_TF_7_ADDR A:0xfc9a8118
y.create.l HWIO_MSS_UIM2_UART_DM_TF_8_ADDR A:0xfc9a811c
y.create.l HWIO_MSS_UIM2_UART_DM_TF_9_ADDR A:0xfc9a8120
y.create.l HWIO_MSS_UIM2_UART_DM_TF_10_ADDR A:0xfc9a8124
y.create.l HWIO_MSS_UIM2_UART_DM_TF_11_ADDR A:0xfc9a8128
y.create.l HWIO_MSS_UIM2_UART_DM_TF_12_ADDR A:0xfc9a812c
y.create.l HWIO_MSS_UIM2_UART_DM_TF_13_ADDR A:0xfc9a8130
y.create.l HWIO_MSS_UIM2_UART_DM_TF_14_ADDR A:0xfc9a8134
y.create.l HWIO_MSS_UIM2_UART_DM_TF_15_ADDR A:0xfc9a8138
y.create.l HWIO_MSS_UIM2_UART_DM_TF_16_ADDR A:0xfc9a813c
y.create.l HWIO_MSS_UIM2_UART_DM_RF_ADDR A:0xfc9a8140
y.create.l HWIO_MSS_UIM2_UART_DM_RF_2_ADDR A:0xfc9a8144
y.create.l HWIO_MSS_UIM2_UART_DM_RF_3_ADDR A:0xfc9a8148
y.create.l HWIO_MSS_UIM2_UART_DM_RF_4_ADDR A:0xfc9a814c
y.create.l HWIO_MSS_UIM2_UART_DM_RF_5_ADDR A:0xfc9a8150
y.create.l HWIO_MSS_UIM2_UART_DM_RF_6_ADDR A:0xfc9a8154
y.create.l HWIO_MSS_UIM2_UART_DM_RF_7_ADDR A:0xfc9a8158
y.create.l HWIO_MSS_UIM2_UART_DM_RF_8_ADDR A:0xfc9a815c
y.create.l HWIO_MSS_UIM2_UART_DM_RF_9_ADDR A:0xfc9a8160
y.create.l HWIO_MSS_UIM2_UART_DM_RF_10_ADDR A:0xfc9a8164
y.create.l HWIO_MSS_UIM2_UART_DM_RF_11_ADDR A:0xfc9a8168
y.create.l HWIO_MSS_UIM2_UART_DM_RF_12_ADDR A:0xfc9a816c
y.create.l HWIO_MSS_UIM2_UART_DM_RF_13_ADDR A:0xfc9a8170
y.create.l HWIO_MSS_UIM2_UART_DM_RF_14_ADDR A:0xfc9a8174
y.create.l HWIO_MSS_UIM2_UART_DM_RF_15_ADDR A:0xfc9a8178
y.create.l HWIO_MSS_UIM2_UART_DM_RF_16_ADDR A:0xfc9a817c
y.create.l HWIO_MSS_UIM2_UART_DM_UIM_CFG_ADDR A:0xfc9a8180
y.create.l HWIO_MSS_UIM2_UART_DM_UIM_CMD_ADDR A:0xfc9a8184
y.create.l HWIO_MSS_UIM2_UART_DM_UIM_IO_STATUS_ADDR A:0xfc9a8188
y.create.l HWIO_MSS_UIM2_UART_DM_UIM_IRQ_ISR_ADDR A:0xfc9a818c
y.create.l HWIO_MSS_UIM2_UART_DM_UIM_IRQ_MISR_ADDR A:0xfc9a8190
y.create.l HWIO_MSS_UIM2_UART_DM_UIM_IRQ_CLR_ADDR A:0xfc9a8194
y.create.l HWIO_MSS_UIM2_UART_DM_UIM_IRQ_IMR_ADDR A:0xfc9a8198
y.create.l HWIO_MSS_UIM2_UART_DM_UIM_IRQ_IMR_SET_ADDR A:0xfc9a819c
y.create.l HWIO_MSS_UIM2_UART_DM_UIM_IRQ_IMR_CLR_ADDR A:0xfc9a81a0
y.create.l HWIO_MSS_CONF_ABT_HW_VERSION_ADDR A:0xfc9b0000
y.create.l HWIO_MSS_CONF_ABT_INST_ID_ADDR A:0xfc9b0004
y.create.l HWIO_MSS_CONF_ABT_NUM_SLAVES_ADDR A:0xfc9b0008
y.create.l HWIO_MSS_CONF_ABT_TIMER_LOADVAL_ADDR A:0xfc9b000c
y.create.l HWIO_MSS_CONF_ABT_TIMER_MODE_ADDR A:0xfc9b0010
y.create.l HWIO_MSS_CONF_ABT_INTR_STATUS_ADDR A:0xfc9b0014
y.create.l HWIO_MSS_CONF_ABT_INTR_CLEAR_ADDR A:0xfc9b0018
y.create.l HWIO_MSS_CONF_ABT_INTR_ENABLE_ADDR A:0xfc9b001c
y.create.l HWIO_MSS_CONF_ABT_SYND_VALID_ADDR A:0xfc9b0020
y.create.l HWIO_MSS_CONF_ABT_SYND_CLEAR_ADDR A:0xfc9b0024
y.create.l HWIO_MSS_CONF_ABT_SYND_ID_ADDR A:0xfc9b0028
y.create.l HWIO_MSS_CONF_ABT_SYND_ADDR0_ADDR A:0xfc9b002c
y.create.l HWIO_MSS_CONF_ABT_SYND_ADDR1_ADDR A:0xfc9b0030
y.create.l HWIO_MSS_CONF_ABT_SYND_HREADY_ADDR A:0xfc9b0034
y.create.l HWIO_COMBODAC_CFG0_0_ADDR A:0xfc9b2000
y.create.l HWIO_COMBODAC_CFG0_1_ADDR A:0xfc9b2004
y.create.l HWIO_COMBODAC_CFG1_0_ADDR A:0xfc9b2008
y.create.l HWIO_COMBODAC_CFG1_1_ADDR A:0xfc9b200c
y.create.l HWIO_COMBODAC_CTRL_0_ADDR A:0xfc9b2010
y.create.l HWIO_COMBODAC_CTRL_1_ADDR A:0xfc9b2014
y.create.l HWIO_COMBODAC_STATUS_0_ADDR A:0xfc9b2018
y.create.l HWIO_COMBODAC_STATUS_1_ADDR A:0xfc9b201c
y.create.l HWIO_COMBODAC_MSBCAL_ADDR A:0xfc9b2020
y.create.l HWIO_COMBODAC_DCCAL_ADDR A:0xfc9b2024
y.create.l HWIO_COMBODAC_MSBCAL_STATUS_ADDR A:0xfc9b2028
y.create.l HWIO_COMBODAC_DCCAL_STATUS_ADDR A:0xfc9b202c
y.create.l HWIO_COMBODAC_READ_MSBCAL_CODES_ADDR A:0xfc9b2030
y.create.l HWIO_COMBODAC_READ_MSBCAL_STATUS_ADDR A:0xfc9b2034
y.create.l HWIO_COMBODAC_READ_DCCAL_CODES_ADDR A:0xfc9b2038
y.create.l HWIO_COMBODAC_READ_DCCAL_STATUS_ADDR A:0xfc9b203c
y.create.l HWIO_COMBODAC_WRITE_MSBCAL_CODES_ADDR A:0xfc9b2040
y.create.l HWIO_COMBODAC_WRITE_MSBCAL_STATUS_ADDR A:0xfc9b2044
y.create.l HWIO_COMBODAC_WRITE_DCCAL_CODES_ADDR A:0xfc9b2048
y.create.l HWIO_COMBODAC_WRITE_DCCAL_STATUS_ADDR A:0xfc9b204c
y.create.l HWIO_COMBODAC_BIST_CFG1_ADDR A:0xfc9b2050
y.create.l HWIO_COMBODAC0_CLK_CFG_ADDR A:0xfc9b2054
y.create.l HWIO_COMBODAC1_CLK_CFG_ADDR A:0xfc9b2058
y.create.l HWIO_COMBODAC_CLK_SRC_CFG_ADDR A:0xfc9b205c
y.create.l HWIO_COMBODAC_REGARRAY0_ADDR A:0xfc9b2800
y.create.l HWIO_COMBODAC_REGARRAY1_ADDR A:0xfc9b2804
y.create.l HWIO_COMBODAC_REGARRAY2_ADDR A:0xfc9b2808
y.create.l HWIO_COMBODAC_REGARRAY3_ADDR A:0xfc9b280c
y.create.l HWIO_COMBODAC_REGARRAY4_ADDR A:0xfc9b2810
y.create.l HWIO_COMBODAC_REGARRAY5_ADDR A:0xfc9b2814
y.create.l HWIO_COMBODAC_REGARRAY6_ADDR A:0xfc9b2818
y.create.l HWIO_COMBODAC_REGARRAY7_ADDR A:0xfc9b281c
y.create.l HWIO_COMBODAC_REGARRAY8_ADDR A:0xfc9b2820
y.create.l HWIO_COMBODAC_REGARRAY9_ADDR A:0xfc9b2824
y.create.l HWIO_MSS_CRYPTO_VERSION_ADDR A:0xfc9da000
y.create.l HWIO_MSS_CRYPTO_DATA_IN0_ADDR A:0xfc9da010
y.create.l HWIO_MSS_CRYPTO_DATA_IN1_ADDR A:0xfc9da014
y.create.l HWIO_MSS_CRYPTO_DATA_IN2_ADDR A:0xfc9da018
y.create.l HWIO_MSS_CRYPTO_DATA_IN3_ADDR A:0xfc9da01c
y.create.l HWIO_MSS_CRYPTO_DATA_OUT0_ADDR A:0xfc9da020
y.create.l HWIO_MSS_CRYPTO_DATA_OUT1_ADDR A:0xfc9da024
y.create.l HWIO_MSS_CRYPTO_DATA_OUT2_ADDR A:0xfc9da028
y.create.l HWIO_MSS_CRYPTO_DATA_OUT3_ADDR A:0xfc9da02c
y.create.l HWIO_MSS_CRYPTO_STATUS_ADDR A:0xfc9da100
y.create.l HWIO_MSS_CRYPTO_STATUS2_ADDR A:0xfc9da104
y.create.l HWIO_MSS_CRYPTO_ENGINES_AVAIL_ADDR A:0xfc9da108
y.create.l HWIO_MSS_CRYPTO_FIFO_SIZES_ADDR A:0xfc9da10c
y.create.l HWIO_MSS_CRYPTO_SEG_SIZE_ADDR A:0xfc9da110
y.create.l HWIO_MSS_CRYPTO_GOPROC_ADDR A:0xfc9da120
y.create.l HWIO_MSS_CRYPTO_GOPROC_QC_KEY_ADDR A:0xfc9db000
y.create.l HWIO_MSS_CRYPTO_GOPROC_OEM_KEY_ADDR A:0xfc9dc000
y.create.l HWIO_MSS_CRYPTO_ENCR_SEG_CFG_ADDR A:0xfc9da200
y.create.l HWIO_MSS_CRYPTO_ENCR_SEG_SIZE_ADDR A:0xfc9da204
y.create.l HWIO_MSS_CRYPTO_ENCR_SEG_START_ADDR A:0xfc9da208
y.create.l HWIO_MSS_CRYPTO_ENCR_KEY0_ADDR A:0xfc9dd000
y.create.l HWIO_MSS_CRYPTO_ENCR_KEY1_ADDR A:0xfc9dd004
y.create.l HWIO_MSS_CRYPTO_ENCR_KEY2_ADDR A:0xfc9dd008
y.create.l HWIO_MSS_CRYPTO_ENCR_KEY3_ADDR A:0xfc9dd00c
y.create.l HWIO_MSS_CRYPTO_ENCR_KEY4_ADDR A:0xfc9dd010
y.create.l HWIO_MSS_CRYPTO_ENCR_KEY5_ADDR A:0xfc9dd014
y.create.l HWIO_MSS_CRYPTO_ENCR_KEY6_ADDR A:0xfc9dd018
y.create.l HWIO_MSS_CRYPTO_ENCR_KEY7_ADDR A:0xfc9dd01c
y.create.l HWIO_MSS_CRYPTO_ENCR_XTS_KEY0_ADDR A:0xfc9dd020
y.create.l HWIO_MSS_CRYPTO_ENCR_XTS_KEY1_ADDR A:0xfc9dd024
y.create.l HWIO_MSS_CRYPTO_ENCR_XTS_KEY2_ADDR A:0xfc9dd028
y.create.l HWIO_MSS_CRYPTO_ENCR_XTS_KEY3_ADDR A:0xfc9dd02c
y.create.l HWIO_MSS_CRYPTO_ENCR_XTS_KEY4_ADDR A:0xfc9dd030
y.create.l HWIO_MSS_CRYPTO_ENCR_XTS_KEY5_ADDR A:0xfc9dd034
y.create.l HWIO_MSS_CRYPTO_ENCR_XTS_KEY6_ADDR A:0xfc9dd038
y.create.l HWIO_MSS_CRYPTO_ENCR_XTS_KEY7_ADDR A:0xfc9dd03c
y.create.l HWIO_MSS_CRYPTO_ENCR_CNTR0_IV0_ADDR A:0xfc9da20c
y.create.l HWIO_MSS_CRYPTO_ENCR_CNTR1_IV1_ADDR A:0xfc9da210
y.create.l HWIO_MSS_CRYPTO_ENCR_CNTR2_IV2_ADDR A:0xfc9da214
y.create.l HWIO_MSS_CRYPTO_ENCR_CNTR3_IV3_ADDR A:0xfc9da218
y.create.l HWIO_MSS_CRYPTO_ENCR_CNTR_MASK_ADDR A:0xfc9da21c
y.create.l HWIO_MSS_CRYPTO_ENCR_CCM_INIT_CNTR0_ADDR A:0xfc9da220
y.create.l HWIO_MSS_CRYPTO_ENCR_CCM_INIT_CNTR1_ADDR A:0xfc9da224
y.create.l HWIO_MSS_CRYPTO_ENCR_CCM_INIT_CNTR2_ADDR A:0xfc9da228
y.create.l HWIO_MSS_CRYPTO_ENCR_CCM_INIT_CNTR3_ADDR A:0xfc9da22c
y.create.l HWIO_MSS_CRYPTO_ENCR_XTS_DU_SIZE_ADDR A:0xfc9da230
y.create.l HWIO_MSS_CRYPTO_AUTH_SEG_CFG_ADDR A:0xfc9da300
y.create.l HWIO_MSS_CRYPTO_AUTH_SEG_SIZE_ADDR A:0xfc9da304
y.create.l HWIO_MSS_CRYPTO_AUTH_SEG_START_ADDR A:0xfc9da308
y.create.l HWIO_MSS_CRYPTO_AUTH_KEY0_ADDR A:0xfc9dd040
y.create.l HWIO_MSS_CRYPTO_AUTH_KEY1_ADDR A:0xfc9dd044
y.create.l HWIO_MSS_CRYPTO_AUTH_KEY2_ADDR A:0xfc9dd048
y.create.l HWIO_MSS_CRYPTO_AUTH_KEY3_ADDR A:0xfc9dd04c
y.create.l HWIO_MSS_CRYPTO_AUTH_KEY4_ADDR A:0xfc9dd050
y.create.l HWIO_MSS_CRYPTO_AUTH_KEY5_ADDR A:0xfc9dd054
y.create.l HWIO_MSS_CRYPTO_AUTH_KEY6_ADDR A:0xfc9dd058
y.create.l HWIO_MSS_CRYPTO_AUTH_KEY7_ADDR A:0xfc9dd05c
y.create.l HWIO_MSS_CRYPTO_AUTH_KEY8_ADDR A:0xfc9dd060
y.create.l HWIO_MSS_CRYPTO_AUTH_KEY9_ADDR A:0xfc9dd064
y.create.l HWIO_MSS_CRYPTO_AUTH_IV0_ADDR A:0xfc9da310
y.create.l HWIO_MSS_CRYPTO_AUTH_IV1_ADDR A:0xfc9da314
y.create.l HWIO_MSS_CRYPTO_AUTH_IV2_ADDR A:0xfc9da318
y.create.l HWIO_MSS_CRYPTO_AUTH_IV3_ADDR A:0xfc9da31c
y.create.l HWIO_MSS_CRYPTO_AUTH_IV4_ADDR A:0xfc9da320
y.create.l HWIO_MSS_CRYPTO_AUTH_IV5_ADDR A:0xfc9da324
y.create.l HWIO_MSS_CRYPTO_AUTH_IV6_ADDR A:0xfc9da328
y.create.l HWIO_MSS_CRYPTO_AUTH_IV7_ADDR A:0xfc9da32c
y.create.l HWIO_MSS_CRYPTO_AUTH_INFO_NONCE0_ADDR A:0xfc9da350
y.create.l HWIO_MSS_CRYPTO_AUTH_INFO_NONCE1_ADDR A:0xfc9da354
y.create.l HWIO_MSS_CRYPTO_AUTH_INFO_NONCE2_ADDR A:0xfc9da358
y.create.l HWIO_MSS_CRYPTO_AUTH_INFO_NONCE3_ADDR A:0xfc9da35c
y.create.l HWIO_MSS_CRYPTO_AUTH_BYTECNT0_ADDR A:0xfc9da390
y.create.l HWIO_MSS_CRYPTO_AUTH_BYTECNT1_ADDR A:0xfc9da394
y.create.l HWIO_MSS_CRYPTO_AUTH_EXP_MAC0_ADDR A:0xfc9da3a0
y.create.l HWIO_MSS_CRYPTO_AUTH_EXP_MAC1_ADDR A:0xfc9da3a4
y.create.l HWIO_MSS_CRYPTO_AUTH_EXP_MAC2_ADDR A:0xfc9da3a8
y.create.l HWIO_MSS_CRYPTO_AUTH_EXP_MAC3_ADDR A:0xfc9da3ac
y.create.l HWIO_MSS_CRYPTO_AUTH_EXP_MAC4_ADDR A:0xfc9da3b0
y.create.l HWIO_MSS_CRYPTO_AUTH_EXP_MAC5_ADDR A:0xfc9da3b4
y.create.l HWIO_MSS_CRYPTO_AUTH_EXP_MAC6_ADDR A:0xfc9da3b8
y.create.l HWIO_MSS_CRYPTO_AUTH_EXP_MAC7_ADDR A:0xfc9da3bc
y.create.l HWIO_MSS_CRYPTO_CONFIG_ADDR A:0xfc9da400
y.create.l HWIO_MSS_CRYPTO_DEBUG_ENABLE_ADDR A:0xfc9df000
y.create.l HWIO_MSS_CRYPTO_DEBUG_ADDR A:0xfc9df004
y.create.l HWIO_MSS_CRYPTO_PWR_CTRL_ADDR A:0xfc9df008
y.create.l HWIO_MSS_CRYPTO_BAM_CTRL_ADDR A:0xfc9c4000
y.create.l HWIO_MSS_CRYPTO_BAM_REVISION_ADDR A:0xfc9c4004
y.create.l HWIO_MSS_CRYPTO_BAM_SW_VERSION_ADDR A:0xfc9c4080
y.create.l HWIO_MSS_CRYPTO_BAM_NUM_PIPES_ADDR A:0xfc9c403c
y.create.l HWIO_MSS_CRYPTO_BAM_TIMER_ADDR A:0xfc9c4040
y.create.l HWIO_MSS_CRYPTO_BAM_TIMER_CTRL_ADDR A:0xfc9c4044
y.create.l HWIO_MSS_CRYPTO_BAM_DESC_CNT_TRSHLD_ADDR A:0xfc9c4008
y.create.l HWIO_MSS_CRYPTO_BAM_IRQ_SRCS_ADDR A:0xfc9c400c
y.create.l HWIO_MSS_CRYPTO_BAM_IRQ_SRCS_MSK_ADDR A:0xfc9c4010
y.create.l HWIO_MSS_CRYPTO_BAM_IRQ_SRCS_UNMASKED_ADDR A:0xfc9c4030
y.create.l HWIO_MSS_CRYPTO_BAM_IRQ_STTS_ADDR A:0xfc9c4014
y.create.l HWIO_MSS_CRYPTO_BAM_IRQ_CLR_ADDR A:0xfc9c4018
y.create.l HWIO_MSS_CRYPTO_BAM_IRQ_EN_ADDR A:0xfc9c401c
y.create.l HWIO_MSS_CRYPTO_BAM_AHB_MASTER_ERR_CTRLS_ADDR A:0xfc9c4024
y.create.l HWIO_MSS_CRYPTO_BAM_AHB_MASTER_ERR_ADDR_ADDR A:0xfc9c4028
y.create.l HWIO_MSS_CRYPTO_BAM_AHB_MASTER_ERR_DATA_ADDR A:0xfc9c402c
y.create.l HWIO_MSS_CRYPTO_BAM_TRUST_REG_ADDR A:0xfc9c4070
y.create.l HWIO_MSS_CRYPTO_BAM_TEST_BUS_SEL_ADDR A:0xfc9c4074
y.create.l HWIO_MSS_CRYPTO_BAM_TEST_BUS_REG_ADDR A:0xfc9c4078
y.create.l HWIO_MSS_CRYPTO_BAM_CNFG_BITS_ADDR A:0xfc9c407c
y.create.l HWIO_MSS_CRYPTO_BAM_IRQ_SRCS_EE0_ADDR A:0xfc9c4800
y.create.l HWIO_MSS_CRYPTO_BAM_IRQ_SRCS_EE1_ADDR A:0xfc9c4880
y.create.l HWIO_MSS_CRYPTO_BAM_IRQ_SRCS_EE2_ADDR A:0xfc9c4900
y.create.l HWIO_MSS_CRYPTO_BAM_IRQ_SRCS_EE3_ADDR A:0xfc9c4980
y.create.l HWIO_MSS_CRYPTO_BAM_IRQ_SRCS_EE4_ADDR A:0xfc9c4a00
y.create.l HWIO_MSS_CRYPTO_BAM_IRQ_SRCS_EE5_ADDR A:0xfc9c4a80
y.create.l HWIO_MSS_CRYPTO_BAM_IRQ_SRCS_EE6_ADDR A:0xfc9c4b00
y.create.l HWIO_MSS_CRYPTO_BAM_IRQ_SRCS_EE7_ADDR A:0xfc9c4b80
y.create.l HWIO_MSS_CRYPTO_BAM_IRQ_SRCS_MSK_EE0_ADDR A:0xfc9c4804
y.create.l HWIO_MSS_CRYPTO_BAM_IRQ_SRCS_MSK_EE1_ADDR A:0xfc9c4884
y.create.l HWIO_MSS_CRYPTO_BAM_IRQ_SRCS_MSK_EE2_ADDR A:0xfc9c4904
y.create.l HWIO_MSS_CRYPTO_BAM_IRQ_SRCS_MSK_EE3_ADDR A:0xfc9c4984
y.create.l HWIO_MSS_CRYPTO_BAM_IRQ_SRCS_MSK_EE4_ADDR A:0xfc9c4a04
y.create.l HWIO_MSS_CRYPTO_BAM_IRQ_SRCS_MSK_EE5_ADDR A:0xfc9c4a84
y.create.l HWIO_MSS_CRYPTO_BAM_IRQ_SRCS_MSK_EE6_ADDR A:0xfc9c4b04
y.create.l HWIO_MSS_CRYPTO_BAM_IRQ_SRCS_MSK_EE7_ADDR A:0xfc9c4b84
y.create.l HWIO_MSS_CRYPTO_BAM_IRQ_SRCS_UNMASKED_EE0_ADDR A:0xfc9c4808
y.create.l HWIO_MSS_CRYPTO_BAM_IRQ_SRCS_UNMASKED_EE1_ADDR A:0xfc9c4888
y.create.l HWIO_MSS_CRYPTO_BAM_IRQ_SRCS_UNMASKED_EE2_ADDR A:0xfc9c4908
y.create.l HWIO_MSS_CRYPTO_BAM_IRQ_SRCS_UNMASKED_EE3_ADDR A:0xfc9c4988
y.create.l HWIO_MSS_CRYPTO_BAM_IRQ_SRCS_UNMASKED_EE4_ADDR A:0xfc9c4a08
y.create.l HWIO_MSS_CRYPTO_BAM_IRQ_SRCS_UNMASKED_EE5_ADDR A:0xfc9c4a88
y.create.l HWIO_MSS_CRYPTO_BAM_IRQ_SRCS_UNMASKED_EE6_ADDR A:0xfc9c4b08
y.create.l HWIO_MSS_CRYPTO_BAM_IRQ_SRCS_UNMASKED_EE7_ADDR A:0xfc9c4b88
y.create.l HWIO_MSS_CRYPTO_BAM_P_CTRL0_ADDR A:0xfc9c5000
y.create.l HWIO_MSS_CRYPTO_BAM_P_CTRL1_ADDR A:0xfc9c6000
y.create.l HWIO_MSS_CRYPTO_BAM_P_RST0_ADDR A:0xfc9c5004
y.create.l HWIO_MSS_CRYPTO_BAM_P_RST1_ADDR A:0xfc9c6004
y.create.l HWIO_MSS_CRYPTO_BAM_P_HALT0_ADDR A:0xfc9c5008
y.create.l HWIO_MSS_CRYPTO_BAM_P_HALT1_ADDR A:0xfc9c6008
y.create.l HWIO_MSS_CRYPTO_BAM_P_TRUST_REG0_ADDR A:0xfc9c5030
y.create.l HWIO_MSS_CRYPTO_BAM_P_TRUST_REG1_ADDR A:0xfc9c6030
y.create.l HWIO_MSS_CRYPTO_BAM_P_IRQ_STTS0_ADDR A:0xfc9c5010
y.create.l HWIO_MSS_CRYPTO_BAM_P_IRQ_STTS1_ADDR A:0xfc9c6010
y.create.l HWIO_MSS_CRYPTO_BAM_P_IRQ_CLR0_ADDR A:0xfc9c5014
y.create.l HWIO_MSS_CRYPTO_BAM_P_IRQ_CLR1_ADDR A:0xfc9c6014
y.create.l HWIO_MSS_CRYPTO_BAM_P_IRQ_EN0_ADDR A:0xfc9c5018
y.create.l HWIO_MSS_CRYPTO_BAM_P_IRQ_EN1_ADDR A:0xfc9c6018
y.create.l HWIO_MSS_CRYPTO_BAM_P_TIMER0_ADDR A:0xfc9c501c
y.create.l HWIO_MSS_CRYPTO_BAM_P_TIMER1_ADDR A:0xfc9c601c
y.create.l HWIO_MSS_CRYPTO_BAM_P_TIMER_CTRL0_ADDR A:0xfc9c5020
y.create.l HWIO_MSS_CRYPTO_BAM_P_TIMER_CTRL1_ADDR A:0xfc9c6020
y.create.l HWIO_MSS_CRYPTO_BAM_P_PRDCR_SDBND0_ADDR A:0xfc9c5024
y.create.l HWIO_MSS_CRYPTO_BAM_P_PRDCR_SDBND1_ADDR A:0xfc9c6024
y.create.l HWIO_MSS_CRYPTO_BAM_P_CNSMR_SDBND0_ADDR A:0xfc9c5028
y.create.l HWIO_MSS_CRYPTO_BAM_P_CNSMR_SDBND1_ADDR A:0xfc9c6028
y.create.l HWIO_MSS_CRYPTO_BAM_P_EVNT_DEST_ADDR0_ADDR A:0xfc9c582c
y.create.l HWIO_MSS_CRYPTO_BAM_P_EVNT_DEST_ADDR1_ADDR A:0xfc9c682c
y.create.l HWIO_MSS_CRYPTO_BAM_P_EVNT_REG0_ADDR A:0xfc9c5818
y.create.l HWIO_MSS_CRYPTO_BAM_P_EVNT_REG1_ADDR A:0xfc9c6818
y.create.l HWIO_MSS_CRYPTO_BAM_P_SW_OFSTS0_ADDR A:0xfc9c5800
y.create.l HWIO_MSS_CRYPTO_BAM_P_SW_OFSTS1_ADDR A:0xfc9c6800
y.create.l HWIO_MSS_CRYPTO_BAM_P_DATA_FIFO_ADDR0_ADDR A:0xfc9c5824
y.create.l HWIO_MSS_CRYPTO_BAM_P_DATA_FIFO_ADDR1_ADDR A:0xfc9c6824
y.create.l HWIO_MSS_CRYPTO_BAM_P_DESC_FIFO_ADDR0_ADDR A:0xfc9c581c
y.create.l HWIO_MSS_CRYPTO_BAM_P_DESC_FIFO_ADDR1_ADDR A:0xfc9c681c
y.create.l HWIO_MSS_CRYPTO_BAM_P_EVNT_GEN_TRSHLD0_ADDR A:0xfc9c5828
y.create.l HWIO_MSS_CRYPTO_BAM_P_EVNT_GEN_TRSHLD1_ADDR A:0xfc9c6828
y.create.l HWIO_MSS_CRYPTO_BAM_P_FIFO_SIZES0_ADDR A:0xfc9c5820
y.create.l HWIO_MSS_CRYPTO_BAM_P_FIFO_SIZES1_ADDR A:0xfc9c6820
y.create.l HWIO_MSS_CRYPTO_BAM_P_RETR_CNTXT_0_ADDR A:0xfc9c5834
y.create.l HWIO_MSS_CRYPTO_BAM_P_RETR_CNTXT_1_ADDR A:0xfc9c6834
y.create.l HWIO_MSS_CRYPTO_BAM_P_SI_CNTXT_0_ADDR A:0xfc9c5838
y.create.l HWIO_MSS_CRYPTO_BAM_P_SI_CNTXT_1_ADDR A:0xfc9c6838
y.create.l HWIO_MSS_CRYPTO_BAM_P_DF_CNTXT_0_ADDR A:0xfc9c5830
y.create.l HWIO_MSS_CRYPTO_BAM_P_DF_CNTXT_1_ADDR A:0xfc9c6830
y.create.l HWIO_MSS_CRYPTO_BAM_P_AU_PSM_CNTXT_1_0_ADDR A:0xfc9c5804
y.create.l HWIO_MSS_CRYPTO_BAM_P_AU_PSM_CNTXT_1_1_ADDR A:0xfc9c6804
y.create.l HWIO_MSS_CRYPTO_BAM_P_PSM_CNTXT_2_0_ADDR A:0xfc9c5808
y.create.l HWIO_MSS_CRYPTO_BAM_P_PSM_CNTXT_2_1_ADDR A:0xfc9c6808
y.create.l HWIO_MSS_CRYPTO_BAM_P_PSM_CNTXT_3_0_ADDR A:0xfc9c580c
y.create.l HWIO_MSS_CRYPTO_BAM_P_PSM_CNTXT_3_1_ADDR A:0xfc9c680c
y.create.l HWIO_MSS_CRYPTO_BAM_P_PSM_CNTXT_4_0_ADDR A:0xfc9c5810
y.create.l HWIO_MSS_CRYPTO_BAM_P_PSM_CNTXT_4_1_ADDR A:0xfc9c6810
y.create.l HWIO_MSS_CRYPTO_BAM_P_PSM_CNTXT_5_0_ADDR A:0xfc9c5814
y.create.l HWIO_MSS_CRYPTO_BAM_P_PSM_CNTXT_5_1_ADDR A:0xfc9c6814
y.create.l HWIO_MSS_RC_CONTROL_ADDR A:0xfca00000
y.create.l HWIO_MSS_RC_CONFIG_ADDR A:0xfca00004
y.create.l HWIO_MSS_RC_LPM_RTC_CONTROL_ADDR A:0xfca00008
y.create.l HWIO_MSS_RC_PPSO_ASSERT_ADDR A:0xfca0000c
y.create.l HWIO_MSS_RC_PPSO_DEASSERT_ADDR A:0xfca00010
y.create.l HWIO_MSS_RC_GPS_ON_ADDR A:0xfca00014
y.create.l HWIO_MSS_RC_TIME_TRANSFER_ADDR A:0xfca00018
y.create.l HWIO_MSS_RC_GNSS_RTC_STATUS_ADDR A:0xfca0001c
y.create.l HWIO_MSS_RC_BP1_COUNT_STATUS_ADDR A:0xfca00020
y.create.l HWIO_MSS_RC_BP1_PHASE_STATUS_ADDR A:0xfca00024
y.create.l HWIO_MSS_RC_BP2_COUNT_STATUS_ADDR A:0xfca00028
y.create.l HWIO_MSS_RC_BP2_PHASE_STATUS_ADDR A:0xfca0002c
y.create.l HWIO_MSS_RC_BP3_COUNT_STATUS_ADDR A:0xfca00030
y.create.l HWIO_MSS_RC_BP3_PHASE_STATUS_ADDR A:0xfca00034
y.create.l HWIO_MSS_RC_BP4_COUNT_STATUS_ADDR A:0xfca00038
y.create.l HWIO_MSS_RC_BP4_PHASE_STATUS_ADDR A:0xfca0003c
y.create.l HWIO_MSS_RC_TT_STATUS_ADDR A:0xfca00040
y.create.l HWIO_MSS_RC_IRQ_STATUS_ADDR A:0xfca00044
y.create.l HWIO_MSS_RC_PPSI_RTC_ADDR A:0xfca00048
y.create.l HWIO_MSS_RC_NAV_TT_RTC_ADDR A:0xfca0004c
y.create.l HWIO_MSS_RC_CDMA_TT_RTC_ADDR A:0xfca00050
y.create.l HWIO_MSS_RC_GNSS_TT_CNT_ADDR A:0xfca00054
y.create.l HWIO_MSS_RC_NAV_TEST_BUS_ADDR A:0xfca00058
y.create.l HWIO_MSS_RC_B1_POLYNOMIAL_MASK_ADDR A:0xfca0005c
y.create.l HWIO_MSS_AD_MODE_ADDR A:0xfca00080
y.create.l HWIO_MSS_AD_RX1_CONFIG_ADDR A:0xfca00084
y.create.l HWIO_MSS_AD_RX2_CONFIG_ADDR A:0xfca00088
y.create.l HWIO_MSS_AD_RX1_QUANTMAP_ADDR A:0xfca0008c
y.create.l HWIO_MSS_AD_RX2_QUANTMAP_ADDR A:0xfca00090
y.create.l HWIO_MSS_AD_MEAS_STATUS_ADDR A:0xfca00094
y.create.l HWIO_MSS_AD_RX1_MEAN_MON_ADDR A:0xfca00098
y.create.l HWIO_MSS_AD_RX2_MEAN_MON_ADDR A:0xfca0009c
y.create.l HWIO_MSS_AD_RX1_BLANK_MONITOR_ADDR A:0xfca000a0
y.create.l HWIO_MSS_AD_RX2_BLANK_MONITOR_ADDR A:0xfca000a4
y.create.l HWIO_MSS_AD_SL_INDEX_ADDR A:0xfca000a8
y.create.l HWIO_MSS_AD_RX1_AMPL_MON_ADDR A:0xfca000ac
y.create.l HWIO_MSS_AD_RX2_AMPL_MON_ADDR A:0xfca000b0
y.create.l HWIO_MSS_AD_SPEC_ANALYZER_CMD_ADDR A:0xfca000b4
y.create.l HWIO_MSS_AD_SPEC_ANALYZER_STATUS_ADDR A:0xfca000b8
y.create.l HWIO_MSS_BP1_CONFIG_ADDR A:0xfca00200
y.create.l HWIO_MSS_BP1_IF_FREQ_ADDR A:0xfca00204
y.create.l HWIO_MSS_BP1_RS_RATE_ADDR A:0xfca00208
y.create.l HWIO_MSS_BP1_OFFSET_ADDR A:0xfca0020c
y.create.l HWIO_MSS_BP1_NOTCH1_ADDR A:0xfca00210
y.create.l HWIO_MSS_BP1_NOTCH2_ADDR A:0xfca00214
y.create.l HWIO_MSS_BP1_NOTCH3_ADDR A:0xfca00218
y.create.l HWIO_MSS_BP1_NOTCH4_ADDR A:0xfca0021c
y.create.l HWIO_MSS_BP1_NOTCH5_ADDR A:0xfca00220
y.create.l HWIO_MSS_BP1_NOTCH6_ADDR A:0xfca00224
y.create.l HWIO_MSS_BP1_EQ_COEF_REAL_ADDR A:0xfca00228
y.create.l HWIO_MSS_BP1_EQ_COEF_IMAG_ADDR A:0xfca0022c
y.create.l HWIO_MSS_BP1_FREQ_ADDR A:0xfca00230
y.create.l HWIO_MSS_BP1_THRESH_ADDR A:0xfca00234
y.create.l HWIO_MSS_BP1_PRE_NOTCH_ADDR A:0xfca00238
y.create.l HWIO_MSS_BP1_RS_PHASE_ADDR A:0xfca0023c
y.create.l HWIO_MSS_BP1_PRE_AMPL_MON_ADDR A:0xfca00240
y.create.l HWIO_MSS_BP1_MEAN_MON_ADDR A:0xfca00244
y.create.l HWIO_MSS_BP1_SCH2_AMPL_MON_ADDR A:0xfca00248
y.create.l HWIO_MSS_BP1_SCH3_AMPL_MON_ADDR A:0xfca0024c
y.create.l HWIO_MSS_BP2_CONFIG_ADDR A:0xfca00300
y.create.l HWIO_MSS_BP2_IF_FREQ_ADDR A:0xfca00304
y.create.l HWIO_MSS_BP2_RS_RATE_ADDR A:0xfca00308
y.create.l HWIO_MSS_BP2_OFFSET_ADDR A:0xfca0030c
y.create.l HWIO_MSS_BP2_NOTCH1_ADDR A:0xfca00310
y.create.l HWIO_MSS_BP2_NOTCH2_ADDR A:0xfca00314
y.create.l HWIO_MSS_BP2_NOTCH3_ADDR A:0xfca00318
y.create.l HWIO_MSS_BP2_NOTCH4_ADDR A:0xfca0031c
y.create.l HWIO_MSS_BP2_NOTCH5_ADDR A:0xfca00320
y.create.l HWIO_MSS_BP2_NOTCH6_ADDR A:0xfca00324
y.create.l HWIO_MSS_BP2_EQ_COEF_REAL_ADDR A:0xfca00328
y.create.l HWIO_MSS_BP2_EQ_COEF_IMAG_ADDR A:0xfca0032c
y.create.l HWIO_MSS_BP2_FREQ_ADDR A:0xfca00330
y.create.l HWIO_MSS_BP2_THRESH_ADDR A:0xfca00334
y.create.l HWIO_MSS_BP2_PRE_NOTCH_ADDR A:0xfca00338
y.create.l HWIO_MSS_BP2_RS_PHASE_ADDR A:0xfca0033c
y.create.l HWIO_MSS_BP2_PRE_AMPL_MON_ADDR A:0xfca00340
y.create.l HWIO_MSS_BP2_MEAN_MON_ADDR A:0xfca00344
y.create.l HWIO_MSS_BP2_SCH2_AMPL_MON_ADDR A:0xfca00348
y.create.l HWIO_MSS_BP2_SCH3_AMPL_MON_ADDR A:0xfca0034c
y.create.l HWIO_MSS_BP3_CONFIG_ADDR A:0xfca00400
y.create.l HWIO_MSS_BP3_IF_FREQ_ADDR A:0xfca00404
y.create.l HWIO_MSS_BP3_RS_RATE_ADDR A:0xfca00408
y.create.l HWIO_MSS_BP3_OFFSET_ADDR A:0xfca0040c
y.create.l HWIO_MSS_BP3_NOTCH1_ADDR A:0xfca00410
y.create.l HWIO_MSS_BP3_NOTCH2_ADDR A:0xfca00414
y.create.l HWIO_MSS_BP3_NOTCH3_ADDR A:0xfca00418
y.create.l HWIO_MSS_BP3_NOTCH4_ADDR A:0xfca0041c
y.create.l HWIO_MSS_BP3_NOTCH5_ADDR A:0xfca00420
y.create.l HWIO_MSS_BP3_NOTCH6_ADDR A:0xfca00424
y.create.l HWIO_MSS_BP3_EQ_COEF_REAL_ADDR A:0xfca00428
y.create.l HWIO_MSS_BP3_EQ_COEF_IMAG_ADDR A:0xfca0042c
y.create.l HWIO_MSS_BP3_RS_PHASE_ADDR A:0xfca00430
y.create.l HWIO_MSS_BP3_SCH1_FREQ_ADDR A:0xfca00434
y.create.l HWIO_MSS_BP3_SCH2_FREQ_ADDR A:0xfca00438
y.create.l HWIO_MSS_BP3_SCH3_FREQ_ADDR A:0xfca0043c
y.create.l HWIO_MSS_BP3_SCH4_FREQ_ADDR A:0xfca00440
y.create.l HWIO_MSS_BP3_SCH5_FREQ_ADDR A:0xfca00444
y.create.l HWIO_MSS_BP3_SCH6_FREQ_ADDR A:0xfca00448
y.create.l HWIO_MSS_BP3_SCH7_FREQ_ADDR A:0xfca0044c
y.create.l HWIO_MSS_BP3_SCH8_FREQ_ADDR A:0xfca00450
y.create.l HWIO_MSS_BP3_SCH9_FREQ_ADDR A:0xfca00454
y.create.l HWIO_MSS_BP3_SCH10_FREQ_ADDR A:0xfca00458
y.create.l HWIO_MSS_BP3_SCH11_FREQ_ADDR A:0xfca0045c
y.create.l HWIO_MSS_BP3_SCH12_FREQ_ADDR A:0xfca00460
y.create.l HWIO_MSS_BP3_THRESH_A_ADDR A:0xfca00464
y.create.l HWIO_MSS_BP3_THRESH_B_ADDR A:0xfca00468
y.create.l HWIO_MSS_BP3_THRESH_C_ADDR A:0xfca0046c
y.create.l HWIO_MSS_BP3_THRESH_D_ADDR A:0xfca00470
y.create.l HWIO_MSS_BP3_THRESH_E_ADDR A:0xfca00474
y.create.l HWIO_MSS_BP3_THRESH_F_ADDR A:0xfca00478
y.create.l HWIO_MSS_BP3_PRE_AMPL_MON_ADDR A:0xfca0047c
y.create.l HWIO_MSS_BP3_MEAN_MON_ADDR A:0xfca00480
y.create.l HWIO_MSS_BP3_SCH1_AMPL_MON_ADDR A:0xfca00484
y.create.l HWIO_MSS_BP3_SCH2_AMPL_MON_ADDR A:0xfca00488
y.create.l HWIO_MSS_BP3_SCH3_AMPL_MON_ADDR A:0xfca0048c
y.create.l HWIO_MSS_BP3_SCH4_AMPL_MON_ADDR A:0xfca00490
y.create.l HWIO_MSS_BP3_SCH5_AMPL_MON_ADDR A:0xfca00494
y.create.l HWIO_MSS_BP3_SCH6_AMPL_MON_ADDR A:0xfca00498
y.create.l HWIO_MSS_BP3_SCH7_AMPL_MON_ADDR A:0xfca0049c
y.create.l HWIO_MSS_BP3_SCH8_AMPL_MON_ADDR A:0xfca004a0
y.create.l HWIO_MSS_BP3_SCH9_AMPL_MON_ADDR A:0xfca004a4
y.create.l HWIO_MSS_BP3_SCH10_AMPL_MON_ADDR A:0xfca004a8
y.create.l HWIO_MSS_BP3_SCH11_AMPL_MON_ADDR A:0xfca004ac
y.create.l HWIO_MSS_BP3_SCH12_AMPL_MON_ADDR A:0xfca004b0
y.create.l HWIO_MSS_BP3_SCH_MODE_ADDR A:0xfca004b4
y.create.l HWIO_MSS_BP3_PRE_NOTCH_ADDR A:0xfca004b8
y.create.l HWIO_MSS_BP3_NOTCH7_ADDR A:0xfca004bc
y.create.l HWIO_MSS_BP3_NOTCH8_ADDR A:0xfca004c0
y.create.l HWIO_MSS_BP3_NOTCH9_ADDR A:0xfca004c4
y.create.l HWIO_MSS_BP3_NOTCH10_ADDR A:0xfca004c8
y.create.l HWIO_MSS_BP3_NOTCH11_ADDR A:0xfca004cc
y.create.l HWIO_MSS_BP3_NOTCH12_ADDR A:0xfca004d0
y.create.l HWIO_MSS_TSG_CMD0_ADDR A:0xfca00100
y.create.l HWIO_MSS_TSG_CH1_CONFIG_ADDR A:0xfca00104
y.create.l HWIO_MSS_TSG_CH1_RS_RATE_ADDR A:0xfca00108
y.create.l HWIO_MSS_TSG_CH1_INIT_COUNT_ADDR A:0xfca0010c
y.create.l HWIO_MSS_TSG_CH1_FREQ_ADDR A:0xfca00110
y.create.l HWIO_MSS_TSG_CH1_DATA_SEED_ADDR A:0xfca00114
y.create.l HWIO_MSS_TSG_CH1_PILOT_SEED_ADDR A:0xfca00118
y.create.l HWIO_MSS_TSG_CH2_CONFIG_ADDR A:0xfca0011c
y.create.l HWIO_MSS_TSG_CH2_RS_RATE_ADDR A:0xfca00120
y.create.l HWIO_MSS_TSG_CH2_INIT_COUNT_ADDR A:0xfca00124
y.create.l HWIO_MSS_TSG_CH2_FREQ_ADDR A:0xfca00128
y.create.l HWIO_MSS_TSG_CH2_DATA_SEED_ADDR A:0xfca0012c
y.create.l HWIO_MSS_TSG_CH2_PILOT_SEED_ADDR A:0xfca00130
y.create.l HWIO_MSS_TSG_RX1_CONFIG_ADDR A:0xfca00134
y.create.l HWIO_MSS_TSG_RX1_OFFSET_ADDR A:0xfca00138
y.create.l HWIO_MSS_TSG_RX2_CONFIG_ADDR A:0xfca0013c
y.create.l HWIO_MSS_TSG_RX2_OFFSET_ADDR A:0xfca00140
y.create.l HWIO_MSS_TSG_FIRST_CODE_ADDR A:0xfca00144
y.create.l HWIO_MSS_TSG_CH1_COUNT_STATUS_ADDR A:0xfca00148
y.create.l HWIO_MSS_TSG_CH2_COUNT_STATUS_ADDR A:0xfca0014c
y.create.l HWIO_MSS_SMI_MODE_ADDR A:0xfca00600
y.create.l HWIO_MSS_SMI_BASEADDR1_ADDR A:0xfca00604
y.create.l HWIO_MSS_SMI_BASEADDR2_ADDR A:0xfca00608
y.create.l HWIO_MSS_SMI_BASEADDR3A_ADDR A:0xfca0060c
y.create.l HWIO_MSS_SMI_BASEADDR3B_ADDR A:0xfca00610
y.create.l HWIO_MSS_SMI_BASEADDR3C_ADDR A:0xfca00614
y.create.l HWIO_MSS_SMI_BASEADDR4_ADDR A:0xfca00618
y.create.l HWIO_MSS_CP_START_ADDR A:0xfca00700
y.create.l HWIO_MSS_CP_CONFIG1_ADDR A:0xfca00704
y.create.l HWIO_MSS_CP_CONFIG2_ADDR A:0xfca00708
y.create.l HWIO_MSS_CP_SAMPLE_INDEX_ADDR A:0xfca0070c
y.create.l HWIO_MSS_CP_PHASE_ADDR A:0xfca00710
y.create.l HWIO_MSS_CP_FREQ_ADDR A:0xfca00714
y.create.l HWIO_MSS_CP_DATA_SEED_ADDR A:0xfca00718
y.create.l HWIO_MSS_CP_PILOT_SEED_ADDR A:0xfca0071c
y.create.l HWIO_MSS_CP_CODE_INDEX_ADDR A:0xfca00720
y.create.l HWIO_MSS_CP_COEF1_ADDR A:0xfca00724
y.create.l HWIO_MSS_CP_COEF2_ADDR A:0xfca00728
y.create.l HWIO_MSS_CP_COEF3_ADDR A:0xfca0072c
y.create.l HWIO_MSS_CP_COEF4_ADDR A:0xfca00730
y.create.l HWIO_MSS_CP_COEF5_ADDR A:0xfca00734
y.create.l HWIO_MSS_CP_COEF6_ADDR A:0xfca00738
y.create.l HWIO_MSS_CP_STATUS_ADDR A:0xfca0073c
y.create.l HWIO_MSS_CCP_BREAKPOINT_ADDR A:0xfca00800
y.create.l HWIO_MSS_CCP_BREAK_STATE_ADDR A:0xfca00804
y.create.l HWIO_MSS_CCP_PROG_STATUS_ADDR A:0xfca00808
y.create.l HWIO_MSS_CCP_G10_STATUS_ADDR A:0xfca0080c
y.create.l HWIO_MSS_CCP_G32_STATUS_ADDR A:0xfca00810
y.create.l HWIO_MSS_CCP_G54_STATUS_ADDR A:0xfca00814
y.create.l HWIO_MSS_CCP_G76_STATUS_ADDR A:0xfca00818
y.create.l HWIO_MSS_CCP_P10_STATUS_ADDR A:0xfca0081c
y.create.l HWIO_MSS_CCP_P2_STATUS_ADDR A:0xfca00820
y.create.l HWIO_MSS_SM_ADDR_BEGIN_ADDR A:0xfca40000
y.create.l HWIO_MSS_SM_ADDR_END_ADDR A:0xfca4effc
y.create.l HWIO_MSS_CMA_ADDR_BEGIN_ADDR A:0xfca0c000
y.create.l HWIO_MSS_CMA_ADDR_END_ADDR A:0xfca0edfc
y.create.l HWIO_MSS_CMB_ADDR_BEGIN_ADDR A:0xfca10000
y.create.l HWIO_MSS_CMB_ADDR_END_ADDR A:0xfca12dfc
y.create.l HWIO_MSS_CCM_ADDR_BEGIN_ADDR A:0xfca14000
y.create.l HWIO_MSS_CCM_ADDR_END_ADDR A:0xfca147fc
y.create.l HWIO_MSS_VM_ADDR_BEGIN_ADDR A:0xfca18000
y.create.l HWIO_MSS_VM_ADDR_END_ADDR A:0xfca18ffc
y.create.l HWIO_MSS_PM_ADDR_BEGIN_ADDR A:0xfca1c000
y.create.l HWIO_MSS_PM_ADDR_END_ADDR A:0xfca1cffc
y.create.l HWIO_MSS_CCM_START_CMD_ADDR A:0xfca14000
y.create.l HWIO_MSS_CCM_WORD1_CMD_ADDR A:0xfca14004
y.create.l HWIO_MSS_CCM_WORD2_CMD_ADDR A:0xfca14008
y.create.l HWIO_MSS_CCM_WORD3_CMD_ADDR A:0xfca1400c
y.create.l HWIO_MSS_CCM_WORD4_CMD_ADDR A:0xfca14010
y.create.l HWIO_MSS_CCM_WORD5_CMD_ADDR A:0xfca14014
y.create.l HWIO_MSS_CCM_WORD6_CMD_ADDR A:0xfca14018
y.create.l HWIO_MSS_CCM_WORD7_CMD_ADDR A:0xfca1401c
y.create.l HWIO_MSS_CCM_END_CMD_ADDR A:0xfca14020
y.create.l HWIO_MSS_CCM_STOP_CMD_ADDR A:0xfca147dc
y.create.l HWIO_MSS_CCM_LOAD_CMD_ADDR A:0xfca147e0
y.create.l HWIO_MSS_CCM_ERROR_CLEAR_CMD_ADDR A:0xfca147e4
y.create.l HWIO_MSS_CCM_TIME_MARGIN_CMD_ADDR A:0xfca147e8
y.create.l HWIO_MSS_CCM_LATE_TASK_ERROR_STATUS_ADDR A:0xfca147ec
y.create.l HWIO_MSS_CCM_OVERRUN_ERROR_STATUS_ADDR A:0xfca147f0
y.create.l HWIO_MSS_CCM_SEQ_NUMBER_STATUS_ADDR A:0xfca147f4
y.create.l HWIO_MSS_CCM_DONE_RTC_STATUS_ADDR A:0xfca147f8
y.create.l HWIO_MSS_CCM_STALL_COUNT_STATUS_ADDR A:0xfca147fc
y.create.l HWIO_MSS_GACC_CLK_CTL_ADDR A:0xfca00a00
y.create.l HWIO_MSS_GACC_RTC_WAIT_ADDR A:0xfca00a04
y.create.l HWIO_MSS_GACC_START_ADDR_ADDR A:0xfca00a08
y.create.l HWIO_MSS_GACC_COUNT_ADDR A:0xfca00a0c
y.create.l HWIO_MSS_GACC_INCR_ADDR A:0xfca00a10
y.create.l HWIO_MSS_GACC_FREQ_ADDR A:0xfca00a14
y.create.l HWIO_MSS_GACC_CONFIG_ADDR A:0xfca00a18
y.create.l HWIO_MSS_GACC_PEAK_ADDR A:0xfca00a1c
y.create.l HWIO_MSS_GACC_DONE_ADDR A:0xfca00a20
y.create.l HWIO_MSS_GACC_RTC_ADDR A:0xfca00a24
y.create.l HWIO_MSS_GACC_TEST_BUS_OUT_ADDR A:0xfca00a28
y.create.l HWIO_MSS_GACC_SAMPLE_MEM_START_ADDR_ADDR A:0xfca28000
y.create.l HWIO_MSS_GACC_SAMPLE_MEM_END_ADDR_ADDR A:0xfca289fc
y.create.l HWIO_MSS_GACC_ENERGY_MEM_START_ADDR_ADDR A:0xfca2c000
y.create.l HWIO_MSS_GACC_ENERGY_MEM_END_ADDR_ADDR A:0xfca2c9fc
y.create.l HWIO_MSS_HI0_CH0_CMD_PTR_SD0_ADDR A:0xfca00b00
y.create.l HWIO_MSS_HI0_CH0_CMD_PTR_SD1_ADDR A:0xfca00f00
y.create.l HWIO_MSS_HI0_CH0_CMD_PTR_SD2_ADDR A:0xfca01300
y.create.l HWIO_MSS_HI0_CH0_CMD_PTR_SD3_ADDR A:0xfca01700
y.create.l HWIO_MSS_HI0_CH1_CMD_PTR_SD0_ADDR A:0xfca00b04
y.create.l HWIO_MSS_HI0_CH1_CMD_PTR_SD1_ADDR A:0xfca00f04
y.create.l HWIO_MSS_HI0_CH1_CMD_PTR_SD2_ADDR A:0xfca01304
y.create.l HWIO_MSS_HI0_CH1_CMD_PTR_SD3_ADDR A:0xfca01704
y.create.l HWIO_MSS_HI0_CH2_CMD_PTR_SD0_ADDR A:0xfca00b08
y.create.l HWIO_MSS_HI0_CH2_CMD_PTR_SD1_ADDR A:0xfca00f08
y.create.l HWIO_MSS_HI0_CH2_CMD_PTR_SD2_ADDR A:0xfca01308
y.create.l HWIO_MSS_HI0_CH2_CMD_PTR_SD3_ADDR A:0xfca01708
y.create.l HWIO_MSS_HI0_CH3_CMD_PTR_SD0_ADDR A:0xfca00b0c
y.create.l HWIO_MSS_HI0_CH3_CMD_PTR_SD1_ADDR A:0xfca00f0c
y.create.l HWIO_MSS_HI0_CH3_CMD_PTR_SD2_ADDR A:0xfca0130c
y.create.l HWIO_MSS_HI0_CH3_CMD_PTR_SD3_ADDR A:0xfca0170c
y.create.l HWIO_MSS_HI0_CH4_CMD_PTR_SD0_ADDR A:0xfca00b10
y.create.l HWIO_MSS_HI0_CH4_CMD_PTR_SD1_ADDR A:0xfca00f10
y.create.l HWIO_MSS_HI0_CH4_CMD_PTR_SD2_ADDR A:0xfca01310
y.create.l HWIO_MSS_HI0_CH4_CMD_PTR_SD3_ADDR A:0xfca01710
y.create.l HWIO_MSS_HI0_CH5_CMD_PTR_SD0_ADDR A:0xfca00b14
y.create.l HWIO_MSS_HI0_CH5_CMD_PTR_SD1_ADDR A:0xfca00f14
y.create.l HWIO_MSS_HI0_CH5_CMD_PTR_SD2_ADDR A:0xfca01314
y.create.l HWIO_MSS_HI0_CH5_CMD_PTR_SD3_ADDR A:0xfca01714
y.create.l HWIO_MSS_HI0_CH6_CMD_PTR_SD0_ADDR A:0xfca00b18
y.create.l HWIO_MSS_HI0_CH6_CMD_PTR_SD1_ADDR A:0xfca00f18
y.create.l HWIO_MSS_HI0_CH6_CMD_PTR_SD2_ADDR A:0xfca01318
y.create.l HWIO_MSS_HI0_CH6_CMD_PTR_SD3_ADDR A:0xfca01718
y.create.l HWIO_MSS_HI0_CH7_CMD_PTR_SD0_ADDR A:0xfca00b1c
y.create.l HWIO_MSS_HI0_CH7_CMD_PTR_SD1_ADDR A:0xfca00f1c
y.create.l HWIO_MSS_HI0_CH7_CMD_PTR_SD2_ADDR A:0xfca0131c
y.create.l HWIO_MSS_HI0_CH7_CMD_PTR_SD3_ADDR A:0xfca0171c
y.create.l HWIO_MSS_HI0_CH0_RSLT_SD0_ADDR A:0xfca00b40
y.create.l HWIO_MSS_HI0_CH0_RSLT_SD1_ADDR A:0xfca00f40
y.create.l HWIO_MSS_HI0_CH0_RSLT_SD2_ADDR A:0xfca01340
y.create.l HWIO_MSS_HI0_CH0_RSLT_SD3_ADDR A:0xfca01740
y.create.l HWIO_MSS_HI0_CH1_RSLT_SD0_ADDR A:0xfca00b44
y.create.l HWIO_MSS_HI0_CH1_RSLT_SD1_ADDR A:0xfca00f44
y.create.l HWIO_MSS_HI0_CH1_RSLT_SD2_ADDR A:0xfca01344
y.create.l HWIO_MSS_HI0_CH1_RSLT_SD3_ADDR A:0xfca01744
y.create.l HWIO_MSS_HI0_CH2_RSLT_SD0_ADDR A:0xfca00b48
y.create.l HWIO_MSS_HI0_CH2_RSLT_SD1_ADDR A:0xfca00f48
y.create.l HWIO_MSS_HI0_CH2_RSLT_SD2_ADDR A:0xfca01348
y.create.l HWIO_MSS_HI0_CH2_RSLT_SD3_ADDR A:0xfca01748
y.create.l HWIO_MSS_HI0_CH3_RSLT_SD0_ADDR A:0xfca00b4c
y.create.l HWIO_MSS_HI0_CH3_RSLT_SD1_ADDR A:0xfca00f4c
y.create.l HWIO_MSS_HI0_CH3_RSLT_SD2_ADDR A:0xfca0134c
y.create.l HWIO_MSS_HI0_CH3_RSLT_SD3_ADDR A:0xfca0174c
y.create.l HWIO_MSS_HI0_CH4_RSLT_SD0_ADDR A:0xfca00b50
y.create.l HWIO_MSS_HI0_CH4_RSLT_SD1_ADDR A:0xfca00f50
y.create.l HWIO_MSS_HI0_CH4_RSLT_SD2_ADDR A:0xfca01350
y.create.l HWIO_MSS_HI0_CH4_RSLT_SD3_ADDR A:0xfca01750
y.create.l HWIO_MSS_HI0_CH5_RSLT_SD0_ADDR A:0xfca00b54
y.create.l HWIO_MSS_HI0_CH5_RSLT_SD1_ADDR A:0xfca00f54
y.create.l HWIO_MSS_HI0_CH5_RSLT_SD2_ADDR A:0xfca01354
y.create.l HWIO_MSS_HI0_CH5_RSLT_SD3_ADDR A:0xfca01754
y.create.l HWIO_MSS_HI0_CH6_RSLT_SD0_ADDR A:0xfca00b58
y.create.l HWIO_MSS_HI0_CH6_RSLT_SD1_ADDR A:0xfca00f58
y.create.l HWIO_MSS_HI0_CH6_RSLT_SD2_ADDR A:0xfca01358
y.create.l HWIO_MSS_HI0_CH6_RSLT_SD3_ADDR A:0xfca01758
y.create.l HWIO_MSS_HI0_CH7_RSLT_SD0_ADDR A:0xfca00b5c
y.create.l HWIO_MSS_HI0_CH7_RSLT_SD1_ADDR A:0xfca00f5c
y.create.l HWIO_MSS_HI0_CH7_RSLT_SD2_ADDR A:0xfca0135c
y.create.l HWIO_MSS_HI0_CH7_RSLT_SD3_ADDR A:0xfca0175c
y.create.l HWIO_MSS_HI0_CH0_FLUSH_STATE0_SD0_ADDR A:0xfca00b80
y.create.l HWIO_MSS_HI0_CH0_FLUSH_STATE0_SD1_ADDR A:0xfca00f80
y.create.l HWIO_MSS_HI0_CH0_FLUSH_STATE0_SD2_ADDR A:0xfca01380
y.create.l HWIO_MSS_HI0_CH0_FLUSH_STATE0_SD3_ADDR A:0xfca01780
y.create.l HWIO_MSS_HI0_CH1_FLUSH_STATE0_SD0_ADDR A:0xfca00b84
y.create.l HWIO_MSS_HI0_CH1_FLUSH_STATE0_SD1_ADDR A:0xfca00f84
y.create.l HWIO_MSS_HI0_CH1_FLUSH_STATE0_SD2_ADDR A:0xfca01384
y.create.l HWIO_MSS_HI0_CH1_FLUSH_STATE0_SD3_ADDR A:0xfca01784
y.create.l HWIO_MSS_HI0_CH2_FLUSH_STATE0_SD0_ADDR A:0xfca00b88
y.create.l HWIO_MSS_HI0_CH2_FLUSH_STATE0_SD1_ADDR A:0xfca00f88
y.create.l HWIO_MSS_HI0_CH2_FLUSH_STATE0_SD2_ADDR A:0xfca01388
y.create.l HWIO_MSS_HI0_CH2_FLUSH_STATE0_SD3_ADDR A:0xfca01788
y.create.l HWIO_MSS_HI0_CH3_FLUSH_STATE0_SD0_ADDR A:0xfca00b8c
y.create.l HWIO_MSS_HI0_CH3_FLUSH_STATE0_SD1_ADDR A:0xfca00f8c
y.create.l HWIO_MSS_HI0_CH3_FLUSH_STATE0_SD2_ADDR A:0xfca0138c
y.create.l HWIO_MSS_HI0_CH3_FLUSH_STATE0_SD3_ADDR A:0xfca0178c
y.create.l HWIO_MSS_HI0_CH4_FLUSH_STATE0_SD0_ADDR A:0xfca00b90
y.create.l HWIO_MSS_HI0_CH4_FLUSH_STATE0_SD1_ADDR A:0xfca00f90
y.create.l HWIO_MSS_HI0_CH4_FLUSH_STATE0_SD2_ADDR A:0xfca01390
y.create.l HWIO_MSS_HI0_CH4_FLUSH_STATE0_SD3_ADDR A:0xfca01790
y.create.l HWIO_MSS_HI0_CH5_FLUSH_STATE0_SD0_ADDR A:0xfca00b94
y.create.l HWIO_MSS_HI0_CH5_FLUSH_STATE0_SD1_ADDR A:0xfca00f94
y.create.l HWIO_MSS_HI0_CH5_FLUSH_STATE0_SD2_ADDR A:0xfca01394
y.create.l HWIO_MSS_HI0_CH5_FLUSH_STATE0_SD3_ADDR A:0xfca01794
y.create.l HWIO_MSS_HI0_CH6_FLUSH_STATE0_SD0_ADDR A:0xfca00b98
y.create.l HWIO_MSS_HI0_CH6_FLUSH_STATE0_SD1_ADDR A:0xfca00f98
y.create.l HWIO_MSS_HI0_CH6_FLUSH_STATE0_SD2_ADDR A:0xfca01398
y.create.l HWIO_MSS_HI0_CH6_FLUSH_STATE0_SD3_ADDR A:0xfca01798
y.create.l HWIO_MSS_HI0_CH7_FLUSH_STATE0_SD0_ADDR A:0xfca00b9c
y.create.l HWIO_MSS_HI0_CH7_FLUSH_STATE0_SD1_ADDR A:0xfca00f9c
y.create.l HWIO_MSS_HI0_CH7_FLUSH_STATE0_SD2_ADDR A:0xfca0139c
y.create.l HWIO_MSS_HI0_CH7_FLUSH_STATE0_SD3_ADDR A:0xfca0179c
y.create.l HWIO_MSS_HI0_CH0_FLUSH_STATE1_SD0_ADDR A:0xfca00bc0
y.create.l HWIO_MSS_HI0_CH0_FLUSH_STATE1_SD1_ADDR A:0xfca00fc0
y.create.l HWIO_MSS_HI0_CH0_FLUSH_STATE1_SD2_ADDR A:0xfca013c0
y.create.l HWIO_MSS_HI0_CH0_FLUSH_STATE1_SD3_ADDR A:0xfca017c0
y.create.l HWIO_MSS_HI0_CH1_FLUSH_STATE1_SD0_ADDR A:0xfca00bc4
y.create.l HWIO_MSS_HI0_CH1_FLUSH_STATE1_SD1_ADDR A:0xfca00fc4
y.create.l HWIO_MSS_HI0_CH1_FLUSH_STATE1_SD2_ADDR A:0xfca013c4
y.create.l HWIO_MSS_HI0_CH1_FLUSH_STATE1_SD3_ADDR A:0xfca017c4
y.create.l HWIO_MSS_HI0_CH2_FLUSH_STATE1_SD0_ADDR A:0xfca00bc8
y.create.l HWIO_MSS_HI0_CH2_FLUSH_STATE1_SD1_ADDR A:0xfca00fc8
y.create.l HWIO_MSS_HI0_CH2_FLUSH_STATE1_SD2_ADDR A:0xfca013c8
y.create.l HWIO_MSS_HI0_CH2_FLUSH_STATE1_SD3_ADDR A:0xfca017c8
y.create.l HWIO_MSS_HI0_CH3_FLUSH_STATE1_SD0_ADDR A:0xfca00bcc
y.create.l HWIO_MSS_HI0_CH3_FLUSH_STATE1_SD1_ADDR A:0xfca00fcc
y.create.l HWIO_MSS_HI0_CH3_FLUSH_STATE1_SD2_ADDR A:0xfca013cc
y.create.l HWIO_MSS_HI0_CH3_FLUSH_STATE1_SD3_ADDR A:0xfca017cc
y.create.l HWIO_MSS_HI0_CH4_FLUSH_STATE1_SD0_ADDR A:0xfca00bd0
y.create.l HWIO_MSS_HI0_CH4_FLUSH_STATE1_SD1_ADDR A:0xfca00fd0
y.create.l HWIO_MSS_HI0_CH4_FLUSH_STATE1_SD2_ADDR A:0xfca013d0
y.create.l HWIO_MSS_HI0_CH4_FLUSH_STATE1_SD3_ADDR A:0xfca017d0
y.create.l HWIO_MSS_HI0_CH5_FLUSH_STATE1_SD0_ADDR A:0xfca00bd4
y.create.l HWIO_MSS_HI0_CH5_FLUSH_STATE1_SD1_ADDR A:0xfca00fd4
y.create.l HWIO_MSS_HI0_CH5_FLUSH_STATE1_SD2_ADDR A:0xfca013d4
y.create.l HWIO_MSS_HI0_CH5_FLUSH_STATE1_SD3_ADDR A:0xfca017d4
y.create.l HWIO_MSS_HI0_CH6_FLUSH_STATE1_SD0_ADDR A:0xfca00bd8
y.create.l HWIO_MSS_HI0_CH6_FLUSH_STATE1_SD1_ADDR A:0xfca00fd8
y.create.l HWIO_MSS_HI0_CH6_FLUSH_STATE1_SD2_ADDR A:0xfca013d8
y.create.l HWIO_MSS_HI0_CH6_FLUSH_STATE1_SD3_ADDR A:0xfca017d8
y.create.l HWIO_MSS_HI0_CH7_FLUSH_STATE1_SD0_ADDR A:0xfca00bdc
y.create.l HWIO_MSS_HI0_CH7_FLUSH_STATE1_SD1_ADDR A:0xfca00fdc
y.create.l HWIO_MSS_HI0_CH7_FLUSH_STATE1_SD2_ADDR A:0xfca013dc
y.create.l HWIO_MSS_HI0_CH7_FLUSH_STATE1_SD3_ADDR A:0xfca017dc
y.create.l HWIO_MSS_HI0_CH0_FLUSH_STATE3_SD0_ADDR A:0xfca00c40
y.create.l HWIO_MSS_HI0_CH0_FLUSH_STATE3_SD1_ADDR A:0xfca01040
y.create.l HWIO_MSS_HI0_CH0_FLUSH_STATE3_SD2_ADDR A:0xfca01440
y.create.l HWIO_MSS_HI0_CH0_FLUSH_STATE3_SD3_ADDR A:0xfca01840
y.create.l HWIO_MSS_HI0_CH1_FLUSH_STATE3_SD0_ADDR A:0xfca00c44
y.create.l HWIO_MSS_HI0_CH1_FLUSH_STATE3_SD1_ADDR A:0xfca01044
y.create.l HWIO_MSS_HI0_CH1_FLUSH_STATE3_SD2_ADDR A:0xfca01444
y.create.l HWIO_MSS_HI0_CH1_FLUSH_STATE3_SD3_ADDR A:0xfca01844
y.create.l HWIO_MSS_HI0_CH2_FLUSH_STATE3_SD0_ADDR A:0xfca00c48
y.create.l HWIO_MSS_HI0_CH2_FLUSH_STATE3_SD1_ADDR A:0xfca01048
y.create.l HWIO_MSS_HI0_CH2_FLUSH_STATE3_SD2_ADDR A:0xfca01448
y.create.l HWIO_MSS_HI0_CH2_FLUSH_STATE3_SD3_ADDR A:0xfca01848
y.create.l HWIO_MSS_HI0_CH3_FLUSH_STATE3_SD0_ADDR A:0xfca00c4c
y.create.l HWIO_MSS_HI0_CH3_FLUSH_STATE3_SD1_ADDR A:0xfca0104c
y.create.l HWIO_MSS_HI0_CH3_FLUSH_STATE3_SD2_ADDR A:0xfca0144c
y.create.l HWIO_MSS_HI0_CH3_FLUSH_STATE3_SD3_ADDR A:0xfca0184c
y.create.l HWIO_MSS_HI0_CH4_FLUSH_STATE3_SD0_ADDR A:0xfca00c50
y.create.l HWIO_MSS_HI0_CH4_FLUSH_STATE3_SD1_ADDR A:0xfca01050
y.create.l HWIO_MSS_HI0_CH4_FLUSH_STATE3_SD2_ADDR A:0xfca01450
y.create.l HWIO_MSS_HI0_CH4_FLUSH_STATE3_SD3_ADDR A:0xfca01850
y.create.l HWIO_MSS_HI0_CH5_FLUSH_STATE3_SD0_ADDR A:0xfca00c54
y.create.l HWIO_MSS_HI0_CH5_FLUSH_STATE3_SD1_ADDR A:0xfca01054
y.create.l HWIO_MSS_HI0_CH5_FLUSH_STATE3_SD2_ADDR A:0xfca01454
y.create.l HWIO_MSS_HI0_CH5_FLUSH_STATE3_SD3_ADDR A:0xfca01854
y.create.l HWIO_MSS_HI0_CH6_FLUSH_STATE3_SD0_ADDR A:0xfca00c58
y.create.l HWIO_MSS_HI0_CH6_FLUSH_STATE3_SD1_ADDR A:0xfca01058
y.create.l HWIO_MSS_HI0_CH6_FLUSH_STATE3_SD2_ADDR A:0xfca01458
y.create.l HWIO_MSS_HI0_CH6_FLUSH_STATE3_SD3_ADDR A:0xfca01858
y.create.l HWIO_MSS_HI0_CH7_FLUSH_STATE3_SD0_ADDR A:0xfca00c5c
y.create.l HWIO_MSS_HI0_CH7_FLUSH_STATE3_SD1_ADDR A:0xfca0105c
y.create.l HWIO_MSS_HI0_CH7_FLUSH_STATE3_SD2_ADDR A:0xfca0145c
y.create.l HWIO_MSS_HI0_CH7_FLUSH_STATE3_SD3_ADDR A:0xfca0185c
y.create.l HWIO_MSS_HI0_CH0_FLUSH_STATE4_SD0_ADDR A:0xfca00c80
y.create.l HWIO_MSS_HI0_CH0_FLUSH_STATE4_SD1_ADDR A:0xfca01080
y.create.l HWIO_MSS_HI0_CH0_FLUSH_STATE4_SD2_ADDR A:0xfca01480
y.create.l HWIO_MSS_HI0_CH0_FLUSH_STATE4_SD3_ADDR A:0xfca01880
y.create.l HWIO_MSS_HI0_CH1_FLUSH_STATE4_SD0_ADDR A:0xfca00c84
y.create.l HWIO_MSS_HI0_CH1_FLUSH_STATE4_SD1_ADDR A:0xfca01084
y.create.l HWIO_MSS_HI0_CH1_FLUSH_STATE4_SD2_ADDR A:0xfca01484
y.create.l HWIO_MSS_HI0_CH1_FLUSH_STATE4_SD3_ADDR A:0xfca01884
y.create.l HWIO_MSS_HI0_CH2_FLUSH_STATE4_SD0_ADDR A:0xfca00c88
y.create.l HWIO_MSS_HI0_CH2_FLUSH_STATE4_SD1_ADDR A:0xfca01088
y.create.l HWIO_MSS_HI0_CH2_FLUSH_STATE4_SD2_ADDR A:0xfca01488
y.create.l HWIO_MSS_HI0_CH2_FLUSH_STATE4_SD3_ADDR A:0xfca01888
y.create.l HWIO_MSS_HI0_CH3_FLUSH_STATE4_SD0_ADDR A:0xfca00c8c
y.create.l HWIO_MSS_HI0_CH3_FLUSH_STATE4_SD1_ADDR A:0xfca0108c
y.create.l HWIO_MSS_HI0_CH3_FLUSH_STATE4_SD2_ADDR A:0xfca0148c
y.create.l HWIO_MSS_HI0_CH3_FLUSH_STATE4_SD3_ADDR A:0xfca0188c
y.create.l HWIO_MSS_HI0_CH4_FLUSH_STATE4_SD0_ADDR A:0xfca00c90
y.create.l HWIO_MSS_HI0_CH4_FLUSH_STATE4_SD1_ADDR A:0xfca01090
y.create.l HWIO_MSS_HI0_CH4_FLUSH_STATE4_SD2_ADDR A:0xfca01490
y.create.l HWIO_MSS_HI0_CH4_FLUSH_STATE4_SD3_ADDR A:0xfca01890
y.create.l HWIO_MSS_HI0_CH5_FLUSH_STATE4_SD0_ADDR A:0xfca00c94
y.create.l HWIO_MSS_HI0_CH5_FLUSH_STATE4_SD1_ADDR A:0xfca01094
y.create.l HWIO_MSS_HI0_CH5_FLUSH_STATE4_SD2_ADDR A:0xfca01494
y.create.l HWIO_MSS_HI0_CH5_FLUSH_STATE4_SD3_ADDR A:0xfca01894
y.create.l HWIO_MSS_HI0_CH6_FLUSH_STATE4_SD0_ADDR A:0xfca00c98
y.create.l HWIO_MSS_HI0_CH6_FLUSH_STATE4_SD1_ADDR A:0xfca01098
y.create.l HWIO_MSS_HI0_CH6_FLUSH_STATE4_SD2_ADDR A:0xfca01498
y.create.l HWIO_MSS_HI0_CH6_FLUSH_STATE4_SD3_ADDR A:0xfca01898
y.create.l HWIO_MSS_HI0_CH7_FLUSH_STATE4_SD0_ADDR A:0xfca00c9c
y.create.l HWIO_MSS_HI0_CH7_FLUSH_STATE4_SD1_ADDR A:0xfca0109c
y.create.l HWIO_MSS_HI0_CH7_FLUSH_STATE4_SD2_ADDR A:0xfca0149c
y.create.l HWIO_MSS_HI0_CH7_FLUSH_STATE4_SD3_ADDR A:0xfca0189c
y.create.l HWIO_MSS_HI0_CH0_FLUSH_STATE5_SD0_ADDR A:0xfca00cc0
y.create.l HWIO_MSS_HI0_CH0_FLUSH_STATE5_SD1_ADDR A:0xfca010c0
y.create.l HWIO_MSS_HI0_CH0_FLUSH_STATE5_SD2_ADDR A:0xfca014c0
y.create.l HWIO_MSS_HI0_CH0_FLUSH_STATE5_SD3_ADDR A:0xfca018c0
y.create.l HWIO_MSS_HI0_CH1_FLUSH_STATE5_SD0_ADDR A:0xfca00cc4
y.create.l HWIO_MSS_HI0_CH1_FLUSH_STATE5_SD1_ADDR A:0xfca010c4
y.create.l HWIO_MSS_HI0_CH1_FLUSH_STATE5_SD2_ADDR A:0xfca014c4
y.create.l HWIO_MSS_HI0_CH1_FLUSH_STATE5_SD3_ADDR A:0xfca018c4
y.create.l HWIO_MSS_HI0_CH2_FLUSH_STATE5_SD0_ADDR A:0xfca00cc8
y.create.l HWIO_MSS_HI0_CH2_FLUSH_STATE5_SD1_ADDR A:0xfca010c8
y.create.l HWIO_MSS_HI0_CH2_FLUSH_STATE5_SD2_ADDR A:0xfca014c8
y.create.l HWIO_MSS_HI0_CH2_FLUSH_STATE5_SD3_ADDR A:0xfca018c8
y.create.l HWIO_MSS_HI0_CH3_FLUSH_STATE5_SD0_ADDR A:0xfca00ccc
y.create.l HWIO_MSS_HI0_CH3_FLUSH_STATE5_SD1_ADDR A:0xfca010cc
y.create.l HWIO_MSS_HI0_CH3_FLUSH_STATE5_SD2_ADDR A:0xfca014cc
y.create.l HWIO_MSS_HI0_CH3_FLUSH_STATE5_SD3_ADDR A:0xfca018cc
y.create.l HWIO_MSS_HI0_CH4_FLUSH_STATE5_SD0_ADDR A:0xfca00cd0
y.create.l HWIO_MSS_HI0_CH4_FLUSH_STATE5_SD1_ADDR A:0xfca010d0
y.create.l HWIO_MSS_HI0_CH4_FLUSH_STATE5_SD2_ADDR A:0xfca014d0
y.create.l HWIO_MSS_HI0_CH4_FLUSH_STATE5_SD3_ADDR A:0xfca018d0
y.create.l HWIO_MSS_HI0_CH5_FLUSH_STATE5_SD0_ADDR A:0xfca00cd4
y.create.l HWIO_MSS_HI0_CH5_FLUSH_STATE5_SD1_ADDR A:0xfca010d4
y.create.l HWIO_MSS_HI0_CH5_FLUSH_STATE5_SD2_ADDR A:0xfca014d4
y.create.l HWIO_MSS_HI0_CH5_FLUSH_STATE5_SD3_ADDR A:0xfca018d4
y.create.l HWIO_MSS_HI0_CH6_FLUSH_STATE5_SD0_ADDR A:0xfca00cd8
y.create.l HWIO_MSS_HI0_CH6_FLUSH_STATE5_SD1_ADDR A:0xfca010d8
y.create.l HWIO_MSS_HI0_CH6_FLUSH_STATE5_SD2_ADDR A:0xfca014d8
y.create.l HWIO_MSS_HI0_CH6_FLUSH_STATE5_SD3_ADDR A:0xfca018d8
y.create.l HWIO_MSS_HI0_CH7_FLUSH_STATE5_SD0_ADDR A:0xfca00cdc
y.create.l HWIO_MSS_HI0_CH7_FLUSH_STATE5_SD1_ADDR A:0xfca010dc
y.create.l HWIO_MSS_HI0_CH7_FLUSH_STATE5_SD2_ADDR A:0xfca014dc
y.create.l HWIO_MSS_HI0_CH7_FLUSH_STATE5_SD3_ADDR A:0xfca018dc
y.create.l HWIO_MSS_HI0_SEC_DOMAIN_IRQ_STATUS_SD0_ADDR A:0xfca00e80
y.create.l HWIO_MSS_HI0_SEC_DOMAIN_IRQ_STATUS_SD1_ADDR A:0xfca01280
y.create.l HWIO_MSS_HI0_SEC_DOMAIN_IRQ_STATUS_SD2_ADDR A:0xfca01680
y.create.l HWIO_MSS_HI0_SEC_DOMAIN_IRQ_STATUS_SD3_ADDR A:0xfca01a80
y.create.l HWIO_MSS_HI0_CH0_RSLT_CONF_SD0_ADDR A:0xfca00e00
y.create.l HWIO_MSS_HI0_CH0_RSLT_CONF_SD1_ADDR A:0xfca01200
y.create.l HWIO_MSS_HI0_CH0_RSLT_CONF_SD2_ADDR A:0xfca01600
y.create.l HWIO_MSS_HI0_CH0_RSLT_CONF_SD3_ADDR A:0xfca01a00
y.create.l HWIO_MSS_HI0_CH1_RSLT_CONF_SD0_ADDR A:0xfca00e04
y.create.l HWIO_MSS_HI0_CH1_RSLT_CONF_SD1_ADDR A:0xfca01204
y.create.l HWIO_MSS_HI0_CH1_RSLT_CONF_SD2_ADDR A:0xfca01604
y.create.l HWIO_MSS_HI0_CH1_RSLT_CONF_SD3_ADDR A:0xfca01a04
y.create.l HWIO_MSS_HI0_CH2_RSLT_CONF_SD0_ADDR A:0xfca00e08
y.create.l HWIO_MSS_HI0_CH2_RSLT_CONF_SD1_ADDR A:0xfca01208
y.create.l HWIO_MSS_HI0_CH2_RSLT_CONF_SD2_ADDR A:0xfca01608
y.create.l HWIO_MSS_HI0_CH2_RSLT_CONF_SD3_ADDR A:0xfca01a08
y.create.l HWIO_MSS_HI0_CH3_RSLT_CONF_SD0_ADDR A:0xfca00e0c
y.create.l HWIO_MSS_HI0_CH3_RSLT_CONF_SD1_ADDR A:0xfca0120c
y.create.l HWIO_MSS_HI0_CH3_RSLT_CONF_SD2_ADDR A:0xfca0160c
y.create.l HWIO_MSS_HI0_CH3_RSLT_CONF_SD3_ADDR A:0xfca01a0c
y.create.l HWIO_MSS_HI0_CH4_RSLT_CONF_SD0_ADDR A:0xfca00e10
y.create.l HWIO_MSS_HI0_CH4_RSLT_CONF_SD1_ADDR A:0xfca01210
y.create.l HWIO_MSS_HI0_CH4_RSLT_CONF_SD2_ADDR A:0xfca01610
y.create.l HWIO_MSS_HI0_CH4_RSLT_CONF_SD3_ADDR A:0xfca01a10
y.create.l HWIO_MSS_HI0_CH5_RSLT_CONF_SD0_ADDR A:0xfca00e14
y.create.l HWIO_MSS_HI0_CH5_RSLT_CONF_SD1_ADDR A:0xfca01214
y.create.l HWIO_MSS_HI0_CH5_RSLT_CONF_SD2_ADDR A:0xfca01614
y.create.l HWIO_MSS_HI0_CH5_RSLT_CONF_SD3_ADDR A:0xfca01a14
y.create.l HWIO_MSS_HI0_CH6_RSLT_CONF_SD0_ADDR A:0xfca00e18
y.create.l HWIO_MSS_HI0_CH6_RSLT_CONF_SD1_ADDR A:0xfca01218
y.create.l HWIO_MSS_HI0_CH6_RSLT_CONF_SD2_ADDR A:0xfca01618
y.create.l HWIO_MSS_HI0_CH6_RSLT_CONF_SD3_ADDR A:0xfca01a18
y.create.l HWIO_MSS_HI0_CH7_RSLT_CONF_SD0_ADDR A:0xfca00e1c
y.create.l HWIO_MSS_HI0_CH7_RSLT_CONF_SD1_ADDR A:0xfca0121c
y.create.l HWIO_MSS_HI0_CH7_RSLT_CONF_SD2_ADDR A:0xfca0161c
y.create.l HWIO_MSS_HI0_CH7_RSLT_CONF_SD3_ADDR A:0xfca01a1c
y.create.l HWIO_MSS_HI0_CH0_STATUS_SD0_ADDR A:0xfca00d00
y.create.l HWIO_MSS_HI0_CH0_STATUS_SD1_ADDR A:0xfca01100
y.create.l HWIO_MSS_HI0_CH0_STATUS_SD2_ADDR A:0xfca01500
y.create.l HWIO_MSS_HI0_CH0_STATUS_SD3_ADDR A:0xfca01900
y.create.l HWIO_MSS_HI0_CH1_STATUS_SD0_ADDR A:0xfca00d04
y.create.l HWIO_MSS_HI0_CH1_STATUS_SD1_ADDR A:0xfca01104
y.create.l HWIO_MSS_HI0_CH1_STATUS_SD2_ADDR A:0xfca01504
y.create.l HWIO_MSS_HI0_CH1_STATUS_SD3_ADDR A:0xfca01904
y.create.l HWIO_MSS_HI0_CH2_STATUS_SD0_ADDR A:0xfca00d08
y.create.l HWIO_MSS_HI0_CH2_STATUS_SD1_ADDR A:0xfca01108
y.create.l HWIO_MSS_HI0_CH2_STATUS_SD2_ADDR A:0xfca01508
y.create.l HWIO_MSS_HI0_CH2_STATUS_SD3_ADDR A:0xfca01908
y.create.l HWIO_MSS_HI0_CH3_STATUS_SD0_ADDR A:0xfca00d0c
y.create.l HWIO_MSS_HI0_CH3_STATUS_SD1_ADDR A:0xfca0110c
y.create.l HWIO_MSS_HI0_CH3_STATUS_SD2_ADDR A:0xfca0150c
y.create.l HWIO_MSS_HI0_CH3_STATUS_SD3_ADDR A:0xfca0190c
y.create.l HWIO_MSS_HI0_CH4_STATUS_SD0_ADDR A:0xfca00d10
y.create.l HWIO_MSS_HI0_CH4_STATUS_SD1_ADDR A:0xfca01110
y.create.l HWIO_MSS_HI0_CH4_STATUS_SD2_ADDR A:0xfca01510
y.create.l HWIO_MSS_HI0_CH4_STATUS_SD3_ADDR A:0xfca01910
y.create.l HWIO_MSS_HI0_CH5_STATUS_SD0_ADDR A:0xfca00d14
y.create.l HWIO_MSS_HI0_CH5_STATUS_SD1_ADDR A:0xfca01114
y.create.l HWIO_MSS_HI0_CH5_STATUS_SD2_ADDR A:0xfca01514
y.create.l HWIO_MSS_HI0_CH5_STATUS_SD3_ADDR A:0xfca01914
y.create.l HWIO_MSS_HI0_CH6_STATUS_SD0_ADDR A:0xfca00d18
y.create.l HWIO_MSS_HI0_CH6_STATUS_SD1_ADDR A:0xfca01118
y.create.l HWIO_MSS_HI0_CH6_STATUS_SD2_ADDR A:0xfca01518
y.create.l HWIO_MSS_HI0_CH6_STATUS_SD3_ADDR A:0xfca01918
y.create.l HWIO_MSS_HI0_CH7_STATUS_SD0_ADDR A:0xfca00d1c
y.create.l HWIO_MSS_HI0_CH7_STATUS_SD1_ADDR A:0xfca0111c
y.create.l HWIO_MSS_HI0_CH7_STATUS_SD2_ADDR A:0xfca0151c
y.create.l HWIO_MSS_HI0_CH7_STATUS_SD3_ADDR A:0xfca0191c
y.create.l HWIO_MSS_HI0_CH0_CONF_ADDR A:0xfca00d40
y.create.l HWIO_MSS_HI0_CH1_CONF_ADDR A:0xfca00d44
y.create.l HWIO_MSS_HI0_CH2_CONF_ADDR A:0xfca00d48
y.create.l HWIO_MSS_HI0_CH3_CONF_ADDR A:0xfca00d4c
y.create.l HWIO_MSS_HI0_CH4_CONF_ADDR A:0xfca00d50
y.create.l HWIO_MSS_HI0_CH5_CONF_ADDR A:0xfca00d54
y.create.l HWIO_MSS_HI0_CH6_CONF_ADDR A:0xfca00d58
y.create.l HWIO_MSS_HI0_CH7_CONF_ADDR A:0xfca00d5c
y.create.l HWIO_MSS_HI0_CH0_DBG_0_ADDR A:0xfca00d80
y.create.l HWIO_MSS_HI0_CH1_DBG_0_ADDR A:0xfca00d84
y.create.l HWIO_MSS_HI0_CH2_DBG_0_ADDR A:0xfca00d88
y.create.l HWIO_MSS_HI0_CH3_DBG_0_ADDR A:0xfca00d8c
y.create.l HWIO_MSS_HI0_CH4_DBG_0_ADDR A:0xfca00d90
y.create.l HWIO_MSS_HI0_CH5_DBG_0_ADDR A:0xfca00d94
y.create.l HWIO_MSS_HI0_CH6_DBG_0_ADDR A:0xfca00d98
y.create.l HWIO_MSS_HI0_CH7_DBG_0_ADDR A:0xfca00d9c
y.create.l HWIO_MSS_HI0_CH0_DBG_1_ADDR A:0xfca00dc0
y.create.l HWIO_MSS_HI0_CH1_DBG_1_ADDR A:0xfca00dc4
y.create.l HWIO_MSS_HI0_CH2_DBG_1_ADDR A:0xfca00dc8
y.create.l HWIO_MSS_HI0_CH3_DBG_1_ADDR A:0xfca00dcc
y.create.l HWIO_MSS_HI0_CH4_DBG_1_ADDR A:0xfca00dd0
y.create.l HWIO_MSS_HI0_CH5_DBG_1_ADDR A:0xfca00dd4
y.create.l HWIO_MSS_HI0_CH6_DBG_1_ADDR A:0xfca00dd8
y.create.l HWIO_MSS_HI0_CH7_DBG_1_ADDR A:0xfca00ddc
y.create.l HWIO_MSS_HI0_CI0_CONF_ADDR A:0xfca00e90
y.create.l HWIO_MSS_HI0_CI1_CONF_ADDR A:0xfca00e94
y.create.l HWIO_MSS_HI0_CI2_CONF_ADDR A:0xfca00e98
y.create.l HWIO_MSS_HI0_CI3_CONF_ADDR A:0xfca00e9c
y.create.l HWIO_MSS_HI0_CI4_CONF_ADDR A:0xfca00ea0
y.create.l HWIO_MSS_HI0_CI5_CONF_ADDR A:0xfca00ea4
y.create.l HWIO_MSS_HI0_CI6_CONF_ADDR A:0xfca00ea8
y.create.l HWIO_MSS_HI0_CI7_CONF_ADDR A:0xfca00eac
y.create.l HWIO_MSS_HI0_CI0_DBG_ERR_ADDR A:0xfca00eb0
y.create.l HWIO_MSS_HI0_CI1_DBG_ERR_ADDR A:0xfca00eb4
y.create.l HWIO_MSS_HI0_CI2_DBG_ERR_ADDR A:0xfca00eb8
y.create.l HWIO_MSS_HI0_CI3_DBG_ERR_ADDR A:0xfca00ebc
y.create.l HWIO_MSS_HI0_CI4_DBG_ERR_ADDR A:0xfca00ec0
y.create.l HWIO_MSS_HI0_CI5_DBG_ERR_ADDR A:0xfca00ec4
y.create.l HWIO_MSS_HI0_CI6_DBG_ERR_ADDR A:0xfca00ec8
y.create.l HWIO_MSS_HI0_CI7_DBG_ERR_ADDR A:0xfca00ecc
y.create.l HWIO_MSS_HI0_CRCI_DBG_ADDR A:0xfca00ed0
y.create.l HWIO_MSS_HI0_CRCI_STATUS_ADDR A:0xfca00ed4
y.create.l HWIO_MSS_HI0_GP_CTL_ADDR A:0xfca00ed8
y.create.l HWIO_MSS_HI0_GP_STATUS_ADDR A:0xfca00edc
y.create.l HWIO_MSS_HI0_GLBL_DBG_CMD_ENG_ADDR A:0xfca00ee0
y.create.l HWIO_MSS_HI0_GLBL_DBG_REQ_ENG_ADDR A:0xfca00ee4
y.create.l HWIO_MSS_HI0_GLBL_DBG_XFR_ENG_ADDR A:0xfca00ee8
y.create.l HWIO_MSS_HI0_GLBL_DBG_CHAN_BLK_ADDR A:0xfca00eec
y.create.l HWIO_MSS_HI0_GLBL_DBG_CHAN_BLK_CLR_ADDR A:0xfca00ef0
y.create.l HWIO_MSS_HI0_GLBL_DBG_TEST_SEL_ADDR A:0xfca00ef4
y.create.l HWIO_MSS_NAV_CLK_ENABLE_ADDR A:0xfcaf8000
y.create.l HWIO_MSS_NAV_CLK_RESET_ADDR A:0xfcaf8004
y.create.l HWIO_MSS_NAV_CLK_CTL_ADDR A:0xfcaf8008
y.create.l HWIO_MSS_NAV_CLK_FRAC31_M_ADDR A:0xfcaf800c
y.create.l HWIO_MSS_NAV_CLK_FRAC31_NOT_2D_ADDR A:0xfcaf8010
y.create.l HWIO_MSS_NAV_CLK_FRAC31_NOT_N_MINUS_M_ADDR A:0xfcaf8014
y.create.l HWIO_MSS_NAV_CLK_FRAC31_UPDATE_ADDR A:0xfcaf8018
y.create.l HWIO_MSS_NAV_CLK_GDS_ADDR A:0xfcaf801c
y.create.l HWIO_MSS_GNSS_ADC_CMD0_ADDR A:0xfcaf0000
y.create.l HWIO_MSS_GNSS_ADC_CMD1_ADDR A:0xfcaf0004
y.create.l HWIO_MSS_GNSS_ADC_CMD2_ADDR A:0xfcaf0008
y.create.l HWIO_MSS_GNSS_ADC_CMD3_ADDR A:0xfcaf000c
y.create.l HWIO_MSS_GNSS_ADC_IDDQ_ADDR A:0xfcaf0010
y.create.l HWIO_MEM_POOL_MEM_PAGE0_START_ADDR A:0xfcbc0000
y.create.l HWIO_MEM_POOL_MEM_PAGE0_END_ADDR A:0xfcbcfffc
y.create.l HWIO_MEM_POOL_MEM_PAGE1_START_ADDR A:0xfcbd0000
y.create.l HWIO_MEM_POOL_MEM_PAGE1_END_ADDR A:0xfcbdfffc
y.create.l HWIO_VPE_ENABLE_ADDR A:0xfcb80000
y.create.l HWIO_VPE_CLK_CTL_ADDR A:0xfcb80004
y.create.l HWIO_VPE_VU_CLK_EN_ADDR A:0xfcb80008
y.create.l HWIO_VPE_PWR_SEQ_EN_ADDR A:0xfcb8000c
y.create.l HWIO_VPE_MODE_CTL_ADDR A:0xfcb80010
y.create.l HWIO_VPE_PWR_SEQ_THRES_ADDR A:0xfcb80014
y.create.l HWIO_VPE_PWR_GATING_STATUS_ADDR A:0xfcb80018
y.create.l HWIO_VPE_AHB_MPBR_CTL_ADDR A:0xfcb8001c
y.create.l HWIO_VPE_AHB_MPBR_WDATA_ADDR A:0xfcb80020
y.create.l HWIO_VPE_AHB_MPBR_RDATA_ADDR A:0xfcb80024
y.create.l HWIO_VPE_AHB_MPBR_CH_EN_ADDR A:0xfcb80028
y.create.l HWIO_VPE_IU_IRQ_PEND_WDATA_ADDR A:0xfcb8002c
y.create.l HWIO_VPE_IU_IRQ_PEND_RDATA_ADDR A:0xfcb80030
y.create.l HWIO_VPE_MVP_SCHEDULE_ADDR A:0xfcb80034
y.create.l HWIO_VPE_DBG_EN_ADDR A:0xfcb80040
y.create.l HWIO_VPE_DBG_HWTRACE_CTL_ADDR A:0xfcb80044
y.create.l HWIO_VPE_DBG_PCTRACE_CTL_ADDR A:0xfcb80048
y.create.l HWIO_VPE_DBG_PCBUF_STAT_VP0_ADDR A:0xfcb8004c
y.create.l HWIO_VPE_DBG_PCBUF_STAT_VP1_ADDR A:0xfcb80050
y.create.l HWIO_VPE_DBG_PCBUF_STAT_VP2_ADDR A:0xfcb80054
y.create.l HWIO_VPE_DBG_PCBUF_STAT_VP3_ADDR A:0xfcb80058
y.create.l HWIO_VPE_DBG_PCBUF_DATA_VP0_ADDR A:0xfcb80060
y.create.l HWIO_VPE_DBG_PCBUF_DATA_VP1_ADDR A:0xfcb80064
y.create.l HWIO_VPE_DBG_PCBUF_DATA_VP2_ADDR A:0xfcb80068
y.create.l HWIO_VPE_DBG_PCBUF_DATA_VP3_ADDR A:0xfcb8006c
y.create.l HWIO_MEM_PL_BRDG_CH0_CFG0_ADDR A:0xfcb80800
y.create.l HWIO_MEM_PL_BRDG_CH1_CFG0_ADDR A:0xfcb8080c
y.create.l HWIO_MEM_PL_BRDG_CH0_CFG1_ADDR A:0xfcb80804
y.create.l HWIO_MEM_PL_BRDG_CH1_CFG1_ADDR A:0xfcb80810
y.create.l HWIO_MEM_PL_MEM_CH0_PAGE_NUM_ADDR A:0xfcb80808
y.create.l HWIO_MEM_PL_MEM_CH1_PAGE_NUM_ADDR A:0xfcb80814
y.create.l HWIO_MEM_PL_MEMSS_SLAVE_ERR_ADDR A:0xfcb80818
y.create.l HWIO_MEM_PL_MEMSS_CLR_SLAVE_ERR_ADDR A:0xfcb8081c
y.create.l HWIO_MEM_PL_SLT_0_ADDR A:0xfcb80c00
y.create.l HWIO_MEM_PL_SLT_1_ADDR A:0xfcb80c04
y.create.l HWIO_MEM_PL_SLT_2_ADDR A:0xfcb80c08
y.create.l HWIO_MEM_PL_SLT_3_ADDR A:0xfcb80c0c
y.create.l HWIO_MEM_PL_SLT_4_ADDR A:0xfcb80c10
y.create.l HWIO_MEM_PL_SLT_5_ADDR A:0xfcb80c14
y.create.l HWIO_MEM_PL_SLT_6_ADDR A:0xfcb80c18
y.create.l HWIO_MEM_PL_SLT_7_ADDR A:0xfcb80c1c
y.create.l HWIO_MEM_PL_SLT_8_ADDR A:0xfcb80c20
y.create.l HWIO_MEM_PL_SLT_9_ADDR A:0xfcb80c24
y.create.l HWIO_MEM_PL_TDM_UPDATE_ADDR A:0xfcb80d00
y.create.l HWIO_VPE_DMEM_START_ADDR A:0xfcb81000
y.create.l HWIO_VPE_DMEM_END_ADDR A:0xfcb86ffc
y.create.l HWIO_VPE_PMEM_START_ADDR A:0xfcb87000
y.create.l HWIO_VPE_PMEM_END_ADDR A:0xfcba2ffc
y.create.l HWIO_TX_ENABLE_ADDR A:0xfcb70000
y.create.l HWIO_TX_MEM_ACCESS_CFG_ADDR A:0xfcb70004
y.create.l HWIO_TX_MEM_PAGE_ADDR A:0xfcb70008
y.create.l HWIO_TX_MEMPOOL_WR_INTF_EVENT_ADDR A:0xfcb7000c
y.create.l HWIO_TX_STMR_TRIG_FRAC_CNT_0_ADDR A:0xfcb70010
y.create.l HWIO_TX_STMR_TRIG_FRAC_CNT_1_ADDR A:0xfcb70014
y.create.l HWIO_TX_FRAME_STB_FRAC_CNT_0_ADDR A:0xfcb70018
y.create.l HWIO_TX_FRAME_STB_FRAC_CNT_1_ADDR A:0xfcb7001c
y.create.l HWIO_TX_MISR_CTRL_ADDR A:0xfcb70020
y.create.l HWIO_TX_MISR_RD_DATA_ADDR A:0xfcb70024
y.create.l HWIO_TX_MISR_CAP_EN_ADDR A:0xfcb70028
y.create.l HWIO_HARQ_DONE_STATUS_ADDR A:0xfcb7002c
y.create.l HWIO_TX_MODE_0_ADDR A:0xfcb70030
y.create.l HWIO_TX_MODE_1_ADDR A:0xfcb70034
y.create.l HWIO_TX_MODE_COMMON_ADDR A:0xfcb70038
y.create.l HWIO_TX_ENABLE_GSM_0_ADDR A:0xfcb7003c
y.create.l HWIO_TX_ENABLE_GSM_1_ADDR A:0xfcb70040
y.create.l HWIO_TX_TDS_CTRL_ADDR A:0xfcb70044
y.create.l HWIO_TX_MEM_TEST_WR_ADDR_ADDR A:0xfcb70048
y.create.l HWIO_TX_MEM_TEST_WR_ADDR_STATUS_ADDR A:0xfcb7004c
y.create.l HWIO_TX_MEM_TEST_RD_ADDR A:0xfcb70050
y.create.l HWIO_TX_MEM_TEST_RD_ADDR_ADDR A:0xfcb70054
y.create.l HWIO_TX_MEM_TEST_RD_ADDR_STATUS_ADDR A:0xfcb70058
y.create.l HWIO_DEBUG_INIT_ADDR A:0xfcb7005c
y.create.l HWIO_TX_SW_AHB_EVENT_ADDR0_ADDR A:0xfcb70060
y.create.l HWIO_TX_SW_AHB_EVENT_ADDR1_ADDR A:0xfcb70064
y.create.l HWIO_TX_SW_AHB_EVENT_ADDR2_ADDR A:0xfcb70068
y.create.l HWIO_TX_SW_AHB_EVENT_ADDR3_ADDR A:0xfcb7006c
y.create.l HWIO_TX_SW_AHB_EVENT_ADDR4_ADDR A:0xfcb70070
y.create.l HWIO_TX_SW_AHB_EVENT_ADDR5_ADDR A:0xfcb70074
y.create.l HWIO_TX_SW_AHB_EVENT_ADDR6_ADDR A:0xfcb70078
y.create.l HWIO_TX_SW_AHB_EVENT_ADDR7_ADDR A:0xfcb7007c
y.create.l HWIO_TX_A2_AHB_EVENT_ADDR_ADDR A:0xfcb70080
y.create.l HWIO_TX_EVENT_LOG_EN_ADDR A:0xfcb70084
y.create.l HWIO_TX_EVENT_SEL_0_ADDR A:0xfcb70088
y.create.l HWIO_TX_EVENT_SEL_1_ADDR A:0xfcb7008c
y.create.l HWIO_TX_TESTBUS_SEL_ADDR A:0xfcb70090
y.create.l HWIO_TX_TESTBUS_RD_DATA_ADDR A:0xfcb70094
y.create.l HWIO_TX_TESTBUS_RD_DATA_MASK_ADDR A:0xfcb70098
y.create.l HWIO_TX_ERROR_IRQ_EN_ADDR A:0xfcb7009c
y.create.l HWIO_TX_ERROR_IRQ_CLEAR_ADDR A:0xfcb700a0
y.create.l HWIO_TX_ERROR_IRQ_STATUS_ADDR A:0xfcb700a4
y.create.l HWIO_TX_STATUS_RD_ADDR A:0xfcb700a8
y.create.l HWIO_TX_DEBUG_IRQ_EN_ADDR A:0xfcb700ac
y.create.l HWIO_TX_DEBUG_IRQ_CLEAR_ADDR A:0xfcb700b0
y.create.l HWIO_TX_DEBUG_IRQ_STATUS_ADDR A:0xfcb700b4
y.create.l HWIO_TX_C2K_MODE_ADDR A:0xfcb71000
y.create.l HWIO_TX_MEM_ERAM_ADDR_0_ADDR A:0xfcb71004
y.create.l HWIO_TX_MEM_ERAM_ADDR_1_ADDR A:0xfcb71008
y.create.l HWIO_TX_MEM_ERAM_ADDR_2_ADDR A:0xfcb7100c
y.create.l HWIO_TX_MEM_ERAM_ADDR_3_ADDR A:0xfcb71010
y.create.l HWIO_TX_MEM_ERAM_ADDR_4_ADDR A:0xfcb71014
y.create.l HWIO_TX_MEM_ERAM_ADDR_5_ADDR A:0xfcb71018
y.create.l HWIO_TX_MEM_ERAM_ADDR_6_ADDR A:0xfcb7101c
y.create.l HWIO_TX_MEM_ERAM_ADDR_7_ADDR A:0xfcb71020
y.create.l HWIO_TX_MEM_ERAM_ADDR_8_ADDR A:0xfcb71024
y.create.l HWIO_TX_MEM_ERAM_ADDR_9_ADDR A:0xfcb71028
y.create.l HWIO_TX_MEM_IRAM_ADDR_0_ADDR A:0xfcb71034
y.create.l HWIO_TX_MEM_IRAM_ADDR_1_ADDR A:0xfcb71038
y.create.l HWIO_TX_MEM_IRAM_ADDR_2_ADDR A:0xfcb7103c
y.create.l HWIO_TX_MEM_IRAM_ADDR_3_ADDR A:0xfcb71040
y.create.l HWIO_TX_MEM_IRAM_ADDR_4_ADDR A:0xfcb71044
y.create.l HWIO_TX_MEM_IRAM_ADDR_5_ADDR A:0xfcb71048
y.create.l HWIO_TX_MEM_IRAM_ADDR_6_ADDR A:0xfcb7104c
y.create.l HWIO_TX_MEM_IRAM_ADDR_7_ADDR A:0xfcb71050
y.create.l HWIO_TX_MEM_IRAM_ADDR_8_ADDR A:0xfcb71054
y.create.l HWIO_TX_MEM_IRAM_ADDR_9_ADDR A:0xfcb71058
y.create.l HWIO_TX_TDS_NEW_FRAME_SW_ADDR A:0xfcb71064
y.create.l HWIO_TX_UNIFIED_DCH_RACH_ENC_TRIGGER_ADDR A:0xfcb71068
y.create.l HWIO_TX_TDS_ERUCCH_ENC_TRIGGER_ADDR A:0xfcb7106c
y.create.l HWIO_TX_1X_ENC_TRIGGER_ADDR A:0xfcb71070
y.create.l HWIO_TX_DO_ENC_TRIGGER_ADDR A:0xfcb71074
y.create.l HWIO_TX_DO_CARRIER_CONFIG_ADDR A:0xfcb71078
y.create.l HWIO_TX_UNIFIED_ENC_NUM_ACTIVE_TRCHS_ADDR A:0xfcb7107c
y.create.l HWIO_TX_UNIFIED_ENC_ENDIAN_FRMT_CTL_ADDR A:0xfcb71080
y.create.l HWIO_TX_UNIFIED_ENC_CIPHER_CK0_0_ADDR A:0xfcb71084
y.create.l HWIO_TX_UNIFIED_ENC_CIPHER_CK0_1_ADDR A:0xfcb71088
y.create.l HWIO_TX_UNIFIED_ENC_CIPHER_CK0_2_ADDR A:0xfcb7108c
y.create.l HWIO_TX_UNIFIED_ENC_CIPHER_CK0_3_ADDR A:0xfcb71090
y.create.l HWIO_TX_UNIFIED_ENC_CIPHER_CK1_0_ADDR A:0xfcb71094
y.create.l HWIO_TX_UNIFIED_ENC_CIPHER_CK1_1_ADDR A:0xfcb71098
y.create.l HWIO_TX_UNIFIED_ENC_CIPHER_CK1_2_ADDR A:0xfcb7109c
y.create.l HWIO_TX_UNIFIED_ENC_CIPHER_CK1_3_ADDR A:0xfcb710a0
y.create.l HWIO_TX_UNIFIED_ENC_CIPHER_CK2_0_ADDR A:0xfcb710a4
y.create.l HWIO_TX_UNIFIED_ENC_CIPHER_CK2_1_ADDR A:0xfcb710a8
y.create.l HWIO_TX_UNIFIED_ENC_CIPHER_CK2_2_ADDR A:0xfcb710ac
y.create.l HWIO_TX_UNIFIED_ENC_CIPHER_CK2_3_ADDR A:0xfcb710b0
y.create.l HWIO_TX_UNIFIED_ENC_CIPHER_CK3_0_ADDR A:0xfcb710b4
y.create.l HWIO_TX_UNIFIED_ENC_CIPHER_CK3_1_ADDR A:0xfcb710b8
y.create.l HWIO_TX_UNIFIED_ENC_CIPHER_CK3_2_ADDR A:0xfcb710bc
y.create.l HWIO_TX_UNIFIED_ENC_CIPHER_CK3_3_ADDR A:0xfcb710c0
y.create.l HWIO_TX_UNIFIED_ENC_CIPHER_CK4_0_ADDR A:0xfcb710c4
y.create.l HWIO_TX_UNIFIED_ENC_CIPHER_CK4_1_ADDR A:0xfcb710c8
y.create.l HWIO_TX_UNIFIED_ENC_CIPHER_CK4_2_ADDR A:0xfcb710cc
y.create.l HWIO_TX_UNIFIED_ENC_CIPHER_CK4_3_ADDR A:0xfcb710d0
y.create.l HWIO_TX_UNIFIED_ENC_CIPHER_CK5_0_ADDR A:0xfcb710d4
y.create.l HWIO_TX_UNIFIED_ENC_CIPHER_CK5_1_ADDR A:0xfcb710d8
y.create.l HWIO_TX_UNIFIED_ENC_CIPHER_CK5_2_ADDR A:0xfcb710dc
y.create.l HWIO_TX_UNIFIED_ENC_CIPHER_CK5_3_ADDR A:0xfcb710e0
y.create.l HWIO_TX_UNIFIED_ENC_ERAM_INCRACC_INIT_ADDR A:0xfcb710e4
y.create.l HWIO_TX_UNIFIED_ENC_FILLER_POLARITY_ADDR A:0xfcb710e8
y.create.l HWIO_TX_TDS_TTI_ERUCCH_ADDR A:0xfcb710ec
y.create.l HWIO_TX_UNIFIED_ENC_EUL_CODING_PARAM_BANK0_ADDR A:0xfcb710f0
y.create.l HWIO_TX_UNIFIED_ENC_EUL_CODING_PARAM_BANK1_ADDR A:0xfcb710f4
y.create.l HWIO_TX_UNIFIED_ENC_EUL_CODE_SEG_SIZE_BANK0_ADDR A:0xfcb710f8
y.create.l HWIO_TX_UNIFIED_ENC_EUL_CODE_SEG_SIZE_BANK1_ADDR A:0xfcb710fc
y.create.l HWIO_TX_UNIFIED_ENC_EUL_TURBO_INTLV_PARAM0_BANK0_ADDR A:0xfcb71100
y.create.l HWIO_TX_UNIFIED_ENC_EUL_TURBO_INTLV_PARAM0_BANK1_ADDR A:0xfcb71104
y.create.l HWIO_TX_UNIFIED_ENC_EUL_TURBO_INTLV_PARAM1_BANK0_ADDR A:0xfcb71108
y.create.l HWIO_TX_UNIFIED_ENC_EUL_TURBO_INTLV_PARAM1_BANK1_ADDR A:0xfcb7110c
y.create.l HWIO_TX_UNIFIED_ENC_OFFL_ENC_FRAME_ADDR A:0xfcb71110
y.create.l HWIO_TX_UNIFIED_EUL_ENC_TRIGGER_ADDR A:0xfcb71114
y.create.l HWIO_TX_UNIFIED_ENC_EUL_ENC_BANK_CFG_ADDR A:0xfcb71118
y.create.l HWIO_TX_1X_CH1_ENC_CTL_ADDR A:0xfcb7111c
y.create.l HWIO_TX_1X_CH1_CRC_POLY_ADDR A:0xfcb71120
y.create.l HWIO_TX_1X_CH2_ENC_CTL_0_ADDR A:0xfcb71124
y.create.l HWIO_TX_1X_CH2_ENC_CTL_1_ADDR A:0xfcb71128
y.create.l HWIO_TX_1X_CH2_CRC_POLY_ADDR A:0xfcb7112c
y.create.l HWIO_TX_1X_CH3_ENC_CTL_0_ADDR A:0xfcb71130
y.create.l HWIO_TX_1X_CH3_ENC_CTL_1_ADDR A:0xfcb71134
y.create.l HWIO_TX_1X_CH3_CRC_POLY_ADDR A:0xfcb71138
y.create.l HWIO_TX_DO_SCRAMB_INIT_0_ADDR A:0xfcb7113c
y.create.l HWIO_TX_DO_SCRAMB_INIT_1_ADDR A:0xfcb71140
y.create.l HWIO_TX_DO_SCRAMB_INIT_2_ADDR A:0xfcb71144
y.create.l HWIO_TX_TDS_RM_EINI_ERUCCH_ADDR A:0xfcb71148
y.create.l HWIO_TX_TDS_RM_EMINUS_ERUCCH_ADDR A:0xfcb7114c
y.create.l HWIO_TX_TDS_RM_EPLUS_ERUCCH_ADDR A:0xfcb71150
y.create.l HWIO_TX_TDS_CCTRCH_SI_ADDR A:0xfcb71154
y.create.l HWIO_TX_TDS_ERUCCH_ADDR_ADDR A:0xfcb71158
y.create.l HWIO_TX_TDS_CCTRCH_ADDR_ADDR A:0xfcb7115c
y.create.l HWIO_TX_TDS_SLOT_DATA_NUM0_CCTRCH1_ADDR A:0xfcb71160
y.create.l HWIO_TX_TDS_SLOT_DATA_NUM1_CCTRCH1_ADDR A:0xfcb71164
y.create.l HWIO_TX_TDS_SLOT_DATA_NUM2_CCTRCH1_ADDR A:0xfcb71168
y.create.l HWIO_TX_TDS_SLOT_DATA_NUM0_CCTRCH2_ADDR A:0xfcb7116c
y.create.l HWIO_TX_TDS_SLOT_DATA_NUM1_CCTRCH2_ADDR A:0xfcb71170
y.create.l HWIO_TX_TDS_SLOT_DATA_NUM2_CCTRCH2_ADDR A:0xfcb71174
y.create.l HWIO_TX_UNIFIED_ENC_EUL_RM_SYS_EINI_ADDR A:0xfcb71178
y.create.l HWIO_TX_UNIFIED_ENC_EUL_RM_SYS_EPLUS_EMINUS_ADDR A:0xfcb7117c
y.create.l HWIO_TX_UNIFIED_ENC_EUL_RM_P1_EINI_ADDR A:0xfcb71180
y.create.l HWIO_TX_UNIFIED_ENC_EUL_RM_P1_EPLUS_ADDR A:0xfcb71184
y.create.l HWIO_TX_UNIFIED_ENC_EUL_RM_P1_EMINUS_ADDR A:0xfcb71188
y.create.l HWIO_TX_UNIFIED_ENC_EUL_RM_P2_EINI_ADDR A:0xfcb7118c
y.create.l HWIO_TX_UNIFIED_ENC_EUL_RM_P2_EPLUS_EMINUS_ADDR A:0xfcb71190
y.create.l HWIO_TX_UNIFIED_ENC_EUL_RM_SYS_NUMBITS_ADDR A:0xfcb71194
y.create.l HWIO_TX_UNIFIED_ENC_EUL_RM_P1P2_NUMBITS_ADDR A:0xfcb71198
y.create.l HWIO_TX_TDS_EUL_NUMBITS_ADDR A:0xfcb7119c
y.create.l HWIO_UMTS_TX_EUL_RM_RAM_BASE_ADDR_ADDR A:0xfcb711a0
y.create.l HWIO_TX_1X_CH1_PUNCT_PATN_1_ADDR A:0xfcb711a4
y.create.l HWIO_TX_1X_CH1_PUNCT_PATN_0_ADDR A:0xfcb711a8
y.create.l HWIO_TX_1X_CH2_PUNCT_PATN_1_ADDR A:0xfcb711ac
y.create.l HWIO_TX_1X_CH2_PUNCT_PATN_0_ADDR A:0xfcb711b0
y.create.l HWIO_TX_1X_CH3_PUNCT_PATN_1_ADDR A:0xfcb711b4
y.create.l HWIO_TX_1X_CH3_PUNCT_PATN_0_ADDR A:0xfcb711b8
y.create.l HWIO_TX_1X_LPN_BOZO_ADDR A:0xfcb711bc
y.create.l HWIO_TX_UNIFIED_PN_LD_ADDR A:0xfcb711c0
y.create.l HWIO_TX_UNIFIED_PN_MASK_LD_ADDR A:0xfcb711c4
y.create.l HWIO_TX_1X_I_PN_STATE_ADDR A:0xfcb711c8
y.create.l HWIO_TX_1X_Q_PN_STATE_ADDR A:0xfcb711cc
y.create.l HWIO_TX_1X_U_PN_MASK_0_ADDR A:0xfcb711d0
y.create.l HWIO_TX_1X_U_PN_MASK_1_ADDR A:0xfcb711d4
y.create.l HWIO_TX_1X_U_PN_STATE_0_ADDR A:0xfcb711d8
y.create.l HWIO_TX_1X_U_PN_STATE_1_ADDR A:0xfcb711dc
y.create.l HWIO_TX_DO_PN_STATE_0_ADDR A:0xfcb711e0
y.create.l HWIO_TX_DO_PN_STATE_1_ADDR A:0xfcb711e4
y.create.l HWIO_TX_DO_I_PN_MASK_0_C0_ADDR A:0xfcb711e8
y.create.l HWIO_TX_DO_I_PN_MASK_0_C1_ADDR A:0xfcb711ec
y.create.l HWIO_TX_DO_I_PN_MASK_0_C2_ADDR A:0xfcb711f0
y.create.l HWIO_TX_DO_I_PN_MASK_1_C0_ADDR A:0xfcb711f4
y.create.l HWIO_TX_DO_I_PN_MASK_1_C1_ADDR A:0xfcb711f8
y.create.l HWIO_TX_DO_I_PN_MASK_1_C2_ADDR A:0xfcb711fc
y.create.l HWIO_TX_DO_Q_PN_MASK_0_C0_ADDR A:0xfcb71200
y.create.l HWIO_TX_DO_Q_PN_MASK_0_C1_ADDR A:0xfcb71204
y.create.l HWIO_TX_DO_Q_PN_MASK_0_C2_ADDR A:0xfcb71208
y.create.l HWIO_TX_DO_Q_PN_MASK_1_C0_ADDR A:0xfcb7120c
y.create.l HWIO_TX_DO_Q_PN_MASK_1_C1_ADDR A:0xfcb71210
y.create.l HWIO_TX_DO_Q_PN_MASK_1_C2_ADDR A:0xfcb71214
y.create.l HWIO_TX_DO_FOC_PN_CTL_C0_ADDR A:0xfcb71218
y.create.l HWIO_TX_DO_FOC_PN_CTL_C1_ADDR A:0xfcb7121c
y.create.l HWIO_TX_DO_FOC_PN_CTL_C2_ADDR A:0xfcb71220
y.create.l HWIO_TX_DO_TRAFFIC_PN_CTL_ADDR A:0xfcb71224
y.create.l HWIO_TX_UMTS_SCR_CODE_INIT_ADDR A:0xfcb71228
y.create.l HWIO_TX_TDS_SCR_CODE_INIT_ADDR A:0xfcb71230
y.create.l HWIO_TX_1X_PICH_PCBIT_DATA_ADDR A:0xfcb71234
y.create.l HWIO_TX_1X_PICH_PCBIT_MASK_ADDR A:0xfcb71238
y.create.l HWIO_TX_DO_REV0_RRI_CTL_ADDR A:0xfcb7123c
y.create.l HWIO_TX_DO_ACK_CTL_C0_ADDR A:0xfcb71240
y.create.l HWIO_TX_DO_ACK_CTL_C1_ADDR A:0xfcb71244
y.create.l HWIO_TX_DO_ACK_CTL_C2_ADDR A:0xfcb71248
y.create.l HWIO_TX_DO_DRC_CTL_C0_ADDR A:0xfcb7124c
y.create.l HWIO_TX_DO_DRC_CTL_C1_ADDR A:0xfcb71250
y.create.l HWIO_TX_DO_DRC_CTL_C2_ADDR A:0xfcb71254
y.create.l HWIO_TX_DO_DSC_CTL_C0_ADDR A:0xfcb71258
y.create.l HWIO_TX_DO_DSC_CTL_C1_ADDR A:0xfcb7125c
y.create.l HWIO_TX_DO_DSC_CTL_C2_ADDR A:0xfcb71260
y.create.l HWIO_TX_DO_REVAB_RRI_CTL_C0_ADDR A:0xfcb71264
y.create.l HWIO_TX_DO_REVAB_RRI_CTL_C1_ADDR A:0xfcb71268
y.create.l HWIO_TX_DO_REVAB_RRI_CTL_C2_ADDR A:0xfcb7126c
y.create.l HWIO_TX_1X_FPC_BIT_ADDR A:0xfcb71270
y.create.l HWIO_TX_UMTS_PHY_CH_TYPE_ADDR A:0xfcb71274
y.create.l HWIO_TX_UMTS_RACH_CTL_ADDR A:0xfcb71278
y.create.l HWIO_TX_UMTS_RACH_OVSF_ADDR A:0xfcb7127c
y.create.l HWIO_TX_UMTS_CTL_CH_DATA_ADDR A:0xfcb71280
y.create.l HWIO_TX_UMTS_SPARE_CH_DATA_ADDR A:0xfcb71284
y.create.l HWIO_TX_UMTS_SPARE_CH_CTL_ADDR A:0xfcb71288
y.create.l HWIO_TX_UNIFIED_SPARE_DATA_CH_CTL_0_ADDR A:0xfcb7128c
y.create.l HWIO_TX_UNIFIED_SPARE_DATA_CH_CTL_1_ADDR A:0xfcb71290
y.create.l HWIO_TX_UNIFIED_SPARE_DATA_CH_FINE_CTL_0_ADDR A:0xfcb71294
y.create.l HWIO_TX_UNIFIED_SPARE_DATA_CH_FINE_CTL_1_ADDR A:0xfcb71298
y.create.l HWIO_TX_UMTS_DPDCH_CTL_ADDR A:0xfcb7129c
y.create.l HWIO_TX_UMTS_HSDPCCH_CTL_ADDR A:0xfcb712a0
y.create.l HWIO_TX_UMTS_HSDPCCH_DATA_ADDR A:0xfcb712a4
y.create.l HWIO_TX_UMTS_EUL_NUMBITS_EDPDCH0_ADDR A:0xfcb712a8
y.create.l HWIO_TX_UMTS_EUL_NUMBITS_EDPDCH1_ADDR A:0xfcb712ac
y.create.l HWIO_TX_UMTS_EUL_NUMBITS_EDPDCH2_ADDR A:0xfcb712b0
y.create.l HWIO_TX_UMTS_EUL_NUMBITS_EDPDCH3_ADDR A:0xfcb712b4
y.create.l HWIO_TX_UMTS_EUL_EDPDCH_CONFIG_ADDR A:0xfcb712c8
y.create.l HWIO_TX_UMTS_EUL_EDPDCH_CTL0_ADDR A:0xfcb712cc
y.create.l HWIO_TX_UMTS_EUL_EDPDCH_CTL1_ADDR A:0xfcb712d0
y.create.l HWIO_TX_UMTS_EUL_EDPDCH_CTL2_ADDR A:0xfcb712d4
y.create.l HWIO_TX_UMTS_EUL_EDPDCH_CTL3_ADDR A:0xfcb712d8
y.create.l HWIO_TX_UMTS_EUL_EDPCCH_CTL_ADDR A:0xfcb712dc
y.create.l HWIO_TX_UMTS_EUL_EDPCCH_DATA_ADDR A:0xfcb712e0
y.create.l HWIO_TX_TDS_EUCCH_ADDR A:0xfcb712e4
y.create.l HWIO_TX_TDS_HSSICH0_ADDR A:0xfcb712e8
y.create.l HWIO_TX_TDS_HSSICH1_ADDR A:0xfcb712ec
y.create.l HWIO_TX_TDS_HSSICH2_ADDR A:0xfcb712f0
y.create.l HWIO_TX_TDS_SYNC_UL0_ADDR A:0xfcb712f4
y.create.l HWIO_TX_TDS_SYNC_UL1_ADDR A:0xfcb712f8
y.create.l HWIO_TX_TDS_SYNC_UL2_ADDR A:0xfcb712fc
y.create.l HWIO_TX_TDS_SYNC_UL3_ADDR A:0xfcb71300
y.create.l HWIO_TX_TDS_MIDAMBLE_SHIFT_ADDR A:0xfcb71304
y.create.l HWIO_TX_TDS_MIDAMBLE0_ADDR A:0xfcb71308
y.create.l HWIO_TX_TDS_MIDAMBLE1_ADDR A:0xfcb7130c
y.create.l HWIO_TX_TDS_MIDAMBLE2_ADDR A:0xfcb71310
y.create.l HWIO_TX_TDS_MIDAMBLE3_ADDR A:0xfcb71314
y.create.l HWIO_TX_TDS_SLOT_CTL_PHY_CH0_ADDR A:0xfcb71318
y.create.l HWIO_TX_TDS_SLOT_CTL_PHY_CH1_ADDR A:0xfcb7131c
y.create.l HWIO_TX_TDS_SS_PHY_CH0_ADDR A:0xfcb71320
y.create.l HWIO_TX_TDS_SS_PHY_CH1_ADDR A:0xfcb71324
y.create.l HWIO_TX_TDS_TFCI_PHY_CH0_ADDR A:0xfcb71328
y.create.l HWIO_TX_TDS_TFCI_PHY_CH1_ADDR A:0xfcb7132c
y.create.l HWIO_TX_TDS_TPC_PHY_CH0_ADDR A:0xfcb71330
y.create.l HWIO_TX_TDS_TPC_PHY_CH1_ADDR A:0xfcb71334
y.create.l HWIO_TX_UNIFIED_NUM_ZEROS_FLUSH_ADDR A:0xfcb71338
y.create.l HWIO_TX_UNIFIED_FRAME_OFFSET_ADDR A:0xfcb7133c
y.create.l HWIO_TX_UNIFIED_FRAME_OFF_LD_ADDR A:0xfcb71340
y.create.l HWIO_TX_UNIFIED_SAMPLE_CNT_INIT_VAL_ADDR A:0xfcb71344
y.create.l HWIO_TX_UNIFIED_SAMPLE_CNT_LD_ADDR A:0xfcb71348
y.create.l HWIO_TX_UNIFIED_SAMPLE_CNT_READ_ADDR A:0xfcb7134c
y.create.l HWIO_TX_UNIFIED_SAMPLE_CNT_UPDATE_TIME_ADDR A:0xfcb71350
y.create.l HWIO_TX_UMTS_EUL_TTI_MODE_ADDR A:0xfcb71354
y.create.l HWIO_TX_UMTS_HSDPCCH_OFFSET_ADDR A:0xfcb71358
y.create.l HWIO_TX_UNIFIED_BETAP_GAIN_UPDATE_ADDR A:0xfcb7135c
y.create.l HWIO_TX_UNIFIED_PA_RANGE_UPDATE_ADDR A:0xfcb71360
y.create.l HWIO_TX_UNIFIED_OFFL_EN_ADDR A:0xfcb71364
y.create.l HWIO_TX_UNIFIED_DTX_EN_ADDR A:0xfcb71368
y.create.l HWIO_TX_UNIFIED_ERAM_CTL_ADDR A:0xfcb7136c
y.create.l HWIO_TX_TDS_EUL_RM_BANK_SEL_ADDR A:0xfcb71370
y.create.l HWIO_TX_UNIFIED_ENC_STATUS_ADDR A:0xfcb71374
y.create.l HWIO_TX_TDS_GUARD_PERIOD_ADDR A:0xfcb71378
y.create.l HWIO_TX_1X_DBR_MASK_READ_ADDR A:0xfcb7137c
y.create.l HWIO_TX_TDS_NEW_SUBFRAME_FW_ADDR A:0xfcb71380
y.create.l HWIO_TX_1X_MISC_CTL_ADDR A:0xfcb71384
y.create.l HWIO_TX_UNIFIED_CARRIER_EN_ADDR A:0xfcb71388
y.create.l HWIO_TX_DO_GAIN_BANK_ADDR A:0xfcb7138c
y.create.l HWIO_TX_UNIFIED_GAIN_0_ADDR A:0xfcb71390
y.create.l HWIO_TX_UNIFIED_GAIN_1_ADDR A:0xfcb71394
y.create.l HWIO_TX_UNIFIED_GAIN_2_ADDR A:0xfcb71398
y.create.l HWIO_TX_UNIFIED_GAIN_3_ADDR A:0xfcb7139c
y.create.l HWIO_TX_UNIFIED_GAIN_4_ADDR A:0xfcb713a0
y.create.l HWIO_TX_UNIFIED_GAIN_5_ADDR A:0xfcb713a4
y.create.l HWIO_TX_C2K_BETAP_GAIN_C0_ADDR A:0xfcb713a8
y.create.l HWIO_TX_C2K_BETAP_GAIN_C1_ADDR A:0xfcb713ac
y.create.l HWIO_TX_C2K_BETAP_GAIN_C2_ADDR A:0xfcb713b0
y.create.l HWIO_TX_UNIFIED_ADVRET_CMD_ADDR A:0xfcb713b4
y.create.l HWIO_TX_UNIFIED_ADVRET_TYPE_ADDR A:0xfcb713b8
y.create.l HWIO_TX_1X_MOD_WCOVER_SEL_ADDR A:0xfcb713bc
y.create.l HWIO_TX_DO_CTL_C0_ADDR A:0xfcb713c0
y.create.l HWIO_TX_DO_CTL_C1_ADDR A:0xfcb713c4
y.create.l HWIO_TX_DO_CTL_C2_ADDR A:0xfcb713c8
y.create.l HWIO_TX_TDS_NUM_DATA_PHY_CH0_ADDR A:0xfcb713cc
y.create.l HWIO_TX_TDS_NUM_DATA_PHY_CH1_ADDR A:0xfcb713d0
y.create.l HWIO_TX_TDS_SPR_FACTOR_CTL_ADDR A:0xfcb713d4
y.create.l HWIO_TX_TDS_EUL_MOD_CTL_ADDR A:0xfcb713d8
y.create.l HWIO_TX_TDS_SLOT_IDX_ADDR A:0xfcb713dc
y.create.l HWIO_TX_UMTS_DCH_RACH_LAST_ADDR A:0xfcb713e0
y.create.l HWIO_TX_UNIFIED_PRED_CLIP_BYPASS_ADDR A:0xfcb713e4
y.create.l HWIO_TX_UNIFIED_PRED_CLIP_C0_ADDR A:0xfcb713e8
y.create.l HWIO_TX_UNIFIED_PRED_CLIP_C1_ADDR A:0xfcb713ec
y.create.l HWIO_TX_UNIFIED_PRED_CLIP_C2_ADDR A:0xfcb713f0
y.create.l HWIO_TX_UNIFIED_PRED_CLIP_GLOBAL_ADDR A:0xfcb713f4
y.create.l HWIO_TX_TDS_BBF_WINDOW_ADDR A:0xfcb713f8
y.create.l HWIO_TX_UNIFIED_PA_RANGE_ADDR A:0xfcb713fc
y.create.l HWIO_TX_UNIFIED_ROTANGLE_0_ADDR A:0xfcb71400
y.create.l HWIO_TX_UNIFIED_ROTANGLE_1_ADDR A:0xfcb71404
y.create.l HWIO_TX_UNIFIED_ROT_FREQ_STEP_C0_ADDR A:0xfcb71408
y.create.l HWIO_TX_UNIFIED_ROT_FREQ_STEP_C1_ADDR A:0xfcb7140c
y.create.l HWIO_TX_UNIFIED_ROT_FREQ_STEP_C2_ADDR A:0xfcb71410
y.create.l HWIO_TX_UNIFIED_CRC_BYPASS_ADDR A:0xfcb71414
y.create.l HWIO_TX_UNIFIED_MEM_PTR_EN_ADDR A:0xfcb71418
y.create.l HWIO_TX_UNIFIED_ENC_TRBLK_PARAM_TRCH0_ADDR A:0xfcb71800
y.create.l HWIO_TX_UNIFIED_ENC_TRBLK_PARAM_TRCH1_ADDR A:0xfcb71804
y.create.l HWIO_TX_UNIFIED_ENC_TRBLK_PARAM_TRCH2_ADDR A:0xfcb71808
y.create.l HWIO_TX_UNIFIED_ENC_TRBLK_PARAM_TRCH3_ADDR A:0xfcb7180c
y.create.l HWIO_TX_UNIFIED_ENC_TRBLK_PARAM_TRCH4_ADDR A:0xfcb71810
y.create.l HWIO_TX_UNIFIED_ENC_TRBLK_PARAM_TRCH5_ADDR A:0xfcb71814
y.create.l HWIO_TX_UNIFIED_ENC_TRBLK_PARAM_TRCH6_ADDR A:0xfcb71818
y.create.l HWIO_TX_UNIFIED_ENC_TRBLK_PARAM_TRCH7_ADDR A:0xfcb7181c
y.create.l HWIO_TX_UNIFIED_ENC_ERAMB_ADDR_TRCH0_ADDR A:0xfcb71820
y.create.l HWIO_TX_UNIFIED_ENC_ERAMB_ADDR_TRCH1_ADDR A:0xfcb71824
y.create.l HWIO_TX_UNIFIED_ENC_ERAMB_ADDR_TRCH2_ADDR A:0xfcb71828
y.create.l HWIO_TX_UNIFIED_ENC_ERAMB_ADDR_TRCH3_ADDR A:0xfcb7182c
y.create.l HWIO_TX_UNIFIED_ENC_ERAMB_ADDR_TRCH4_ADDR A:0xfcb71830
y.create.l HWIO_TX_UNIFIED_ENC_ERAMB_ADDR_TRCH5_ADDR A:0xfcb71834
y.create.l HWIO_TX_UNIFIED_ENC_ERAMB_ADDR_TRCH6_ADDR A:0xfcb71838
y.create.l HWIO_TX_UNIFIED_ENC_ERAMB_ADDR_TRCH7_ADDR A:0xfcb7183c
y.create.l HWIO_TX_UNIFIED_ENC_CODING_PARAM_TRCH0_ADDR A:0xfcb71900
y.create.l HWIO_TX_UNIFIED_ENC_CODING_PARAM_TRCH1_ADDR A:0xfcb71904
y.create.l HWIO_TX_UNIFIED_ENC_CODING_PARAM_TRCH2_ADDR A:0xfcb71908
y.create.l HWIO_TX_UNIFIED_ENC_CODING_PARAM_TRCH3_ADDR A:0xfcb7190c
y.create.l HWIO_TX_UNIFIED_ENC_CODING_PARAM_TRCH4_ADDR A:0xfcb71910
y.create.l HWIO_TX_UNIFIED_ENC_CODING_PARAM_TRCH5_ADDR A:0xfcb71914
y.create.l HWIO_TX_UNIFIED_ENC_CODING_PARAM_TRCH6_ADDR A:0xfcb71918
y.create.l HWIO_TX_UNIFIED_ENC_CODING_PARAM_TRCH7_ADDR A:0xfcb7191c
y.create.l HWIO_TX_UNIFIED_ENC_CODE_SEG_SIZE_TRCH0_ADDR A:0xfcb71920
y.create.l HWIO_TX_UNIFIED_ENC_CODE_SEG_SIZE_TRCH1_ADDR A:0xfcb71924
y.create.l HWIO_TX_UNIFIED_ENC_CODE_SEG_SIZE_TRCH2_ADDR A:0xfcb71928
y.create.l HWIO_TX_UNIFIED_ENC_CODE_SEG_SIZE_TRCH3_ADDR A:0xfcb7192c
y.create.l HWIO_TX_UNIFIED_ENC_CODE_SEG_SIZE_TRCH4_ADDR A:0xfcb71930
y.create.l HWIO_TX_UNIFIED_ENC_CODE_SEG_SIZE_TRCH5_ADDR A:0xfcb71934
y.create.l HWIO_TX_UNIFIED_ENC_CODE_SEG_SIZE_TRCH6_ADDR A:0xfcb71938
y.create.l HWIO_TX_UNIFIED_ENC_CODE_SEG_SIZE_TRCH7_ADDR A:0xfcb7193c
y.create.l HWIO_TX_UNIFIED_ENC_RM_EINI_TRCH0_ADDR A:0xfcb71940
y.create.l HWIO_TX_UNIFIED_ENC_RM_EINI_TRCH1_ADDR A:0xfcb71944
y.create.l HWIO_TX_UNIFIED_ENC_RM_EINI_TRCH2_ADDR A:0xfcb71948
y.create.l HWIO_TX_UNIFIED_ENC_RM_EINI_TRCH3_ADDR A:0xfcb7194c
y.create.l HWIO_TX_UNIFIED_ENC_RM_EINI_TRCH4_ADDR A:0xfcb71950
y.create.l HWIO_TX_UNIFIED_ENC_RM_EINI_TRCH5_ADDR A:0xfcb71954
y.create.l HWIO_TX_UNIFIED_ENC_RM_EINI_TRCH6_ADDR A:0xfcb71958
y.create.l HWIO_TX_UNIFIED_ENC_RM_EINI_TRCH7_ADDR A:0xfcb7195c
y.create.l HWIO_TX_UNIFIED_ENC_RM_EMINUS_TRCH0_ADDR A:0xfcb71960
y.create.l HWIO_TX_UNIFIED_ENC_RM_EMINUS_TRCH1_ADDR A:0xfcb71964
y.create.l HWIO_TX_UNIFIED_ENC_RM_EMINUS_TRCH2_ADDR A:0xfcb71968
y.create.l HWIO_TX_UNIFIED_ENC_RM_EMINUS_TRCH3_ADDR A:0xfcb7196c
y.create.l HWIO_TX_UNIFIED_ENC_RM_EMINUS_TRCH4_ADDR A:0xfcb71970
y.create.l HWIO_TX_UNIFIED_ENC_RM_EMINUS_TRCH5_ADDR A:0xfcb71974
y.create.l HWIO_TX_UNIFIED_ENC_RM_EMINUS_TRCH6_ADDR A:0xfcb71978
y.create.l HWIO_TX_UNIFIED_ENC_RM_EMINUS_TRCH7_ADDR A:0xfcb7197c
y.create.l HWIO_TX_UNIFIED_ENC_RM_EPLUS_TRCH0_ADDR A:0xfcb71980
y.create.l HWIO_TX_UNIFIED_ENC_RM_EPLUS_TRCH1_ADDR A:0xfcb71984
y.create.l HWIO_TX_UNIFIED_ENC_RM_EPLUS_TRCH2_ADDR A:0xfcb71988
y.create.l HWIO_TX_UNIFIED_ENC_RM_EPLUS_TRCH3_ADDR A:0xfcb7198c
y.create.l HWIO_TX_UNIFIED_ENC_RM_EPLUS_TRCH4_ADDR A:0xfcb71990
y.create.l HWIO_TX_UNIFIED_ENC_RM_EPLUS_TRCH5_ADDR A:0xfcb71994
y.create.l HWIO_TX_UNIFIED_ENC_RM_EPLUS_TRCH6_ADDR A:0xfcb71998
y.create.l HWIO_TX_UNIFIED_ENC_RM_EPLUS_TRCH7_ADDR A:0xfcb7199c
y.create.l HWIO_TX_UNIFIED_ENC_TURBO_INTLV_PARAM0_TRCH0_ADDR A:0xfcb719a0
y.create.l HWIO_TX_UNIFIED_ENC_TURBO_INTLV_PARAM0_TRCH1_ADDR A:0xfcb719a4
y.create.l HWIO_TX_UNIFIED_ENC_TURBO_INTLV_PARAM0_TRCH2_ADDR A:0xfcb719a8
y.create.l HWIO_TX_UNIFIED_ENC_TURBO_INTLV_PARAM0_TRCH3_ADDR A:0xfcb719ac
y.create.l HWIO_TX_UNIFIED_ENC_TURBO_INTLV_PARAM0_TRCH4_ADDR A:0xfcb719b0
y.create.l HWIO_TX_UNIFIED_ENC_TURBO_INTLV_PARAM0_TRCH5_ADDR A:0xfcb719b4
y.create.l HWIO_TX_UNIFIED_ENC_TURBO_INTLV_PARAM0_TRCH6_ADDR A:0xfcb719b8
y.create.l HWIO_TX_UNIFIED_ENC_TURBO_INTLV_PARAM0_TRCH7_ADDR A:0xfcb719bc
y.create.l HWIO_TX_UNIFIED_ENC_TURBO_INTLV_PARAM1_TRCH0_ADDR A:0xfcb719c0
y.create.l HWIO_TX_UNIFIED_ENC_TURBO_INTLV_PARAM1_TRCH1_ADDR A:0xfcb719c4
y.create.l HWIO_TX_UNIFIED_ENC_TURBO_INTLV_PARAM1_TRCH2_ADDR A:0xfcb719c8
y.create.l HWIO_TX_UNIFIED_ENC_TURBO_INTLV_PARAM1_TRCH3_ADDR A:0xfcb719cc
y.create.l HWIO_TX_UNIFIED_ENC_TURBO_INTLV_PARAM1_TRCH4_ADDR A:0xfcb719d0
y.create.l HWIO_TX_UNIFIED_ENC_TURBO_INTLV_PARAM1_TRCH5_ADDR A:0xfcb719d4
y.create.l HWIO_TX_UNIFIED_ENC_TURBO_INTLV_PARAM1_TRCH6_ADDR A:0xfcb719d8
y.create.l HWIO_TX_UNIFIED_ENC_TURBO_INTLV_PARAM1_TRCH7_ADDR A:0xfcb719dc
y.create.l HWIO_TX_UNIFIED_ENC_ERAM_DATA_INCRACC_0_ADDR A:0xfcb71a00
y.create.l HWIO_TX_UNIFIED_ENC_ERAM_DATA_INCRACC_1_ADDR A:0xfcb71a04
y.create.l HWIO_TX_UNIFIED_ENC_ERAM_DATA_INCRACC_2_ADDR A:0xfcb71a08
y.create.l HWIO_TX_UNIFIED_ENC_ERAM_DATA_INCRACC_3_ADDR A:0xfcb71a0c
y.create.l HWIO_TX_UNIFIED_ENC_TRCH_MUX_ORDER_CCTRCH1_ADDR A:0xfcb71a20
y.create.l HWIO_TX_TDS_TRCH_MUX_ORDER_CCTRCH2_ADDR A:0xfcb71a40
y.create.l HWIO_TX_TDS_DPCH0_LAST_SLOT0_BANK0_ADDR A:0xfcb71b00
y.create.l HWIO_TX_TDS_DPCH0_LAST_SLOT1_BANK0_ADDR A:0xfcb71b04
y.create.l HWIO_TX_TDS_DPCH0_LAST_SLOT2_BANK0_ADDR A:0xfcb71b08
y.create.l HWIO_TX_TDS_DPCH0_LAST_SLOT3_BANK0_ADDR A:0xfcb71b0c
y.create.l HWIO_TX_TDS_DPCH0_LAST_SLOT4_BANK0_ADDR A:0xfcb71b10
y.create.l HWIO_TX_TDS_DPCH0_SLOT0_BANK0_ADDR A:0xfcb71b40
y.create.l HWIO_TX_TDS_DPCH0_SLOT1_BANK0_ADDR A:0xfcb71b44
y.create.l HWIO_TX_TDS_DPCH0_SLOT2_BANK0_ADDR A:0xfcb71b48
y.create.l HWIO_TX_TDS_DPCH0_SLOT3_BANK0_ADDR A:0xfcb71b4c
y.create.l HWIO_TX_TDS_DPCH0_SLOT4_BANK0_ADDR A:0xfcb71b50
y.create.l HWIO_TX_TDS_DPCH0_SLOT5_BANK0_ADDR A:0xfcb71b54
y.create.l HWIO_TX_TDS_DPCH0_SLOT6_BANK0_ADDR A:0xfcb71b58
y.create.l HWIO_TX_TDS_DPCH0_SLOT7_BANK0_ADDR A:0xfcb71b5c
y.create.l HWIO_TX_TDS_DPCH0_SLOT8_BANK0_ADDR A:0xfcb71b60
y.create.l HWIO_TX_TDS_DPCH0_SLOT9_BANK0_ADDR A:0xfcb71b64
y.create.l HWIO_TX_TDS_DPCH1_LAST_SLOT0_BANK0_ADDR A:0xfcb71b80
y.create.l HWIO_TX_TDS_DPCH1_LAST_SLOT1_BANK0_ADDR A:0xfcb71b84
y.create.l HWIO_TX_TDS_DPCH1_LAST_SLOT2_BANK0_ADDR A:0xfcb71b88
y.create.l HWIO_TX_TDS_DPCH1_LAST_SLOT3_BANK0_ADDR A:0xfcb71b8c
y.create.l HWIO_TX_TDS_DPCH1_LAST_SLOT4_BANK0_ADDR A:0xfcb71b90
y.create.l HWIO_TX_TDS_DPCH1_SLOT0_BANK0_ADDR A:0xfcb71bc0
y.create.l HWIO_TX_TDS_DPCH1_SLOT1_BANK0_ADDR A:0xfcb71bc4
y.create.l HWIO_TX_TDS_DPCH1_SLOT2_BANK0_ADDR A:0xfcb71bc8
y.create.l HWIO_TX_TDS_DPCH1_SLOT3_BANK0_ADDR A:0xfcb71bcc
y.create.l HWIO_TX_TDS_DPCH1_SLOT4_BANK0_ADDR A:0xfcb71bd0
y.create.l HWIO_TX_TDS_DPCH1_SLOT5_BANK0_ADDR A:0xfcb71bd4
y.create.l HWIO_TX_TDS_DPCH1_SLOT6_BANK0_ADDR A:0xfcb71bd8
y.create.l HWIO_TX_TDS_DPCH1_SLOT7_BANK0_ADDR A:0xfcb71bdc
y.create.l HWIO_TX_TDS_DPCH1_SLOT8_BANK0_ADDR A:0xfcb71be0
y.create.l HWIO_TX_TDS_DPCH1_SLOT9_BANK0_ADDR A:0xfcb71be4
y.create.l HWIO_TX_TDS_EPUCH_LAST_BANK0_ADDR A:0xfcb71c00
y.create.l HWIO_TX_TDS_EPUCH_SLOT0_BANK0_ADDR A:0xfcb71c20
y.create.l HWIO_TX_TDS_EPUCH_SLOT1_BANK0_ADDR A:0xfcb71c24
y.create.l HWIO_TX_TDS_EPUCH_SLOT2_BANK0_ADDR A:0xfcb71c28
y.create.l HWIO_TX_TDS_EPUCH_SLOT3_BANK0_ADDR A:0xfcb71c2c
y.create.l HWIO_TX_TDS_EPUCH_SLOT4_BANK0_ADDR A:0xfcb71c30
y.create.l HWIO_TX_TDS_ERUCCH_LAST_BANK0_ADDR A:0xfcb71c40
y.create.l HWIO_TX_TDS_ERUCCH_SUBFRAME0_BANK0_ADDR A:0xfcb71c60
y.create.l HWIO_TX_TDS_ERUCCH_SUBFRAME1_BANK0_ADDR A:0xfcb71c64
y.create.l HWIO_TX_TDS_DPCH0_LAST_SLOT0_BANK1_ADDR A:0xfcb71ca0
y.create.l HWIO_TX_TDS_DPCH0_LAST_SLOT1_BANK1_ADDR A:0xfcb71ca4
y.create.l HWIO_TX_TDS_DPCH0_LAST_SLOT2_BANK1_ADDR A:0xfcb71ca8
y.create.l HWIO_TX_TDS_DPCH0_LAST_SLOT3_BANK1_ADDR A:0xfcb71cac
y.create.l HWIO_TX_TDS_DPCH0_LAST_SLOT4_BANK1_ADDR A:0xfcb71cb0
y.create.l HWIO_TX_TDS_DPCH0_SLOT0_BANK1_ADDR A:0xfcb71cc0
y.create.l HWIO_TX_TDS_DPCH0_SLOT1_BANK1_ADDR A:0xfcb71cc4
y.create.l HWIO_TX_TDS_DPCH0_SLOT2_BANK1_ADDR A:0xfcb71cc8
y.create.l HWIO_TX_TDS_DPCH0_SLOT3_BANK1_ADDR A:0xfcb71ccc
y.create.l HWIO_TX_TDS_DPCH0_SLOT4_BANK1_ADDR A:0xfcb71cd0
y.create.l HWIO_TX_TDS_DPCH0_SLOT5_BANK1_ADDR A:0xfcb71cd4
y.create.l HWIO_TX_TDS_DPCH0_SLOT6_BANK1_ADDR A:0xfcb71cd8
y.create.l HWIO_TX_TDS_DPCH0_SLOT7_BANK1_ADDR A:0xfcb71cdc
y.create.l HWIO_TX_TDS_DPCH0_SLOT8_BANK1_ADDR A:0xfcb71ce0
y.create.l HWIO_TX_TDS_DPCH0_SLOT9_BANK1_ADDR A:0xfcb71ce4
y.create.l HWIO_TX_TDS_DPCH1_LAST_SLOT0_BANK1_ADDR A:0xfcb71d00
y.create.l HWIO_TX_TDS_DPCH1_LAST_SLOT1_BANK1_ADDR A:0xfcb71d04
y.create.l HWIO_TX_TDS_DPCH1_LAST_SLOT2_BANK1_ADDR A:0xfcb71d08
y.create.l HWIO_TX_TDS_DPCH1_LAST_SLOT3_BANK1_ADDR A:0xfcb71d0c
y.create.l HWIO_TX_TDS_DPCH1_LAST_SLOT4_BANK1_ADDR A:0xfcb71d10
y.create.l HWIO_TX_TDS_DPCH1_SLOT0_BANK1_ADDR A:0xfcb71d40
y.create.l HWIO_TX_TDS_DPCH1_SLOT1_BANK1_ADDR A:0xfcb71d44
y.create.l HWIO_TX_TDS_DPCH1_SLOT2_BANK1_ADDR A:0xfcb71d48
y.create.l HWIO_TX_TDS_DPCH1_SLOT3_BANK1_ADDR A:0xfcb71d4c
y.create.l HWIO_TX_TDS_DPCH1_SLOT4_BANK1_ADDR A:0xfcb71d50
y.create.l HWIO_TX_TDS_DPCH1_SLOT5_BANK1_ADDR A:0xfcb71d54
y.create.l HWIO_TX_TDS_DPCH1_SLOT6_BANK1_ADDR A:0xfcb71d58
y.create.l HWIO_TX_TDS_DPCH1_SLOT7_BANK1_ADDR A:0xfcb71d5c
y.create.l HWIO_TX_TDS_DPCH1_SLOT8_BANK1_ADDR A:0xfcb71d60
y.create.l HWIO_TX_TDS_DPCH1_SLOT9_BANK1_ADDR A:0xfcb71d64
y.create.l HWIO_TX_TDS_EPUCH_LAST_BANK1_ADDR A:0xfcb71d80
y.create.l HWIO_TX_TDS_EPUCH_SLOT0_BANK1_ADDR A:0xfcb71da0
y.create.l HWIO_TX_TDS_EPUCH_SLOT1_BANK1_ADDR A:0xfcb71da4
y.create.l HWIO_TX_TDS_EPUCH_SLOT2_BANK1_ADDR A:0xfcb71da8
y.create.l HWIO_TX_TDS_EPUCH_SLOT3_BANK1_ADDR A:0xfcb71dac
y.create.l HWIO_TX_TDS_EPUCH_SLOT4_BANK1_ADDR A:0xfcb71db0
y.create.l HWIO_TX_TDS_ERUCCH_LAST_BANK1_ADDR A:0xfcb71dc0
y.create.l HWIO_TX_TDS_ERUCCH_SUBFRAME0_BANK1_ADDR A:0xfcb71de0
y.create.l HWIO_TX_TDS_ERUCCH_SUBFRAME1_BANK1_ADDR A:0xfcb71de4
y.create.l HWIO_TX_DO_GAIN_0_1_C0_BANK0_ADDR A:0xfcb71e00
y.create.l HWIO_TX_DO_GAIN_0_1_C1_BANK0_ADDR A:0xfcb71e04
y.create.l HWIO_TX_DO_GAIN_0_1_C2_BANK0_ADDR A:0xfcb71e08
y.create.l HWIO_TX_DO_GAIN_2_3_C0_BANK0_ADDR A:0xfcb71e0c
y.create.l HWIO_TX_DO_GAIN_2_3_C1_BANK0_ADDR A:0xfcb71e10
y.create.l HWIO_TX_DO_GAIN_2_3_C2_BANK0_ADDR A:0xfcb71e14
y.create.l HWIO_TX_DO_GAIN_4_5_C0_BANK0_ADDR A:0xfcb71e18
y.create.l HWIO_TX_DO_GAIN_4_5_C1_BANK0_ADDR A:0xfcb71e1c
y.create.l HWIO_TX_DO_GAIN_4_5_C2_BANK0_ADDR A:0xfcb71e20
y.create.l HWIO_TX_DO_GAIN_6_7_C0_BANK0_ADDR A:0xfcb71e24
y.create.l HWIO_TX_DO_GAIN_6_7_C1_BANK0_ADDR A:0xfcb71e28
y.create.l HWIO_TX_DO_GAIN_6_7_C2_BANK0_ADDR A:0xfcb71e2c
y.create.l HWIO_TX_DO_GAIN_8_9_C0_BANK0_ADDR A:0xfcb71e30
y.create.l HWIO_TX_DO_GAIN_8_9_C1_BANK0_ADDR A:0xfcb71e34
y.create.l HWIO_TX_DO_GAIN_8_9_C2_BANK0_ADDR A:0xfcb71e38
y.create.l HWIO_TX_DO_GAIN_0_1_C0_BANK1_ADDR A:0xfcb71f00
y.create.l HWIO_TX_DO_GAIN_0_1_C1_BANK1_ADDR A:0xfcb71f04
y.create.l HWIO_TX_DO_GAIN_0_1_C2_BANK1_ADDR A:0xfcb71f08
y.create.l HWIO_TX_DO_GAIN_2_3_C0_BANK1_ADDR A:0xfcb71f0c
y.create.l HWIO_TX_DO_GAIN_2_3_C1_BANK1_ADDR A:0xfcb71f10
y.create.l HWIO_TX_DO_GAIN_2_3_C2_BANK1_ADDR A:0xfcb71f14
y.create.l HWIO_TX_DO_GAIN_4_5_C0_BANK1_ADDR A:0xfcb71f18
y.create.l HWIO_TX_DO_GAIN_4_5_C1_BANK1_ADDR A:0xfcb71f1c
y.create.l HWIO_TX_DO_GAIN_4_5_C2_BANK1_ADDR A:0xfcb71f20
y.create.l HWIO_TX_DO_GAIN_6_7_C0_BANK1_ADDR A:0xfcb71f24
y.create.l HWIO_TX_DO_GAIN_6_7_C1_BANK1_ADDR A:0xfcb71f28
y.create.l HWIO_TX_DO_GAIN_6_7_C2_BANK1_ADDR A:0xfcb71f2c
y.create.l HWIO_TX_DO_GAIN_8_9_C0_BANK1_ADDR A:0xfcb71f30
y.create.l HWIO_TX_DO_GAIN_8_9_C1_BANK1_ADDR A:0xfcb71f34
y.create.l HWIO_TX_DO_GAIN_8_9_C2_BANK1_ADDR A:0xfcb71f38
y.create.l HWIO_TX_MEM_START_ADDR A:0xfcb72000
y.create.l HWIO_TX_WRTR_CFG0_ADDR A:0xfcb73000
y.create.l HWIO_TX_WRTR_CFG1_ADDR A:0xfcb73004
y.create.l HWIO_TX_WRTR_XFER_CTL_ADDR A:0xfcb73008
y.create.l HWIO_TX_BRDG_CTL_ADDR A:0xfcb7300c
y.create.l HWIO_TX_BRDG_STATUS_ADDR A:0xfcb73010
y.create.l HWIO_TX_BRDG_CLEAR_ADDR A:0xfcb73014
y.create.l HWIO_TX_WRTR_VBUF_ADDR_ADDR A:0xfcb73018
y.create.l HWIO_TXC_TECH_SEL_A0_ADDR A:0xfcb74000
y.create.l HWIO_TXC_DP_CFG_A0_ADDR A:0xfcb74004
y.create.l HWIO_TXC_DP_CFG_2_A0_ADDR A:0xfcb74008
y.create.l HWIO_TXC_DP_ENV_SCALE_VAL_A0_ADDR A:0xfcb74010
y.create.l HWIO_TXC_DP_RAMP_ARM_A0_ADDR A:0xfcb74024
y.create.l HWIO_TXC_DP_RAMP_START_TIME_A0_ADDR A:0xfcb74028
y.create.l HWIO_TXC_DP_RAMP_SLOT_A_CFG_A0_ADDR A:0xfcb74038
y.create.l HWIO_TXC_DP_RAMP_SLOT_B_CFG_A0_ADDR A:0xfcb7403c
y.create.l HWIO_TXC_DP_RAMP_GAP_A0_ADDR A:0xfcb74040
y.create.l HWIO_TXC_DP_PHASE_OVR_VAL_A0_ADDR A:0xfcb74080
y.create.l HWIO_TXC_PP_PHASE_OVR_VAL_A0_ADDR A:0xfcb74084
y.create.l HWIO_TXC_DP_ENV_OVR_VAL_A0_ADDR A:0xfcb74088
y.create.l HWIO_TXC_EP_ENV_OVR_VAL_A0_ADDR A:0xfcb7408c
y.create.l HWIO_TXC_DP_ROT_PHASE_INC_A0_ADDR A:0xfcb740a0
y.create.l HWIO_TXC_DP_ROT_PHASE_INIT_A0_ADDR A:0xfcb740a8
y.create.l HWIO_TXC_DP_ROT_PHASE_SHIFT_A0_ADDR A:0xfcb740b0
y.create.l HWIO_TXC_DP_IQ_GAIN_A0_ADDR A:0xfcb740b8
y.create.l HWIO_TXC_DP_IQMC_A0_ADDR A:0xfcb740d0
y.create.l HWIO_TXC_DP_PEQ1_A0_ADDR A:0xfcb740d8
y.create.l HWIO_TXC_DP_PEQ2_A0_ADDR A:0xfcb740f0
y.create.l HWIO_TXC_DP_DCOC_A0_ADDR A:0xfcb740f8
y.create.l HWIO_TXC_DM1_CFG_A0_ADDR A:0xfcb74100
y.create.l HWIO_TXC_EP_GAIN_A0_ADDR A:0xfcb74160
y.create.l HWIO_TXC_EP_PEQ1_A0_ADDR A:0xfcb74168
y.create.l HWIO_TXC_EP_DCOC_A0_ADDR A:0xfcb74170
y.create.l HWIO_TXC_EP_DM2_FINE_TAU_A0_ADDR A:0xfcb74178
y.create.l HWIO_TXC_EP_DM3_FRAC_TAU_A0_ADDR A:0xfcb7417c
y.create.l HWIO_TXC_PP_GAIN_A0_ADDR A:0xfcb74180
y.create.l HWIO_TXC_PP_SPILL_A0_ADDR A:0xfcb74190
y.create.l HWIO_TXC_EP_PEQ2_A0_ADDR A:0xfcb74198
y.create.l HWIO_TXC_TIMESTAMP_T1_A0_ADDR A:0xfcb741a0
y.create.l HWIO_TXC_TIMESTAMP_REUSE_A0_ADDR A:0xfcb741b0
y.create.l HWIO_TXC_SAMPLE_COUNT_A0_ADDR A:0xfcb741b4
y.create.l HWIO_TXC_SAMPLE_COUNT_CTL_A0_ADDR A:0xfcb741b8
y.create.l HWIO_TXC_REF_ARM_A0_ADDR A:0xfcb741c0
y.create.l HWIO_TXC_REF_DWN_FACTOR_A0_ADDR A:0xfcb741c4
y.create.l HWIO_TXC_REF_NUM_SAMPLES_A0_ADDR A:0xfcb741c8
y.create.l HWIO_TXC_REF_START_TIME_A0_ADDR A:0xfcb741cc
y.create.l HWIO_TXC_REF_STATUS_A0_ADDR A:0xfcb741d0
y.create.l HWIO_TXC_REF_PEAK_POWER_A0_ADDR A:0xfcb741d4
y.create.l HWIO_TXC_REF_RMS_POWER_M_A0_ADDR A:0xfcb741d8
y.create.l HWIO_TXC_REF_RMS_POWER_L_A0_ADDR A:0xfcb741dc
y.create.l HWIO_TXC_REF_MODE_A0_ADDR A:0xfcb741e0
y.create.l HWIO_TXC_REF_I_GAIN_VAL_A0_ADDR A:0xfcb741e4
y.create.l HWIO_TXC_REF_Q_GAIN_VAL_A0_ADDR A:0xfcb741e8
y.create.l HWIO_TXC_REF_POWERCALC_OR_LOG_A0_ADDR A:0xfcb741ec
y.create.l HWIO_TXC_TESTBUS_SELECT_A0_ADDR A:0xfcb741f0
y.create.l HWIO_TXC_AMAM_PENDING_A0_ADDR A:0xfcb74220
y.create.l HWIO_TXC_AMPM_PENDING_A0_ADDR A:0xfcb74224
y.create.l HWIO_TXC_AMAM_ACTIVE_A0_ADDR A:0xfcb74240
y.create.l HWIO_TXC_AMPM_ACTIVE_A0_ADDR A:0xfcb74244
y.create.l HWIO_TXC_RAMP_ACTIVE_A0_ADDR A:0xfcb7424c
y.create.l HWIO_TXC_DP_CFG_LATCHED_A0_ADDR A:0xfcb74300
y.create.l HWIO_TXC_DP_ENV_SCALE_VAL_LATCHED_A0_ADDR A:0xfcb74304
y.create.l HWIO_TXC_DP_PHASE_OVR_VAL_LATCHED_A0_ADDR A:0xfcb74308
y.create.l HWIO_TXC_PP_PHASE_OVR_VAL_LATCHED_A0_ADDR A:0xfcb7430c
y.create.l HWIO_TXC_DP_ENV_OVR_VAL_LATCHED_A0_ADDR A:0xfcb74310
y.create.l HWIO_TXC_EP_ENV_OVR_VAL_LATCHED_A0_ADDR A:0xfcb74314
y.create.l HWIO_TXC_DP_ROT_PHASE_INC_LATCHED_A0_ADDR A:0xfcb74318
y.create.l HWIO_TXC_DP_ROT_PHASE_INIT_LATCHED_A0_ADDR A:0xfcb7431c
y.create.l HWIO_TXC_DP_ROT_PHASE_SHIFT_LATCHED_A0_ADDR A:0xfcb74320
y.create.l HWIO_TXC_DP_IQ_GAIN_LATCHED_A0_ADDR A:0xfcb74324
y.create.l HWIO_TXC_DP_IQMC_LATCHED_A0_ADDR A:0xfcb74328
y.create.l HWIO_TXC_DP_PEQ1_LATCHED_A0_ADDR A:0xfcb7432c
y.create.l HWIO_TXC_DP_PEQ2_LATCHED_A0_ADDR A:0xfcb74330
y.create.l HWIO_TXC_DP_DCOC_LATCHED_A0_ADDR A:0xfcb74334
y.create.l HWIO_TXC_DM1_CFG_LATCHED_A0_ADDR A:0xfcb74338
y.create.l HWIO_TXC_EP_GAIN_LATCHED_A0_ADDR A:0xfcb7433c
y.create.l HWIO_TXC_EP_PEQ1_LATCHED_A0_ADDR A:0xfcb74340
y.create.l HWIO_TXC_EP_DCOC_LATCHED_A0_ADDR A:0xfcb74344
y.create.l HWIO_TXC_EP_DM2_FINE_TAU_LATCHED_A0_ADDR A:0xfcb74348
y.create.l HWIO_TXC_EP_DM3_FRAC_TAU_LATCHED_A0_ADDR A:0xfcb7434c
y.create.l HWIO_TXC_PP_GAIN_LATCHED_A0_ADDR A:0xfcb74350
y.create.l HWIO_TXC_PP_SPILL_LATCHED_A0_ADDR A:0xfcb74354
y.create.l HWIO_TXC_EP_PEQ2_LATCHED_A0_ADDR A:0xfcb74358
y.create.l HWIO_TXC_DP_CFG_2_LATCHED_A0_ADDR A:0xfcb7435c
y.create.l HWIO_TXR_IQ_DAC_A0_ADDR A:0xfcb75000
y.create.l HWIO_TXR_STR_CTRL_A0_ADDR A:0xfcb75008
y.create.l HWIO_TXR_PDA_CTRL_A0_ADDR A:0xfcb7500c
y.create.l HWIO_TXR_PDA_WD_UPDATE_CTRL_A0_ADDR A:0xfcb75010
y.create.l HWIO_TXR_PDA_CTRL_WD_OFFSET_A0_ADDR A:0xfcb75014
y.create.l HWIO_TXR_PDA_OFFSET_CMD_A0_ADDR A:0xfcb75018
y.create.l HWIO_TXR_PPDSM_CTL_A0_ADDR A:0xfcb7501c
y.create.l HWIO_TXR_FIFO_PTR_DIFF_A_A0_ADDR A:0xfcb75028
y.create.l HWIO_TXR_FIFO_PTR_DIFF_B_A0_ADDR A:0xfcb7502c
y.create.l HWIO_TXR_FIFO_STATUS_A_A0_ADDR A:0xfcb75030
y.create.l HWIO_TXR_FIFO_STATUS_B_A0_ADDR A:0xfcb75034
y.create.l HWIO_TXR_FIFO_CMD_A0_ADDR A:0xfcb75038
y.create.l HWIO_TXR_FIFO_CTRL_A0_ADDR A:0xfcb7503c
y.create.l HWIO_TXR_STREAM_IF_CTRL_A0_ADDR A:0xfcb75040
y.create.l HWIO_TXR_FMT_CONV_CTL_A0_ADDR A:0xfcb75050
y.create.l HWIO_TXR_IQ_DAC_CURRENT_A0_ADDR A:0xfcb75054
y.create.l HWIO_TXR_STR_CTRL_CURRENT_A0_ADDR A:0xfcb75058
y.create.l HWIO_TXR_PDA_CTRL_CURRENT_A0_ADDR A:0xfcb7505c
y.create.l HWIO_TXR_PDA_WD_UPDATE_CTRL_CURRENT_A0_ADDR A:0xfcb75060
y.create.l HWIO_TXR_PDA_CTRL_WD_OFFSET_CURRENT_A0_ADDR A:0xfcb75064
y.create.l HWIO_TXR_PDA_OFFSET_CMD_CURRENT_A0_ADDR A:0xfcb75068
y.create.l HWIO_TXR_PPDSM_CTL_CURRENT_A0_ADDR A:0xfcb7506c
y.create.l HWIO_TXR_STREAM_IF_CTRL_CURRENT_A0_ADDR A:0xfcb75078
y.create.l HWIO_TXR_FMT_CONV_CTL_CURRENT_A0_ADDR A:0xfcb7507c
y.create.l HWIO_TXC_TECH_SEL_A1_ADDR A:0xfcb76000
y.create.l HWIO_TXC_DP_CFG_A1_ADDR A:0xfcb76004
y.create.l HWIO_TXC_DP_CFG_2_A1_ADDR A:0xfcb76008
y.create.l HWIO_TXC_DP_ENV_SCALE_VAL_A1_ADDR A:0xfcb76010
y.create.l HWIO_TXC_DP_RAMP_ARM_A1_ADDR A:0xfcb76024
y.create.l HWIO_TXC_DP_RAMP_START_TIME_A1_ADDR A:0xfcb76028
y.create.l HWIO_TXC_DP_RAMP_SLOT_A_CFG_A1_ADDR A:0xfcb76038
y.create.l HWIO_TXC_DP_RAMP_SLOT_B_CFG_A1_ADDR A:0xfcb7603c
y.create.l HWIO_TXC_DP_RAMP_GAP_A1_ADDR A:0xfcb76040
y.create.l HWIO_TXC_DP_PHASE_OVR_VAL_A1_ADDR A:0xfcb76080
y.create.l HWIO_TXC_PP_PHASE_OVR_VAL_A1_ADDR A:0xfcb76084
y.create.l HWIO_TXC_DP_ENV_OVR_VAL_A1_ADDR A:0xfcb76088
y.create.l HWIO_TXC_EP_ENV_OVR_VAL_A1_ADDR A:0xfcb7608c
y.create.l HWIO_TXC_DP_ROT_PHASE_INC_A1_ADDR A:0xfcb760a0
y.create.l HWIO_TXC_DP_ROT_PHASE_INIT_A1_ADDR A:0xfcb760a8
y.create.l HWIO_TXC_DP_ROT_PHASE_SHIFT_A1_ADDR A:0xfcb760b0
y.create.l HWIO_TXC_DP_IQ_GAIN_A1_ADDR A:0xfcb760b8
y.create.l HWIO_TXC_DP_IQMC_A1_ADDR A:0xfcb760d0
y.create.l HWIO_TXC_DP_PEQ1_A1_ADDR A:0xfcb760d8
y.create.l HWIO_TXC_DP_PEQ2_A1_ADDR A:0xfcb760f0
y.create.l HWIO_TXC_DP_DCOC_A1_ADDR A:0xfcb760f8
y.create.l HWIO_TXC_DM1_CFG_A1_ADDR A:0xfcb76100
y.create.l HWIO_TXC_EP_GAIN_A1_ADDR A:0xfcb76160
y.create.l HWIO_TXC_EP_PEQ1_A1_ADDR A:0xfcb76168
y.create.l HWIO_TXC_EP_DCOC_A1_ADDR A:0xfcb76170
y.create.l HWIO_TXC_EP_DM2_FINE_TAU_A1_ADDR A:0xfcb76178
y.create.l HWIO_TXC_EP_DM3_FRAC_TAU_A1_ADDR A:0xfcb7617c
y.create.l HWIO_TXC_PP_GAIN_A1_ADDR A:0xfcb76180
y.create.l HWIO_TXC_PP_SPILL_A1_ADDR A:0xfcb76190
y.create.l HWIO_TXC_EP_PEQ2_A1_ADDR A:0xfcb76198
y.create.l HWIO_TXC_TIMESTAMP_T1_A1_ADDR A:0xfcb761a0
y.create.l HWIO_TXC_TIMESTAMP_REUSE_A1_ADDR A:0xfcb761b0
y.create.l HWIO_TXC_SAMPLE_COUNT_A1_ADDR A:0xfcb761b4
y.create.l HWIO_TXC_SAMPLE_COUNT_CTL_A1_ADDR A:0xfcb761b8
y.create.l HWIO_TXC_REF_ARM_A1_ADDR A:0xfcb761c0
y.create.l HWIO_TXC_REF_DWN_FACTOR_A1_ADDR A:0xfcb761c4
y.create.l HWIO_TXC_REF_NUM_SAMPLES_A1_ADDR A:0xfcb761c8
y.create.l HWIO_TXC_REF_START_TIME_A1_ADDR A:0xfcb761cc
y.create.l HWIO_TXC_REF_STATUS_A1_ADDR A:0xfcb761d0
y.create.l HWIO_TXC_REF_PEAK_POWER_A1_ADDR A:0xfcb761d4
y.create.l HWIO_TXC_REF_RMS_POWER_M_A1_ADDR A:0xfcb761d8
y.create.l HWIO_TXC_REF_RMS_POWER_L_A1_ADDR A:0xfcb761dc
y.create.l HWIO_TXC_REF_MODE_A1_ADDR A:0xfcb761e0
y.create.l HWIO_TXC_REF_I_GAIN_VAL_A1_ADDR A:0xfcb761e4
y.create.l HWIO_TXC_REF_Q_GAIN_VAL_A1_ADDR A:0xfcb761e8
y.create.l HWIO_TXC_REF_POWERCALC_OR_LOG_A1_ADDR A:0xfcb761ec
y.create.l HWIO_TXC_TESTBUS_SELECT_A1_ADDR A:0xfcb761f0
y.create.l HWIO_TXC_AMAM_PENDING_A1_ADDR A:0xfcb76220
y.create.l HWIO_TXC_AMPM_PENDING_A1_ADDR A:0xfcb76224
y.create.l HWIO_TXC_AMAM_ACTIVE_A1_ADDR A:0xfcb76240
y.create.l HWIO_TXC_AMPM_ACTIVE_A1_ADDR A:0xfcb76244
y.create.l HWIO_TXC_RAMP_ACTIVE_A1_ADDR A:0xfcb7624c
y.create.l HWIO_TXC_DP_CFG_LATCHED_A1_ADDR A:0xfcb76300
y.create.l HWIO_TXC_DP_ENV_SCALE_VAL_LATCHED_A1_ADDR A:0xfcb76304
y.create.l HWIO_TXC_DP_PHASE_OVR_VAL_LATCHED_A1_ADDR A:0xfcb76308
y.create.l HWIO_TXC_PP_PHASE_OVR_VAL_LATCHED_A1_ADDR A:0xfcb7630c
y.create.l HWIO_TXC_DP_ENV_OVR_VAL_LATCHED_A1_ADDR A:0xfcb76310
y.create.l HWIO_TXC_EP_ENV_OVR_VAL_LATCHED_A1_ADDR A:0xfcb76314
y.create.l HWIO_TXC_DP_ROT_PHASE_INC_LATCHED_A1_ADDR A:0xfcb76318
y.create.l HWIO_TXC_DP_ROT_PHASE_INIT_LATCHED_A1_ADDR A:0xfcb7631c
y.create.l HWIO_TXC_DP_ROT_PHASE_SHIFT_LATCHED_A1_ADDR A:0xfcb76320
y.create.l HWIO_TXC_DP_IQ_GAIN_LATCHED_A1_ADDR A:0xfcb76324
y.create.l HWIO_TXC_DP_IQMC_LATCHED_A1_ADDR A:0xfcb76328
y.create.l HWIO_TXC_DP_PEQ1_LATCHED_A1_ADDR A:0xfcb7632c
y.create.l HWIO_TXC_DP_PEQ2_LATCHED_A1_ADDR A:0xfcb76330
y.create.l HWIO_TXC_DP_DCOC_LATCHED_A1_ADDR A:0xfcb76334
y.create.l HWIO_TXC_DM1_CFG_LATCHED_A1_ADDR A:0xfcb76338
y.create.l HWIO_TXC_EP_GAIN_LATCHED_A1_ADDR A:0xfcb7633c
y.create.l HWIO_TXC_EP_PEQ1_LATCHED_A1_ADDR A:0xfcb76340
y.create.l HWIO_TXC_EP_DCOC_LATCHED_A1_ADDR A:0xfcb76344
y.create.l HWIO_TXC_EP_DM2_FINE_TAU_LATCHED_A1_ADDR A:0xfcb76348
y.create.l HWIO_TXC_EP_DM3_FRAC_TAU_LATCHED_A1_ADDR A:0xfcb7634c
y.create.l HWIO_TXC_PP_GAIN_LATCHED_A1_ADDR A:0xfcb76350
y.create.l HWIO_TXC_PP_SPILL_LATCHED_A1_ADDR A:0xfcb76354
y.create.l HWIO_TXC_EP_PEQ2_LATCHED_A1_ADDR A:0xfcb76358
y.create.l HWIO_TXC_DP_CFG_2_LATCHED_A1_ADDR A:0xfcb7635c
y.create.l HWIO_TXR_IQ_DAC_A1_ADDR A:0xfcb77000
y.create.l HWIO_TXR_STR_CTRL_A1_ADDR A:0xfcb77008
y.create.l HWIO_TXR_PDA_CTRL_A1_ADDR A:0xfcb7700c
y.create.l HWIO_TXR_PDA_WD_UPDATE_CTRL_A1_ADDR A:0xfcb77010
y.create.l HWIO_TXR_PDA_CTRL_WD_OFFSET_A1_ADDR A:0xfcb77014
y.create.l HWIO_TXR_PDA_OFFSET_CMD_A1_ADDR A:0xfcb77018
y.create.l HWIO_TXR_PPDSM_CTL_A1_ADDR A:0xfcb7701c
y.create.l HWIO_TXR_FIFO_PTR_DIFF_A_A1_ADDR A:0xfcb77028
y.create.l HWIO_TXR_FIFO_PTR_DIFF_B_A1_ADDR A:0xfcb7702c
y.create.l HWIO_TXR_FIFO_STATUS_A_A1_ADDR A:0xfcb77030
y.create.l HWIO_TXR_FIFO_STATUS_B_A1_ADDR A:0xfcb77034
y.create.l HWIO_TXR_FIFO_CMD_A1_ADDR A:0xfcb77038
y.create.l HWIO_TXR_FIFO_CTRL_A1_ADDR A:0xfcb7703c
y.create.l HWIO_TXR_STREAM_IF_CTRL_A1_ADDR A:0xfcb77040
y.create.l HWIO_TXR_FMT_CONV_CTL_A1_ADDR A:0xfcb77050
y.create.l HWIO_TXR_IQ_DAC_CURRENT_A1_ADDR A:0xfcb77054
y.create.l HWIO_TXR_STR_CTRL_CURRENT_A1_ADDR A:0xfcb77058
y.create.l HWIO_TXR_PDA_CTRL_CURRENT_A1_ADDR A:0xfcb7705c
y.create.l HWIO_TXR_PDA_WD_UPDATE_CTRL_CURRENT_A1_ADDR A:0xfcb77060
y.create.l HWIO_TXR_PDA_CTRL_WD_OFFSET_CURRENT_A1_ADDR A:0xfcb77064
y.create.l HWIO_TXR_PDA_OFFSET_CMD_CURRENT_A1_ADDR A:0xfcb77068
y.create.l HWIO_TXR_PPDSM_CTL_CURRENT_A1_ADDR A:0xfcb7706c
y.create.l HWIO_TXR_STREAM_IF_CTRL_CURRENT_A1_ADDR A:0xfcb77078
y.create.l HWIO_TXR_FMT_CONV_CTL_CURRENT_A1_ADDR A:0xfcb7707c
y.create.l HWIO_TXC_MEM_BANK0_ADDR0_A0_ADDR A:0xfcb78000
y.create.l HWIO_TXC_MEM_BANK0_ADDR1_A0_ADDR A:0xfcb78004
y.create.l HWIO_TXC_MEM_BANK0_ADDR2_A0_ADDR A:0xfcb78008
y.create.l HWIO_TXC_MEM_BANK0_ADDR3_A0_ADDR A:0xfcb7800c
y.create.l HWIO_TXC_MEM_BANK1_ADDR0_A0_ADDR A:0xfcb78800
y.create.l HWIO_TXC_MEM_BANK1_ADDR1_A0_ADDR A:0xfcb78804
y.create.l HWIO_TXC_MEM_BANK1_ADDR2_A0_ADDR A:0xfcb78808
y.create.l HWIO_TXC_MEM_BANK1_ADDR3_A0_ADDR A:0xfcb7880c
y.create.l HWIO_TXC_MEM_BANK0_ADDR0_A1_ADDR A:0xfcb79000
y.create.l HWIO_TXC_MEM_BANK0_ADDR1_A1_ADDR A:0xfcb79004
y.create.l HWIO_TXC_MEM_BANK0_ADDR2_A1_ADDR A:0xfcb79008
y.create.l HWIO_TXC_MEM_BANK0_ADDR3_A1_ADDR A:0xfcb7900c
y.create.l HWIO_TXC_MEM_BANK1_ADDR0_A1_ADDR A:0xfcb79800
y.create.l HWIO_TXC_MEM_BANK1_ADDR1_A1_ADDR A:0xfcb79804
y.create.l HWIO_TXC_MEM_BANK1_ADDR2_A1_ADDR A:0xfcb79808
y.create.l HWIO_TXC_MEM_BANK1_ADDR3_A1_ADDR A:0xfcb7980c
y.create.l HWIO_RXFE_ENABLE_ADDR A:0xfcb60000
y.create.l HWIO_RXFE_ADC0_LOGIC_CFG_ADDR A:0xfcb60004
y.create.l HWIO_RXFE_ADC1_LOGIC_CFG_ADDR A:0xfcb60008
y.create.l HWIO_RXFE_WB0_ADCMUX_CFG_ADDR A:0xfcb6000c
y.create.l HWIO_RXFE_WB1_ADCMUX_CFG_ADDR A:0xfcb60010
y.create.l HWIO_RXFE_NB0_WBMUX_CFG_ADDR A:0xfcb60014
y.create.l HWIO_RXFE_NB1_WBMUX_CFG_ADDR A:0xfcb60018
y.create.l HWIO_RXFE_NB2_WBMUX_CFG_ADDR A:0xfcb6001c
y.create.l HWIO_RXFE_NB3_WBMUX_CFG_ADDR A:0xfcb60020
y.create.l HWIO_RXFE_NB4_WBMUX_CFG_ADDR A:0xfcb60024
y.create.l HWIO_RXFE_NB5_WBMUX_CFG_ADDR A:0xfcb60028
y.create.l HWIO_RXFE_TOP_STATUS_ADDR A:0xfcb6002c
y.create.l HWIO_RXFE_RFIF_UPDATE_CMD_ADDR A:0xfcb60030
y.create.l HWIO_RXFE_CMNNOTCH_FILT0_CFG0_ADDR A:0xfcb60034
y.create.l HWIO_RXFE_CMNNOTCH_FILT0_CFG1_ADDR A:0xfcb60038
y.create.l HWIO_RXFE_CMNNOTCH_FILT1_CFG0_ADDR A:0xfcb6003c
y.create.l HWIO_RXFE_CMNNOTCH_FILT1_CFG1_ADDR A:0xfcb60040
y.create.l HWIO_RXFE_CMNNOTCH_FILT2_CFG0_ADDR A:0xfcb60044
y.create.l HWIO_RXFE_CMNNOTCH_FILT2_CFG1_ADDR A:0xfcb60048
y.create.l HWIO_RXFE_CMNNOTCH_FILT3_CFG0_ADDR A:0xfcb6004c
y.create.l HWIO_RXFE_CMNNOTCH_FILT3_CFG1_ADDR A:0xfcb60050
y.create.l HWIO_RXFE_CMNNOTCH_FILT01_CFG_ADDR A:0xfcb60054
y.create.l HWIO_RXFE_CMNNOTCH_FILT23_CFG_ADDR A:0xfcb60058
y.create.l HWIO_RXFE_ACI_FILT0_CFG_ADDR A:0xfcb6005c
y.create.l HWIO_RXFE_ACI_FILT1_CFG_ADDR A:0xfcb60060
y.create.l HWIO_RXFE_DBG_ENABLES_ADDR A:0xfcb60064
y.create.l HWIO_RXFE_DBG_PROBE_CTL_ADDR A:0xfcb60068
y.create.l HWIO_RXFE_DBG_CMD_ADDR A:0xfcb6006c
y.create.l HWIO_RXFE_PBS_CFG_ADDR A:0xfcb60070
y.create.l HWIO_RXFE_TOP_SPARE_REG_ADDR A:0xfcb60074
y.create.l HWIO_RXFE_ADC_TEST1_REG_ADC0_ADDR A:0xfcb62000
y.create.l HWIO_RXFE_ADC_TEST2_REG_ADC0_ADDR A:0xfcb62004
y.create.l HWIO_RXFE_ADC_TEST3_REG_ADC0_ADDR A:0xfcb62008
y.create.l HWIO_RXFE_ADC_CONFIG1_REG_ADC0_ADDR A:0xfcb6200c
y.create.l HWIO_RXFE_ADC_CONFIG2_REG_ADC0_ADDR A:0xfcb62010
y.create.l HWIO_RXFE_ADC_CONTROL_REG_ADC0_ADDR A:0xfcb62014
y.create.l HWIO_RXFE_ADC_TEST1_REG_ADC1_ADDR A:0xfcb62100
y.create.l HWIO_RXFE_ADC_TEST2_REG_ADC1_ADDR A:0xfcb62104
y.create.l HWIO_RXFE_ADC_TEST3_REG_ADC1_ADDR A:0xfcb62108
y.create.l HWIO_RXFE_ADC_CONFIG1_REG_ADC1_ADDR A:0xfcb6210c
y.create.l HWIO_RXFE_ADC_CONFIG2_REG_ADC1_ADDR A:0xfcb62110
y.create.l HWIO_RXFE_ADC_CONTROL_REG_ADC1_ADDR A:0xfcb62114
y.create.l HWIO_RXFE_WB_TOP_CTL_WB0_ADDR A:0xfcb64000
y.create.l HWIO_RXFE_WB_TOP_CMD_WB0_ADDR A:0xfcb64004
y.create.l HWIO_RXFE_WB_TOP_STATUS_WB0_ADDR A:0xfcb64008
y.create.l HWIO_RXFE_WB_STOPGATE_ACTION_SAMPLE_WB0_ADDR A:0xfcb6400c
y.create.l HWIO_RXFE_WB_TIMINGCTL_STATUS_WB0_ADDR A:0xfcb64010
y.create.l HWIO_RXFE_WB_MISC_CFG_WB0_ADDR A:0xfcb64014
y.create.l HWIO_RXFE_WB_WBPWR_CFG_WB0_ADDR A:0xfcb64018
y.create.l HWIO_RXFE_WB_WBPWR_CMD_WB0_ADDR A:0xfcb6401c
y.create.l HWIO_RXFE_WB_WBPWR_START_ACTION_SAMPLE_WB0_ADDR A:0xfcb64020
y.create.l HWIO_RXFE_WB_WBPWR_START_MASK_WB0_ADDR A:0xfcb64024
y.create.l HWIO_RXFE_WB_WBPWR_STOP_ACTION_SAMPLE_WB0_ADDR A:0xfcb64028
y.create.l HWIO_RXFE_WB_WBPWR_FINAL_ACC_WB0_ADDR A:0xfcb6402c
y.create.l HWIO_RXFE_WB_WBPWR_CURR_ACC_WB0_ADDR A:0xfcb64030
y.create.l HWIO_RXFE_WB_WBPWR_MAX_ACC_WB0_ADDR A:0xfcb64034
y.create.l HWIO_RXFE_WB_WBDC_CFG_WB0_ADDR A:0xfcb64038
y.create.l HWIO_RXFE_WB_WBDC_CMD_WB0_ADDR A:0xfcb6403c
y.create.l HWIO_RXFE_WB_WBDC_START_ACTION_SAMPLE_WB0_ADDR A:0xfcb64040
y.create.l HWIO_RXFE_WB_WBDC_STOP_ACTION_SAMPLE_WB0_ADDR A:0xfcb64044
y.create.l HWIO_RXFE_WB_WBDC_UPDATE_ACTION_SAMPLE_WB0_ADDR A:0xfcb64048
y.create.l HWIO_RXFE_WB_WBDC_UPDATE_DELAY_WB0_ADDR A:0xfcb6404c
y.create.l HWIO_RXFE_WB_WBDC_OVRD_I_WB0_ADDR A:0xfcb64050
y.create.l HWIO_RXFE_WB_WBDC_OVRD_Q_WB0_ADDR A:0xfcb64054
y.create.l HWIO_RXFE_WB_WBDC_EST1_CURR_I_WB0_ADDR A:0xfcb64058
y.create.l HWIO_RXFE_WB_WBDC_EST1_CURR_Q_WB0_ADDR A:0xfcb6405c
y.create.l HWIO_RXFE_WB_WBDC_EST1_PREV_I_WB0_ADDR A:0xfcb64060
y.create.l HWIO_RXFE_WB_WBDC_EST1_PREV_Q_WB0_ADDR A:0xfcb64064
y.create.l HWIO_RXFE_WB_WBDC_EST1_LOAD_I_WB0_ADDR A:0xfcb64068
y.create.l HWIO_RXFE_WB_WBDC_EST1_LOAD_Q_WB0_ADDR A:0xfcb6406c
y.create.l HWIO_RXFE_WB_WBDC_EST2_CURR_I_WB0_ADDR A:0xfcb64070
y.create.l HWIO_RXFE_WB_WBDC_EST2_CURR_Q_WB0_ADDR A:0xfcb64074
y.create.l HWIO_RXFE_WB_WBDC_EST2_PREV_I_WB0_ADDR A:0xfcb64078
y.create.l HWIO_RXFE_WB_WBDC_EST2_PREV_Q_WB0_ADDR A:0xfcb6407c
y.create.l HWIO_RXFE_WB_WBDC_EST2_LOAD_I_WB0_ADDR A:0xfcb64080
y.create.l HWIO_RXFE_WB_WBDC_EST2_LOAD_Q_WB0_ADDR A:0xfcb64084
y.create.l HWIO_RXFE_WB_VSRC_CFG_WB0_ADDR A:0xfcb64088
y.create.l HWIO_RXFE_WB_VSRC_T2BYT1M1_WB0_ADDR A:0xfcb6408c
y.create.l HWIO_RXFE_WB_VSRC_CMD_WB0_ADDR A:0xfcb64090
y.create.l HWIO_RXFE_WB_VSRC_STATUS_WB0_ADDR A:0xfcb64094
y.create.l HWIO_RXFE_WB_VSRC_UPDT_ACTION_SAMPLE_WB0_ADDR A:0xfcb64098
y.create.l HWIO_RXFE_WB_VSRC_CURR_T1BYT2_WB0_ADDR A:0xfcb6409c
y.create.l HWIO_RXFE_WB_VSRC_CURR_T2BYT1M1_WB0_ADDR A:0xfcb640a0
y.create.l HWIO_RXFE_WB_VSRC_SCTR_LOAD_VALUE_WB0_ADDR A:0xfcb640a4
y.create.l HWIO_RXFE_WB_VSRC_SCTR_WA_WB0_ADDR A:0xfcb640a8
y.create.l HWIO_RXFE_WB_VSRC_SCTR_SNAPSHOT_WB0_ADDR A:0xfcb640ac
y.create.l HWIO_RXFE_WB_VSRC_ACC_SNAPSHOT_WB0_ADDR A:0xfcb640b0
y.create.l HWIO_RXFE_WB_DEC_FILT_CFG_WB0_ADDR A:0xfcb640b4
y.create.l HWIO_RXFE_WB_IQMC_CFG0_WB0_ADDR A:0xfcb640b8
y.create.l HWIO_RXFE_WB_IQMC_CFG1_WB0_ADDR A:0xfcb640bc
y.create.l HWIO_RXFE_WB_IQMC_CURR_VALS_WB0_ADDR A:0xfcb640c0
y.create.l HWIO_RXFE_WB_IQMC_UPDT_CMD_WB0_ADDR A:0xfcb640c4
y.create.l HWIO_RXFE_WB_IQMC_UPDT_ACTION_SAMPLE_WB0_ADDR A:0xfcb640c8
y.create.l HWIO_RXFE_WB_NOTCH_FILT0_CFG0_WB0_ADDR A:0xfcb640cc
y.create.l HWIO_RXFE_WB_NOTCH_FILT1_CFG0_WB0_ADDR A:0xfcb640d4
y.create.l HWIO_RXFE_WB_NOTCH_FILT0_CFG1_WB0_ADDR A:0xfcb640d0
y.create.l HWIO_RXFE_WB_NOTCH_FILT1_CFG1_WB0_ADDR A:0xfcb640d8
y.create.l HWIO_RXFE_WB_NOTCH_FILT01_CFG_WB0_ADDR A:0xfcb640dc
y.create.l HWIO_RXFE_WB_SPARE_REG_WB0_ADDR A:0xfcb640e0
y.create.l HWIO_RXFE_WB_TOP_CTL_WB1_ADDR A:0xfcb65000
y.create.l HWIO_RXFE_WB_TOP_CMD_WB1_ADDR A:0xfcb65004
y.create.l HWIO_RXFE_WB_TOP_STATUS_WB1_ADDR A:0xfcb65008
y.create.l HWIO_RXFE_WB_STOPGATE_ACTION_SAMPLE_WB1_ADDR A:0xfcb6500c
y.create.l HWIO_RXFE_WB_TIMINGCTL_STATUS_WB1_ADDR A:0xfcb65010
y.create.l HWIO_RXFE_WB_MISC_CFG_WB1_ADDR A:0xfcb65014
y.create.l HWIO_RXFE_WB_WBPWR_CFG_WB1_ADDR A:0xfcb65018
y.create.l HWIO_RXFE_WB_WBPWR_CMD_WB1_ADDR A:0xfcb6501c
y.create.l HWIO_RXFE_WB_WBPWR_START_ACTION_SAMPLE_WB1_ADDR A:0xfcb65020
y.create.l HWIO_RXFE_WB_WBPWR_START_MASK_WB1_ADDR A:0xfcb65024
y.create.l HWIO_RXFE_WB_WBPWR_STOP_ACTION_SAMPLE_WB1_ADDR A:0xfcb65028
y.create.l HWIO_RXFE_WB_WBPWR_FINAL_ACC_WB1_ADDR A:0xfcb6502c
y.create.l HWIO_RXFE_WB_WBPWR_CURR_ACC_WB1_ADDR A:0xfcb65030
y.create.l HWIO_RXFE_WB_WBPWR_MAX_ACC_WB1_ADDR A:0xfcb65034
y.create.l HWIO_RXFE_WB_WBDC_CFG_WB1_ADDR A:0xfcb65038
y.create.l HWIO_RXFE_WB_WBDC_CMD_WB1_ADDR A:0xfcb6503c
y.create.l HWIO_RXFE_WB_WBDC_START_ACTION_SAMPLE_WB1_ADDR A:0xfcb65040
y.create.l HWIO_RXFE_WB_WBDC_STOP_ACTION_SAMPLE_WB1_ADDR A:0xfcb65044
y.create.l HWIO_RXFE_WB_WBDC_UPDATE_ACTION_SAMPLE_WB1_ADDR A:0xfcb65048
y.create.l HWIO_RXFE_WB_WBDC_UPDATE_DELAY_WB1_ADDR A:0xfcb6504c
y.create.l HWIO_RXFE_WB_WBDC_OVRD_I_WB1_ADDR A:0xfcb65050
y.create.l HWIO_RXFE_WB_WBDC_OVRD_Q_WB1_ADDR A:0xfcb65054
y.create.l HWIO_RXFE_WB_WBDC_EST1_CURR_I_WB1_ADDR A:0xfcb65058
y.create.l HWIO_RXFE_WB_WBDC_EST1_CURR_Q_WB1_ADDR A:0xfcb6505c
y.create.l HWIO_RXFE_WB_WBDC_EST1_PREV_I_WB1_ADDR A:0xfcb65060
y.create.l HWIO_RXFE_WB_WBDC_EST1_PREV_Q_WB1_ADDR A:0xfcb65064
y.create.l HWIO_RXFE_WB_WBDC_EST1_LOAD_I_WB1_ADDR A:0xfcb65068
y.create.l HWIO_RXFE_WB_WBDC_EST1_LOAD_Q_WB1_ADDR A:0xfcb6506c
y.create.l HWIO_RXFE_WB_WBDC_EST2_CURR_I_WB1_ADDR A:0xfcb65070
y.create.l HWIO_RXFE_WB_WBDC_EST2_CURR_Q_WB1_ADDR A:0xfcb65074
y.create.l HWIO_RXFE_WB_WBDC_EST2_PREV_I_WB1_ADDR A:0xfcb65078
y.create.l HWIO_RXFE_WB_WBDC_EST2_PREV_Q_WB1_ADDR A:0xfcb6507c
y.create.l HWIO_RXFE_WB_WBDC_EST2_LOAD_I_WB1_ADDR A:0xfcb65080
y.create.l HWIO_RXFE_WB_WBDC_EST2_LOAD_Q_WB1_ADDR A:0xfcb65084
y.create.l HWIO_RXFE_WB_VSRC_CFG_WB1_ADDR A:0xfcb65088
y.create.l HWIO_RXFE_WB_VSRC_T2BYT1M1_WB1_ADDR A:0xfcb6508c
y.create.l HWIO_RXFE_WB_VSRC_CMD_WB1_ADDR A:0xfcb65090
y.create.l HWIO_RXFE_WB_VSRC_STATUS_WB1_ADDR A:0xfcb65094
y.create.l HWIO_RXFE_WB_VSRC_UPDT_ACTION_SAMPLE_WB1_ADDR A:0xfcb65098
y.create.l HWIO_RXFE_WB_VSRC_CURR_T1BYT2_WB1_ADDR A:0xfcb6509c
y.create.l HWIO_RXFE_WB_VSRC_CURR_T2BYT1M1_WB1_ADDR A:0xfcb650a0
y.create.l HWIO_RXFE_WB_VSRC_SCTR_LOAD_VALUE_WB1_ADDR A:0xfcb650a4
y.create.l HWIO_RXFE_WB_VSRC_SCTR_WA_WB1_ADDR A:0xfcb650a8
y.create.l HWIO_RXFE_WB_VSRC_SCTR_SNAPSHOT_WB1_ADDR A:0xfcb650ac
y.create.l HWIO_RXFE_WB_VSRC_ACC_SNAPSHOT_WB1_ADDR A:0xfcb650b0
y.create.l HWIO_RXFE_WB_DEC_FILT_CFG_WB1_ADDR A:0xfcb650b4
y.create.l HWIO_RXFE_WB_IQMC_CFG0_WB1_ADDR A:0xfcb650b8
y.create.l HWIO_RXFE_WB_IQMC_CFG1_WB1_ADDR A:0xfcb650bc
y.create.l HWIO_RXFE_WB_IQMC_CURR_VALS_WB1_ADDR A:0xfcb650c0
y.create.l HWIO_RXFE_WB_IQMC_UPDT_CMD_WB1_ADDR A:0xfcb650c4
y.create.l HWIO_RXFE_WB_IQMC_UPDT_ACTION_SAMPLE_WB1_ADDR A:0xfcb650c8
y.create.l HWIO_RXFE_WB_NOTCH_FILT0_CFG0_WB1_ADDR A:0xfcb650cc
y.create.l HWIO_RXFE_WB_NOTCH_FILT1_CFG0_WB1_ADDR A:0xfcb650d4
y.create.l HWIO_RXFE_WB_NOTCH_FILT0_CFG1_WB1_ADDR A:0xfcb650d0
y.create.l HWIO_RXFE_WB_NOTCH_FILT1_CFG1_WB1_ADDR A:0xfcb650d8
y.create.l HWIO_RXFE_WB_NOTCH_FILT01_CFG_WB1_ADDR A:0xfcb650dc
y.create.l HWIO_RXFE_WB_SPARE_REG_WB1_ADDR A:0xfcb650e0
y.create.l HWIO_RXFE_NB_TOP_CTL_NB0_ADDR A:0xfcb68000
y.create.l HWIO_RXFE_NB_GATE_CMD_NB0_ADDR A:0xfcb68004
y.create.l HWIO_RXFE_NB_GATE_STATUS_NB0_ADDR A:0xfcb68008
y.create.l HWIO_RXFE_NB_GATE_ACTION_SAMPLE_NB0_ADDR A:0xfcb6800c
y.create.l HWIO_RXFE_NB_TIMINGCTL_STATUS_NB0_ADDR A:0xfcb68010
y.create.l HWIO_RXFE_NB_CSR_CFG_NB0_ADDR A:0xfcb68014
y.create.l HWIO_RXFE_NB_CSR_CMD_NB0_ADDR A:0xfcb68018
y.create.l HWIO_RXFE_NB_CSR_PHASEUPDT_ACTION_SAMPLE_NB0_ADDR A:0xfcb6801c
y.create.l HWIO_RXFE_NB_CSR_FREQUPDT_ACTION_SAMPLE_NB0_ADDR A:0xfcb68020
y.create.l HWIO_RXFE_NB_CSR_PHASE_OFFSET_NB0_ADDR A:0xfcb68024
y.create.l HWIO_RXFE_NB_CSR_FREQ_OFFSET_NB0_ADDR A:0xfcb68028
y.create.l HWIO_RXFE_NB_CSR_CURR_PHASE_OFFSET_NB0_ADDR A:0xfcb6802c
y.create.l HWIO_RXFE_NB_CSR_CURR_FREQ_OFFSET_NB0_ADDR A:0xfcb68030
y.create.l HWIO_RXFE_NB_FILTERS_CFG_NB0_ADDR A:0xfcb68034
y.create.l HWIO_RXFE_NB_ICI_COEF0_NB0_ADDR A:0xfcb6803c
y.create.l HWIO_RXFE_NB_ICI_COEF1_NB0_ADDR A:0xfcb68040
y.create.l HWIO_RXFE_NB_ICI_COEF2_NB0_ADDR A:0xfcb68044
y.create.l HWIO_RXFE_NB_ICI_COEF3_NB0_ADDR A:0xfcb68048
y.create.l HWIO_RXFE_NB_ICI_COEF4_NB0_ADDR A:0xfcb6804c
y.create.l HWIO_RXFE_NB_ICI_COEF5_NB0_ADDR A:0xfcb68050
y.create.l HWIO_RXFE_NB_ICI_COEF6_NB0_ADDR A:0xfcb68054
y.create.l HWIO_RXFE_NB_ICI_COEF7_NB0_ADDR A:0xfcb68058
y.create.l HWIO_RXFE_NB_ICI_COEF8_NB0_ADDR A:0xfcb6805c
y.create.l HWIO_RXFE_NB_ICI_COEF9_NB0_ADDR A:0xfcb68060
y.create.l HWIO_RXFE_NB_GDA_NB0_ADDR A:0xfcb68068
y.create.l HWIO_RXFE_NB_NBDC_COMPVAL_I_NB0_ADDR A:0xfcb6806c
y.create.l HWIO_RXFE_NB_NBDC_COMPVAL_Q_NB0_ADDR A:0xfcb68070
y.create.l HWIO_RXFE_NB_NBPWR_CFG_NB0_ADDR A:0xfcb68074
y.create.l HWIO_RXFE_NB_NBPWR_CMD_NB0_ADDR A:0xfcb68078
y.create.l HWIO_RXFE_NB_NBPWR_START_ACTION_SAMPLE_NB0_ADDR A:0xfcb6807c
y.create.l HWIO_RXFE_NB_NBPWR_START_MASK_NB0_ADDR A:0xfcb68080
y.create.l HWIO_RXFE_NB_NBPWR_STOP_ACTION_SAMPLE_NB0_ADDR A:0xfcb68084
y.create.l HWIO_RXFE_NB_NBPWR_FINAL_ACC_NB0_ADDR A:0xfcb68088
y.create.l HWIO_RXFE_NB_NBPWR_CURR_ACC_NB0_ADDR A:0xfcb6808c
y.create.l HWIO_RXFE_NB_NBPWR_MAX_ACC_NB0_ADDR A:0xfcb68090
y.create.l HWIO_RXFE_NB_DVGA_CFG_NB0_ADDR A:0xfcb68094
y.create.l HWIO_RXFE_NB_DVGA_RXFE_GAIN_NB0_ADDR A:0xfcb68098
y.create.l HWIO_RXFE_NB_DVGA_OVERRIDE_DVGA_GAIN_NB0_ADDR A:0xfcb6809c
y.create.l HWIO_RXFE_NB_DVGA_CMD_NB0_ADDR A:0xfcb680a0
y.create.l HWIO_RXFE_NB_DVGA_UPDT_ACTION_SAMPLE_NB0_ADDR A:0xfcb680a4
y.create.l HWIO_RXFE_NB_DVGA_UPDT_MASK_NB0_ADDR A:0xfcb680a8
y.create.l HWIO_RXFE_NB_FINAL_BITWIDTHS_CFG_NB0_ADDR A:0xfcb680ac
y.create.l HWIO_RXFE_NB_WTR_CFG_NB0_ADDR A:0xfcb680b0
y.create.l HWIO_RXFE_NB_WTR_FUNC_CFG_NB0_ADDR A:0xfcb680b4
y.create.l HWIO_RXFE_NB_WTR_DBG_CFG0_NB0_ADDR A:0xfcb680b8
y.create.l HWIO_RXFE_NB_WTR_DBG_CFG1_NB0_ADDR A:0xfcb680bc
y.create.l HWIO_RXFE_NB_WTR_CMD_NB0_ADDR A:0xfcb680c0
y.create.l HWIO_RXFE_NB_WTR_START_ACTION_SAMPLE_NB0_ADDR A:0xfcb680c4
y.create.l HWIO_RXFE_NB_WTR_STOP_ACTION_SAMPLE_NB0_ADDR A:0xfcb680c8
y.create.l HWIO_RXFE_NB_WTR_STATUS_NB0_ADDR A:0xfcb680d0
y.create.l HWIO_RXFE_NB_WTR_ADDR_SNAPSHOT_NB0_ADDR A:0xfcb680d4
y.create.l HWIO_RXFE_NB_SPARE_REG_NB0_ADDR A:0xfcb680d8
y.create.l HWIO_RXFE_NB_TOP_CTL_NB1_ADDR A:0xfcb69000
y.create.l HWIO_RXFE_NB_GATE_CMD_NB1_ADDR A:0xfcb69004
y.create.l HWIO_RXFE_NB_GATE_STATUS_NB1_ADDR A:0xfcb69008
y.create.l HWIO_RXFE_NB_GATE_ACTION_SAMPLE_NB1_ADDR A:0xfcb6900c
y.create.l HWIO_RXFE_NB_TIMINGCTL_STATUS_NB1_ADDR A:0xfcb69010
y.create.l HWIO_RXFE_NB_CSR_CFG_NB1_ADDR A:0xfcb69014
y.create.l HWIO_RXFE_NB_CSR_CMD_NB1_ADDR A:0xfcb69018
y.create.l HWIO_RXFE_NB_CSR_PHASEUPDT_ACTION_SAMPLE_NB1_ADDR A:0xfcb6901c
y.create.l HWIO_RXFE_NB_CSR_FREQUPDT_ACTION_SAMPLE_NB1_ADDR A:0xfcb69020
y.create.l HWIO_RXFE_NB_CSR_PHASE_OFFSET_NB1_ADDR A:0xfcb69024
y.create.l HWIO_RXFE_NB_CSR_FREQ_OFFSET_NB1_ADDR A:0xfcb69028
y.create.l HWIO_RXFE_NB_CSR_CURR_PHASE_OFFSET_NB1_ADDR A:0xfcb6902c
y.create.l HWIO_RXFE_NB_CSR_CURR_FREQ_OFFSET_NB1_ADDR A:0xfcb69030
y.create.l HWIO_RXFE_NB_FILTERS_CFG_NB1_ADDR A:0xfcb69034
y.create.l HWIO_RXFE_NB_ICI_COEF0_NB1_ADDR A:0xfcb6903c
y.create.l HWIO_RXFE_NB_ICI_COEF1_NB1_ADDR A:0xfcb69040
y.create.l HWIO_RXFE_NB_ICI_COEF2_NB1_ADDR A:0xfcb69044
y.create.l HWIO_RXFE_NB_ICI_COEF3_NB1_ADDR A:0xfcb69048
y.create.l HWIO_RXFE_NB_ICI_COEF4_NB1_ADDR A:0xfcb6904c
y.create.l HWIO_RXFE_NB_ICI_COEF5_NB1_ADDR A:0xfcb69050
y.create.l HWIO_RXFE_NB_ICI_COEF6_NB1_ADDR A:0xfcb69054
y.create.l HWIO_RXFE_NB_ICI_COEF7_NB1_ADDR A:0xfcb69058
y.create.l HWIO_RXFE_NB_ICI_COEF8_NB1_ADDR A:0xfcb6905c
y.create.l HWIO_RXFE_NB_ICI_COEF9_NB1_ADDR A:0xfcb69060
y.create.l HWIO_RXFE_NB_GDA_NB1_ADDR A:0xfcb69068
y.create.l HWIO_RXFE_NB_NBDC_COMPVAL_I_NB1_ADDR A:0xfcb6906c
y.create.l HWIO_RXFE_NB_NBDC_COMPVAL_Q_NB1_ADDR A:0xfcb69070
y.create.l HWIO_RXFE_NB_NBPWR_CFG_NB1_ADDR A:0xfcb69074
y.create.l HWIO_RXFE_NB_NBPWR_CMD_NB1_ADDR A:0xfcb69078
y.create.l HWIO_RXFE_NB_NBPWR_START_ACTION_SAMPLE_NB1_ADDR A:0xfcb6907c
y.create.l HWIO_RXFE_NB_NBPWR_START_MASK_NB1_ADDR A:0xfcb69080
y.create.l HWIO_RXFE_NB_NBPWR_STOP_ACTION_SAMPLE_NB1_ADDR A:0xfcb69084
y.create.l HWIO_RXFE_NB_NBPWR_FINAL_ACC_NB1_ADDR A:0xfcb69088
y.create.l HWIO_RXFE_NB_NBPWR_CURR_ACC_NB1_ADDR A:0xfcb6908c
y.create.l HWIO_RXFE_NB_NBPWR_MAX_ACC_NB1_ADDR A:0xfcb69090
y.create.l HWIO_RXFE_NB_DVGA_CFG_NB1_ADDR A:0xfcb69094
y.create.l HWIO_RXFE_NB_DVGA_RXFE_GAIN_NB1_ADDR A:0xfcb69098
y.create.l HWIO_RXFE_NB_DVGA_OVERRIDE_DVGA_GAIN_NB1_ADDR A:0xfcb6909c
y.create.l HWIO_RXFE_NB_DVGA_CMD_NB1_ADDR A:0xfcb690a0
y.create.l HWIO_RXFE_NB_DVGA_UPDT_ACTION_SAMPLE_NB1_ADDR A:0xfcb690a4
y.create.l HWIO_RXFE_NB_DVGA_UPDT_MASK_NB1_ADDR A:0xfcb690a8
y.create.l HWIO_RXFE_NB_FINAL_BITWIDTHS_CFG_NB1_ADDR A:0xfcb690ac
y.create.l HWIO_RXFE_NB_WTR_CFG_NB1_ADDR A:0xfcb690b0
y.create.l HWIO_RXFE_NB_WTR_FUNC_CFG_NB1_ADDR A:0xfcb690b4
y.create.l HWIO_RXFE_NB_WTR_DBG_CFG0_NB1_ADDR A:0xfcb690b8
y.create.l HWIO_RXFE_NB_WTR_DBG_CFG1_NB1_ADDR A:0xfcb690bc
y.create.l HWIO_RXFE_NB_WTR_CMD_NB1_ADDR A:0xfcb690c0
y.create.l HWIO_RXFE_NB_WTR_START_ACTION_SAMPLE_NB1_ADDR A:0xfcb690c4
y.create.l HWIO_RXFE_NB_WTR_STOP_ACTION_SAMPLE_NB1_ADDR A:0xfcb690c8
y.create.l HWIO_RXFE_NB_WTR_STATUS_NB1_ADDR A:0xfcb690d0
y.create.l HWIO_RXFE_NB_WTR_ADDR_SNAPSHOT_NB1_ADDR A:0xfcb690d4
y.create.l HWIO_RXFE_NB_SPARE_REG_NB1_ADDR A:0xfcb690d8
y.create.l HWIO_RXFE_NB_TOP_CTL_NB2_ADDR A:0xfcb6a000
y.create.l HWIO_RXFE_NB_GATE_CMD_NB2_ADDR A:0xfcb6a004
y.create.l HWIO_RXFE_NB_GATE_STATUS_NB2_ADDR A:0xfcb6a008
y.create.l HWIO_RXFE_NB_GATE_ACTION_SAMPLE_NB2_ADDR A:0xfcb6a00c
y.create.l HWIO_RXFE_NB_TIMINGCTL_STATUS_NB2_ADDR A:0xfcb6a010
y.create.l HWIO_RXFE_NB_CSR_CFG_NB2_ADDR A:0xfcb6a014
y.create.l HWIO_RXFE_NB_CSR_CMD_NB2_ADDR A:0xfcb6a018
y.create.l HWIO_RXFE_NB_CSR_PHASEUPDT_ACTION_SAMPLE_NB2_ADDR A:0xfcb6a01c
y.create.l HWIO_RXFE_NB_CSR_FREQUPDT_ACTION_SAMPLE_NB2_ADDR A:0xfcb6a020
y.create.l HWIO_RXFE_NB_CSR_PHASE_OFFSET_NB2_ADDR A:0xfcb6a024
y.create.l HWIO_RXFE_NB_CSR_FREQ_OFFSET_NB2_ADDR A:0xfcb6a028
y.create.l HWIO_RXFE_NB_CSR_CURR_PHASE_OFFSET_NB2_ADDR A:0xfcb6a02c
y.create.l HWIO_RXFE_NB_CSR_CURR_FREQ_OFFSET_NB2_ADDR A:0xfcb6a030
y.create.l HWIO_RXFE_NB_FILTERS_CFG_NB2_ADDR A:0xfcb6a034
y.create.l HWIO_RXFE_NB_ICI_COEF0_NB2_ADDR A:0xfcb6a03c
y.create.l HWIO_RXFE_NB_ICI_COEF1_NB2_ADDR A:0xfcb6a040
y.create.l HWIO_RXFE_NB_ICI_COEF2_NB2_ADDR A:0xfcb6a044
y.create.l HWIO_RXFE_NB_ICI_COEF3_NB2_ADDR A:0xfcb6a048
y.create.l HWIO_RXFE_NB_ICI_COEF4_NB2_ADDR A:0xfcb6a04c
y.create.l HWIO_RXFE_NB_ICI_COEF5_NB2_ADDR A:0xfcb6a050
y.create.l HWIO_RXFE_NB_ICI_COEF6_NB2_ADDR A:0xfcb6a054
y.create.l HWIO_RXFE_NB_ICI_COEF7_NB2_ADDR A:0xfcb6a058
y.create.l HWIO_RXFE_NB_ICI_COEF8_NB2_ADDR A:0xfcb6a05c
y.create.l HWIO_RXFE_NB_ICI_COEF9_NB2_ADDR A:0xfcb6a060
y.create.l HWIO_RXFE_NB_GDA_NB2_ADDR A:0xfcb6a068
y.create.l HWIO_RXFE_NB_NBDC_COMPVAL_I_NB2_ADDR A:0xfcb6a06c
y.create.l HWIO_RXFE_NB_NBDC_COMPVAL_Q_NB2_ADDR A:0xfcb6a070
y.create.l HWIO_RXFE_NB_NBPWR_CFG_NB2_ADDR A:0xfcb6a074
y.create.l HWIO_RXFE_NB_NBPWR_CMD_NB2_ADDR A:0xfcb6a078
y.create.l HWIO_RXFE_NB_NBPWR_START_ACTION_SAMPLE_NB2_ADDR A:0xfcb6a07c
y.create.l HWIO_RXFE_NB_NBPWR_START_MASK_NB2_ADDR A:0xfcb6a080
y.create.l HWIO_RXFE_NB_NBPWR_STOP_ACTION_SAMPLE_NB2_ADDR A:0xfcb6a084
y.create.l HWIO_RXFE_NB_NBPWR_FINAL_ACC_NB2_ADDR A:0xfcb6a088
y.create.l HWIO_RXFE_NB_NBPWR_CURR_ACC_NB2_ADDR A:0xfcb6a08c
y.create.l HWIO_RXFE_NB_NBPWR_MAX_ACC_NB2_ADDR A:0xfcb6a090
y.create.l HWIO_RXFE_NB_DVGA_CFG_NB2_ADDR A:0xfcb6a094
y.create.l HWIO_RXFE_NB_DVGA_RXFE_GAIN_NB2_ADDR A:0xfcb6a098
y.create.l HWIO_RXFE_NB_DVGA_OVERRIDE_DVGA_GAIN_NB2_ADDR A:0xfcb6a09c
y.create.l HWIO_RXFE_NB_DVGA_CMD_NB2_ADDR A:0xfcb6a0a0
y.create.l HWIO_RXFE_NB_DVGA_UPDT_ACTION_SAMPLE_NB2_ADDR A:0xfcb6a0a4
y.create.l HWIO_RXFE_NB_DVGA_UPDT_MASK_NB2_ADDR A:0xfcb6a0a8
y.create.l HWIO_RXFE_NB_FINAL_BITWIDTHS_CFG_NB2_ADDR A:0xfcb6a0ac
y.create.l HWIO_RXFE_NB_WTR_CFG_NB2_ADDR A:0xfcb6a0b0
y.create.l HWIO_RXFE_NB_WTR_FUNC_CFG_NB2_ADDR A:0xfcb6a0b4
y.create.l HWIO_RXFE_NB_WTR_DBG_CFG0_NB2_ADDR A:0xfcb6a0b8
y.create.l HWIO_RXFE_NB_WTR_DBG_CFG1_NB2_ADDR A:0xfcb6a0bc
y.create.l HWIO_RXFE_NB_WTR_CMD_NB2_ADDR A:0xfcb6a0c0
y.create.l HWIO_RXFE_NB_WTR_START_ACTION_SAMPLE_NB2_ADDR A:0xfcb6a0c4
y.create.l HWIO_RXFE_NB_WTR_STOP_ACTION_SAMPLE_NB2_ADDR A:0xfcb6a0c8
y.create.l HWIO_RXFE_NB_WTR_STATUS_NB2_ADDR A:0xfcb6a0d0
y.create.l HWIO_RXFE_NB_WTR_ADDR_SNAPSHOT_NB2_ADDR A:0xfcb6a0d4
y.create.l HWIO_RXFE_NB_SPARE_REG_NB2_ADDR A:0xfcb6a0d8
y.create.l HWIO_RXFE_NB_TOP_CTL_NB3_ADDR A:0xfcb6b000
y.create.l HWIO_RXFE_NB_GATE_CMD_NB3_ADDR A:0xfcb6b004
y.create.l HWIO_RXFE_NB_GATE_STATUS_NB3_ADDR A:0xfcb6b008
y.create.l HWIO_RXFE_NB_GATE_ACTION_SAMPLE_NB3_ADDR A:0xfcb6b00c
y.create.l HWIO_RXFE_NB_TIMINGCTL_STATUS_NB3_ADDR A:0xfcb6b010
y.create.l HWIO_RXFE_NB_CSR_CFG_NB3_ADDR A:0xfcb6b014
y.create.l HWIO_RXFE_NB_CSR_CMD_NB3_ADDR A:0xfcb6b018
y.create.l HWIO_RXFE_NB_CSR_PHASEUPDT_ACTION_SAMPLE_NB3_ADDR A:0xfcb6b01c
y.create.l HWIO_RXFE_NB_CSR_FREQUPDT_ACTION_SAMPLE_NB3_ADDR A:0xfcb6b020
y.create.l HWIO_RXFE_NB_CSR_PHASE_OFFSET_NB3_ADDR A:0xfcb6b024
y.create.l HWIO_RXFE_NB_CSR_FREQ_OFFSET_NB3_ADDR A:0xfcb6b028
y.create.l HWIO_RXFE_NB_CSR_CURR_PHASE_OFFSET_NB3_ADDR A:0xfcb6b02c
y.create.l HWIO_RXFE_NB_CSR_CURR_FREQ_OFFSET_NB3_ADDR A:0xfcb6b030
y.create.l HWIO_RXFE_NB_FILTERS_CFG_NB3_ADDR A:0xfcb6b034
y.create.l HWIO_RXFE_NB_ICI_COEF0_NB3_ADDR A:0xfcb6b03c
y.create.l HWIO_RXFE_NB_ICI_COEF1_NB3_ADDR A:0xfcb6b040
y.create.l HWIO_RXFE_NB_ICI_COEF2_NB3_ADDR A:0xfcb6b044
y.create.l HWIO_RXFE_NB_ICI_COEF3_NB3_ADDR A:0xfcb6b048
y.create.l HWIO_RXFE_NB_ICI_COEF4_NB3_ADDR A:0xfcb6b04c
y.create.l HWIO_RXFE_NB_ICI_COEF5_NB3_ADDR A:0xfcb6b050
y.create.l HWIO_RXFE_NB_ICI_COEF6_NB3_ADDR A:0xfcb6b054
y.create.l HWIO_RXFE_NB_ICI_COEF7_NB3_ADDR A:0xfcb6b058
y.create.l HWIO_RXFE_NB_ICI_COEF8_NB3_ADDR A:0xfcb6b05c
y.create.l HWIO_RXFE_NB_ICI_COEF9_NB3_ADDR A:0xfcb6b060
y.create.l HWIO_RXFE_NB_GDA_NB3_ADDR A:0xfcb6b068
y.create.l HWIO_RXFE_NB_NBDC_COMPVAL_I_NB3_ADDR A:0xfcb6b06c
y.create.l HWIO_RXFE_NB_NBDC_COMPVAL_Q_NB3_ADDR A:0xfcb6b070
y.create.l HWIO_RXFE_NB_NBPWR_CFG_NB3_ADDR A:0xfcb6b074
y.create.l HWIO_RXFE_NB_NBPWR_CMD_NB3_ADDR A:0xfcb6b078
y.create.l HWIO_RXFE_NB_NBPWR_START_ACTION_SAMPLE_NB3_ADDR A:0xfcb6b07c
y.create.l HWIO_RXFE_NB_NBPWR_START_MASK_NB3_ADDR A:0xfcb6b080
y.create.l HWIO_RXFE_NB_NBPWR_STOP_ACTION_SAMPLE_NB3_ADDR A:0xfcb6b084
y.create.l HWIO_RXFE_NB_NBPWR_FINAL_ACC_NB3_ADDR A:0xfcb6b088
y.create.l HWIO_RXFE_NB_NBPWR_CURR_ACC_NB3_ADDR A:0xfcb6b08c
y.create.l HWIO_RXFE_NB_NBPWR_MAX_ACC_NB3_ADDR A:0xfcb6b090
y.create.l HWIO_RXFE_NB_DVGA_CFG_NB3_ADDR A:0xfcb6b094
y.create.l HWIO_RXFE_NB_DVGA_RXFE_GAIN_NB3_ADDR A:0xfcb6b098
y.create.l HWIO_RXFE_NB_DVGA_OVERRIDE_DVGA_GAIN_NB3_ADDR A:0xfcb6b09c
y.create.l HWIO_RXFE_NB_DVGA_CMD_NB3_ADDR A:0xfcb6b0a0
y.create.l HWIO_RXFE_NB_DVGA_UPDT_ACTION_SAMPLE_NB3_ADDR A:0xfcb6b0a4
y.create.l HWIO_RXFE_NB_DVGA_UPDT_MASK_NB3_ADDR A:0xfcb6b0a8
y.create.l HWIO_RXFE_NB_FINAL_BITWIDTHS_CFG_NB3_ADDR A:0xfcb6b0ac
y.create.l HWIO_RXFE_NB_WTR_CFG_NB3_ADDR A:0xfcb6b0b0
y.create.l HWIO_RXFE_NB_WTR_FUNC_CFG_NB3_ADDR A:0xfcb6b0b4
y.create.l HWIO_RXFE_NB_WTR_DBG_CFG0_NB3_ADDR A:0xfcb6b0b8
y.create.l HWIO_RXFE_NB_WTR_DBG_CFG1_NB3_ADDR A:0xfcb6b0bc
y.create.l HWIO_RXFE_NB_WTR_CMD_NB3_ADDR A:0xfcb6b0c0
y.create.l HWIO_RXFE_NB_WTR_START_ACTION_SAMPLE_NB3_ADDR A:0xfcb6b0c4
y.create.l HWIO_RXFE_NB_WTR_STOP_ACTION_SAMPLE_NB3_ADDR A:0xfcb6b0c8
y.create.l HWIO_RXFE_NB_WTR_STATUS_NB3_ADDR A:0xfcb6b0d0
y.create.l HWIO_RXFE_NB_WTR_ADDR_SNAPSHOT_NB3_ADDR A:0xfcb6b0d4
y.create.l HWIO_RXFE_NB_SPARE_REG_NB3_ADDR A:0xfcb6b0d8
y.create.l HWIO_RXFE_NB_TOP_CTL_NB4_ADDR A:0xfcb6c000
y.create.l HWIO_RXFE_NB_GATE_CMD_NB4_ADDR A:0xfcb6c004
y.create.l HWIO_RXFE_NB_GATE_STATUS_NB4_ADDR A:0xfcb6c008
y.create.l HWIO_RXFE_NB_GATE_ACTION_SAMPLE_NB4_ADDR A:0xfcb6c00c
y.create.l HWIO_RXFE_NB_TIMINGCTL_STATUS_NB4_ADDR A:0xfcb6c010
y.create.l HWIO_RXFE_NB_CSR_CFG_NB4_ADDR A:0xfcb6c014
y.create.l HWIO_RXFE_NB_CSR_CMD_NB4_ADDR A:0xfcb6c018
y.create.l HWIO_RXFE_NB_CSR_PHASEUPDT_ACTION_SAMPLE_NB4_ADDR A:0xfcb6c01c
y.create.l HWIO_RXFE_NB_CSR_FREQUPDT_ACTION_SAMPLE_NB4_ADDR A:0xfcb6c020
y.create.l HWIO_RXFE_NB_CSR_PHASE_OFFSET_NB4_ADDR A:0xfcb6c024
y.create.l HWIO_RXFE_NB_CSR_FREQ_OFFSET_NB4_ADDR A:0xfcb6c028
y.create.l HWIO_RXFE_NB_CSR_CURR_PHASE_OFFSET_NB4_ADDR A:0xfcb6c02c
y.create.l HWIO_RXFE_NB_CSR_CURR_FREQ_OFFSET_NB4_ADDR A:0xfcb6c030
y.create.l HWIO_RXFE_NB_FILTERS_CFG_NB4_ADDR A:0xfcb6c034
y.create.l HWIO_RXFE_NB_ICI_COEF0_NB4_ADDR A:0xfcb6c03c
y.create.l HWIO_RXFE_NB_ICI_COEF1_NB4_ADDR A:0xfcb6c040
y.create.l HWIO_RXFE_NB_ICI_COEF2_NB4_ADDR A:0xfcb6c044
y.create.l HWIO_RXFE_NB_ICI_COEF3_NB4_ADDR A:0xfcb6c048
y.create.l HWIO_RXFE_NB_ICI_COEF4_NB4_ADDR A:0xfcb6c04c
y.create.l HWIO_RXFE_NB_ICI_COEF5_NB4_ADDR A:0xfcb6c050
y.create.l HWIO_RXFE_NB_ICI_COEF6_NB4_ADDR A:0xfcb6c054
y.create.l HWIO_RXFE_NB_ICI_COEF7_NB4_ADDR A:0xfcb6c058
y.create.l HWIO_RXFE_NB_ICI_COEF8_NB4_ADDR A:0xfcb6c05c
y.create.l HWIO_RXFE_NB_ICI_COEF9_NB4_ADDR A:0xfcb6c060
y.create.l HWIO_RXFE_NB_GDA_NB4_ADDR A:0xfcb6c068
y.create.l HWIO_RXFE_NB_NBDC_COMPVAL_I_NB4_ADDR A:0xfcb6c06c
y.create.l HWIO_RXFE_NB_NBDC_COMPVAL_Q_NB4_ADDR A:0xfcb6c070
y.create.l HWIO_RXFE_NB_NBPWR_CFG_NB4_ADDR A:0xfcb6c074
y.create.l HWIO_RXFE_NB_NBPWR_CMD_NB4_ADDR A:0xfcb6c078
y.create.l HWIO_RXFE_NB_NBPWR_START_ACTION_SAMPLE_NB4_ADDR A:0xfcb6c07c
y.create.l HWIO_RXFE_NB_NBPWR_START_MASK_NB4_ADDR A:0xfcb6c080
y.create.l HWIO_RXFE_NB_NBPWR_STOP_ACTION_SAMPLE_NB4_ADDR A:0xfcb6c084
y.create.l HWIO_RXFE_NB_NBPWR_FINAL_ACC_NB4_ADDR A:0xfcb6c088
y.create.l HWIO_RXFE_NB_NBPWR_CURR_ACC_NB4_ADDR A:0xfcb6c08c
y.create.l HWIO_RXFE_NB_NBPWR_MAX_ACC_NB4_ADDR A:0xfcb6c090
y.create.l HWIO_RXFE_NB_DVGA_CFG_NB4_ADDR A:0xfcb6c094
y.create.l HWIO_RXFE_NB_DVGA_RXFE_GAIN_NB4_ADDR A:0xfcb6c098
y.create.l HWIO_RXFE_NB_DVGA_OVERRIDE_DVGA_GAIN_NB4_ADDR A:0xfcb6c09c
y.create.l HWIO_RXFE_NB_DVGA_CMD_NB4_ADDR A:0xfcb6c0a0
y.create.l HWIO_RXFE_NB_DVGA_UPDT_ACTION_SAMPLE_NB4_ADDR A:0xfcb6c0a4
y.create.l HWIO_RXFE_NB_DVGA_UPDT_MASK_NB4_ADDR A:0xfcb6c0a8
y.create.l HWIO_RXFE_NB_FINAL_BITWIDTHS_CFG_NB4_ADDR A:0xfcb6c0ac
y.create.l HWIO_RXFE_NB_WTR_CFG_NB4_ADDR A:0xfcb6c0b0
y.create.l HWIO_RXFE_NB_WTR_FUNC_CFG_NB4_ADDR A:0xfcb6c0b4
y.create.l HWIO_RXFE_NB_WTR_DBG_CFG0_NB4_ADDR A:0xfcb6c0b8
y.create.l HWIO_RXFE_NB_WTR_DBG_CFG1_NB4_ADDR A:0xfcb6c0bc
y.create.l HWIO_RXFE_NB_WTR_CMD_NB4_ADDR A:0xfcb6c0c0
y.create.l HWIO_RXFE_NB_WTR_START_ACTION_SAMPLE_NB4_ADDR A:0xfcb6c0c4
y.create.l HWIO_RXFE_NB_WTR_STOP_ACTION_SAMPLE_NB4_ADDR A:0xfcb6c0c8
y.create.l HWIO_RXFE_NB_WTR_STATUS_NB4_ADDR A:0xfcb6c0d0
y.create.l HWIO_RXFE_NB_WTR_ADDR_SNAPSHOT_NB4_ADDR A:0xfcb6c0d4
y.create.l HWIO_RXFE_NB_SPARE_REG_NB4_ADDR A:0xfcb6c0d8
y.create.l HWIO_RXFE_NB_TOP_CTL_NB5_ADDR A:0xfcb6d000
y.create.l HWIO_RXFE_NB_GATE_CMD_NB5_ADDR A:0xfcb6d004
y.create.l HWIO_RXFE_NB_GATE_STATUS_NB5_ADDR A:0xfcb6d008
y.create.l HWIO_RXFE_NB_GATE_ACTION_SAMPLE_NB5_ADDR A:0xfcb6d00c
y.create.l HWIO_RXFE_NB_TIMINGCTL_STATUS_NB5_ADDR A:0xfcb6d010
y.create.l HWIO_RXFE_NB_CSR_CFG_NB5_ADDR A:0xfcb6d014
y.create.l HWIO_RXFE_NB_CSR_CMD_NB5_ADDR A:0xfcb6d018
y.create.l HWIO_RXFE_NB_CSR_PHASEUPDT_ACTION_SAMPLE_NB5_ADDR A:0xfcb6d01c
y.create.l HWIO_RXFE_NB_CSR_FREQUPDT_ACTION_SAMPLE_NB5_ADDR A:0xfcb6d020
y.create.l HWIO_RXFE_NB_CSR_PHASE_OFFSET_NB5_ADDR A:0xfcb6d024
y.create.l HWIO_RXFE_NB_CSR_FREQ_OFFSET_NB5_ADDR A:0xfcb6d028
y.create.l HWIO_RXFE_NB_CSR_CURR_PHASE_OFFSET_NB5_ADDR A:0xfcb6d02c
y.create.l HWIO_RXFE_NB_CSR_CURR_FREQ_OFFSET_NB5_ADDR A:0xfcb6d030
y.create.l HWIO_RXFE_NB_FILTERS_CFG_NB5_ADDR A:0xfcb6d034
y.create.l HWIO_RXFE_NB_ICI_COEF0_NB5_ADDR A:0xfcb6d03c
y.create.l HWIO_RXFE_NB_ICI_COEF1_NB5_ADDR A:0xfcb6d040
y.create.l HWIO_RXFE_NB_ICI_COEF2_NB5_ADDR A:0xfcb6d044
y.create.l HWIO_RXFE_NB_ICI_COEF3_NB5_ADDR A:0xfcb6d048
y.create.l HWIO_RXFE_NB_ICI_COEF4_NB5_ADDR A:0xfcb6d04c
y.create.l HWIO_RXFE_NB_ICI_COEF5_NB5_ADDR A:0xfcb6d050
y.create.l HWIO_RXFE_NB_ICI_COEF6_NB5_ADDR A:0xfcb6d054
y.create.l HWIO_RXFE_NB_ICI_COEF7_NB5_ADDR A:0xfcb6d058
y.create.l HWIO_RXFE_NB_ICI_COEF8_NB5_ADDR A:0xfcb6d05c
y.create.l HWIO_RXFE_NB_ICI_COEF9_NB5_ADDR A:0xfcb6d060
y.create.l HWIO_RXFE_NB_GDA_NB5_ADDR A:0xfcb6d068
y.create.l HWIO_RXFE_NB_NBDC_COMPVAL_I_NB5_ADDR A:0xfcb6d06c
y.create.l HWIO_RXFE_NB_NBDC_COMPVAL_Q_NB5_ADDR A:0xfcb6d070
y.create.l HWIO_RXFE_NB_NBPWR_CFG_NB5_ADDR A:0xfcb6d074
y.create.l HWIO_RXFE_NB_NBPWR_CMD_NB5_ADDR A:0xfcb6d078
y.create.l HWIO_RXFE_NB_NBPWR_START_ACTION_SAMPLE_NB5_ADDR A:0xfcb6d07c
y.create.l HWIO_RXFE_NB_NBPWR_START_MASK_NB5_ADDR A:0xfcb6d080
y.create.l HWIO_RXFE_NB_NBPWR_STOP_ACTION_SAMPLE_NB5_ADDR A:0xfcb6d084
y.create.l HWIO_RXFE_NB_NBPWR_FINAL_ACC_NB5_ADDR A:0xfcb6d088
y.create.l HWIO_RXFE_NB_NBPWR_CURR_ACC_NB5_ADDR A:0xfcb6d08c
y.create.l HWIO_RXFE_NB_NBPWR_MAX_ACC_NB5_ADDR A:0xfcb6d090
y.create.l HWIO_RXFE_NB_DVGA_CFG_NB5_ADDR A:0xfcb6d094
y.create.l HWIO_RXFE_NB_DVGA_RXFE_GAIN_NB5_ADDR A:0xfcb6d098
y.create.l HWIO_RXFE_NB_DVGA_OVERRIDE_DVGA_GAIN_NB5_ADDR A:0xfcb6d09c
y.create.l HWIO_RXFE_NB_DVGA_CMD_NB5_ADDR A:0xfcb6d0a0
y.create.l HWIO_RXFE_NB_DVGA_UPDT_ACTION_SAMPLE_NB5_ADDR A:0xfcb6d0a4
y.create.l HWIO_RXFE_NB_DVGA_UPDT_MASK_NB5_ADDR A:0xfcb6d0a8
y.create.l HWIO_RXFE_NB_FINAL_BITWIDTHS_CFG_NB5_ADDR A:0xfcb6d0ac
y.create.l HWIO_RXFE_NB_WTR_CFG_NB5_ADDR A:0xfcb6d0b0
y.create.l HWIO_RXFE_NB_WTR_FUNC_CFG_NB5_ADDR A:0xfcb6d0b4
y.create.l HWIO_RXFE_NB_WTR_DBG_CFG0_NB5_ADDR A:0xfcb6d0b8
y.create.l HWIO_RXFE_NB_WTR_DBG_CFG1_NB5_ADDR A:0xfcb6d0bc
y.create.l HWIO_RXFE_NB_WTR_CMD_NB5_ADDR A:0xfcb6d0c0
y.create.l HWIO_RXFE_NB_WTR_START_ACTION_SAMPLE_NB5_ADDR A:0xfcb6d0c4
y.create.l HWIO_RXFE_NB_WTR_STOP_ACTION_SAMPLE_NB5_ADDR A:0xfcb6d0c8
y.create.l HWIO_RXFE_NB_WTR_STATUS_NB5_ADDR A:0xfcb6d0d0
y.create.l HWIO_RXFE_NB_WTR_ADDR_SNAPSHOT_NB5_ADDR A:0xfcb6d0d4
y.create.l HWIO_RXFE_NB_SPARE_REG_NB5_ADDR A:0xfcb6d0d8
y.create.l HWIO_RXFE_WRTR0_CFG0_ADDR A:0xfcb6f000
y.create.l HWIO_RXFE_WRTR1_CFG0_ADDR A:0xfcb6f008
y.create.l HWIO_RXFE_WRTR2_CFG0_ADDR A:0xfcb6f010
y.create.l HWIO_RXFE_WRTR3_CFG0_ADDR A:0xfcb6f018
y.create.l HWIO_RXFE_WRTR4_CFG0_ADDR A:0xfcb6f020
y.create.l HWIO_RXFE_WRTR5_CFG0_ADDR A:0xfcb6f028
y.create.l HWIO_RXFE_WRTR0_CFG1_ADDR A:0xfcb6f004
y.create.l HWIO_RXFE_WRTR1_CFG1_ADDR A:0xfcb6f00c
y.create.l HWIO_RXFE_WRTR2_CFG1_ADDR A:0xfcb6f014
y.create.l HWIO_RXFE_WRTR3_CFG1_ADDR A:0xfcb6f01c
y.create.l HWIO_RXFE_WRTR4_CFG1_ADDR A:0xfcb6f024
y.create.l HWIO_RXFE_WRTR5_CFG1_ADDR A:0xfcb6f02c
y.create.l HWIO_RXFE_WRTR_XFER_CTL_ADDR A:0xfcb6f030
y.create.l HWIO_RXFE_BRDG_CTL_ADDR A:0xfcb6f034
y.create.l HWIO_RXFE_BRDG_STATUS_ADDR A:0xfcb6f038
y.create.l HWIO_RXFE_BRDG_CLEAR_ADDR A:0xfcb6f048
y.create.l HWIO_DEMBACK_EN_ADDR A:0xfcb40000
y.create.l HWIO_DEMBACK_MODE_SEL_ADDR A:0xfcb40004
y.create.l HWIO_DEMBACK_AHB_ERR_ADDR A:0xfcb40008
y.create.l HWIO_DEMBACK_MM_RDR0_CFG0_ADDR A:0xfcb41000
y.create.l HWIO_DEMBACK_MM_RDR1_CFG0_ADDR A:0xfcb4100c
y.create.l HWIO_DEMBACK_MM_RDR2_CFG0_ADDR A:0xfcb41018
y.create.l HWIO_DEMBACK_MM_RDR0_CFG1_ADDR A:0xfcb41004
y.create.l HWIO_DEMBACK_MM_RDR1_CFG1_ADDR A:0xfcb41010
y.create.l HWIO_DEMBACK_MM_RDR2_CFG1_ADDR A:0xfcb4101c
y.create.l HWIO_DEMBACK_MM_RDR0_XFER_CTL_ADDR A:0xfcb41008
y.create.l HWIO_DEMBACK_MM_RDR1_XFER_CTL_ADDR A:0xfcb41014
y.create.l HWIO_DEMBACK_MM_RDR2_XFER_CTL_ADDR A:0xfcb41020
y.create.l HWIO_DEMBACK_RDR3_CFG0_ADDR A:0xfcb41024
y.create.l HWIO_DEMBACK_RDR3_CFG1_ADDR A:0xfcb41028
y.create.l HWIO_DEMBACK_RDR3_XFER_CTL_ADDR A:0xfcb4102c
y.create.l HWIO_DEMBACK_NN_RDR0_CFG0_ADDR A:0xfcb41030
y.create.l HWIO_DEMBACK_NN_RDR1_CFG0_ADDR A:0xfcb4103c
y.create.l HWIO_DEMBACK_NN_RDR0_CFG1_ADDR A:0xfcb41034
y.create.l HWIO_DEMBACK_NN_RDR1_CFG1_ADDR A:0xfcb41040
y.create.l HWIO_DEMBACK_NN_RDR0_XFER_CTL_ADDR A:0xfcb41038
y.create.l HWIO_DEMBACK_NN_RDR1_XFER_CTL_ADDR A:0xfcb41044
y.create.l HWIO_DEMBACK_NN_RDR2_CFG0_ADDR A:0xfcb41048
y.create.l HWIO_DEMBACK_NN_RDR2_CFG1_ADDR A:0xfcb4104c
y.create.l HWIO_DEMBACK_NN_RDR2_XFER_CTL_ADDR A:0xfcb41050
y.create.l HWIO_DEMBACK_NN_RDR3_CFG0_ADDR A:0xfcb41054
y.create.l HWIO_DEMBACK_NN_RDR3_CFG1_ADDR A:0xfcb41058
y.create.l HWIO_DEMBACK_NN_RDR3_XFER_CTL_ADDR A:0xfcb4105c
y.create.l HWIO_DEMBACK_WRTR0_CFG0_ADDR A:0xfcb41060
y.create.l HWIO_DEMBACK_WRTR1_CFG0_ADDR A:0xfcb4106c
y.create.l HWIO_DEMBACK_WRTR0_CFG1_ADDR A:0xfcb41064
y.create.l HWIO_DEMBACK_WRTR1_CFG1_ADDR A:0xfcb41070
y.create.l HWIO_DEMBACK_WRTR0_XFER_CTL_ADDR A:0xfcb41068
y.create.l HWIO_DEMBACK_WRTR1_XFER_CTL_ADDR A:0xfcb41074
y.create.l HWIO_DEMBACK_WRTR2_CFG0_ADDR A:0xfcb41078
y.create.l HWIO_DEMBACK_WRTR2_CFG1_ADDR A:0xfcb4107c
y.create.l HWIO_DEMBACK_WRTR2_XFER_CTL_ADDR A:0xfcb41080
y.create.l HWIO_DEMBACK_WRTR3_CFG0_ADDR A:0xfcb41084
y.create.l HWIO_DEMBACK_WRTR3_CFG1_ADDR A:0xfcb41088
y.create.l HWIO_DEMBACK_WRTR3_XFER_CTL_ADDR A:0xfcb4108c
y.create.l HWIO_DEMBACK_BRDG_CTL_ADDR A:0xfcb41090
y.create.l HWIO_DEMBACK_BRDG_STATUS_ADDR A:0xfcb41094
y.create.l HWIO_DEMBACK_BRDG_CLEAR_ADDR A:0xfcb41098
y.create.l HWIO_DEMBACK_DBG_CFG0_ADDR A:0xfcb4109c
y.create.l HWIO_DEMBACK_DBG_CFG1_ADDR A:0xfcb410a0
y.create.l HWIO_DEMBACK_DBG_CTL_ADDR A:0xfcb410a4
y.create.l HWIO_DEMBACK_DBG_MATCH_MASK0_ADDR A:0xfcb410a8
y.create.l HWIO_DEMBACK_DBG_MATCH_MASK1_ADDR A:0xfcb410ac
y.create.l HWIO_DEMBACK_DBG_MATCH_PATTERN0_ADDR A:0xfcb410b0
y.create.l HWIO_DEMBACK_DBG_MATCH_PATTERN1_ADDR A:0xfcb410b4
y.create.l HWIO_DEMBACK_DBG_TRACE_LEN_ADDR A:0xfcb410b8
y.create.l HWIO_DEMBACK_DBG_WINDOW_LEN_ADDR A:0xfcb410bc
y.create.l HWIO_DEMBACK_DBG_TRIGGER_LEN_ADDR A:0xfcb410c0
y.create.l HWIO_DBACK_AMP_EST0_0_ADDR A:0xfcb44000
y.create.l HWIO_DBACK_AMP_EST0_1_ADDR A:0xfcb44008
y.create.l HWIO_DBACK_AMP_EST0_2_ADDR A:0xfcb44010
y.create.l HWIO_DBACK_AMP_EST0_3_ADDR A:0xfcb44018
y.create.l HWIO_DBACK_AMP_EST0_4_ADDR A:0xfcb44020
y.create.l HWIO_DBACK_AMP_EST0_5_ADDR A:0xfcb44028
y.create.l HWIO_DBACK_ENG_EST0_0_ADDR A:0xfcb44004
y.create.l HWIO_DBACK_ENG_EST0_1_ADDR A:0xfcb4400c
y.create.l HWIO_DBACK_ENG_EST0_2_ADDR A:0xfcb44014
y.create.l HWIO_DBACK_ENG_EST0_3_ADDR A:0xfcb4401c
y.create.l HWIO_DBACK_ENG_EST0_4_ADDR A:0xfcb44024
y.create.l HWIO_DBACK_ENG_EST0_5_ADDR A:0xfcb4402c
y.create.l HWIO_DBACK_AMP_EST1_0_ADDR A:0xfcb44030
y.create.l HWIO_DBACK_AMP_EST1_1_ADDR A:0xfcb44038
y.create.l HWIO_DBACK_AMP_EST1_2_ADDR A:0xfcb44040
y.create.l HWIO_DBACK_AMP_EST1_3_ADDR A:0xfcb44048
y.create.l HWIO_DBACK_AMP_EST1_4_ADDR A:0xfcb44050
y.create.l HWIO_DBACK_AMP_EST1_5_ADDR A:0xfcb44058
y.create.l HWIO_DBACK_ENG_EST1_0_ADDR A:0xfcb44034
y.create.l HWIO_DBACK_ENG_EST1_1_ADDR A:0xfcb4403c
y.create.l HWIO_DBACK_ENG_EST1_2_ADDR A:0xfcb44044
y.create.l HWIO_DBACK_ENG_EST1_3_ADDR A:0xfcb4404c
y.create.l HWIO_DBACK_ENG_EST1_4_ADDR A:0xfcb44054
y.create.l HWIO_DBACK_ENG_EST1_5_ADDR A:0xfcb4405c
y.create.l HWIO_DBACK_HS_CH0_PART1_DEC_DATA0_ADDR A:0xfcb44060
y.create.l HWIO_DBACK_HS_CH1_PART1_DEC_DATA0_ADDR A:0xfcb4406c
y.create.l HWIO_DBACK_HS_CH2_PART1_DEC_DATA0_ADDR A:0xfcb44078
y.create.l HWIO_DBACK_HS_CH3_PART1_DEC_DATA0_ADDR A:0xfcb44084
y.create.l HWIO_DBACK_HS_CH4_PART1_DEC_DATA0_ADDR A:0xfcb44090
y.create.l HWIO_DBACK_HS_CH5_PART1_DEC_DATA0_ADDR A:0xfcb4409c
y.create.l HWIO_DBACK_HS_CH6_PART1_DEC_DATA0_ADDR A:0xfcb440a8
y.create.l HWIO_DBACK_HS_CH7_PART1_DEC_DATA0_ADDR A:0xfcb440b4
y.create.l HWIO_DBACK_HS_CH8_PART1_DEC_DATA0_ADDR A:0xfcb440c0
y.create.l HWIO_DBACK_HS_CH9_PART1_DEC_DATA0_ADDR A:0xfcb440cc
y.create.l HWIO_DBACK_HS_CH0_PART1_DEC_STAT_ADDR A:0xfcb44064
y.create.l HWIO_DBACK_HS_CH1_PART1_DEC_STAT_ADDR A:0xfcb44070
y.create.l HWIO_DBACK_HS_CH2_PART1_DEC_STAT_ADDR A:0xfcb4407c
y.create.l HWIO_DBACK_HS_CH3_PART1_DEC_STAT_ADDR A:0xfcb44088
y.create.l HWIO_DBACK_HS_CH4_PART1_DEC_STAT_ADDR A:0xfcb44094
y.create.l HWIO_DBACK_HS_CH5_PART1_DEC_STAT_ADDR A:0xfcb440a0
y.create.l HWIO_DBACK_HS_CH6_PART1_DEC_STAT_ADDR A:0xfcb440ac
y.create.l HWIO_DBACK_HS_CH7_PART1_DEC_STAT_ADDR A:0xfcb440b8
y.create.l HWIO_DBACK_HS_CH8_PART1_DEC_STAT_ADDR A:0xfcb440c4
y.create.l HWIO_DBACK_HS_CH9_PART1_DEC_STAT_ADDR A:0xfcb440d0
y.create.l HWIO_DBACK_HS_CH0_SLOT1_AE_EST_ADDR A:0xfcb44068
y.create.l HWIO_DBACK_HS_CH1_SLOT1_AE_EST_ADDR A:0xfcb44074
y.create.l HWIO_DBACK_HS_CH2_SLOT1_AE_EST_ADDR A:0xfcb44080
y.create.l HWIO_DBACK_HS_CH3_SLOT1_AE_EST_ADDR A:0xfcb4408c
y.create.l HWIO_DBACK_HS_CH4_SLOT1_AE_EST_ADDR A:0xfcb44098
y.create.l HWIO_DBACK_HS_CH5_SLOT1_AE_EST_ADDR A:0xfcb440a4
y.create.l HWIO_DBACK_HS_CH6_SLOT1_AE_EST_ADDR A:0xfcb440b0
y.create.l HWIO_DBACK_HS_CH7_SLOT1_AE_EST_ADDR A:0xfcb440bc
y.create.l HWIO_DBACK_HS_CH8_SLOT1_AE_EST_ADDR A:0xfcb440c8
y.create.l HWIO_DBACK_HS_CH9_SLOT1_AE_EST_ADDR A:0xfcb440d4
y.create.l HWIO_DBACK_HS_CH0_PART2_DEC_DATA1_ADDR A:0xfcb440d8
y.create.l HWIO_DBACK_HS_CH1_PART2_DEC_DATA1_ADDR A:0xfcb440e8
y.create.l HWIO_DBACK_HS_CH2_PART2_DEC_DATA1_ADDR A:0xfcb440f8
y.create.l HWIO_DBACK_HS_CH3_PART2_DEC_DATA1_ADDR A:0xfcb44108
y.create.l HWIO_DBACK_HS_CH4_PART2_DEC_DATA1_ADDR A:0xfcb44118
y.create.l HWIO_DBACK_HS_CH5_PART2_DEC_DATA1_ADDR A:0xfcb44128
y.create.l HWIO_DBACK_HS_CH6_PART2_DEC_DATA1_ADDR A:0xfcb44138
y.create.l HWIO_DBACK_HS_CH7_PART2_DEC_DATA1_ADDR A:0xfcb44148
y.create.l HWIO_DBACK_HS_CH8_PART2_DEC_DATA1_ADDR A:0xfcb44158
y.create.l HWIO_DBACK_HS_CH9_PART2_DEC_DATA1_ADDR A:0xfcb44168
y.create.l HWIO_DBACK_HS_CH0_PART2_DEC_STAT_ADDR A:0xfcb440dc
y.create.l HWIO_DBACK_HS_CH1_PART2_DEC_STAT_ADDR A:0xfcb440ec
y.create.l HWIO_DBACK_HS_CH2_PART2_DEC_STAT_ADDR A:0xfcb440fc
y.create.l HWIO_DBACK_HS_CH3_PART2_DEC_STAT_ADDR A:0xfcb4410c
y.create.l HWIO_DBACK_HS_CH4_PART2_DEC_STAT_ADDR A:0xfcb4411c
y.create.l HWIO_DBACK_HS_CH5_PART2_DEC_STAT_ADDR A:0xfcb4412c
y.create.l HWIO_DBACK_HS_CH6_PART2_DEC_STAT_ADDR A:0xfcb4413c
y.create.l HWIO_DBACK_HS_CH7_PART2_DEC_STAT_ADDR A:0xfcb4414c
y.create.l HWIO_DBACK_HS_CH8_PART2_DEC_STAT_ADDR A:0xfcb4415c
y.create.l HWIO_DBACK_HS_CH9_PART2_DEC_STAT_ADDR A:0xfcb4416c
y.create.l HWIO_DBACK_HS_CH0_SLOT2_AE_EST_ADDR A:0xfcb440e0
y.create.l HWIO_DBACK_HS_CH1_SLOT2_AE_EST_ADDR A:0xfcb440f0
y.create.l HWIO_DBACK_HS_CH2_SLOT2_AE_EST_ADDR A:0xfcb44100
y.create.l HWIO_DBACK_HS_CH3_SLOT2_AE_EST_ADDR A:0xfcb44110
y.create.l HWIO_DBACK_HS_CH4_SLOT2_AE_EST_ADDR A:0xfcb44120
y.create.l HWIO_DBACK_HS_CH5_SLOT2_AE_EST_ADDR A:0xfcb44130
y.create.l HWIO_DBACK_HS_CH6_SLOT2_AE_EST_ADDR A:0xfcb44140
y.create.l HWIO_DBACK_HS_CH7_SLOT2_AE_EST_ADDR A:0xfcb44150
y.create.l HWIO_DBACK_HS_CH8_SLOT2_AE_EST_ADDR A:0xfcb44160
y.create.l HWIO_DBACK_HS_CH9_SLOT2_AE_EST_ADDR A:0xfcb44170
y.create.l HWIO_DBACK_HS_CH0_SLOT3_AE_EST_ADDR A:0xfcb440e4
y.create.l HWIO_DBACK_HS_CH1_SLOT3_AE_EST_ADDR A:0xfcb440f4
y.create.l HWIO_DBACK_HS_CH2_SLOT3_AE_EST_ADDR A:0xfcb44104
y.create.l HWIO_DBACK_HS_CH3_SLOT3_AE_EST_ADDR A:0xfcb44114
y.create.l HWIO_DBACK_HS_CH4_SLOT3_AE_EST_ADDR A:0xfcb44124
y.create.l HWIO_DBACK_HS_CH5_SLOT3_AE_EST_ADDR A:0xfcb44134
y.create.l HWIO_DBACK_HS_CH6_SLOT3_AE_EST_ADDR A:0xfcb44144
y.create.l HWIO_DBACK_HS_CH7_SLOT3_AE_EST_ADDR A:0xfcb44154
y.create.l HWIO_DBACK_HS_CH8_SLOT3_AE_EST_ADDR A:0xfcb44164
y.create.l HWIO_DBACK_HS_CH9_SLOT3_AE_EST_ADDR A:0xfcb44174
y.create.l HWIO_DBACK_EAGCH_DEC_DATA_ADDR A:0xfcb44178
y.create.l HWIO_DBACK_EAGCH_DEC_STAT_ADDR A:0xfcb4417c
y.create.l HWIO_DBACK_EAGCH_METRIC_ADDR A:0xfcb44180
y.create.l HWIO_DBACK_HSSCCH_CTL1_ADDR A:0xfcb44184
y.create.l HWIO_DBACK_HSSCCH_CTL2_ADDR A:0xfcb44188
y.create.l HWIO_HS_SCCH_PART2_DECODE_MAP_ADDR A:0xfcb4418c
y.create.l HWIO_DBACK_CH0_UEID_MASK_0_ADDR A:0xfcb44190
y.create.l HWIO_DBACK_CH1_UEID_MASK_0_ADDR A:0xfcb44194
y.create.l HWIO_DBACK_CH2_UEID_MASK_0_ADDR A:0xfcb44198
y.create.l HWIO_DBACK_CH3_UEID_MASK_0_ADDR A:0xfcb4419c
y.create.l HWIO_DBACK_CH4_UEID_MASK_0_ADDR A:0xfcb441a0
y.create.l HWIO_DBACK_CH5_UEID_MASK_0_ADDR A:0xfcb441a4
y.create.l HWIO_DBACK_CH6_UEID_MASK_0_ADDR A:0xfcb441a8
y.create.l HWIO_DBACK_CH7_UEID_MASK_0_ADDR A:0xfcb441ac
y.create.l HWIO_DBACK_CH8_UEID_MASK_0_ADDR A:0xfcb441b0
y.create.l HWIO_DBACK_CH9_UEID_MASK_0_ADDR A:0xfcb441b4
y.create.l HWIO_DBACK_CH0_UEID_MASK_1_ADDR A:0xfcb441b8
y.create.l HWIO_DBACK_CH1_UEID_MASK_1_ADDR A:0xfcb441bc
y.create.l HWIO_DBACK_CH2_UEID_MASK_1_ADDR A:0xfcb441c0
y.create.l HWIO_DBACK_CH3_UEID_MASK_1_ADDR A:0xfcb441c4
y.create.l HWIO_DBACK_CH4_UEID_MASK_1_ADDR A:0xfcb441c8
y.create.l HWIO_DBACK_CH5_UEID_MASK_1_ADDR A:0xfcb441cc
y.create.l HWIO_DBACK_CH6_UEID_MASK_1_ADDR A:0xfcb441d0
y.create.l HWIO_DBACK_CH7_UEID_MASK_1_ADDR A:0xfcb441d4
y.create.l HWIO_DBACK_CH8_UEID_MASK_1_ADDR A:0xfcb441d8
y.create.l HWIO_DBACK_CH9_UEID_MASK_1_ADDR A:0xfcb441dc
y.create.l HWIO_DBACK_HSSCCH_PART1_TRIGGER_ADDR A:0xfcb441e0
y.create.l HWIO_DBACK_HSSCCH_YAM_THRES_ADDR A:0xfcb441e4
y.create.l HWIO_DBACK_HSSCCH_PART2_TRIGGER_ADDR A:0xfcb441e8
y.create.l HWIO_DBACK_HSSCCH_STATUS_ADDR A:0xfcb441ec
y.create.l HWIO_DBACK_EAGCH_CONFIG_ADDR A:0xfcb441f0
y.create.l HWIO_DBACK_EAGCH_CTL_ADDR A:0xfcb441f4
y.create.l HWIO_DBACK_EAGCH_TRIGGER_ADDR A:0xfcb441f8
y.create.l HWIO_DBACK_EAGCH_RM_PATTERN_0_ADDR A:0xfcb441fc
y.create.l HWIO_DBACK_EAGCH_RM_PATTERN_1_ADDR A:0xfcb44200
y.create.l HWIO_DBACK_EAGCH_RM_PATTERN_2_ADDR A:0xfcb44204
y.create.l HWIO_DBACK_HS_EUL_CTL_CH_RST_ADDR A:0xfcb44208
y.create.l HWIO_DBACK_NONHS_WCB_SIZE_ADDR A:0xfcb4420c
y.create.l HWIO_DBACK_HS_WCB_SIZE_ADDR A:0xfcb44210
y.create.l HWIO_DBACK_PART1_INT_STATUS_ADDR A:0xfcb44214
y.create.l HWIO_DBACK_PART1_INT_CLR_ADDR A:0xfcb44218
y.create.l HWIO_DBACK_PART1_INT_EN_ADDR A:0xfcb4421c
y.create.l HWIO_DBACK_PART2_INT_STATUS_ADDR A:0xfcb44220
y.create.l HWIO_DBACK_PART2_INT_CLR_ADDR A:0xfcb44224
y.create.l HWIO_DBACK_PART2_INT_EN_ADDR A:0xfcb44228
y.create.l HWIO_DBACK_EAGCH_INT_EN_ADDR A:0xfcb4422c
y.create.l HWIO_DBACK_TEST_MEM_SEL_ADDR A:0xfcb44230
y.create.l HWIO_DBACK_TEST_BUS_SEL_ADDR A:0xfcb44234
y.create.l HWIO_DBACK_MEM_ADDR_ADDR A:0xfcb44238
y.create.l HWIO_DBACK_MEM_DATA0_ADDR A:0xfcb4423c
y.create.l HWIO_DBACK_MEM_DATA1_ADDR A:0xfcb44240
y.create.l HWIO_DBACK_MEM_DATA2_ADDR A:0xfcb44244
y.create.l HWIO_DBACK_MEM_DATA3_ADDR A:0xfcb44248
y.create.l HWIO_DBACK_MEM_DATA4_ADDR A:0xfcb4424c
y.create.l HWIO_T_DBACK_HS_CH0_DEC_DATA0_ADDR A:0xfcb45000
y.create.l HWIO_T_DBACK_HS_CH1_DEC_DATA0_ADDR A:0xfcb4500c
y.create.l HWIO_T_DBACK_HS_CH2_DEC_DATA0_ADDR A:0xfcb45018
y.create.l HWIO_T_DBACK_HS_CH3_DEC_DATA0_ADDR A:0xfcb45024
y.create.l HWIO_T_DBACK_HS_CH0_DEC_DATA1_ADDR A:0xfcb45004
y.create.l HWIO_T_DBACK_HS_CH1_DEC_DATA1_ADDR A:0xfcb45010
y.create.l HWIO_T_DBACK_HS_CH2_DEC_DATA1_ADDR A:0xfcb4501c
y.create.l HWIO_T_DBACK_HS_CH3_DEC_DATA1_ADDR A:0xfcb45028
y.create.l HWIO_T_DBACK_HS_CH0_DEC_STAT_ADDR A:0xfcb45008
y.create.l HWIO_T_DBACK_HS_CH1_DEC_STAT_ADDR A:0xfcb45014
y.create.l HWIO_T_DBACK_HS_CH2_DEC_STAT_ADDR A:0xfcb45020
y.create.l HWIO_T_DBACK_HS_CH3_DEC_STAT_ADDR A:0xfcb4502c
y.create.l HWIO_T_DBACK_EAGCH0_DEC_DATA0_ADDR A:0xfcb45030
y.create.l HWIO_T_DBACK_EAGCH1_DEC_DATA0_ADDR A:0xfcb45040
y.create.l HWIO_T_DBACK_EAGCH2_DEC_DATA0_ADDR A:0xfcb45050
y.create.l HWIO_T_DBACK_EAGCH3_DEC_DATA0_ADDR A:0xfcb45060
y.create.l HWIO_T_DBACK_EAGCH0_DEC_DATA1_ADDR A:0xfcb45034
y.create.l HWIO_T_DBACK_EAGCH1_DEC_DATA1_ADDR A:0xfcb45044
y.create.l HWIO_T_DBACK_EAGCH2_DEC_DATA1_ADDR A:0xfcb45054
y.create.l HWIO_T_DBACK_EAGCH3_DEC_DATA1_ADDR A:0xfcb45064
y.create.l HWIO_T_DBACK_EAGCH0_DEC_STAT_ADDR A:0xfcb45038
y.create.l HWIO_T_DBACK_EAGCH1_DEC_STAT_ADDR A:0xfcb45048
y.create.l HWIO_T_DBACK_EAGCH2_DEC_STAT_ADDR A:0xfcb45058
y.create.l HWIO_T_DBACK_EAGCH3_DEC_STAT_ADDR A:0xfcb45068
y.create.l HWIO_T_DBACK_EAGCH0_METRIC_ADDR A:0xfcb4503c
y.create.l HWIO_T_DBACK_EAGCH1_METRIC_ADDR A:0xfcb4504c
y.create.l HWIO_T_DBACK_EAGCH2_METRIC_ADDR A:0xfcb4505c
y.create.l HWIO_T_DBACK_EAGCH3_METRIC_ADDR A:0xfcb4506c
y.create.l HWIO_T_DBACK_FPACH_DEC_DATA0_ADDR A:0xfcb45070
y.create.l HWIO_T_DBACK_FPACH_DEC_DATA1_ADDR A:0xfcb45074
y.create.l HWIO_T_DBACK_FPACH_DEC_STAT_ADDR A:0xfcb45078
y.create.l HWIO_T_DBACK_TEST_MEM_SEL_ADDR A:0xfcb4507c
y.create.l HWIO_T_DBACK_TEST_BUS_SEL_ADDR A:0xfcb45080
y.create.l HWIO_T_DBACK_MEM_ADDR_ADDR A:0xfcb45084
y.create.l HWIO_T_DBACK_MEM_DATA0_ADDR A:0xfcb45088
y.create.l HWIO_T_DBACK_MEM_DATA1_ADDR A:0xfcb4508c
y.create.l HWIO_T_DBACK_MEM_DATA2_ADDR A:0xfcb45090
y.create.l HWIO_T_DBACK_MEM_DATA3_ADDR A:0xfcb45094
y.create.l HWIO_T_DBACK_MEM_DATA4_ADDR A:0xfcb45098
y.create.l HWIO_DINT_CFG_ADDR A:0xfcb46000
y.create.l HWIO_DINT_CH0_CFG_ADDR A:0xfcb46004
y.create.l HWIO_DINT_CH1_CFG_ADDR A:0xfcb46008
y.create.l HWIO_DINT_CH2_CFG_ADDR A:0xfcb4600c
y.create.l HWIO_TD_BLOCK_SIZE_ADDR A:0xfcb46014
y.create.l HWIO_TD_INTLV_CFG_LO_ADDR A:0xfcb46018
y.create.l HWIO_TD_INTLV_CFG_HI_ADDR A:0xfcb4601c
y.create.l HWIO_TD_INTLV_SIZE_LO_ADDR A:0xfcb46020
y.create.l HWIO_TD_PUNCT_LO_ADDR A:0xfcb46024
y.create.l HWIO_TD_PUNCT_HI_ADDR A:0xfcb46028
y.create.l HWIO_DINT_PKT_OFFSET_ADDR A:0xfcb46030
y.create.l HWIO_DINT_PKT_CFG_ADDR A:0xfcb46034
y.create.l HWIO_DINT_TASK_OFFSET_ADDR A:0xfcb46038
y.create.l HWIO_DINT_TASK_LIST_ADDR A:0xfcb4603c
y.create.l HWIO_TST_SYNC_DINT_ADDR A:0xfcb46040
y.create.l HWIO_TST_CH0_SYMS_ADDR A:0xfcb46044
y.create.l HWIO_TST_CH1_SYMS_ADDR A:0xfcb46048
y.create.l HWIO_TST_CH2_SYMS_ADDR A:0xfcb4604c
y.create.l HWIO_TST_SEL_DINT_ADDR A:0xfcb46054
y.create.l HWIO_DINT_OTD_CFG_ADDR A:0xfcb46058
y.create.l HWIO_TST_SYS_TIME_ADDR A:0xfcb46070
y.create.l HWIO_DEINT_DBG_BUS_CTL_ADDR A:0xfcb46074
y.create.l HWIO_DEC_CLR_INT_STATUS_ADDR A:0xfcb46084
y.create.l HWIO_DEINT_CLK_STATUS_ADDR A:0xfcb46088
y.create.l HWIO_DEC_DONE_INT_STATUS_ADDR A:0xfcb4608c
y.create.l HWIO_DEINT_TASK_STATUS_ADDR A:0xfcb46090
y.create.l HWIO_DEINT_FRMHYP_STATUS_ADDR A:0xfcb46094
y.create.l HWIO_DINT_VD_RD_ADDR_ADDR A:0xfcb46098
y.create.l HWIO_DINT_FCH_CFG0_ADDR A:0xfcb4609c
y.create.l HWIO_DINT_FCH_CFG1_ADDR A:0xfcb460a0
y.create.l HWIO_DINT_FCH_TRIGGER_ADDR A:0xfcb460a4
y.create.l HWIO_DINT_FCH_WR_BANK_ADDR A:0xfcb460a8
y.create.l HWIO_DINT_FCH_EGTH_HYP_CFG0_ADDR A:0xfcb460ac
y.create.l HWIO_DINT_FCH_EGTH_HYP_CFG1_ADDR A:0xfcb460b0
y.create.l HWIO_DINT_FCH_EGTH_HYP_CFG2_ADDR A:0xfcb460b4
y.create.l HWIO_DINT_FCH_EGTH_HYP_CFG3_ADDR A:0xfcb460b8
y.create.l HWIO_DINT_FCH_QRTR_HYP_CFG0_ADDR A:0xfcb460bc
y.create.l HWIO_DINT_FCH_QRTR_HYP_CFG1_ADDR A:0xfcb460c0
y.create.l HWIO_DINT_FCH_QRTR_HYP_CFG2_ADDR A:0xfcb460c4
y.create.l HWIO_DINT_FCH_QRTR_HYP_CFG3_ADDR A:0xfcb460c8
y.create.l HWIO_DINT_FCH_HALF_HYP_CFG0_ADDR A:0xfcb460cc
y.create.l HWIO_DINT_FCH_HALF_HYP_CFG1_ADDR A:0xfcb460d0
y.create.l HWIO_DINT_FCH_HALF_HYP_CFG2_ADDR A:0xfcb460d4
y.create.l HWIO_DINT_FCH_HALF_HYP_CFG3_ADDR A:0xfcb460d8
y.create.l HWIO_DINT_FCH_FULL_HYP_CFG0_ADDR A:0xfcb460dc
y.create.l HWIO_DINT_FCH_FULL_HYP_CFG1_ADDR A:0xfcb460e0
y.create.l HWIO_DINT_FCH_FULL_HYP_CFG2_ADDR A:0xfcb460e4
y.create.l HWIO_DINT_FCH_FULL_HYP_CFG3_ADDR A:0xfcb460e8
y.create.l HWIO_HDR_DINT_STATUS_ADDR A:0xfcb47024
y.create.l HWIO_HDR_DINT_DGB_BUS_ADDR A:0xfcb47080
y.create.l HWIO_HDR_DINT_CLK_STATUS_ADDR A:0xfcb47084
y.create.l HWIO_SVD_TBVD_CLK_STATUS_REG_ADDR A:0xfcb48000
y.create.l HWIO_SVD_TBVD_HW_IDLE_ADDR A:0xfcb48004
y.create.l HWIO_SVD_TBVD_TESTBUS_ENABLE_ADDR A:0xfcb48008
y.create.l HWIO_SVD_MODE_ADDR A:0xfcb4800c
y.create.l HWIO_SVD_POLY2IJ_ADDR A:0xfcb48010
y.create.l HWIO_SVD_POLY3IJ_ADDR A:0xfcb48014
y.create.l HWIO_SVD_POLY3K_ADDR A:0xfcb48018
y.create.l HWIO_SVD_POLY4IJ_ADDR A:0xfcb4801c
y.create.l HWIO_SVD_POLY4KL_ADDR A:0xfcb48020
y.create.l HWIO_SVD_TESTCON_ADDR A:0xfcb48024
y.create.l HWIO_SVD_TESTOUT_ADDR A:0xfcb48028
y.create.l HWIO_SVD_TEST_MEM_SEL_ADDR A:0xfcb4802c
y.create.l HWIO_SVD_TEST_MEM_ADDR_ADDR A:0xfcb48030
y.create.l HWIO_SVD_TEST_MEM_WRITE_ADDR A:0xfcb48034
y.create.l HWIO_SVD_TEST_MEM_READ0_ADDR A:0xfcb48038
y.create.l HWIO_SVD_TEST_MEM_READ1_ADDR A:0xfcb4803c
y.create.l HWIO_SVD_TEST_MEM_DIN_ADDR A:0xfcb48040
y.create.l HWIO_TBVD_DEBUG_MEM_CMD_ADDR A:0xfcb48044
y.create.l HWIO_TBVD_DEBUG_MEM_WR_ADDR A:0xfcb48048
y.create.l HWIO_TBVD_DEBUG_MEM_RD_ADDR A:0xfcb4804c
y.create.l HWIO_DB_DMA_STATUS_WORD0_ADDR A:0xfcb49000
y.create.l HWIO_DB_DMA_SHARED_WORD0_ADDR A:0xfcb49100
y.create.l HWIO_DB_DMA_SHARED_WORD1_ADDR A:0xfcb49104
y.create.l HWIO_W_DBACK_HS_SHARED_WORD0_ADDR A:0xfcb4c100
y.create.l HWIO_W_DBACK_HS_SHARED_WORD1_ADDR A:0xfcb4c104
y.create.l HWIO_W_DBACK_HS_SHARED_WORD2_ADDR A:0xfcb4c108
y.create.l HWIO_W_DBACK_HS_SHARED_WORD3_ADDR A:0xfcb4c10c
y.create.l HWIO_W_DBACK_HS_SHARED_WORD4_ADDR A:0xfcb4c110
y.create.l HWIO_W_DBACK_HS_SHARED_WORD5_ADDR A:0xfcb4c114
y.create.l HWIO_W_DBACK_HS_SHARED_WORD6_ADDR A:0xfcb4c118
y.create.l HWIO_W_DBACK_HS_SHARED_WORD7_ADDR A:0xfcb4c11c
y.create.l HWIO_W_DBACK_HS_SHARED_WORD8_ADDR A:0xfcb4c120
y.create.l HWIO_W_DBACK_HS_SHARED_WORD9_ADDR A:0xfcb4c124
y.create.l HWIO_W_DBACK_HS_SHARED_WORD10_ADDR A:0xfcb4c128
y.create.l HWIO_W_DBACK_HS_SHARED_WORD11_ADDR A:0xfcb4c12c
y.create.l HWIO_W_DBACK_HS_SHARED_WORD12_ADDR A:0xfcb4c130
y.create.l HWIO_W_DBACK_HS_SHARED_WORD13_ADDR A:0xfcb4c134
y.create.l HWIO_W_DBACK_HS_SHARED_WORD14_ADDR A:0xfcb4c138
y.create.l HWIO_W_DBACK_HS_SHARED_WORD15_ADDR A:0xfcb4c13c
y.create.l HWIO_W_DBACK_HS_SHARED_WORD16_ADDR A:0xfcb4c140
y.create.l HWIO_W_DBACK_HS_SHARED_WORD17_ADDR A:0xfcb4c144
y.create.l HWIO_W_DBACK_HS_SHARED_WORD18_ADDR A:0xfcb4c148
y.create.l HWIO_W_DBACK_HS_SHARED_WORD19_ADDR A:0xfcb4c14c
y.create.l HWIO_W_DBACK_HS_SHARED_WORD20_ADDR A:0xfcb4c150
y.create.l HWIO_W_DBACK_HS_SHARED_WORD21_ADDR A:0xfcb4c154
y.create.l HWIO_W_DBACK_HS_SHARED_WORD22_ADDR A:0xfcb4c158
y.create.l HWIO_W_DBACK_HS_SHARED_WORD23_ADDR A:0xfcb4c15c
y.create.l HWIO_W_DBACK_HS_SHARED_WORD24_ADDR A:0xfcb4c160
y.create.l HWIO_W_DBACK_HS_SHARED_WORD25_ADDR A:0xfcb4c164
y.create.l HWIO_W_DBACK_HS_SHARED_WORD26_ADDR A:0xfcb4c168
y.create.l HWIO_W_DBACK_HS_SHARED_WORD27_ADDR A:0xfcb4c16c
y.create.l HWIO_W_DBACK_HS_SHARED_WORD28_ADDR A:0xfcb4c170
y.create.l HWIO_W_DBACK_HS_SHARED_WORD29_ADDR A:0xfcb4c174
y.create.l HWIO_W_DBACK_HS_SHARED_WORD30_ADDR A:0xfcb4c178
y.create.l HWIO_W_DBACK_HS_SHARED_WORD31_ADDR A:0xfcb4c17c
y.create.l HWIO_W_DBACK_HS_SHARED_WORD32_ADDR A:0xfcb4c180
y.create.l HWIO_W_DBACK_HS_SHARED_WORD33_ADDR A:0xfcb4c184
y.create.l HWIO_W_DBACK_HS_SHARED_WORD34_ADDR A:0xfcb4c188
y.create.l HWIO_W_DBACK_HS_SHARED_WORD35_ADDR A:0xfcb4c18c
y.create.l HWIO_W_DBACK_HS_SHARED_WORD36_ADDR A:0xfcb4c190
y.create.l HWIO_W_DBACK_HS_SHARED_WORD37_ADDR A:0xfcb4c194
y.create.l HWIO_W_DBACK_HS_SHARED_WORD38_ADDR A:0xfcb4c198
y.create.l HWIO_W_DBACK_HS_SHARED_WORD39_ADDR A:0xfcb4c19c
y.create.l HWIO_W_DBACK_HS_SHARED_WORD40_ADDR A:0xfcb4c1a0
y.create.l HWIO_W_DBACK_HS_SHARED_WORD41_ADDR A:0xfcb4c1a4
y.create.l HWIO_W_DBACK_HS_SHARED_WORD42_ADDR A:0xfcb4c1a8
y.create.l HWIO_W_DBACK_HS_SHARED_WORD43_ADDR A:0xfcb4c1ac
y.create.l HWIO_W_DBACK_HS_SHARED_WORD44_ADDR A:0xfcb4c1b0
y.create.l HWIO_W_DBACK_HS_SHARED_WORD45_ADDR A:0xfcb4c1b4
y.create.l HWIO_W_DBACK_HS_SHARED_WORD46_ADDR A:0xfcb4c1b8
y.create.l HWIO_W_DBACK_HS_SHARED_WORD47_ADDR A:0xfcb4c1bc
y.create.l HWIO_W_DBACK_HS_SHARED_WORD48_ADDR A:0xfcb4c1c0
y.create.l HWIO_W_DBACK_HS_SHARED_WORD49_ADDR A:0xfcb4c1c4
y.create.l HWIO_W_DBACK_HS_SHARED_WORD50_ADDR A:0xfcb4c1c8
y.create.l HWIO_W_DBACK_HS_SHARED_WORD51_ADDR A:0xfcb4c1cc
y.create.l HWIO_W_DBACK_HS_SHARED_WORD52_ADDR A:0xfcb4c1d0
y.create.l HWIO_W_DBACK_HS_SHARED_WORD53_ADDR A:0xfcb4c1d4
y.create.l HWIO_W_DBACK_HS_SHARED_WORD54_ADDR A:0xfcb4c1d8
y.create.l HWIO_W_DBACK_HS_SHARED_WORD55_ADDR A:0xfcb4c1dc
y.create.l HWIO_W_DBACK_HS_SHARED_WORD56_ADDR A:0xfcb4c1e0
y.create.l HWIO_W_DBACK_HS_SHARED_WORD57_ADDR A:0xfcb4c1e4
y.create.l HWIO_W_DBACK_HS_TD_DECIB_WRITER_WORD0_ADDR A:0xfcb4c200
y.create.l HWIO_W_DBACK_HS_TD_DECIB_WRITER_CFG_WORD0_ADDR A:0xfcb4c300
y.create.l HWIO_W_DBACK_HS_TD_DECIB_WRITER_CFG_WORD1_ADDR A:0xfcb4c304
y.create.l HWIO_W_DBACK_HS_TD_DECIB_WRITER_CFG_WORD2_ADDR A:0xfcb4c308
y.create.l HWIO_W_DBACK_HS_TD_DECIB_WRITER_CFG_WORD3_ADDR A:0xfcb4c30c
y.create.l HWIO_W_DBACK_HS_TD_DECIB_WRITER_CFG_WORD4_ADDR A:0xfcb4c310
y.create.l HWIO_W_DBACK_HS_TD_DECIB_WRITER_CFG_WORD5_ADDR A:0xfcb4c314
y.create.l HWIO_W_DBACK_HS_TD_DECIB_WRITER_CFG_WORD6_ADDR A:0xfcb4c318
y.create.l HWIO_W_DBACK_HS_TD_DECIB_WRITER_CFG_WORD7_ADDR A:0xfcb4c31c
y.create.l HWIO_W_DBACK_NONHS_SHARED_WORD0_ADDR A:0xfcb4d100
y.create.l HWIO_W_DBACK_NONHS_SHARED_WORD1_ADDR A:0xfcb4d104
y.create.l HWIO_W_DBACK_NONHS_SHARED_WORD2_ADDR A:0xfcb4d108
y.create.l HWIO_W_DBACK_NONHS_SHARED_WORD3_ADDR A:0xfcb4d10c
y.create.l HWIO_W_DBACK_NONHS_SHARED_WORD4_ADDR A:0xfcb4d110
y.create.l HWIO_W_DBACK_NONHS_SHARED_WORD5_ADDR A:0xfcb4d114
y.create.l HWIO_W_DBACK_NONHS_SHARED_WORD6_ADDR A:0xfcb4d118
y.create.l HWIO_W_DBACK_NONHS_SHARED_WORD7_ADDR A:0xfcb4d11c
y.create.l HWIO_W_DBACK_NONHS_DRM_CFG_WORD0_ADDR A:0xfcb4d200
y.create.l HWIO_W_DBACK_NONHS_DRM_CFG_WORD1_ADDR A:0xfcb4d204
y.create.l HWIO_W_DBACK_NONHS_DRM_CFG_WORD2_ADDR A:0xfcb4d208
y.create.l HWIO_W_DBACK_NONHS_DRM_CFG_WORD3_ADDR A:0xfcb4d20c
y.create.l HWIO_W_DBACK_NONHS_DRM_CFG_WORD4_ADDR A:0xfcb4d210
y.create.l HWIO_W_DBACK_NONHS_DRM_CFG_WORD5_ADDR A:0xfcb4d214
y.create.l HWIO_W_DBACK_NONHS_DRM_CFG_WORD6_ADDR A:0xfcb4d218
y.create.l HWIO_W_DBACK_NONHS_DRM_CFG_WORD7_ADDR A:0xfcb4d21c
y.create.l HWIO_W_DBACK_NONHS_DRM_CFG_WORD8_ADDR A:0xfcb4d220
y.create.l HWIO_W_DBACK_NONHS_DRM_CFG_WORD9_ADDR A:0xfcb4d224
y.create.l HWIO_W_DBACK_NONHS_DRM_CFG_WORD10_ADDR A:0xfcb4d228
y.create.l HWIO_W_DBACK_NONHS_DRM_CFG_WORD11_ADDR A:0xfcb4d22c
y.create.l HWIO_W_DBACK_NONHS_DRM_CFG_WORD12_ADDR A:0xfcb4d230
y.create.l HWIO_W_DBACK_NONHS_DRM_CFG_WORD13_ADDR A:0xfcb4d234
y.create.l HWIO_W_DBACK_NONHS_DRM_CFG_WORD14_ADDR A:0xfcb4d238
y.create.l HWIO_W_DBACK_NONHS_DRM_CFG_WORD15_ADDR A:0xfcb4d23c
y.create.l HWIO_W_DBACK_NONHS_TD_DECIB_WRITER_CFG_WORD0_ADDR A:0xfcb4d300
y.create.l HWIO_W_DBACK_NONHS_TD_DECIB_WRITER_CFG_WORD1_ADDR A:0xfcb4d304
y.create.l HWIO_T_DBACK_SHARED_WORD0_ADDR A:0xfcb4e100
y.create.l HWIO_T_DBACK_SHARED_WORD1_ADDR A:0xfcb4e104
y.create.l HWIO_T_DBACK_SHARED_WORD2_ADDR A:0xfcb4e108
y.create.l HWIO_T_DBACK_SHARED_WORD3_ADDR A:0xfcb4e10c
y.create.l HWIO_T_DBACK_SHARED_WORD4_ADDR A:0xfcb4e110
y.create.l HWIO_T_DBACK_SHARED_WORD5_ADDR A:0xfcb4e114
y.create.l HWIO_T_DBACK_SHARED_WORD6_ADDR A:0xfcb4e118
y.create.l HWIO_T_DBACK_SHARED_WORD7_ADDR A:0xfcb4e11c
y.create.l HWIO_T_DBACK_SHARED_WORD8_ADDR A:0xfcb4e120
y.create.l HWIO_T_DBACK_SHARED_WORD9_ADDR A:0xfcb4e124
y.create.l HWIO_T_DBACK_SHARED_WORD10_ADDR A:0xfcb4e128
y.create.l HWIO_T_DBACK_SHARED_WORD11_ADDR A:0xfcb4e12c
y.create.l HWIO_T_DBACK_SHARED_WORD12_ADDR A:0xfcb4e130
y.create.l HWIO_T_DBACK_SHARED_WORD13_ADDR A:0xfcb4e134
y.create.l HWIO_T_DBACK_SHARED_WORD14_ADDR A:0xfcb4e138
y.create.l HWIO_T_DBACK_SHARED_WORD15_ADDR A:0xfcb4e13c
y.create.l HWIO_T_DBACK_SHARED_WORD16_ADDR A:0xfcb4e140
y.create.l HWIO_T_DBACK_SHARED_WORD17_ADDR A:0xfcb4e144
y.create.l HWIO_T_DBACK_SHARED_WORD18_ADDR A:0xfcb4e148
y.create.l HWIO_T_DBACK_SHARED_WORD19_ADDR A:0xfcb4e14c
y.create.l HWIO_T_DBACK_SHARED_WORD20_ADDR A:0xfcb4e150
y.create.l HWIO_T_DBACK_SHARED_WORD21_ADDR A:0xfcb4e154
y.create.l HWIO_T_DBACK_SHARED_WORD22_ADDR A:0xfcb4e158
y.create.l HWIO_T_DBACK_SHARED_WORD23_ADDR A:0xfcb4e15c
y.create.l HWIO_T_DBACK_SHARED_WORD24_ADDR A:0xfcb4e160
y.create.l HWIO_T_DBACK_SHARED_WORD25_ADDR A:0xfcb4e164
y.create.l HWIO_T_DBACK_SHARED_WORD26_ADDR A:0xfcb4e168
y.create.l HWIO_T_DBACK_SHARED_WORD27_ADDR A:0xfcb4e16c
y.create.l HWIO_T_DBACK_SHARED_WORD28_ADDR A:0xfcb4e170
y.create.l HWIO_T_DBACK_SHARED_WORD29_ADDR A:0xfcb4e174
y.create.l HWIO_T_DBACK_SHARED_WORD30_ADDR A:0xfcb4e178
y.create.l HWIO_T_DBACK_SHARED_WORD31_ADDR A:0xfcb4e17c
y.create.l HWIO_T_DBACK_SHARED_WORD32_ADDR A:0xfcb4e180
y.create.l HWIO_T_DBACK_SHARED_WORD33_ADDR A:0xfcb4e184
y.create.l HWIO_T_DBACK_SHARED_WORD34_ADDR A:0xfcb4e188
y.create.l HWIO_T_DBACK_SHARED_WORD35_ADDR A:0xfcb4e18c
y.create.l HWIO_T_DBACK_SHARED_WORD36_ADDR A:0xfcb4e190
y.create.l HWIO_T_DBACK_SHARED_WORD37_ADDR A:0xfcb4e194
y.create.l HWIO_T_DBACK_SHARED_WORD38_ADDR A:0xfcb4e198
y.create.l HWIO_T_DBACK_NONHS_DRM_CFG_WORD0_ADDR A:0xfcb4e200
y.create.l HWIO_T_DBACK_NONHS_DRM_CFG_WORD1_ADDR A:0xfcb4e204
y.create.l HWIO_T_DBACK_NONHS_DRM_CFG_WORD2_ADDR A:0xfcb4e208
y.create.l HWIO_T_DBACK_NONHS_DRM_CFG_WORD3_ADDR A:0xfcb4e20c
y.create.l HWIO_T_DBACK_NONHS_DRM_CFG_WORD4_ADDR A:0xfcb4e210
y.create.l HWIO_T_DBACK_NONHS_DRM_CFG_WORD5_ADDR A:0xfcb4e214
y.create.l HWIO_T_DBACK_NONHS_DRM_CFG_WORD6_ADDR A:0xfcb4e218
y.create.l HWIO_T_DBACK_NONHS_DRM_CFG_WORD7_ADDR A:0xfcb4e21c
y.create.l HWIO_T_DBACK_NONHS_DRM_CFG_WORD8_ADDR A:0xfcb4e220
y.create.l HWIO_T_DBACK_NONHS_DRM_CFG_WORD9_ADDR A:0xfcb4e224
y.create.l HWIO_T_DBACK_NONHS_DRM_CFG_WORD10_ADDR A:0xfcb4e228
y.create.l HWIO_T_DBACK_NONHS_DRM_CFG_WORD11_ADDR A:0xfcb4e22c
y.create.l HWIO_T_DBACK_NONHS_DRM_CFG_WORD12_ADDR A:0xfcb4e230
y.create.l HWIO_T_DBACK_NONHS_DRM_CFG_WORD13_ADDR A:0xfcb4e234
y.create.l HWIO_T_DBACK_NONHS_DRM_CFG_WORD14_ADDR A:0xfcb4e238
y.create.l HWIO_T_DBACK_NONHS_DRM_CFG_WORD15_ADDR A:0xfcb4e23c
y.create.l HWIO_T_DBACK_NONHS_DRM_CFG_WORD16_ADDR A:0xfcb4e240
y.create.l HWIO_T_DBACK_NONHS_DRM_CFG_WORD17_ADDR A:0xfcb4e244
y.create.l HWIO_T_DBACK_NONHS_DRM_CFG_WORD18_ADDR A:0xfcb4e248
y.create.l HWIO_T_DBACK_NONHS_DRM_CFG_WORD19_ADDR A:0xfcb4e24c
y.create.l HWIO_T_DBACK_NONHS_DRM_CFG_WORD20_ADDR A:0xfcb4e250
y.create.l HWIO_T_DBACK_NONHS_DRM_CFG_WORD21_ADDR A:0xfcb4e254
y.create.l HWIO_T_DBACK_NONHS_DRM_CFG_WORD22_ADDR A:0xfcb4e258
y.create.l HWIO_T_DBACK_NONHS_DRM_CFG_WORD23_ADDR A:0xfcb4e25c
y.create.l HWIO_T_DBACK_NONHS_DRM_CFG_WORD24_ADDR A:0xfcb4e260
y.create.l HWIO_T_DBACK_NONHS_DRM_CFG_WORD25_ADDR A:0xfcb4e264
y.create.l HWIO_T_DBACK_NONHS_TD_DECIB_WRITER_CFG_WORD0_ADDR A:0xfcb4e300
y.create.l HWIO_T_DBACK_NONHS_TD_DECIB_WRITER_CFG_WORD1_ADDR A:0xfcb4e304
y.create.l HWIO_T_DBACK_HS_TD_DECIB_WRITER_CFG_WORD0_ADDR A:0xfcb4e400
y.create.l HWIO_T_DBACK_HS_TD_DECIB_WRITER_CFG_WORD1_ADDR A:0xfcb4e404
y.create.l HWIO_T_DBACK_HS_TD_DECIB_WRITER_CFG_WORD2_ADDR A:0xfcb4e408
y.create.l HWIO_T_DBACK_HS_TD_DECIB_WRITER_CFG_WORD3_ADDR A:0xfcb4e40c
y.create.l HWIO_T_DBACK_HS_TD_DECIB_WRITER_CFG_WORD4_ADDR A:0xfcb4e410
y.create.l HWIO_T_DBACK_HS_TD_DECIB_WRITER_CFG_WORD5_ADDR A:0xfcb4e414
y.create.l HWIO_T_DBACK_HS_TD_DECIB_WRITER_CFG_WORD6_ADDR A:0xfcb4e418
y.create.l HWIO_T_DBACK_HS_TD_DECIB_WRITER_CFG_WORD7_ADDR A:0xfcb4e41c
y.create.l HWIO_HDR_DEINT_CFG_WORD0_ADDR A:0xfcb4f100
y.create.l HWIO_HDR_DEINT_CFG_WORD1_ADDR A:0xfcb4f104
y.create.l HWIO_HDR_DEINT_CFG_WORD2_ADDR A:0xfcb4f108
y.create.l HWIO_HDR_DEINT_CFG_WORD3_ADDR A:0xfcb4f10c
y.create.l HWIO_HDR_DEINT_CFG_WORD4_ADDR A:0xfcb4f110
y.create.l HWIO_HDR_DEINT_CFG_WORD5_ADDR A:0xfcb4f114
y.create.l HWIO_HDR_DEINT_CFG_WORD6_ADDR A:0xfcb4f118
y.create.l HWIO_HDR_DEINT_CFG_WORD7_ADDR A:0xfcb4f11c
y.create.l HWIO_HDR_DEINT_CFG_WORD8_ADDR A:0xfcb4f120
y.create.l HWIO_HDR_DEINT_CFG_WORD9_ADDR A:0xfcb4f124
y.create.l HWIO_HDR_DEINT_CFG_WORD10_ADDR A:0xfcb4f128
y.create.l HWIO_HDR_DEINT_CFG_WORD11_ADDR A:0xfcb4f12c
y.create.l HWIO_HDR_DEINT_CFG_WORD12_ADDR A:0xfcb4f130
y.create.l HWIO_HDR_DEINT_CFG_WORD13_ADDR A:0xfcb4f134
y.create.l HWIO_HDR_DEINT_CFG_WORD14_ADDR A:0xfcb4f138
y.create.l HWIO_HDR_DEINT_CFG_WORD15_ADDR A:0xfcb4f13c
y.create.l HWIO_HDR_DEINT_CFG_WORD16_ADDR A:0xfcb4f140
y.create.l HWIO_HDR_DEINT_WORD0_ADDR A:0xfcb4f200
y.create.l HWIO_HDR_DEINT_WORD1_ADDR A:0xfcb4f204
y.create.l HWIO_HDR_DEINT_WORD2_ADDR A:0xfcb4f208
y.create.l HWIO_HDR_DEINT_WORD3_ADDR A:0xfcb4f20c
y.create.l HWIO_HDR_DEINT_WORD4_ADDR A:0xfcb4f210
y.create.l HWIO_HDR_DEINT_WORD5_ADDR A:0xfcb4f214
y.create.l HWIO_HDR_DEINT_WORD6_ADDR A:0xfcb4f218
y.create.l HWIO_HDR_DEINT_WORD7_ADDR A:0xfcb4f21c
y.create.l HWIO_HDR_DEINT_WORD8_ADDR A:0xfcb4f220
y.create.l HWIO_HDR_DEINT_WORD9_ADDR A:0xfcb4f224
y.create.l HWIO_HDR_DEINT_WORD10_ADDR A:0xfcb4f228
y.create.l HWIO_HDR_DEINT_WORD11_ADDR A:0xfcb4f22c
y.create.l HWIO_HDR_DEINT_WORD12_ADDR A:0xfcb4f230
y.create.l HWIO_HDR_DEINT_WORD13_ADDR A:0xfcb4f234
y.create.l HWIO_DEMBACK_BUFF_MODE_ADDR A:0xfcb54004
y.create.l HWIO_DEMBACK_BUFF_MEM_CMD_ADDR A:0xfcb54010
y.create.l HWIO_DEMBACK_BUFF_MEM_WR_ADDR A:0xfcb54014
y.create.l HWIO_DEMBACK_BUFF_MEM_RD_ADDR A:0xfcb54018
y.create.l HWIO_DEMBACK_BUFF_SVD_DECOB_RD_MIN_ADDR A:0xfcb56000
y.create.l HWIO_DEMBACK_BUFF_SVD_DECOB_RD_MAX_ADDR A:0xfcb56d7c
y.create.l HWIO_TDEC_CLK_CTL_ADDR A:0xfcb3c000
y.create.l HWIO_TDEC_SW_CLK_EN_ADDR A:0xfcb3c004
y.create.l HWIO_TDEC_CLK_STATUS_REG_ADDR A:0xfcb3c008
y.create.l HWIO_TDEC_MODE_CTL_ADDR A:0xfcb3c00c
y.create.l HWIO_TDECIB_CLK_STATUS_ADDR A:0xfcb3c018
y.create.l HWIO_TD_COMMON_CFG0_ADDR A:0xfcb3c020
y.create.l HWIO_TD_COMMON_CFG1_ADDR A:0xfcb3c024
y.create.l HWIO_TD_COMMON_CFG2_ADDR A:0xfcb3c028
y.create.l HWIO_TD_COMMON_CFG3_ADDR A:0xfcb3c02c
y.create.l HWIO_TD_COMMON_CFG4_ADDR A:0xfcb3c030
y.create.l HWIO_TD_COMMON_CFG5_ADDR A:0xfcb3c034
y.create.l HWIO_TD_COMMON_START_ADDR A:0xfcb3c038
y.create.l HWIO_TD_1X_CFG_ADDR A:0xfcb3c03c
y.create.l HWIO_TD_1X_DECOB_WRITE_PTR_ADDR A:0xfcb3c040
y.create.l HWIO_TDEC_HW_IDLE_ADDR A:0xfcb3c044
y.create.l HWIO_TDEC_PING_STATUS_0_ADDR A:0xfcb3c048
y.create.l HWIO_TDEC_PING_STATUS_1_ADDR A:0xfcb3c04c
y.create.l HWIO_TDEC_PONG_STATUS_0_ADDR A:0xfcb3c050
y.create.l HWIO_TDEC_PONG_STATUS_1_ADDR A:0xfcb3c054
y.create.l HWIO_TDEC_GERAN_STATUS_0_ADDR A:0xfcb3c058
y.create.l HWIO_TDEC_GERAN_STATUS_1_ADDR A:0xfcb3c05c
y.create.l HWIO_TDEC_TESTBUS_ENABLE_ADDR A:0xfcb3c060
y.create.l HWIO_TDEC_TESTBUS_STATUS_ADDR A:0xfcb3c064
y.create.l HWIO_DECIB_PAGE_ID_ADDR A:0xfcb3c068
y.create.l HWIO_TDEC_AHB_ERROR_ADDR_RD_ADDR A:0xfcb3c070
y.create.l HWIO_TD_CFG_STATUS_WORD0_ADDR A:0xfcb3d000
y.create.l HWIO_W_TD_CFG_WORD0_0_ADDR A:0xfcb3d100
y.create.l HWIO_W_TD_CFG_WORD1_0_ADDR A:0xfcb3d104
y.create.l HWIO_W_TD_CFG_WORD2_0_ADDR A:0xfcb3d108
y.create.l HWIO_W_TD_CFG_WORD3_0_ADDR A:0xfcb3d10c
y.create.l HWIO_W_TD_CFG_WORD4_0_ADDR A:0xfcb3d110
y.create.l HWIO_W_TD_CFG_WORD5_0_ADDR A:0xfcb3d114
y.create.l HWIO_W_TD_CFG_WORD6_0_ADDR A:0xfcb3d118
y.create.l HWIO_W_TD_CFG_WORD7_0_ADDR A:0xfcb3d11c
y.create.l HWIO_W_TD_CFG_WORD8_0_ADDR A:0xfcb3d120
y.create.l HWIO_W_TD_CFG_WORD9_0_ADDR A:0xfcb3d124
y.create.l HWIO_W_TD_CFG_WORD0_1_ADDR A:0xfcb3d200
y.create.l HWIO_W_TD_CFG_WORD1_1_ADDR A:0xfcb3d204
y.create.l HWIO_W_TD_CFG_WORD2_1_ADDR A:0xfcb3d208
y.create.l HWIO_W_TD_CFG_WORD3_1_ADDR A:0xfcb3d20c
y.create.l HWIO_W_TD_CFG_WORD4_1_ADDR A:0xfcb3d210
y.create.l HWIO_W_TD_CFG_WORD5_1_ADDR A:0xfcb3d214
y.create.l HWIO_W_TD_CFG_WORD6_1_ADDR A:0xfcb3d218
y.create.l HWIO_W_TD_CFG_WORD7_1_ADDR A:0xfcb3d21c
y.create.l HWIO_W_TD_CFG_WORD8_1_ADDR A:0xfcb3d220
y.create.l HWIO_W_TD_CFG_WORD9_1_ADDR A:0xfcb3d224
y.create.l HWIO_GERAN_TD_CFG_WORD0_0_ADDR A:0xfcb3d300
y.create.l HWIO_GERAN_TD_CFG_WORD1_0_ADDR A:0xfcb3d304
y.create.l HWIO_GERAN_TD_CFG_WORD2_0_ADDR A:0xfcb3d308
y.create.l HWIO_GERAN_TD_CFG_WORD3_0_ADDR A:0xfcb3d30c
y.create.l HWIO_GERAN_TD_CFG_WORD0_1_ADDR A:0xfcb3d400
y.create.l HWIO_GERAN_TD_CFG_WORD1_1_ADDR A:0xfcb3d404
y.create.l HWIO_GERAN_TD_CFG_WORD2_1_ADDR A:0xfcb3d408
y.create.l HWIO_GERAN_TD_CFG_WORD3_1_ADDR A:0xfcb3d40c
y.create.l HWIO_HDR_TD_CFG_WORD0_0_ADDR A:0xfcb3d500
y.create.l HWIO_HDR_TD_CFG_WORD1_0_ADDR A:0xfcb3d504
y.create.l HWIO_HDR_TD_CFG_WORD2_0_ADDR A:0xfcb3d508
y.create.l HWIO_HDR_TD_CFG_WORD0_1_ADDR A:0xfcb3d600
y.create.l HWIO_HDR_TD_CFG_WORD1_1_ADDR A:0xfcb3d604
y.create.l HWIO_HDR_TD_CFG_WORD2_1_ADDR A:0xfcb3d608
y.create.l HWIO_TD_STATUS_WORD0_ADDR A:0xfcb3e000
y.create.l HWIO_W_TD_WORD0_0_ADDR A:0xfcb3e100
y.create.l HWIO_W_TD_WORD0_1_ADDR A:0xfcb3e200
y.create.l HWIO_GERAN_TD_WORD0_0_ADDR A:0xfcb3e300
y.create.l HWIO_GERAN_TD_WORD1_0_ADDR A:0xfcb3e304
y.create.l HWIO_GERAN_TD_WORD2_0_ADDR A:0xfcb3e308
y.create.l HWIO_GERAN_TD_WORD3_0_ADDR A:0xfcb3e30c
y.create.l HWIO_GERAN_TD_WORD4_0_ADDR A:0xfcb3e310
y.create.l HWIO_GERAN_TD_WORD5_0_ADDR A:0xfcb3e314
y.create.l HWIO_GERAN_TD_WORD6_0_ADDR A:0xfcb3e318
y.create.l HWIO_GERAN_TD_WORD0_1_ADDR A:0xfcb3e400
y.create.l HWIO_GERAN_TD_WORD1_1_ADDR A:0xfcb3e404
y.create.l HWIO_GERAN_TD_WORD2_1_ADDR A:0xfcb3e408
y.create.l HWIO_GERAN_TD_WORD3_1_ADDR A:0xfcb3e40c
y.create.l HWIO_GERAN_TD_WORD4_1_ADDR A:0xfcb3e410
y.create.l HWIO_GERAN_TD_WORD5_1_ADDR A:0xfcb3e414
y.create.l HWIO_GERAN_TD_WORD6_1_ADDR A:0xfcb3e418
y.create.l HWIO_HDR_TD_WORD0_0_ADDR A:0xfcb3e500
y.create.l HWIO_HDR_TD_WORD1_0_ADDR A:0xfcb3e504
y.create.l HWIO_HDR_TD_WORD2_0_ADDR A:0xfcb3e508
y.create.l HWIO_HDR_TD_WORD3_0_ADDR A:0xfcb3e50c
y.create.l HWIO_HDR_TD_WORD4_0_ADDR A:0xfcb3e510
y.create.l HWIO_HDR_TD_WORD5_0_ADDR A:0xfcb3e514
y.create.l HWIO_HDR_TD_WORD0_1_ADDR A:0xfcb3e600
y.create.l HWIO_HDR_TD_WORD1_1_ADDR A:0xfcb3e604
y.create.l HWIO_HDR_TD_WORD2_1_ADDR A:0xfcb3e608
y.create.l HWIO_HDR_TD_WORD3_1_ADDR A:0xfcb3e60c
y.create.l HWIO_HDR_TD_WORD4_1_ADDR A:0xfcb3e610
y.create.l HWIO_HDR_TD_WORD5_1_ADDR A:0xfcb3e614
y.create.l HWIO_TDECIB_MEM_START_ADDR A:0xfcb3f000
y.create.l HWIO_TDECIB_MEM_END_ADDR A:0xfcb3fffc
y.create.l HWIO_USRCH_STATUS_ADDR A:0xfcb30000
y.create.l HWIO_USRCH_CONFIG_WORD0_ADDR A:0xfcb30100
y.create.l HWIO_USRCH_ACC_WORD0_ADDR A:0xfcb30200
y.create.l HWIO_USRCH_ACC_WORD1_ADDR A:0xfcb30204
y.create.l HWIO_USRCH_ACC_WORD2_ADDR A:0xfcb30208
y.create.l HWIO_USRCH_ACC_WORD3_ADDR A:0xfcb3020c
y.create.l HWIO_USRCH_ACC_WORD4_ADDR A:0xfcb30210
y.create.l HWIO_USRCH_ACC_WORD5_ADDR A:0xfcb30214
y.create.l HWIO_USRCH_ACC_WORD6_ADDR A:0xfcb30218
y.create.l HWIO_USRCH_ACC_WORD7_ADDR A:0xfcb3021c
y.create.l HWIO_USRCH_PEAK_SORT_WORD0_ADDR A:0xfcb30300
y.create.l HWIO_USRCH_PEAK_SORT_WORD1_ADDR A:0xfcb30304
y.create.l HWIO_USRCH_PEAK_SORT_WORD2_ADDR A:0xfcb30308
y.create.l HWIO_USRCH_PEAK_SORT_WORD3_ADDR A:0xfcb3030c
y.create.l HWIO_USRCH_PEAK_SORT_WORD4_ADDR A:0xfcb30310
y.create.l HWIO_USRCH_CMD_WORD0_ADDR A:0xfcb30400
y.create.l HWIO_USRCH_STATUS_BUS_0_ADDR A:0xfcb30500
y.create.l HWIO_USRCH_STATUS_BUS_1_ADDR A:0xfcb30504
y.create.l HWIO_USRCH_STATUS_BUS_2_ADDR A:0xfcb30508
y.create.l HWIO_USRCH_STATUS_BUS_3_ADDR A:0xfcb3050c
y.create.l HWIO_USRCH_STATUS_BUS_4_ADDR A:0xfcb30510
y.create.l HWIO_USRCH_STATUS_BUS_5_ADDR A:0xfcb30514
y.create.l HWIO_USRCH_STATUS_BUS_6_ADDR A:0xfcb30518
y.create.l HWIO_USRCH_STATUS_BUS_7_ADDR A:0xfcb3051c
y.create.l HWIO_USRCH_STATUS_BUS_8_ADDR A:0xfcb30520
y.create.l HWIO_USRCH_STATUS_BUS_9_ADDR A:0xfcb30524
y.create.l HWIO_USRCH_STATUS_BUS_10_ADDR A:0xfcb30528
y.create.l HWIO_USRCH_STATUS_BUS_11_ADDR A:0xfcb3052c
y.create.l HWIO_USRCH_STATUS_BUS_12_ADDR A:0xfcb30530
y.create.l HWIO_USRCH_STATUS_BUS_13_ADDR A:0xfcb30534
y.create.l HWIO_USRCH_STATUS_BUS_14_ADDR A:0xfcb30538
y.create.l HWIO_USRCH_STATUS_BUS_15_ADDR A:0xfcb3053c
y.create.l HWIO_USRCH_STATUS_BUS_16_ADDR A:0xfcb30540
y.create.l HWIO_USRCH_STATUS_BUS_17_ADDR A:0xfcb30544
y.create.l HWIO_USRCH_STATUS_BUS_18_ADDR A:0xfcb30548
y.create.l HWIO_USRCH_STATUS_BUS_19_ADDR A:0xfcb3054c
y.create.l HWIO_USRCH_STATUS_BUS_20_ADDR A:0xfcb30550
y.create.l HWIO_USRCH_STATUS_BUS_21_ADDR A:0xfcb30554
y.create.l HWIO_USRCH_STATUS_BUS_22_ADDR A:0xfcb30558
y.create.l HWIO_USRCH_STATUS_BUS_23_ADDR A:0xfcb3055c
y.create.l HWIO_USRCH_STATUS_BUS_24_ADDR A:0xfcb30560
y.create.l HWIO_USRCH_STATUS_BUS_25_ADDR A:0xfcb30564
y.create.l HWIO_USRCH_STATUS_BUS_26_ADDR A:0xfcb30568
y.create.l HWIO_USRCH_STATUS_BUS_27_ADDR A:0xfcb3056c
y.create.l HWIO_USRCH_STATUS_BUS_28_ADDR A:0xfcb30570
y.create.l HWIO_USRCH_STATUS_BUS_29_ADDR A:0xfcb30574
y.create.l HWIO_USRCH_STATUS_BUS_30_ADDR A:0xfcb30578
y.create.l HWIO_USRCH_STATUS_BUS_31_ADDR A:0xfcb3057c
y.create.l HWIO_USRCH_PS_RESULT_0_ADDR A:0xfcb30580
y.create.l HWIO_USRCH_PS_RESULT_1_WORD0_ADDR A:0xfcb30584
y.create.l HWIO_USRCH_PS_RESULT_1_WORD1_ADDR A:0xfcb30588
y.create.l HWIO_DEMSS_RDR0_CFG0_ADDR A:0xfcb32000
y.create.l HWIO_DEMSS_RDR0_CFG1_ADDR A:0xfcb32004
y.create.l HWIO_DEMSS_RDR0_XFER_CTL_ADDR A:0xfcb32008
y.create.l HWIO_DEMSS_RDR1_CFG0_0_ADDR A:0xfcb3200c
y.create.l HWIO_DEMSS_RDR1_CFG0_1_ADDR A:0xfcb32014
y.create.l HWIO_DEMSS_RDR1_CFG1_0_ADDR A:0xfcb32010
y.create.l HWIO_DEMSS_RDR1_CFG1_1_ADDR A:0xfcb32018
y.create.l HWIO_DEMSS_RDR1_XFER_CTL_ADDR A:0xfcb3201c
y.create.l HWIO_DEMSS_RDR2_CFG0_ADDR A:0xfcb32020
y.create.l HWIO_DEMSS_RDR2_CFG1_ADDR A:0xfcb32024
y.create.l HWIO_DEMSS_RDR2_XFER_CTL_ADDR A:0xfcb32028
y.create.l HWIO_DEMSS_RDR3_CFG0_0_ADDR A:0xfcb3202c
y.create.l HWIO_DEMSS_RDR3_CFG0_1_ADDR A:0xfcb32034
y.create.l HWIO_DEMSS_RDR3_CFG0_2_ADDR A:0xfcb3203c
y.create.l HWIO_DEMSS_RDR3_CFG0_3_ADDR A:0xfcb32044
y.create.l HWIO_DEMSS_RDR3_CFG0_4_ADDR A:0xfcb3204c
y.create.l HWIO_DEMSS_RDR3_CFG0_5_ADDR A:0xfcb32054
y.create.l HWIO_DEMSS_RDR3_CFG0_6_ADDR A:0xfcb3205c
y.create.l HWIO_DEMSS_RDR3_CFG0_7_ADDR A:0xfcb32064
y.create.l HWIO_DEMSS_RDR3_CFG1_0_ADDR A:0xfcb32030
y.create.l HWIO_DEMSS_RDR3_CFG1_1_ADDR A:0xfcb32038
y.create.l HWIO_DEMSS_RDR3_CFG1_2_ADDR A:0xfcb32040
y.create.l HWIO_DEMSS_RDR3_CFG1_3_ADDR A:0xfcb32048
y.create.l HWIO_DEMSS_RDR3_CFG1_4_ADDR A:0xfcb32050
y.create.l HWIO_DEMSS_RDR3_CFG1_5_ADDR A:0xfcb32058
y.create.l HWIO_DEMSS_RDR3_CFG1_6_ADDR A:0xfcb32060
y.create.l HWIO_DEMSS_RDR3_CFG1_7_ADDR A:0xfcb32068
y.create.l HWIO_DEMSS_RDR3_XFER_CTL_ADDR A:0xfcb3206c
y.create.l HWIO_DEMSS_RDR4_CFG0_0_ADDR A:0xfcb32070
y.create.l HWIO_DEMSS_RDR4_CFG0_1_ADDR A:0xfcb32078
y.create.l HWIO_DEMSS_RDR4_CFG0_2_ADDR A:0xfcb32080
y.create.l HWIO_DEMSS_RDR4_CFG0_3_ADDR A:0xfcb32088
y.create.l HWIO_DEMSS_RDR4_CFG1_0_ADDR A:0xfcb32074
y.create.l HWIO_DEMSS_RDR4_CFG1_1_ADDR A:0xfcb3207c
y.create.l HWIO_DEMSS_RDR4_CFG1_2_ADDR A:0xfcb32084
y.create.l HWIO_DEMSS_RDR4_CFG1_3_ADDR A:0xfcb3208c
y.create.l HWIO_DEMSS_RDR4_XFER_CTL_ADDR A:0xfcb32090
y.create.l HWIO_DEMSS_BRDG_CTL_ADDR A:0xfcb32094
y.create.l HWIO_DEMSS_BRDG_STATUS_ADDR A:0xfcb32098
y.create.l HWIO_DEMSS_BRDG_CLEAR_ADDR A:0xfcb3209c
y.create.l HWIO_QLIC_TASK_FIFO_START_ADDR A:0xfcb33000
y.create.l HWIO_QLIC_TASK_FIFO_END_ADDR A:0xfcb33004
y.create.l HWIO_QLIC_TASK_WR_PTR_ADDR A:0xfcb33008
y.create.l HWIO_QLIC_TASK_RD_PTR_ADDR A:0xfcb3300c
y.create.l HWIO_QLIC_CTL_ADDR A:0xfcb33010
y.create.l HWIO_QLIC_TASK_STATUS_RD_ADDR A:0xfcb33014
y.create.l HWIO_QLIC_ENGINE_IIR_SCALE_ADDR A:0xfcb33018
y.create.l HWIO_QLIC_ENGINE_NORM_SEC0_RD_ADDR A:0xfcb3301c
y.create.l HWIO_QLIC_ENGINE_NORM_SEC1_RD_ADDR A:0xfcb33020
y.create.l HWIO_QLIC_ENGINE_NORM_SEC2_RD_ADDR A:0xfcb33024
y.create.l HWIO_QLIC_ENGINE_NORM_SEC3_RD_ADDR A:0xfcb33028
y.create.l HWIO_QLIC_ENGINE_NORM_SEC4_RD_ADDR A:0xfcb3302c
y.create.l HWIO_QLIC_ENGINE_NORM_SEC5_RD_ADDR A:0xfcb33030
y.create.l HWIO_QLIC_ENGINE_NORM_SEC6_RD_ADDR A:0xfcb33034
y.create.l HWIO_QLIC_ENGINE_NORM_SEC7_RD_ADDR A:0xfcb33038
y.create.l HWIO_QLIC_ENGINE_NORM_SEC8_RD_ADDR A:0xfcb3303c
y.create.l HWIO_QLIC_ENGINE_NORM_SEC9_RD_ADDR A:0xfcb33040
y.create.l HWIO_QLIC_ENGINE_NOISE_SEC0_RD_ADDR A:0xfcb33044
y.create.l HWIO_QLIC_ENGINE_NOISE_SEC1_RD_ADDR A:0xfcb33048
y.create.l HWIO_QLIC_ENGINE_NOISE_SEC2_RD_ADDR A:0xfcb3304c
y.create.l HWIO_QLIC_ENGINE_NOISE_SEC3_RD_ADDR A:0xfcb33050
y.create.l HWIO_QLIC_ENGINE_NOISE_SEC4_RD_ADDR A:0xfcb33054
y.create.l HWIO_QLIC_ENGINE_NOISE_SEC5_RD_ADDR A:0xfcb33058
y.create.l HWIO_QLIC_ENGINE_NOISE_SEC6_RD_ADDR A:0xfcb3305c
y.create.l HWIO_QLIC_ENGINE_NOISE_SEC7_RD_ADDR A:0xfcb33060
y.create.l HWIO_QLIC_ENGINE_NOISE_SEC8_RD_ADDR A:0xfcb33064
y.create.l HWIO_QLIC_ENGINE_NOISE_SEC9_RD_ADDR A:0xfcb33068
y.create.l HWIO_QLIC_ENGINE_O_RAM_ADDR_ADDR A:0xfcb3306c
y.create.l HWIO_QLIC_ENGINE_O_RAM_DATA_MSB_RD_ADDR A:0xfcb33070
y.create.l HWIO_QLIC_ENGINE_O_RAM_DATA_LSB_RD_ADDR A:0xfcb33074
y.create.l HWIO_QLIC_STATE_FW_ADDR A:0xfcb33080
y.create.l HWIO_QLIC_TEST_CONFIG_ADDR A:0xfcb33084
y.create.l HWIO_QLIC_TESTBUS_FW_ADDR A:0xfcb33088
y.create.l HWIO_QLIC_MTI_CTL_ADDR A:0xfcb33400
y.create.l HWIO_QLIC_FERAM0_WORD0_ADDR A:0xfcb33404
y.create.l HWIO_QLIC_FERAM0_WORD1_ADDR A:0xfcb33408
y.create.l HWIO_QLIC_FERAM1_WORD0_ADDR A:0xfcb3340c
y.create.l HWIO_QLIC_FERAM1_WORD1_ADDR A:0xfcb33410
y.create.l HWIO_QLIC_OMGRAM_WORD0_ADDR A:0xfcb33414
y.create.l HWIO_QLIC_OMGRAM_WORD1_ADDR A:0xfcb33418
y.create.l HWIO_QLIC_SECRAM_WORD0_ADDR A:0xfcb3341c
y.create.l HWIO_QLIC_SECRAM_WORD1_ADDR A:0xfcb33420
y.create.l HWIO_QLIC_SECRAM_WORD2_ADDR A:0xfcb33424
y.create.l HWIO_QLIC_COMBRAM0_WORD0_ADDR A:0xfcb33428
y.create.l HWIO_QLIC_COMBRAM0_WORD1_ADDR A:0xfcb3342c
y.create.l HWIO_QLIC_COMBRAM0_WORD2_ADDR A:0xfcb33430
y.create.l HWIO_QLIC_COMBRAM1_WORD0_ADDR A:0xfcb33434
y.create.l HWIO_QLIC_COMBRAM1_WORD1_ADDR A:0xfcb33438
y.create.l HWIO_QLIC_COMBRAM1_WORD2_ADDR A:0xfcb3343c
y.create.l HWIO_QLIC_STATE_SW_ADDR A:0xfcb33440
y.create.l HWIO_QLIC_TESTBUS_SW_ADDR A:0xfcb3344c
y.create.l HWIO_QLIC_FE_TASK_WORD_0_ADDR A:0xfcb33800
y.create.l HWIO_QLIC_FE_TASK_WORD_1_ADDR A:0xfcb33804
y.create.l HWIO_QLIC_FE_TASK_WORD_2_ADDR A:0xfcb33808
y.create.l HWIO_QLIC_FE_TASK_WORD_3_ADDR A:0xfcb3380c
y.create.l HWIO_QLIC_ENGINE_TASK_WORD_0_ADDR A:0xfcb33810
y.create.l HWIO_QLIC_ENGINE_TASK_WORD_1_ADDR A:0xfcb33814
y.create.l HWIO_QLIC_BE_TASK_WORD_0_ADDR A:0xfcb33820
y.create.l HWIO_QLIC_BE_TASK_WORD_1_ADDR A:0xfcb33824
y.create.l HWIO_QLIC_BE_TASK_WORD_2_ADDR A:0xfcb33828
y.create.l HWIO_QLIC_BE_TASK_WORD_3_ADDR A:0xfcb3382c
y.create.l HWIO_QLIC_ERAM_TASK_WORD_0_ADDR A:0xfcb33830
y.create.l HWIO_QLIC_ERAM_TASK_WORD_1_ADDR A:0xfcb33834
y.create.l HWIO_EDGE_ENABLE_ADDR A:0xfcb34000
y.create.l HWIO_TEST_PT_CTL_RW_ADDR A:0xfcb34004
y.create.l HWIO_ENCRYPT_ACC_RESET_ADDR A:0xfcb34100
y.create.l HWIO_ENCRYPT_ACC_CGC_CTL_ADDR A:0xfcb34104
y.create.l HWIO_ENCRYPT_ACC_CGC_STATUS_ADDR A:0xfcb34108
y.create.l HWIO_GEA_CONFIG_0_ADDR A:0xfcb3410c
y.create.l HWIO_GEA_INPUT_ADDR A:0xfcb34110
y.create.l HWIO_GEA_KC_0_ADDR A:0xfcb34114
y.create.l HWIO_GEA_KC_1_ADDR A:0xfcb34118
y.create.l HWIO_GEA_KC_2_ADDR A:0xfcb3411c
y.create.l HWIO_GEA_KC_3_ADDR A:0xfcb34120
y.create.l HWIO_GEA34_KS_LENGTH_ADDR A:0xfcb34124
y.create.l HWIO_GEA34_STATUS_ADDR A:0xfcb34128
y.create.l HWIO_GEA34_KEY_STRM_DOUT_ADDR A:0xfcb3412c
y.create.l HWIO_AMBA_KEY_STRM_WORD0_RD_ADDR A:0xfcb34130
y.create.l HWIO_AMBA_KEY_STRM_WORD1_RD_ADDR A:0xfcb34134
y.create.l HWIO_AMBA_KEY_STRM_WORD2_RD_ADDR A:0xfcb34138
y.create.l HWIO_AMBA_KEY_STRM_WORD3_RD_ADDR A:0xfcb3413c
y.create.l HWIO_AMBA_KEY_STRM_WORD4_RD_ADDR A:0xfcb34140
y.create.l HWIO_AMBA_KEY_STRM_WORD5_RD_ADDR A:0xfcb34144
y.create.l HWIO_AMBA_KEY_STRM_WORD6_RD_ADDR A:0xfcb34148
y.create.l HWIO_AMBA_KEY_STRM_WORD7_RD_ADDR A:0xfcb3414c
y.create.l HWIO_AMBA_KEY_STRM_STATUS_ADDR A:0xfcb34150
y.create.l HWIO_AFIVE_CONFIG_0_ADDR A:0xfcb34154
y.create.l HWIO_AFIVE_INPUT_ADDR A:0xfcb34158
y.create.l HWIO_AFIVE_KC_0_ADDR A:0xfcb3415c
y.create.l HWIO_AFIVE_KC_1_ADDR A:0xfcb34160
y.create.l HWIO_AFIVE_KC_2_ADDR A:0xfcb34164
y.create.l HWIO_AFIVE_KC_3_ADDR A:0xfcb34168
y.create.l HWIO_AFIVE_KEY_STRM_WORD0_RD_ADDR A:0xfcb3416c
y.create.l HWIO_AFIVE_KEY_STRM_WORD1_RD_ADDR A:0xfcb34170
y.create.l HWIO_AFIVE_KEY_STRM_WORD2_RD_ADDR A:0xfcb34174
y.create.l HWIO_AFIVE_KEY_STRM_WORD3_RD_ADDR A:0xfcb34178
y.create.l HWIO_AFIVE_KEY_STRM_WORD4_RD_ADDR A:0xfcb3417c
y.create.l HWIO_AFIVE_KEY_STRM_WORD5_RD_ADDR A:0xfcb34180
y.create.l HWIO_AFIVE_KEY_STRM_WORD6_RD_ADDR A:0xfcb34184
y.create.l HWIO_AFIVE_KEY_STRM_WORD7_RD_ADDR A:0xfcb34188
y.create.l HWIO_AFIVE_KEY_STRM_WORD8_RD_ADDR A:0xfcb3418c
y.create.l HWIO_AFIVE_KEY_STRM_WORD9_RD_ADDR A:0xfcb34190
y.create.l HWIO_AFIVE34_STATUS_ADDR A:0xfcb34198
y.create.l HWIO_EEQ_RESET_ADDR A:0xfcb34200
y.create.l HWIO_EEQ_CGC_CTL_ADDR A:0xfcb34204
y.create.l HWIO_EEQ_CGC_STATUS_ADDR A:0xfcb34208
y.create.l HWIO_EEQ_TRIGGER_ADDR A:0xfcb3420c
y.create.l HWIO_EEQ_CONFIG_ADDR A:0xfcb34210
y.create.l HWIO_INIT_HD_BITS_REV_ADDR A:0xfcb34214
y.create.l HWIO_INIT_HD_BITS_FWD_ADDR A:0xfcb34218
y.create.l HWIO_WMF_DMA_BASE_ADDR A:0xfcb3421c
y.create.l HWIO_SOFT_DEC_BASE_ADDR A:0xfcb34220
y.create.l HWIO_INIT_CH_EST0_ADDR A:0xfcb34224
y.create.l HWIO_INIT_CH_EST1_ADDR A:0xfcb34228
y.create.l HWIO_INIT_CH_EST2_ADDR A:0xfcb3422c
y.create.l HWIO_INIT_CH_EST3_ADDR A:0xfcb34230
y.create.l HWIO_REV_NOISE_POWER_ADDR A:0xfcb34234
y.create.l HWIO_FWD_NOISE_POWER_ADDR A:0xfcb34238
y.create.l HWIO_REV_SEMIBURST_HD_BITS_ADDR A:0xfcb3423c
y.create.l HWIO_FWD_SEMIBURST_HD_BITS_ADDR A:0xfcb34240
y.create.l HWIO_EVMOD_CGC_CTL_ADDR A:0xfcb34300
y.create.l HWIO_EVMOD_CGC_STATUS_ADDR A:0xfcb34304
y.create.l HWIO_EVMOD_DMA_START_ADDR_ADDR A:0xfcb34308
y.create.l HWIO_EVMOD_DMA_CIRC_BUF_TOP_ADDR A:0xfcb3430c
y.create.l HWIO_EVMOD_DMA_CIRC_BUF_LEN_ADDR A:0xfcb34310
y.create.l HWIO_EVMOD_MODLTR_CONFIG_1_ADDR A:0xfcb34314
y.create.l HWIO_EVMOD_MODLTR_CONFIG_2_ADDR A:0xfcb34318
y.create.l HWIO_EVMOD_MODLTR_CONFIG_3_ADDR A:0xfcb3431c
y.create.l HWIO_EVMOD_MODLTR_ARM_ADDR A:0xfcb34320
y.create.l HWIO_EVMOD_C0_LUT_DATA_ADDR A:0xfcb34324
y.create.l HWIO_EVMOD_C1_LUT_DATA_ADDR A:0xfcb34328
y.create.l HWIO_EVMOD_CONST_MAP_GMSK_ADDR A:0xfcb3432c
y.create.l HWIO_EVMOD_CONST_MAP_EPSK_0_ADDR A:0xfcb34330
y.create.l HWIO_EVMOD_CONST_MAP_EPSK_1_ADDR A:0xfcb34334
y.create.l HWIO_EVMOD_CONST_MAP_QAM16_ADDR A:0xfcb34338
y.create.l HWIO_EVMOD_DPL_PAR_CTRL_ADDR A:0xfcb3433c
y.create.l HWIO_EVMOD_DPL_CTRL_ADDR A:0xfcb34340
y.create.l HWIO_EVMOD_DPL_GAIN_ADDR A:0xfcb34344
y.create.l HWIO_EVMOD_PAR_CTRL_ADDR A:0xfcb34348
y.create.l HWIO_EVMOD_PAR_LPF_GAIN_ADDR A:0xfcb3434c
y.create.l HWIO_EVMOD_PAR_CORRECTION_GAIN_ADDR A:0xfcb34350
y.create.l HWIO_EVMOD_DPL_PAR_LPF_H0_ADDR A:0xfcb34354
y.create.l HWIO_EVMOD_DPL_PAR_LPF_H1_ADDR A:0xfcb34358
y.create.l HWIO_EVMOD_DPL_PAR_LPF_H2_ADDR A:0xfcb3435c
y.create.l HWIO_EVMOD_DPL_PAR_LPF_H3_ADDR A:0xfcb34360
y.create.l HWIO_EVMOD_DPL_PAR_LPF_H4_ADDR A:0xfcb34364
y.create.l HWIO_EVMOD_DPL_PAR_LPF_H5_ADDR A:0xfcb34368
y.create.l HWIO_EVMOD_DPL_PAR_LPF_H6_ADDR A:0xfcb3436c
y.create.l HWIO_EVMOD_DPL_PAR_LPF_H7_ADDR A:0xfcb34370
y.create.l HWIO_EVMOD_TIMESTAMP_T1_ADDR A:0xfcb34374
y.create.l HWIO_EVMOD_SAMPLE_COUNT_ADDR A:0xfcb34378
y.create.l HWIO_EVMOD_SAMPLE_COUNT_CTRL_ADDR A:0xfcb3437c
y.create.l HWIO_EVMOD_DPL_PAR_DEBUG_CTRL_ADDR A:0xfcb34380
y.create.l HWIO_EVMOD_DPL_PAR_DEBUG_DATA_ADDR A:0xfcb34384
y.create.l HWIO_EDGE_ENABLE_G1_ADDR A:0xfcb34800
y.create.l HWIO_TEST_PT_CTL_RW_G1_ADDR A:0xfcb34804
y.create.l HWIO_ENCRYPT_ACC_RESET_G1_ADDR A:0xfcb34900
y.create.l HWIO_ENCRYPT_ACC_CGC_CTL_G1_ADDR A:0xfcb34904
y.create.l HWIO_ENCRYPT_ACC_CGC_STATUS_G1_ADDR A:0xfcb34908
y.create.l HWIO_GEA_CONFIG_0_G1_ADDR A:0xfcb3490c
y.create.l HWIO_GEA_INPUT_G1_ADDR A:0xfcb34910
y.create.l HWIO_GEA_KC_0_G1_ADDR A:0xfcb34914
y.create.l HWIO_GEA_KC_1_G1_ADDR A:0xfcb34918
y.create.l HWIO_GEA_KC_2_G1_ADDR A:0xfcb3491c
y.create.l HWIO_GEA_KC_3_G1_ADDR A:0xfcb34920
y.create.l HWIO_GEA34_KS_LENGTH_G1_ADDR A:0xfcb34924
y.create.l HWIO_GEA34_STATUS_G1_ADDR A:0xfcb34928
y.create.l HWIO_GEA34_KEY_STRM_DOUT_G1_ADDR A:0xfcb3492c
y.create.l HWIO_AMBA_KEY_STRM_WORD0_RD_G1_ADDR A:0xfcb34930
y.create.l HWIO_AMBA_KEY_STRM_WORD1_RD_G1_ADDR A:0xfcb34934
y.create.l HWIO_AMBA_KEY_STRM_WORD2_RD_G1_ADDR A:0xfcb34938
y.create.l HWIO_AMBA_KEY_STRM_WORD3_RD_G1_ADDR A:0xfcb3493c
y.create.l HWIO_AMBA_KEY_STRM_WORD4_RD_G1_ADDR A:0xfcb34940
y.create.l HWIO_AMBA_KEY_STRM_WORD5_RD_G1_ADDR A:0xfcb34944
y.create.l HWIO_AMBA_KEY_STRM_WORD6_RD_G1_ADDR A:0xfcb34948
y.create.l HWIO_AMBA_KEY_STRM_WORD7_RD_G1_ADDR A:0xfcb3494c
y.create.l HWIO_AMBA_KEY_STRM_STATUS_G1_ADDR A:0xfcb34950
y.create.l HWIO_AFIVE_CONFIG_0_G1_ADDR A:0xfcb34954
y.create.l HWIO_AFIVE_INPUT_G1_ADDR A:0xfcb34958
y.create.l HWIO_AFIVE_KC_0_G1_ADDR A:0xfcb3495c
y.create.l HWIO_AFIVE_KC_1_G1_ADDR A:0xfcb34960
y.create.l HWIO_AFIVE_KC_2_G1_ADDR A:0xfcb34964
y.create.l HWIO_AFIVE_KC_3_G1_ADDR A:0xfcb34968
y.create.l HWIO_AFIVE_KEY_STRM_WORD0_RD_G1_ADDR A:0xfcb3496c
y.create.l HWIO_AFIVE_KEY_STRM_WORD1_RD_G1_ADDR A:0xfcb34970
y.create.l HWIO_AFIVE_KEY_STRM_WORD2_RD_G1_ADDR A:0xfcb34974
y.create.l HWIO_AFIVE_KEY_STRM_WORD3_RD_G1_ADDR A:0xfcb34978
y.create.l HWIO_AFIVE_KEY_STRM_WORD4_RD_G1_ADDR A:0xfcb3497c
y.create.l HWIO_AFIVE_KEY_STRM_WORD5_RD_G1_ADDR A:0xfcb34980
y.create.l HWIO_AFIVE_KEY_STRM_WORD6_RD_G1_ADDR A:0xfcb34984
y.create.l HWIO_AFIVE_KEY_STRM_WORD7_RD_G1_ADDR A:0xfcb34988
y.create.l HWIO_AFIVE_KEY_STRM_WORD8_RD_G1_ADDR A:0xfcb3498c
y.create.l HWIO_AFIVE_KEY_STRM_WORD9_RD_G1_ADDR A:0xfcb34990
y.create.l HWIO_AFIVE34_STATUS_G1_ADDR A:0xfcb34998
y.create.l HWIO_EVMOD_CGC_CTL_G1_ADDR A:0xfcb34b00
y.create.l HWIO_EVMOD_CGC_STATUS_G1_ADDR A:0xfcb34b04
y.create.l HWIO_EVMOD_DMA_START_ADDR_G1_ADDR A:0xfcb34b08
y.create.l HWIO_EVMOD_DMA_CIRC_BUF_TOP_G1_ADDR A:0xfcb34b0c
y.create.l HWIO_EVMOD_DMA_CIRC_BUF_LEN_G1_ADDR A:0xfcb34b10
y.create.l HWIO_EVMOD_MODLTR_CONFIG_1_G1_ADDR A:0xfcb34b14
y.create.l HWIO_EVMOD_MODLTR_CONFIG_2_G1_ADDR A:0xfcb34b18
y.create.l HWIO_EVMOD_MODLTR_CONFIG_3_G1_ADDR A:0xfcb34b1c
y.create.l HWIO_EVMOD_MODLTR_ARM_G1_ADDR A:0xfcb34b20
y.create.l HWIO_EVMOD_C0_LUT_DATA_G1_ADDR A:0xfcb34b24
y.create.l HWIO_EVMOD_C1_LUT_DATA_G1_ADDR A:0xfcb34b28
y.create.l HWIO_EVMOD_CONST_MAP_GMSK_G1_ADDR A:0xfcb34b2c
y.create.l HWIO_EVMOD_CONST_MAP_EPSK_0_G1_ADDR A:0xfcb34b30
y.create.l HWIO_EVMOD_CONST_MAP_EPSK_1_G1_ADDR A:0xfcb34b34
y.create.l HWIO_EVMOD_CONST_MAP_QAM16_G1_ADDR A:0xfcb34b38
y.create.l HWIO_EVMOD_DPL_PAR_CTRL_G1_ADDR A:0xfcb34b3c
y.create.l HWIO_EVMOD_DPL_CTRL_G1_ADDR A:0xfcb34b40
y.create.l HWIO_EVMOD_DPL_GAIN_G1_ADDR A:0xfcb34b44
y.create.l HWIO_EVMOD_PAR_CTRL_G1_ADDR A:0xfcb34b48
y.create.l HWIO_EVMOD_PAR_LPF_GAIN_G1_ADDR A:0xfcb34b4c
y.create.l HWIO_EVMOD_PAR_CORRECTION_GAIN_G1_ADDR A:0xfcb34b50
y.create.l HWIO_EVMOD_DPL_PAR_LPF_H0_G1_ADDR A:0xfcb34b54
y.create.l HWIO_EVMOD_DPL_PAR_LPF_H1_G1_ADDR A:0xfcb34b58
y.create.l HWIO_EVMOD_DPL_PAR_LPF_H2_G1_ADDR A:0xfcb34b5c
y.create.l HWIO_EVMOD_DPL_PAR_LPF_H3_G1_ADDR A:0xfcb34b60
y.create.l HWIO_EVMOD_DPL_PAR_LPF_H4_G1_ADDR A:0xfcb34b64
y.create.l HWIO_EVMOD_DPL_PAR_LPF_H5_G1_ADDR A:0xfcb34b68
y.create.l HWIO_EVMOD_DPL_PAR_LPF_H6_G1_ADDR A:0xfcb34b6c
y.create.l HWIO_EVMOD_DPL_PAR_LPF_H7_G1_ADDR A:0xfcb34b70
y.create.l HWIO_EVMOD_TIMESTAMP_T1_G1_ADDR A:0xfcb34b74
y.create.l HWIO_EVMOD_SAMPLE_COUNT_G1_ADDR A:0xfcb34b78
y.create.l HWIO_EVMOD_SAMPLE_COUNT_CTRL_G1_ADDR A:0xfcb34b7c
y.create.l HWIO_EVMOD_DPL_PAR_DEBUG_CTRL_G1_ADDR A:0xfcb34b80
y.create.l HWIO_EVMOD_DPL_PAR_DEBUG_DATA_G1_ADDR A:0xfcb34b84
y.create.l HWIO_CSRCH_ENABLE_ADDR A:0xfcb35000
y.create.l HWIO_SRCH_QUEUE_CMD_ADDR A:0xfcb35004
y.create.l HWIO_SRCH_QUEUE_CTL_0_ADDR A:0xfcb35008
y.create.l HWIO_SRCH_QUEUE_CTL_1_ADDR A:0xfcb3500c
y.create.l HWIO_SRCH_QUEUE_STATUS_ADDR A:0xfcb35010
y.create.l HWIO_SRCH_QUEUE_WRITE_PTR_ADDR A:0xfcb35014
y.create.l HWIO_SRCH_QUEUE_CMP_ADDR A:0xfcb35018
y.create.l HWIO_SRCH_QUEUE_TST_ADDR A:0xfcb3501c
y.create.l HWIO_SRCH_TEST_MODE_ADDR A:0xfcb35020
y.create.l HWIO_SRCH_TEST_STATUS_ADDR A:0xfcb35024
y.create.l HWIO_SRCH_OFFLINE_WRITE_PTR_ADDR A:0xfcb35028
y.create.l HWIO_SRCH_SEARCH_CTL_DBG_ADDR A:0xfcb3502c
y.create.l HWIO_SRCH_WINDOW_CTL_DBG_ADDR A:0xfcb35030
y.create.l HWIO_SRCH_SAMPLE_CTL1_DBG_ADDR A:0xfcb35034
y.create.l HWIO_SRCH_SAMPLE_CTL2_DBG_ADDR A:0xfcb35038
y.create.l HWIO_SRCH_PILOT_CTL_DBG_ADDR A:0xfcb3503c
y.create.l HWIO_SRCH_RESULT_CTL_DBG_ADDR A:0xfcb35040
y.create.l HWIO_FING_STATUS_RD_ADDR A:0xfcb36000
y.create.l HWIO_FING_DESKEW_ADDR_RD_ADDR A:0xfcb36004
y.create.l HWIO_FING_SLOT_SYM_NUM_RD_ADDR A:0xfcb36008
y.create.l HWIO_FING_CHAN_ENABLE_RD_ADDR A:0xfcb3600c
y.create.l HWIO_FING_ON_TIME_RD_ADDR A:0xfcb36010
y.create.l HWIO_FING_ON_TIME_DIV_RD_ADDR A:0xfcb36014
y.create.l HWIO_FING_SYM_CH0_RD_ADDR A:0xfcb36018
y.create.l HWIO_FING_SYM_CH0_DIV_RD_ADDR A:0xfcb3601c
y.create.l HWIO_FING_EARLY_LATE_RD_ADDR A:0xfcb36020
y.create.l HWIO_FING_EARLY_LATE_DIV_RD_ADDR A:0xfcb36024
y.create.l HWIO_FINGER_POSITION_RD_ADDR A:0xfcb36028
y.create.l HWIO_FINGER_PN_OFFSET_RD_ADDR A:0xfcb3602c
y.create.l HWIO_FING_MMSE_RXX_RD_ADDR A:0xfcb36030
y.create.l HWIO_FING_MMSE_RE_RXY_RD_ADDR A:0xfcb36034
y.create.l HWIO_FING_MMSE_RYY_RD_ADDR A:0xfcb36038
y.create.l HWIO_FING_MMSE_IM_RXY_RD_ADDR A:0xfcb3603c
y.create.l HWIO_COMB_DESKEW_ADDR_RD_ADDR A:0xfcb36040
y.create.l HWIO_COMB_STATUS13_RD_ADDR A:0xfcb36044
y.create.l HWIO_COMB_STATUS15_RD_ADDR A:0xfcb36048
y.create.l HWIO_COMB_STATUS16_RD_ADDR A:0xfcb3604c
y.create.l HWIO_COMB_BETA_CH0_SW_RD_ADDR A:0xfcb36050
y.create.l HWIO_COMB_PN_SCRAM_IQ_CH0_RD_ADDR A:0xfcb36054
y.create.l HWIO_COMB_SYS_TIME_RD_ADDR A:0xfcb36058
y.create.l HWIO_FING_ROT_FREQ_WR_ADDR A:0xfcb37000
y.create.l HWIO_FING_ROT_PHASE_WR_ADDR A:0xfcb37004
y.create.l HWIO_FING_IQ_PILOT0_WR_ADDR A:0xfcb37008
y.create.l HWIO_FING_IQ_PILOT1_WR_ADDR A:0xfcb3700c
y.create.l HWIO_FING_QLIC_IQ_CH_EST0_ADDR A:0xfcb37010
y.create.l HWIO_FING_QLIC_IQ_CH_EST1_ADDR A:0xfcb37014
y.create.l HWIO_FING_QLIC_CFG_ADDR A:0xfcb37018
y.create.l HWIO_FING_RESULT_TCM_ADDR_ADDR A:0xfcb3701c
y.create.l HWIO_DEM1X_F0_PILOT_IMMED_ADDR A:0xfcb37100
y.create.l HWIO_DEM1X_F1_PILOT_IMMED_ADDR A:0xfcb37140
y.create.l HWIO_DEM1X_F2_PILOT_IMMED_ADDR A:0xfcb37180
y.create.l HWIO_DEM1X_F3_PILOT_IMMED_ADDR A:0xfcb371c0
y.create.l HWIO_DEM1X_F4_PILOT_IMMED_ADDR A:0xfcb37200
y.create.l HWIO_DEM1X_F5_PILOT_IMMED_ADDR A:0xfcb37240
y.create.l HWIO_DEM1X_F6_PILOT_IMMED_ADDR A:0xfcb37280
y.create.l HWIO_DEM1X_F7_PILOT_IMMED_ADDR A:0xfcb372c0
y.create.l HWIO_DEM1X_F0_DIVERSITY_IMMED_ADDR A:0xfcb37104
y.create.l HWIO_DEM1X_F1_DIVERSITY_IMMED_ADDR A:0xfcb37144
y.create.l HWIO_DEM1X_F2_DIVERSITY_IMMED_ADDR A:0xfcb37184
y.create.l HWIO_DEM1X_F3_DIVERSITY_IMMED_ADDR A:0xfcb371c4
y.create.l HWIO_DEM1X_F4_DIVERSITY_IMMED_ADDR A:0xfcb37204
y.create.l HWIO_DEM1X_F5_DIVERSITY_IMMED_ADDR A:0xfcb37244
y.create.l HWIO_DEM1X_F6_DIVERSITY_IMMED_ADDR A:0xfcb37284
y.create.l HWIO_DEM1X_F7_DIVERSITY_IMMED_ADDR A:0xfcb372c4
y.create.l HWIO_DEM1X_F0_WALSH_ACC0_IMMED_ADDR A:0xfcb37108
y.create.l HWIO_DEM1X_F0_WALSH_ACC1_IMMED_ADDR A:0xfcb3710c
y.create.l HWIO_DEM1X_F0_WALSH_ACC2_IMMED_ADDR A:0xfcb37110
y.create.l HWIO_DEM1X_F0_WALSH_ACC3_IMMED_ADDR A:0xfcb37114
y.create.l HWIO_DEM1X_F1_WALSH_ACC0_IMMED_ADDR A:0xfcb37148
y.create.l HWIO_DEM1X_F1_WALSH_ACC1_IMMED_ADDR A:0xfcb3714c
y.create.l HWIO_DEM1X_F1_WALSH_ACC2_IMMED_ADDR A:0xfcb37150
y.create.l HWIO_DEM1X_F1_WALSH_ACC3_IMMED_ADDR A:0xfcb37154
y.create.l HWIO_DEM1X_F2_WALSH_ACC0_IMMED_ADDR A:0xfcb37188
y.create.l HWIO_DEM1X_F2_WALSH_ACC1_IMMED_ADDR A:0xfcb3718c
y.create.l HWIO_DEM1X_F2_WALSH_ACC2_IMMED_ADDR A:0xfcb37190
y.create.l HWIO_DEM1X_F2_WALSH_ACC3_IMMED_ADDR A:0xfcb37194
y.create.l HWIO_DEM1X_F3_WALSH_ACC0_IMMED_ADDR A:0xfcb371c8
y.create.l HWIO_DEM1X_F3_WALSH_ACC1_IMMED_ADDR A:0xfcb371cc
y.create.l HWIO_DEM1X_F3_WALSH_ACC2_IMMED_ADDR A:0xfcb371d0
y.create.l HWIO_DEM1X_F3_WALSH_ACC3_IMMED_ADDR A:0xfcb371d4
y.create.l HWIO_DEM1X_F4_WALSH_ACC0_IMMED_ADDR A:0xfcb37208
y.create.l HWIO_DEM1X_F4_WALSH_ACC1_IMMED_ADDR A:0xfcb3720c
y.create.l HWIO_DEM1X_F4_WALSH_ACC2_IMMED_ADDR A:0xfcb37210
y.create.l HWIO_DEM1X_F4_WALSH_ACC3_IMMED_ADDR A:0xfcb37214
y.create.l HWIO_DEM1X_F5_WALSH_ACC0_IMMED_ADDR A:0xfcb37248
y.create.l HWIO_DEM1X_F5_WALSH_ACC1_IMMED_ADDR A:0xfcb3724c
y.create.l HWIO_DEM1X_F5_WALSH_ACC2_IMMED_ADDR A:0xfcb37250
y.create.l HWIO_DEM1X_F5_WALSH_ACC3_IMMED_ADDR A:0xfcb37254
y.create.l HWIO_DEM1X_F6_WALSH_ACC0_IMMED_ADDR A:0xfcb37288
y.create.l HWIO_DEM1X_F6_WALSH_ACC1_IMMED_ADDR A:0xfcb3728c
y.create.l HWIO_DEM1X_F6_WALSH_ACC2_IMMED_ADDR A:0xfcb37290
y.create.l HWIO_DEM1X_F6_WALSH_ACC3_IMMED_ADDR A:0xfcb37294
y.create.l HWIO_DEM1X_F7_WALSH_ACC0_IMMED_ADDR A:0xfcb372c8
y.create.l HWIO_DEM1X_F7_WALSH_ACC1_IMMED_ADDR A:0xfcb372cc
y.create.l HWIO_DEM1X_F7_WALSH_ACC2_IMMED_ADDR A:0xfcb372d0
y.create.l HWIO_DEM1X_F7_WALSH_ACC3_IMMED_ADDR A:0xfcb372d4
y.create.l HWIO_DEM1X_F0_WALSH_ACC0_FRAME_ADDR A:0xfcb37308
y.create.l HWIO_DEM1X_F0_WALSH_ACC1_FRAME_ADDR A:0xfcb3730c
y.create.l HWIO_DEM1X_F0_WALSH_ACC2_FRAME_ADDR A:0xfcb37310
y.create.l HWIO_DEM1X_F0_WALSH_ACC3_FRAME_ADDR A:0xfcb37314
y.create.l HWIO_DEM1X_F1_WALSH_ACC0_FRAME_ADDR A:0xfcb37348
y.create.l HWIO_DEM1X_F1_WALSH_ACC1_FRAME_ADDR A:0xfcb3734c
y.create.l HWIO_DEM1X_F1_WALSH_ACC2_FRAME_ADDR A:0xfcb37350
y.create.l HWIO_DEM1X_F1_WALSH_ACC3_FRAME_ADDR A:0xfcb37354
y.create.l HWIO_DEM1X_F2_WALSH_ACC0_FRAME_ADDR A:0xfcb37388
y.create.l HWIO_DEM1X_F2_WALSH_ACC1_FRAME_ADDR A:0xfcb3738c
y.create.l HWIO_DEM1X_F2_WALSH_ACC2_FRAME_ADDR A:0xfcb37390
y.create.l HWIO_DEM1X_F2_WALSH_ACC3_FRAME_ADDR A:0xfcb37394
y.create.l HWIO_DEM1X_F3_WALSH_ACC0_FRAME_ADDR A:0xfcb373c8
y.create.l HWIO_DEM1X_F3_WALSH_ACC1_FRAME_ADDR A:0xfcb373cc
y.create.l HWIO_DEM1X_F3_WALSH_ACC2_FRAME_ADDR A:0xfcb373d0
y.create.l HWIO_DEM1X_F3_WALSH_ACC3_FRAME_ADDR A:0xfcb373d4
y.create.l HWIO_DEM1X_F4_WALSH_ACC0_FRAME_ADDR A:0xfcb37408
y.create.l HWIO_DEM1X_F4_WALSH_ACC1_FRAME_ADDR A:0xfcb3740c
y.create.l HWIO_DEM1X_F4_WALSH_ACC2_FRAME_ADDR A:0xfcb37410
y.create.l HWIO_DEM1X_F4_WALSH_ACC3_FRAME_ADDR A:0xfcb37414
y.create.l HWIO_DEM1X_F5_WALSH_ACC0_FRAME_ADDR A:0xfcb37448
y.create.l HWIO_DEM1X_F5_WALSH_ACC1_FRAME_ADDR A:0xfcb3744c
y.create.l HWIO_DEM1X_F5_WALSH_ACC2_FRAME_ADDR A:0xfcb37450
y.create.l HWIO_DEM1X_F5_WALSH_ACC3_FRAME_ADDR A:0xfcb37454
y.create.l HWIO_DEM1X_F6_WALSH_ACC0_FRAME_ADDR A:0xfcb37488
y.create.l HWIO_DEM1X_F6_WALSH_ACC1_FRAME_ADDR A:0xfcb3748c
y.create.l HWIO_DEM1X_F6_WALSH_ACC2_FRAME_ADDR A:0xfcb37490
y.create.l HWIO_DEM1X_F6_WALSH_ACC3_FRAME_ADDR A:0xfcb37494
y.create.l HWIO_DEM1X_F7_WALSH_ACC0_FRAME_ADDR A:0xfcb374c8
y.create.l HWIO_DEM1X_F7_WALSH_ACC1_FRAME_ADDR A:0xfcb374cc
y.create.l HWIO_DEM1X_F7_WALSH_ACC2_FRAME_ADDR A:0xfcb374d0
y.create.l HWIO_DEM1X_F7_WALSH_ACC3_FRAME_ADDR A:0xfcb374d4
y.create.l HWIO_DEM1X_F0_HW_CH1_IMMED_ADDR A:0xfcb37138
y.create.l HWIO_DEM1X_F1_HW_CH1_IMMED_ADDR A:0xfcb37178
y.create.l HWIO_DEM1X_F2_HW_CH1_IMMED_ADDR A:0xfcb371b8
y.create.l HWIO_DEM1X_F3_HW_CH1_IMMED_ADDR A:0xfcb371f8
y.create.l HWIO_DEM1X_F4_HW_CH1_IMMED_ADDR A:0xfcb37238
y.create.l HWIO_DEM1X_F5_HW_CH1_IMMED_ADDR A:0xfcb37278
y.create.l HWIO_DEM1X_F6_HW_CH1_IMMED_ADDR A:0xfcb372b8
y.create.l HWIO_DEM1X_F7_HW_CH1_IMMED_ADDR A:0xfcb372f8
y.create.l HWIO_DEM1X_F0_HW_CH1_FRAME_ADDR A:0xfcb37338
y.create.l HWIO_DEM1X_F1_HW_CH1_FRAME_ADDR A:0xfcb37378
y.create.l HWIO_DEM1X_F2_HW_CH1_FRAME_ADDR A:0xfcb373b8
y.create.l HWIO_DEM1X_F3_HW_CH1_FRAME_ADDR A:0xfcb373f8
y.create.l HWIO_DEM1X_F4_HW_CH1_FRAME_ADDR A:0xfcb37438
y.create.l HWIO_DEM1X_F5_HW_CH1_FRAME_ADDR A:0xfcb37478
y.create.l HWIO_DEM1X_F6_HW_CH1_FRAME_ADDR A:0xfcb374b8
y.create.l HWIO_DEM1X_F7_HW_CH1_FRAME_ADDR A:0xfcb374f8
y.create.l HWIO_DEM1X_F0_HW_CH2_IMMED_ADDR A:0xfcb3713c
y.create.l HWIO_DEM1X_F1_HW_CH2_IMMED_ADDR A:0xfcb3717c
y.create.l HWIO_DEM1X_F2_HW_CH2_IMMED_ADDR A:0xfcb371bc
y.create.l HWIO_DEM1X_F3_HW_CH2_IMMED_ADDR A:0xfcb371fc
y.create.l HWIO_DEM1X_F4_HW_CH2_IMMED_ADDR A:0xfcb3723c
y.create.l HWIO_DEM1X_F5_HW_CH2_IMMED_ADDR A:0xfcb3727c
y.create.l HWIO_DEM1X_F6_HW_CH2_IMMED_ADDR A:0xfcb372bc
y.create.l HWIO_DEM1X_F7_HW_CH2_IMMED_ADDR A:0xfcb372fc
y.create.l HWIO_DEM1X_F0_HW_CH2_FRAME_ADDR A:0xfcb3733c
y.create.l HWIO_DEM1X_F1_HW_CH2_FRAME_ADDR A:0xfcb3737c
y.create.l HWIO_DEM1X_F2_HW_CH2_FRAME_ADDR A:0xfcb373bc
y.create.l HWIO_DEM1X_F3_HW_CH2_FRAME_ADDR A:0xfcb373fc
y.create.l HWIO_DEM1X_F4_HW_CH2_FRAME_ADDR A:0xfcb3743c
y.create.l HWIO_DEM1X_F5_HW_CH2_FRAME_ADDR A:0xfcb3747c
y.create.l HWIO_DEM1X_F6_HW_CH2_FRAME_ADDR A:0xfcb374bc
y.create.l HWIO_DEM1X_F7_HW_CH2_FRAME_ADDR A:0xfcb374fc
y.create.l HWIO_DEM1X_SYNC_ADDR A:0xfcb37800
y.create.l HWIO_DEM1X_LATCH_ADDR A:0xfcb37804
y.create.l HWIO_DEM1X_TRACKING_ADDR A:0xfcb37808
y.create.l HWIO_DEM1X_FRAME_OFFSET_ADDR A:0xfcb3780c
y.create.l HWIO_DEM1X_OFFLINE_ADDR A:0xfcb37810
y.create.l HWIO_DEM1X_REF_COUNT_ADDR A:0xfcb37814
y.create.l HWIO_DEM1X_RTC_ADJUST_ADDR A:0xfcb37818
y.create.l HWIO_DEM1X_RTF_CTL_SEL_ADDR A:0xfcb3781c
y.create.l HWIO_DEM1X_FINGER_MERGE_F8_ADDR A:0xfcb37820
y.create.l HWIO_DEM1X_COMBINER_TIME_LOAD_ADDR A:0xfcb37a00
y.create.l HWIO_DEM1X_ARM_COMBINER_SLAM_ADDR A:0xfcb37a04
y.create.l HWIO_DEM1X_SLEW_COMBINER_TIME_ADDR A:0xfcb37a08
y.create.l HWIO_DEM1X_LC_STATE_LOAD_LO_ADDR A:0xfcb37a0c
y.create.l HWIO_DEM1X_LC_STATE_LOAD_HI_ADDR A:0xfcb37a10
y.create.l HWIO_DEM1X_ARM_LC_STATE_LOAD_ADDR A:0xfcb37a14
y.create.l HWIO_DEM1X_COMBINER_TIME_ADDR A:0xfcb37a18
y.create.l HWIO_DEM1X_FRAME_COUNT_ADDR A:0xfcb37a1c
y.create.l HWIO_DEM1X_LC_STATE_LO_ADDR A:0xfcb37a20
y.create.l HWIO_DEM1X_LC_STATE_HI_ADDR A:0xfcb37a24
y.create.l HWIO_DEM1X_TRAFFIC_REV_PWR_CTL_ADDR A:0xfcb37a28
y.create.l HWIO_DEM1X_COMMON_REV_PWR_CTL_ADDR A:0xfcb37a2c
y.create.l HWIO_DEM1X_COMMON_REV_PWR_CTL2_ADDR A:0xfcb37a30
y.create.l HWIO_DEM1X_FWD_PWR_CTL_IMMED_ADDR A:0xfcb37a34
y.create.l HWIO_DEM1X_FWD_PWR_CTL_FRAME_ADDR A:0xfcb37a38
y.create.l HWIO_DEM1X_FWD_PWR_CTL_TIMING_ADDR A:0xfcb37a3c
y.create.l HWIO_DEM1X_BETA_TIMING_ADDR A:0xfcb37a40
y.create.l HWIO_DEM1X_TIME_INT1_ENABLE_ADDR A:0xfcb37a44
y.create.l HWIO_DEM1X_TIME_INT1_STATUS_ADDR A:0xfcb37a48
y.create.l HWIO_DEM1X_TIME_INT1_CLEAR_ADDR A:0xfcb37a4c
y.create.l HWIO_DEM1X_TIME_INT2_ENABLE_ADDR A:0xfcb37a50
y.create.l HWIO_DEM1X_TIME_INT2_STATUS_ADDR A:0xfcb37a54
y.create.l HWIO_DEM1X_TIME_INT2_CLEAR_ADDR A:0xfcb37a58
y.create.l HWIO_DEM1X_CH0_LC_MASK_LO_IMMED_ADDR A:0xfcb37a5c
y.create.l HWIO_DEM1X_CH1_LC_MASK_LO_IMMED_ADDR A:0xfcb37a64
y.create.l HWIO_DEM1X_CH2_LC_MASK_LO_IMMED_ADDR A:0xfcb37a6c
y.create.l HWIO_DEM1X_CH0_LC_MASK_HI_IMMED_ADDR A:0xfcb37a60
y.create.l HWIO_DEM1X_CH1_LC_MASK_HI_IMMED_ADDR A:0xfcb37a68
y.create.l HWIO_DEM1X_CH2_LC_MASK_HI_IMMED_ADDR A:0xfcb37a70
y.create.l HWIO_DEM1X_CH7_LC_MASK_LO_IMMED_ADDR A:0xfcb37a74
y.create.l HWIO_DEM1X_CH7_LC_MASK_HI_IMMED_ADDR A:0xfcb37a78
y.create.l HWIO_DEM1X_CH8_LC_MASK_LO_IMMED_ADDR A:0xfcb37a7c
y.create.l HWIO_DEM1X_CH8_LC_MASK_HI_IMMED_ADDR A:0xfcb37a80
y.create.l HWIO_DEM1X_CH0_LC_MASK_LO_SPN_ROLL_ADDR A:0xfcb37a84
y.create.l HWIO_DEM1X_CH1_LC_MASK_LO_SPN_ROLL_ADDR A:0xfcb37a8c
y.create.l HWIO_DEM1X_CH2_LC_MASK_LO_SPN_ROLL_ADDR A:0xfcb37a94
y.create.l HWIO_DEM1X_CH0_LC_MASK_HI_SPN_ROLL_ADDR A:0xfcb37a88
y.create.l HWIO_DEM1X_CH1_LC_MASK_HI_SPN_ROLL_ADDR A:0xfcb37a90
y.create.l HWIO_DEM1X_CH2_LC_MASK_HI_SPN_ROLL_ADDR A:0xfcb37a98
y.create.l HWIO_DEM1X_CH7_LC_MASK_LO_SPN_ROLL_ADDR A:0xfcb37a9c
y.create.l HWIO_DEM1X_CH7_LC_MASK_HI_SPN_ROLL_ADDR A:0xfcb37aa0
y.create.l HWIO_DEM1X_CH8_LC_MASK_LO_SPN_ROLL_ADDR A:0xfcb37aa4
y.create.l HWIO_DEM1X_CH8_LC_MASK_HI_SPN_ROLL_ADDR A:0xfcb37aa8
y.create.l HWIO_DEM1X_COMBINER_CTL_ADDR A:0xfcb37aac
y.create.l HWIO_DEM1X_FW_CH_ENABLE_IMMED_ADDR A:0xfcb37ab0
y.create.l HWIO_DEM1X_FW_CH_ENABLE_FRAME_ADDR A:0xfcb37ab4
y.create.l HWIO_DEM1X_CHANNEL0_IMMED_ADDR A:0xfcb37ab8
y.create.l HWIO_DEM1X_CHANNEL0_FRAME_ADDR A:0xfcb37abc
y.create.l HWIO_DEM1X_CHANNEL1_IMMED_ADDR A:0xfcb37ac0
y.create.l HWIO_DEM1X_CHANNEL1_FRAME_ADDR A:0xfcb37ac4
y.create.l HWIO_DEM1X_CHANNEL2_IMMED_ADDR A:0xfcb37ac8
y.create.l HWIO_DEM1X_CHANNEL2_FRAME_ADDR A:0xfcb37acc
y.create.l HWIO_DEM1X_CHANNEL8_IMMED_ADDR A:0xfcb37ad0
y.create.l HWIO_DEM1X_CHANNEL8_FRAME_ADDR A:0xfcb37ad4
y.create.l HWIO_DEM1X_SYS_TIME_GP_COMPARE_ADDR A:0xfcb37ad8
y.create.l HWIO_DEM1X_LPN_ADV_ADDR A:0xfcb37adc
y.create.l HWIO_FING_LOCK_WR_ADDR A:0xfcb37c00
y.create.l HWIO_FING_PAGE_WR_ADDR A:0xfcb37c04
y.create.l HWIO_FING_PROC_DONE_WR_ADDR A:0xfcb37c08
y.create.l HWIO_FING_PAGE_RD_ADDR A:0xfcb37c0c
y.create.l HWIO_FING_SYM_CH1_RD_ADDR A:0xfcb37c10
y.create.l HWIO_FING_SYM_CH2_RD_ADDR A:0xfcb37c14
y.create.l HWIO_FING_SYM_CH8_RD_ADDR A:0xfcb37c18
y.create.l HWIO_FING_SYM_CH1_DIV_RD_ADDR A:0xfcb37c1c
y.create.l HWIO_FING_SYM_CH2_DIV_RD_ADDR A:0xfcb37c20
y.create.l HWIO_FING_SYM_CH8_DIV_RD_ADDR A:0xfcb37c24
y.create.l HWIO_COMB_TRK_LO_ADJ_WR_ADDR A:0xfcb37c28
y.create.l HWIO_COMB_CH1_IQ_ACC_RD_ADDR A:0xfcb37c2c
y.create.l HWIO_COMB_CH2_IQ_ACC_RD_ADDR A:0xfcb37c30
y.create.l HWIO_COMB_PN_SCRAM_IQ_CACKCH_RD_ADDR A:0xfcb37c34
y.create.l HWIO_COMB_FUND_SOFT_DEC_IQ_WR_ADDR A:0xfcb37c38
y.create.l HWIO_COMB_BETA_CH1_SW_RD_ADDR A:0xfcb37c3c
y.create.l HWIO_COMB_COUNT_RD_ADDR A:0xfcb37c40
y.create.l HWIO_COMB_FUND_DEINT_BUSY_ADDR A:0xfcb37c44
y.create.l HWIO_COMB_CACKCH_STATUS_RD_ADDR A:0xfcb37c48
y.create.l HWIO_COMB_FWD_LINK_PWR_CTRL_WR_ADDR A:0xfcb37c4c
y.create.l HWIO_DEM1X_FINGER0_FW_ADDR A:0xfcb37c50
y.create.l HWIO_DEM1X_FINGER1_FW_ADDR A:0xfcb37c54
y.create.l HWIO_DEM1X_FINGER2_FW_ADDR A:0xfcb37c58
y.create.l HWIO_DEM1X_FINGER3_FW_ADDR A:0xfcb37c5c
y.create.l HWIO_DEM1X_FINGER4_FW_ADDR A:0xfcb37c60
y.create.l HWIO_DEM1X_FINGER5_FW_ADDR A:0xfcb37c64
y.create.l HWIO_DEM1X_FINGER6_FW_ADDR A:0xfcb37c68
y.create.l HWIO_DEM1X_FINGER7_FW_ADDR A:0xfcb37c6c
y.create.l HWIO_FING_TT_WR_ADDR A:0xfcb37c70
y.create.l HWIO_DEM1X_FING_DMA_CTRL_ADDR A:0xfcb37c74
y.create.l HWIO_DEM1X_FING_IRQ_DISABLE_ADDR A:0xfcb37c78
y.create.l HWIO_DEM1X_FING_IRQ_CLEAR_ADDR A:0xfcb37c7c
y.create.l HWIO_DEM1X_FING_IRQ_STATUS_ADDR A:0xfcb37c80
y.create.l HWIO_DEM1X_FFE_TEST_ADDR A:0xfcb37e00
y.create.l HWIO_DEM1X_TEST_MEM_SEL_ADDR A:0xfcb37e04
y.create.l HWIO_DEM1X_TEST_MEM_ADDR_ADDR A:0xfcb37e08
y.create.l HWIO_DEM1X_TEST_MEM_WRITE_ADDR A:0xfcb37e0c
y.create.l HWIO_DEM1X_TEST_MEM_READ0_ADDR A:0xfcb37e10
y.create.l HWIO_DEM1X_TEST_BUS_SEL_ADDR A:0xfcb37e14
y.create.l HWIO_DEM1X_TEST_BUS_READ_ADDR A:0xfcb37e18
y.create.l HWIO_CDMA_DEMOD_ENABLE_ADDR A:0xfcb37e1c
y.create.l HWIO_PDMEM_MIN_ADDR A:0xfcb00000
y.create.l HWIO_PDMEM_MAX_ADDR A:0xfcb0fffc
y.create.l HWIO_CCS_MSTS_ADDR A:0xfcb1fc00
y.create.l HWIO_CCS_MCTL_ADDR A:0xfcb1fc04
y.create.l HWIO_CCS_IPC_ADDR A:0xfcb1fc08
y.create.l HWIO_CCS_PIC0MSK_ADDR A:0xfcb1fc0c
y.create.l HWIO_CCS_PIC0STS_ADDR A:0xfcb1fc10
y.create.l HWIO_CCS_PIC1MSK_ADDR A:0xfcb1fc14
y.create.l HWIO_CCS_PIC1STS_ADDR A:0xfcb1fc18
y.create.l HWIO_CCS_PIC2MSK_ADDR A:0xfcb1fc1c
y.create.l HWIO_CCS_PIC2STS_ADDR A:0xfcb1fc20
y.create.l HWIO_CCS_PIC3MSK_ADDR A:0xfcb1fc24
y.create.l HWIO_CCS_PIC3STS_ADDR A:0xfcb1fc28
y.create.l HWIO_CCS_PIC4MSK_ADDR A:0xfcb1fc2c
y.create.l HWIO_CCS_PIC4STS_ADDR A:0xfcb1fc30
y.create.l HWIO_CCS_PIC5MSK_ADDR A:0xfcb1fc34
y.create.l HWIO_CCS_PIC5STS_ADDR A:0xfcb1fc38
y.create.l HWIO_CCS_PIC6MSK_ADDR A:0xfcb1fc3c
y.create.l HWIO_CCS_PIC6STS_ADDR A:0xfcb1fc40
y.create.l HWIO_CCS_PIT_ADDR A:0xfcb1fc44
y.create.l HWIO_CCS_UTIME_ADDR A:0xfcb1fc48
y.create.l HWIO_CCS_MON0_ADDR A:0xfcb1fc4c
y.create.l HWIO_CCS_MON1_ADDR A:0xfcb1fc50
y.create.l HWIO_CCS_MON2_ADDR A:0xfcb1fc54
y.create.l HWIO_CCS_MON3_ADDR A:0xfcb1fc58
y.create.l HWIO_CCS_MON4_ADDR A:0xfcb1fc5c
y.create.l HWIO_CCS_MON5_ADDR A:0xfcb1fc60
y.create.l HWIO_CCS_MON6_ADDR A:0xfcb1fc64
y.create.l HWIO_CCS_MON7_ADDR A:0xfcb1fc68
y.create.l HWIO_CCS_MON8_ADDR A:0xfcb1fc6c
y.create.l HWIO_CCS_MON9_ADDR A:0xfcb1fc70
y.create.l HWIO_CCS_TMR0_ADDR A:0xfcb1fc7c
y.create.l HWIO_CCS_TMR1_ADDR A:0xfcb1fc80
y.create.l HWIO_CCS_TMR2_ADDR A:0xfcb1fc84
y.create.l HWIO_CCS_TMR3_ADDR A:0xfcb1fc88
y.create.l HWIO_CCS_DMAC_ADDR A:0xfcb1fc8c
y.create.l HWIO_CCS_DMAC0SRC_ADDR A:0xfcb1fc90
y.create.l HWIO_CCS_DMAC1SRC_ADDR A:0xfcb1fca0
y.create.l HWIO_CCS_DMAC2SRC_ADDR A:0xfcb1fcb0
y.create.l HWIO_CCS_DMAC3SRC_ADDR A:0xfcb1fcc0
y.create.l HWIO_CCS_DMAC4SRC_ADDR A:0xfcb1fcd0
y.create.l HWIO_CCS_DMAC5SRC_ADDR A:0xfcb1fce0
y.create.l HWIO_CCS_DMAC6SRC_ADDR A:0xfcb1fcf0
y.create.l HWIO_CCS_DMAC7SRC_ADDR A:0xfcb1fd00
y.create.l HWIO_CCS_DMAC0DST_ADDR A:0xfcb1fc94
y.create.l HWIO_CCS_DMAC1DST_ADDR A:0xfcb1fca4
y.create.l HWIO_CCS_DMAC2DST_ADDR A:0xfcb1fcb4
y.create.l HWIO_CCS_DMAC3DST_ADDR A:0xfcb1fcc4
y.create.l HWIO_CCS_DMAC4DST_ADDR A:0xfcb1fcd4
y.create.l HWIO_CCS_DMAC5DST_ADDR A:0xfcb1fce4
y.create.l HWIO_CCS_DMAC6DST_ADDR A:0xfcb1fcf4
y.create.l HWIO_CCS_DMAC7DST_ADDR A:0xfcb1fd04
y.create.l HWIO_CCS_DMAC0LNK_ADDR A:0xfcb1fc98
y.create.l HWIO_CCS_DMAC1LNK_ADDR A:0xfcb1fca8
y.create.l HWIO_CCS_DMAC2LNK_ADDR A:0xfcb1fcb8
y.create.l HWIO_CCS_DMAC3LNK_ADDR A:0xfcb1fcc8
y.create.l HWIO_CCS_DMAC4LNK_ADDR A:0xfcb1fcd8
y.create.l HWIO_CCS_DMAC5LNK_ADDR A:0xfcb1fce8
y.create.l HWIO_CCS_DMAC6LNK_ADDR A:0xfcb1fcf8
y.create.l HWIO_CCS_DMAC7LNK_ADDR A:0xfcb1fd08
y.create.l HWIO_CCS_DMAC0CTL_ADDR A:0xfcb1fc9c
y.create.l HWIO_CCS_DMAC1CTL_ADDR A:0xfcb1fcac
y.create.l HWIO_CCS_DMAC2CTL_ADDR A:0xfcb1fcbc
y.create.l HWIO_CCS_DMAC3CTL_ADDR A:0xfcb1fccc
y.create.l HWIO_CCS_DMAC4CTL_ADDR A:0xfcb1fcdc
y.create.l HWIO_CCS_DMAC5CTL_ADDR A:0xfcb1fcec
y.create.l HWIO_CCS_DMAC6CTL_ADDR A:0xfcb1fcfc
y.create.l HWIO_CCS_DMAC7CTL_ADDR A:0xfcb1fd0c
y.create.l HWIO_CCS_RFI_ADDR A:0xfcb1fd10
y.create.l HWIO_CCS_SSBI0_ADDR A:0xfcb1fd14
y.create.l HWIO_CCS_SSBI1_ADDR A:0xfcb1fd1c
y.create.l HWIO_CCS_SSBI2_ADDR A:0xfcb1fd24
y.create.l HWIO_CCS_SSBI3_ADDR A:0xfcb1fd2c
y.create.l HWIO_CCS_SSBI4_ADDR A:0xfcb1fd34
y.create.l HWIO_CCS_SSBI5_ADDR A:0xfcb1fd3c
y.create.l HWIO_CCS_SSBI0DAT_ADDR A:0xfcb1fd18
y.create.l HWIO_CCS_SSBI1DAT_ADDR A:0xfcb1fd20
y.create.l HWIO_CCS_SSBI2DAT_ADDR A:0xfcb1fd28
y.create.l HWIO_CCS_SSBI3DAT_ADDR A:0xfcb1fd30
y.create.l HWIO_CCS_SSBI4DAT_ADDR A:0xfcb1fd38
y.create.l HWIO_CCS_SSBI5DAT_ADDR A:0xfcb1fd40
y.create.l HWIO_CCS_GRFC_SET_ADDR A:0xfcb1fd44
y.create.l HWIO_CCS_GRFC_CLR_ADDR A:0xfcb1fd48
y.create.l HWIO_CCS_RFFE0_ADDR A:0xfcb1fd4c
y.create.l HWIO_CCS_RFFE1_ADDR A:0xfcb1fd54
y.create.l HWIO_CCS_RFFE0DAT_ADDR A:0xfcb1fd50
y.create.l HWIO_CCS_RFFE1DAT_ADDR A:0xfcb1fd58
y.create.l HWIO_CCS_QPT_ADDR A:0xfcb1fd5c
y.create.l HWIO_CCS_BP0_ADDR A:0xfcb1fd60
y.create.l HWIO_CCS_BP1_ADDR A:0xfcb1fd64
y.create.l HWIO_MTC_ENABLE_ADDR A:0xfcb20000
y.create.l HWIO_MODEM_PWRUP_ADDR A:0xfcb20004
y.create.l HWIO_MODEM_PWRON_ADDR A:0xfcb20008
y.create.l HWIO_MODEM_ID_ADDR A:0xfcb2000c
y.create.l HWIO_MODEM_FEATURE_EN_ADDR A:0xfcb20010
y.create.l HWIO_MODEM_OPTION_EN_ADDR A:0xfcb20014
y.create.l HWIO_MODEM_CLK_MP_CFG_ADDR A:0xfcb20018
y.create.l HWIO_MODEM_CLK_MP_TRIG_ADDR A:0xfcb2001c
y.create.l HWIO_MODEM_CLK_MP_STATUS_ADDR A:0xfcb20020
y.create.l HWIO_MODEM_CLK_TDEC_CFG_ADDR A:0xfcb20024
y.create.l HWIO_MODEM_CLK_TDEC_TRIG_ADDR A:0xfcb20028
y.create.l HWIO_MODEM_CLK_TDEC_STATUS_ADDR A:0xfcb2002c
y.create.l HWIO_MODEM_CLK_DBG_CFG_ADDR A:0xfcb20030
y.create.l HWIO_MODEM_CLK_SPARE_ADDR A:0xfcb20034
y.create.l HWIO_MCDMA_RESET_ADDR A:0xfcb20400
y.create.l HWIO_MCDMA_ENABLE_ADDR A:0xfcb2049c
y.create.l HWIO_MCDMA_LOG_CH_BUSY_ADDR A:0xfcb20404
y.create.l HWIO_MCDMA_LOG_HW_CH0_SYNC_ADDR A:0xfcb20408
y.create.l HWIO_MCDMA_LOG_HW_CH1_SYNC_ADDR A:0xfcb2040c
y.create.l HWIO_MCDMA_LOG_HW_CH2_SYNC_ADDR A:0xfcb20410
y.create.l HWIO_MCDMA_LOG_HW_CH3_SYNC_ADDR A:0xfcb20414
y.create.l HWIO_MCDMA_LOG_HW_CH4_SYNC_ADDR A:0xfcb20418
y.create.l HWIO_MCDMA_LOG_HW_CH0_CTL_ADDR A:0xfcb20420
y.create.l HWIO_MCDMA_LOG_HW_CH1_CTL_ADDR A:0xfcb20424
y.create.l HWIO_MCDMA_LOG_HW_CH2_CTL_ADDR A:0xfcb20428
y.create.l HWIO_MCDMA_LOG_HW_CH3_CTL_ADDR A:0xfcb2042c
y.create.l HWIO_MCDMA_LOG_HW_CH4_CTL_ADDR A:0xfcb20430
y.create.l HWIO_MCDMA_LOG_SW_CH0_RESET_ADDR A:0xfcb20438
y.create.l HWIO_MCDMA_LOG_SW_CH1_RESET_ADDR A:0xfcb2043c
y.create.l HWIO_MCDMA_LOG_SW_CH2_RESET_ADDR A:0xfcb20440
y.create.l HWIO_MCDMA_LOG_SW_CH3_RESET_ADDR A:0xfcb20444
y.create.l HWIO_MCDMA_LOG_SW_CH0_CTL_ADDR A:0xfcb2044c
y.create.l HWIO_MCDMA_LOG_SW_CH1_CTL_ADDR A:0xfcb20450
y.create.l HWIO_MCDMA_LOG_SW_CH2_CTL_ADDR A:0xfcb20454
y.create.l HWIO_MCDMA_LOG_SW_CH3_CTL_ADDR A:0xfcb20458
y.create.l HWIO_MCDMA_PHY_CH_CTL_ADDR A:0xfcb20460
y.create.l HWIO_MCDMA_LOG_HW_CH0_DBG_ADDR A:0xfcb20464
y.create.l HWIO_MCDMA_LOG_HW_CH1_DBG_ADDR A:0xfcb20468
y.create.l HWIO_MCDMA_LOG_HW_CH2_DBG_ADDR A:0xfcb2046c
y.create.l HWIO_MCDMA_LOG_HW_CH3_DBG_ADDR A:0xfcb20470
y.create.l HWIO_MCDMA_LOG_HW_CH4_DBG_ADDR A:0xfcb20474
y.create.l HWIO_MCDMA_LOG_SW_CH0_DBG_ADDR A:0xfcb20478
y.create.l HWIO_MCDMA_LOG_SW_CH1_DBG_ADDR A:0xfcb2047c
y.create.l HWIO_MCDMA_LOG_SW_CH2_DBG_ADDR A:0xfcb20480
y.create.l HWIO_MCDMA_LOG_SW_CH3_DBG_ADDR A:0xfcb20484
y.create.l HWIO_MCDMA_PHY_CH_DBG_ADDR A:0xfcb20488
y.create.l HWIO_MCDMA_VBUF_CFG_DBG_ADDR A:0xfcb2048c
y.create.l HWIO_MCDMA_VBUF_CFG_SEL_ADDR A:0xfcb20490
y.create.l HWIO_MCDMA_VBUF_CFG_RD0_ADDR A:0xfcb20494
y.create.l HWIO_MCDMA_VBUF_CFG_RD1_ADDR A:0xfcb20498
y.create.l HWIO_A2_SW_RESET_THRD_ADDR A:0xfcb20800
y.create.l HWIO_A2_SW_RESET_ACC_ADDR A:0xfcb20804
y.create.l HWIO_A2_TASK0_EN_ADDR A:0xfcb20808
y.create.l HWIO_A2_TASK1_EN_ADDR A:0xfcb2080c
y.create.l HWIO_A2_TASK2_EN_ADDR A:0xfcb20810
y.create.l HWIO_A2_TASK3_EN_ADDR A:0xfcb20814
y.create.l HWIO_A2_TASK0_WR_PTR_ADDR A:0xfcb20820
y.create.l HWIO_A2_TASK1_WR_PTR_ADDR A:0xfcb20824
y.create.l HWIO_A2_TASK2_WR_PTR_ADDR A:0xfcb20828
y.create.l HWIO_A2_TASK3_WR_PTR_ADDR A:0xfcb2082c
y.create.l HWIO_A2_TASK0_RD_PTR_ADDR A:0xfcb20840
y.create.l HWIO_A2_TASK1_RD_PTR_ADDR A:0xfcb20844
y.create.l HWIO_A2_TASK2_RD_PTR_ADDR A:0xfcb20848
y.create.l HWIO_A2_TASK3_RD_PTR_ADDR A:0xfcb2084c
y.create.l HWIO_A2_TASK0_RD_PTR_INIT_ADDR A:0xfcb20860
y.create.l HWIO_A2_TASK1_RD_PTR_INIT_ADDR A:0xfcb20864
y.create.l HWIO_A2_TASK2_RD_PTR_INIT_ADDR A:0xfcb20868
y.create.l HWIO_A2_TASK3_RD_PTR_INIT_ADDR A:0xfcb2086c
y.create.l HWIO_A2_TASK0_RD_PTR_INIT_EN_ADDR A:0xfcb20880
y.create.l HWIO_A2_TASK1_RD_PTR_INIT_EN_ADDR A:0xfcb20884
y.create.l HWIO_A2_TASK2_RD_PTR_INIT_EN_ADDR A:0xfcb20888
y.create.l HWIO_A2_TASK3_RD_PTR_INIT_EN_ADDR A:0xfcb2088c
y.create.l HWIO_A2_QUEUE_UPPER_ADDR_ADDR A:0xfcb208b0
y.create.l HWIO_A2_STATUS0_WR_EN_ADDR A:0xfcb208c8
y.create.l HWIO_A2_STATUS1_WR_EN_ADDR A:0xfcb208cc
y.create.l HWIO_A2_STATUS2_WR_EN_ADDR A:0xfcb208d0
y.create.l HWIO_A2_STATUS3_WR_EN_ADDR A:0xfcb208d4
y.create.l HWIO_A2_STATUS4_WR_EN_ADDR A:0xfcb208d8
y.create.l HWIO_A2_STATUS0_WR_START_ADDR A:0xfcb208dc
y.create.l HWIO_A2_STATUS1_WR_START_ADDR A:0xfcb208e0
y.create.l HWIO_A2_STATUS2_WR_START_ADDR A:0xfcb208e4
y.create.l HWIO_A2_STATUS3_WR_START_ADDR A:0xfcb208e8
y.create.l HWIO_A2_STATUS4_WR_START_ADDR A:0xfcb208ec
y.create.l HWIO_A2_STATUS0_WR_END_ADDR A:0xfcb208f0
y.create.l HWIO_A2_STATUS1_WR_END_ADDR A:0xfcb208f4
y.create.l HWIO_A2_STATUS2_WR_END_ADDR A:0xfcb208f8
y.create.l HWIO_A2_STATUS3_WR_END_ADDR A:0xfcb208fc
y.create.l HWIO_A2_STATUS4_WR_END_ADDR A:0xfcb20900
y.create.l HWIO_A2_STATUS0_WR_PTR_INIT_ADDR A:0xfcb20904
y.create.l HWIO_A2_STATUS1_WR_PTR_INIT_ADDR A:0xfcb20908
y.create.l HWIO_A2_STATUS2_WR_PTR_INIT_ADDR A:0xfcb2090c
y.create.l HWIO_A2_STATUS3_WR_PTR_INIT_ADDR A:0xfcb20910
y.create.l HWIO_A2_STATUS4_WR_PTR_INIT_ADDR A:0xfcb20914
y.create.l HWIO_A2_STATUS0_WR_PTR_INIT_EN_ADDR A:0xfcb20918
y.create.l HWIO_A2_STATUS1_WR_PTR_INIT_EN_ADDR A:0xfcb2091c
y.create.l HWIO_A2_STATUS2_WR_PTR_INIT_EN_ADDR A:0xfcb20920
y.create.l HWIO_A2_STATUS3_WR_PTR_INIT_EN_ADDR A:0xfcb20924
y.create.l HWIO_A2_STATUS4_WR_PTR_INIT_EN_ADDR A:0xfcb20928
y.create.l HWIO_A2_STATUS0_WR_PTR_CURRENT_ADDR A:0xfcb2092c
y.create.l HWIO_A2_STATUS1_WR_PTR_CURRENT_ADDR A:0xfcb20930
y.create.l HWIO_A2_STATUS2_WR_PTR_CURRENT_ADDR A:0xfcb20934
y.create.l HWIO_A2_STATUS3_WR_PTR_CURRENT_ADDR A:0xfcb20938
y.create.l HWIO_A2_STATUS4_WR_PTR_CURRENT_ADDR A:0xfcb2093c
y.create.l HWIO_A2_STATUS0_WR_PTR_ADDR A:0xfcb20940
y.create.l HWIO_A2_STATUS1_WR_PTR_ADDR A:0xfcb20944
y.create.l HWIO_A2_STATUS2_WR_PTR_ADDR A:0xfcb20948
y.create.l HWIO_A2_STATUS3_WR_PTR_ADDR A:0xfcb2094c
y.create.l HWIO_A2_STATUS4_WR_PTR_ADDR A:0xfcb20950
y.create.l HWIO_A2_STATUS0_RD_PTR_ADDR A:0xfcb20954
y.create.l HWIO_A2_STATUS1_RD_PTR_ADDR A:0xfcb20958
y.create.l HWIO_A2_STATUS2_RD_PTR_ADDR A:0xfcb2095c
y.create.l HWIO_A2_STATUS3_RD_PTR_ADDR A:0xfcb20960
y.create.l HWIO_A2_STATUS4_RD_PTR_ADDR A:0xfcb20964
y.create.l HWIO_A2_FRAG0_THRESHOLD_ADDR A:0xfcb209c0
y.create.l HWIO_A2_FRAG1_THRESHOLD_ADDR A:0xfcb209c4
y.create.l HWIO_A2_FRAG0_REFILL_EN_ADDR A:0xfcb209c8
y.create.l HWIO_A2_FRAG1_REFILL_EN_ADDR A:0xfcb209cc
y.create.l HWIO_A2_FRAG0_LEN_ADDR A:0xfcb209d0
y.create.l HWIO_A2_FRAG1_LEN_ADDR A:0xfcb209d4
y.create.l HWIO_A2_FRAG0_ADDR_ADDR A:0xfcb209d8
y.create.l HWIO_A2_FRAG1_ADDR_ADDR A:0xfcb209dc
y.create.l HWIO_A2_FRAG0_PTR_ADDR A:0xfcb209e0
y.create.l HWIO_A2_FRAG1_PTR_ADDR A:0xfcb209e4
y.create.l HWIO_A2_FRAG_CACHE_LINE_ADDR A:0xfcb209e8
y.create.l HWIO_A2_FRAG_CACHE_LINE_MASK_ADDR A:0xfcb209ec
y.create.l HWIO_A2_FRAG0_TRANSFER_LEN_ADDR A:0xfcb209f0
y.create.l HWIO_A2_FRAG1_TRANSFER_LEN_ADDR A:0xfcb209f4
y.create.l HWIO_A2_FRAG0_HDR_LEN_ADDR A:0xfcb209f8
y.create.l HWIO_A2_FRAG1_HDR_LEN_ADDR A:0xfcb209fc
y.create.l HWIO_A2_FRAG0_QUEUE_START_ADDR_ADDR A:0xfcb20a08
y.create.l HWIO_A2_FRAG1_QUEUE_START_ADDR_ADDR A:0xfcb20a0c
y.create.l HWIO_A2_FRAG0_QUEUE_WR_PTR_ADDR A:0xfcb20aa0
y.create.l HWIO_A2_FRAG1_QUEUE_WR_PTR_ADDR A:0xfcb20aa4
y.create.l HWIO_A2_FRAG0_QUEUE_RD_PTR_ADDR A:0xfcb20aa8
y.create.l HWIO_A2_FRAG1_QUEUE_RD_PTR_ADDR A:0xfcb20aac
y.create.l HWIO_A2_FRAG0_RD_PTR_INIT_EN_ADDR A:0xfcb20acc
y.create.l HWIO_A2_FRAG1_RD_PTR_INIT_EN_ADDR A:0xfcb20ad0
y.create.l HWIO_A2_TIMER0_CFG_ADDR A:0xfcb20a10
y.create.l HWIO_A2_TIMER1_CFG_ADDR A:0xfcb20a14
y.create.l HWIO_A2_TIMER2_CFG_ADDR A:0xfcb20a18
y.create.l HWIO_A2_TIMER3_CFG_ADDR A:0xfcb20a1c
y.create.l HWIO_A2_TIMER0_CMD_ADDR A:0xfcb20a20
y.create.l HWIO_A2_TIMER1_CMD_ADDR A:0xfcb20a24
y.create.l HWIO_A2_TIMER2_CMD_ADDR A:0xfcb20a28
y.create.l HWIO_A2_TIMER3_CMD_ADDR A:0xfcb20a2c
y.create.l HWIO_A2_TIMER0_PERIOD_ADDR A:0xfcb20a40
y.create.l HWIO_A2_TIMER1_PERIOD_ADDR A:0xfcb20a44
y.create.l HWIO_A2_TIMER2_PERIOD_ADDR A:0xfcb20a48
y.create.l HWIO_A2_TIMER3_PERIOD_ADDR A:0xfcb20a4c
y.create.l HWIO_A2_TIMER0_STATUS_ADDR A:0xfcb20a50
y.create.l HWIO_A2_TIMER1_STATUS_ADDR A:0xfcb20a54
y.create.l HWIO_A2_TIMER2_STATUS_ADDR A:0xfcb20a58
y.create.l HWIO_A2_TIMER3_STATUS_ADDR A:0xfcb20a5c
y.create.l HWIO_A2_PER_DL_CFG_ADDR A:0xfcb20a70
y.create.l HWIO_A2_PER0_UL_CFG_ADDR A:0xfcb20a74
y.create.l HWIO_A2_PER1_UL_CFG_ADDR A:0xfcb20a78
y.create.l HWIO_A2_PER2_UL_CFG_ADDR A:0xfcb20a7c
y.create.l HWIO_A2_DL_PHY_DEC_TRBLK_THRESHOLD_ADDR A:0xfcb20a90
y.create.l HWIO_A2_DL_PHY_CFG_ADDR A:0xfcb20a94
y.create.l HWIO_A2_HW_THRD_EN_ADDR A:0xfcb20a98
y.create.l HWIO_A2_UL_PHY_CFG_ADDR A:0xfcb20a9c
y.create.l HWIO_A2_LTE_DLPHY_CMD_ADDR_ADDR A:0xfcb20ab0
y.create.l HWIO_A2_IP_FILT_FRAG_ADDR_ADDR A:0xfcb20ab4
y.create.l HWIO_A2_MCDMA_DMA_IN_ADDR_ADDR A:0xfcb20ab8
y.create.l HWIO_A2_MCDMA_DMA_OUT_ADDR_ADDR A:0xfcb20abc
y.create.l HWIO_A2_MCDMA_TASK_ADDR_ADDR A:0xfcb20ac0
y.create.l HWIO_A2_MCDMA_BAM_NDP_ADDR_ADDR A:0xfcb20ac4
y.create.l HWIO_A2_DECOB_PREFETCH_ADDR_ADDR A:0xfcb20ac8
y.create.l HWIO_A2_MCDMA_OST_BRST_ADDR A:0xfcb20ad4
y.create.l HWIO_A2_MCDMA_MAX_BRST_SIZE_ADDR A:0xfcb20ad8
y.create.l HWIO_A2_HW_CLK_CTL_ADDR A:0xfcb20ae0
y.create.l HWIO_A2_CLK_EN_CTL_ADDR A:0xfcb20ae4
y.create.l HWIO_A2_CLK_STATUS_ADDR A:0xfcb20ae8
y.create.l HWIO_A2_UL_PER_1ST_PKT_INT_EN_ADDR A:0xfcb20aec
y.create.l HWIO_A2_DBG_LINK_RD_ADDR A:0xfcb20af0
y.create.l HWIO_A2_DBG_FRAG0_LEN_ADDR A:0xfcb20af8
y.create.l HWIO_A2_DBG_FRAG1_LEN_ADDR A:0xfcb20afc
y.create.l HWIO_A2_DBG_FRAG2_LEN_ADDR A:0xfcb20b00
y.create.l HWIO_A2_DBG_FRAG3_LEN_ADDR A:0xfcb20b04
y.create.l HWIO_A2_DBG_FRAG4_LEN_ADDR A:0xfcb20b08
y.create.l HWIO_A2_DBG_FRAG0_ADDR_CUR_ADDR A:0xfcb20b0c
y.create.l HWIO_A2_DBG_FRAG1_ADDR_CUR_ADDR A:0xfcb20b10
y.create.l HWIO_A2_DBG_FRAG2_ADDR_CUR_ADDR A:0xfcb20b14
y.create.l HWIO_A2_DBG_FRAG3_ADDR_CUR_ADDR A:0xfcb20b18
y.create.l HWIO_A2_DBG_FRAG4_ADDR_CUR_ADDR A:0xfcb20b1c
y.create.l HWIO_A2_DBG_FRAG0_ADDR_NXT_ADDR A:0xfcb20b20
y.create.l HWIO_A2_DBG_FRAG1_ADDR_NXT_ADDR A:0xfcb20b24
y.create.l HWIO_A2_DBG_FRAG2_ADDR_NXT_ADDR A:0xfcb20b28
y.create.l HWIO_A2_DBG_FRAG3_ADDR_NXT_ADDR A:0xfcb20b2c
y.create.l HWIO_A2_DBG_FRAG4_ADDR_NXT_ADDR A:0xfcb20b30
y.create.l HWIO_A2_DBG_FRAG0_PTR_ADDR A:0xfcb20b34
y.create.l HWIO_A2_DBG_FRAG1_PTR_ADDR A:0xfcb20b38
y.create.l HWIO_A2_DBG_FRAG2_PTR_ADDR A:0xfcb20b3c
y.create.l HWIO_A2_DBG_FRAG3_PTR_ADDR A:0xfcb20b40
y.create.l HWIO_A2_DBG_FRAG4_PTR_ADDR A:0xfcb20b44
y.create.l HWIO_A2_DBG_TRBLK_LENGTH_ADDR A:0xfcb20b60
y.create.l HWIO_A2_DBG_TRBLK_START_ADDR_ADDR A:0xfcb20b64
y.create.l HWIO_A2_DBG_TRBLK_SW_INFO0_ADDR A:0xfcb20b68
y.create.l HWIO_A2_DBG_TRBLK_SW_INFO1_ADDR A:0xfcb20b6c
y.create.l HWIO_A2_DBG_TRBLK_TRIGGER_ADDR A:0xfcb20b70
y.create.l HWIO_A2_DBG_TRBLK_STATUS_ADDR A:0xfcb20b74
y.create.l HWIO_A2_DBG_STRM_ID_ADDR A:0xfcb20b80
y.create.l HWIO_A2_DBG_DMA_SRC_ADDR A:0xfcb20b84
y.create.l HWIO_A2_DBG_DMA_DST_ADDR A:0xfcb20b8c
y.create.l HWIO_A2_DBG_DMA_CTL_ADDR A:0xfcb20b90
y.create.l HWIO_A2_DBG_TASK_FETCHER_ADDR A:0xfcb20b94
y.create.l HWIO_A2_DBG_DL0_BAM_ADDR A:0xfcb20b98
y.create.l HWIO_A2_DBG_DL1_BAM_ADDR A:0xfcb20b9c
y.create.l HWIO_A2_DBG_DL2_BAM_ADDR A:0xfcb20ba0
y.create.l HWIO_A2_DBG_UL0_BAM_ADDR A:0xfcb20ba4
y.create.l HWIO_A2_DBG_UL1_BAM_ADDR A:0xfcb20ba8
y.create.l HWIO_A2_DBG_UL2_BAM_ADDR A:0xfcb20bac
y.create.l HWIO_A2_DBG_FRM_ADDR A:0xfcb20bb0
y.create.l HWIO_A2_DBG_DFRM_ADDR A:0xfcb20bb4
y.create.l HWIO_A2_DBG_CIPH_ADDR A:0xfcb20bb8
y.create.l HWIO_A2_DBG_IPF_ADDR A:0xfcb20bbc
y.create.l HWIO_A2_DBG_MIU0_ADDR A:0xfcb20bc0
y.create.l HWIO_A2_DBG_MIU1_ADDR A:0xfcb20bc4
y.create.l HWIO_A2_DBG_MIU2_ADDR A:0xfcb20bc8
y.create.l HWIO_A2_DBG_MIU3_ADDR A:0xfcb20bcc
y.create.l HWIO_A2_DBG_TASK_WORD_ADDR A:0xfcb20bd0
y.create.l HWIO_DBG_RESET_ADDR A:0xfcb20c00
y.create.l HWIO_DBG_ENABLE_ADDR A:0xfcb20c04
y.create.l HWIO_DBG_LOG_STATUS_ADDR A:0xfcb20c08
y.create.l HWIO_DBG_MUX_MASK_0_ADDR A:0xfcb20c0c
y.create.l HWIO_DBG_MUX_MASK_1_ADDR A:0xfcb20c10
y.create.l HWIO_DBG_MUX_MASK_2_ADDR A:0xfcb20c14
y.create.l HWIO_DBG_MUX_MASK_3_ADDR A:0xfcb20c18
y.create.l HWIO_DBG_MUX_MASK_4_ADDR A:0xfcb20c1c
y.create.l HWIO_DBG_MUX_MASK_5_ADDR A:0xfcb20c20
y.create.l HWIO_DBG_MUX_MASK_6_ADDR A:0xfcb20c24
y.create.l HWIO_DBG_MUX_MASK_7_ADDR A:0xfcb20c28
y.create.l HWIO_DBG_MUX_MASK_8_ADDR A:0xfcb20c2c
y.create.l HWIO_DBG_MUX_MASK_9_ADDR A:0xfcb20c30
y.create.l HWIO_DBG_PORT_MUX_ADDR A:0xfcb20c4c
y.create.l HWIO_DBG_ERR_IRQ_MASK0_ADDR A:0xfcb20c50
y.create.l HWIO_DBG_ERR_IRQ_MASK1_ADDR A:0xfcb20c54
y.create.l HWIO_DBG_SW_LOG_ADDR A:0xfcb20c58
y.create.l HWIO_DBG_DATA_DST_ADDR A:0xfcb20c5c
y.create.l HWIO_DBG_START_ADDR_ADDR A:0xfcb20c60
y.create.l HWIO_DBG_EXT_MEM_CNT_VAL_ADDR A:0xfcb20c64
y.create.l HWIO_DBG_SHRD_START_ADDR_ADDR A:0xfcb20c68
y.create.l HWIO_DBG_SHRD_END_ADDR_ADDR A:0xfcb20c6c
y.create.l HWIO_DBG_MAX_OST_BURSTS_ADDR A:0xfcb20c70
y.create.l HWIO_DBG_ERR_IRQ_EN0_ADDR A:0xfcb20c74
y.create.l HWIO_DBG_ERR_IRQ_EN1_ADDR A:0xfcb20c78
y.create.l HWIO_DBG_ERR_IRQ_CLR0_ADDR A:0xfcb20c7c
y.create.l HWIO_DBG_ERR_IRQ_CLR1_ADDR A:0xfcb20c80
y.create.l HWIO_DBG_ERR_IRQ_STATUS0_ADDR A:0xfcb20c84
y.create.l HWIO_DBG_ERR_IRQ_STATUS1_ADDR A:0xfcb20c88
y.create.l HWIO_MTC_BRDG_MCDMA_RD_ENABLE_ADDR A:0xfcb2100c
y.create.l HWIO_MTC_BRDG_MCDMA_WR_ENABLE_ADDR A:0xfcb21010
y.create.l HWIO_MTC_BRDG_A2_RD_ENABLE_ADDR A:0xfcb21014
y.create.l HWIO_MTC_BRDG_CTL_ADDR A:0xfcb21000
y.create.l HWIO_MTC_BRDG_STATUS_ADDR A:0xfcb21004
y.create.l HWIO_MTC_BRDG_CLEAR_ADDR A:0xfcb21008
y.create.l HWIO_A2_SHRD_MEM_BASE_MIN_ADDR A:0xfcb22000
y.create.l HWIO_A2_SHRD_MEM_BASE_MAX_ADDR A:0xfcb2367c
y.create.l HWIO_MCDMA_TS_STATUS_WORD0_ADDR A:0xfcb24000
y.create.l HWIO_MCDMA_TS_VBUF_CFG_WORD0_ADDR A:0xfcb24100
y.create.l HWIO_MCDMA_TS_VBUF_CFG_WORD1_ADDR A:0xfcb24104
y.create.l HWIO_MCDMA_TS_DMA_CH0_WORD0_ADDR A:0xfcb24200
y.create.l HWIO_MCDMA_TS_DMA_CH0_WORD1_ADDR A:0xfcb24204
y.create.l HWIO_MCDMA_TS_DMA_CH0_WORD2_ADDR A:0xfcb24208
y.create.l HWIO_MCDMA_TS_DMA_CH1_WORD0_ADDR A:0xfcb24300
y.create.l HWIO_MCDMA_TS_DMA_CH1_WORD1_ADDR A:0xfcb24304
y.create.l HWIO_MCDMA_TS_DMA_CH1_WORD2_ADDR A:0xfcb24308
y.create.l HWIO_MCDMA_TS_DMA_CH2_WORD0_ADDR A:0xfcb24400
y.create.l HWIO_MCDMA_TS_DMA_CH2_WORD1_ADDR A:0xfcb24404
y.create.l HWIO_MCDMA_TS_DMA_CH2_WORD2_ADDR A:0xfcb24408
y.create.l HWIO_MCDMA_TS_DMA_CH3_WORD0_ADDR A:0xfcb24500
y.create.l HWIO_MCDMA_TS_DMA_CH3_WORD1_ADDR A:0xfcb24504
y.create.l HWIO_MCDMA_TS_DMA_CH3_WORD2_ADDR A:0xfcb24508
y.create.l HWIO_DBG_STATUS_WORD0_ADDR A:0xfcb24800
y.create.l HWIO_DBG_TASK_WORD0_ADDR A:0xfcb24900
y.create.l HWIO_DBG_TASK_WORD1_ADDR A:0xfcb24904
y.create.l HWIO_UNIV_STMR_MSTMR_EXPY_ADDR A:0xfcb24c00
y.create.l HWIO_O_STMR_MSTMR_EXPY_ADDR A:0xfcb24c04
y.create.l HWIO_STMR_REF_COUNT_EXPY_ADDR A:0xfcb24c08
y.create.l HWIO_STMR_PROG_SNP_INT0_STATUS_ADDR A:0xfcb24c0c
y.create.l HWIO_STMR_PROG_SNP_INT1_STATUS_ADDR A:0xfcb24c10
y.create.l HWIO_STMR_PROG_SNP_INT0_CMD_ADDR A:0xfcb24c14
y.create.l HWIO_STMR_PROG_SNP_INT1_CMD_ADDR A:0xfcb24c18
y.create.l HWIO_STMR_PROG_SNP_INT0_SET_ADDR A:0xfcb24c1c
y.create.l HWIO_STMR_PROG_SNP_INT1_SET_ADDR A:0xfcb24c20
y.create.l HWIO_TDS_STMR_ENABLE_ADDR A:0xfcb28400
y.create.l HWIO_TDS_STMR_STATUS_ADDR A:0xfcb28404
y.create.l HWIO_TDS_STMR_FCW_CTL_ADDR A:0xfcb28408
y.create.l HWIO_TDS_STMR_RESET_ADDR A:0xfcb2840c
y.create.l HWIO_TDS_STMR_ST_EVENT_CMD_ADDR A:0xfcb28410
y.create.l HWIO_TDS_STMR_ST_EVENT_TIME_ADDR A:0xfcb28414
y.create.l HWIO_TDS_STMR_WALLTIME_COUNT_ADDR A:0xfcb28418
y.create.l HWIO_TDS_STMR_COMMON_PHASE_ADDR A:0xfcb2841c
y.create.l HWIO_TDS_STMR_WALLTIME_CMD_ADDR A:0xfcb28420
y.create.l HWIO_TDS_STMR_WALL_TIME_MODIFIER_ADDR A:0xfcb28424
y.create.l HWIO_TDS_STMR_WALLTIME_INT_EVENT_0_ADDR A:0xfcb28428
y.create.l HWIO_TDS_STMR_WALLTIME_INT_EVENT_1_ADDR A:0xfcb2842c
y.create.l HWIO_TDS_STMR_WALLTIME_INT_EVENT_2_ADDR A:0xfcb28430
y.create.l HWIO_TDS_STMR_WALLTIME_INT_EVENT_3_ADDR A:0xfcb28434
y.create.l HWIO_TDS_STMR_WALLTIME_INT_EVENT_4_ADDR A:0xfcb28438
y.create.l HWIO_TDS_STMR_WALLTIME_INT_EVENT_5_ADDR A:0xfcb2843c
y.create.l HWIO_TDS_STMR_WALLTIME_INT_EVENT_6_ADDR A:0xfcb28440
y.create.l HWIO_TDS_STMR_WALLTIME_INT_EVENT_7_ADDR A:0xfcb28444
y.create.l HWIO_TDS_STMR_WALLTIME_INT_CMD_ADDR A:0xfcb28448
y.create.l HWIO_TDS_STMR_WALLTIME_INT_STATUS_ADDR A:0xfcb2844c
y.create.l HWIO_TDS_STMR_RXTIME_COUNT_ADDR A:0xfcb28450
y.create.l HWIO_TDS_STMR_RXTIME_CMD_ADDR A:0xfcb28454
y.create.l HWIO_TDS_STMR_RX_TIME_MODIFIER_ADDR A:0xfcb28458
y.create.l HWIO_TDS_STMR_RXTIME_INT_EVENT_0_ADDR A:0xfcb2845c
y.create.l HWIO_TDS_STMR_RXTIME_INT_EVENT_1_ADDR A:0xfcb28460
y.create.l HWIO_TDS_STMR_RXTIME_INT_EVENT_2_ADDR A:0xfcb28464
y.create.l HWIO_TDS_STMR_RXTIME_INT_EVENT_3_ADDR A:0xfcb28468
y.create.l HWIO_TDS_STMR_RXTIME_INT_EVENT_4_ADDR A:0xfcb2846c
y.create.l HWIO_TDS_STMR_RXTIME_INT_EVENT_5_ADDR A:0xfcb28470
y.create.l HWIO_TDS_STMR_RXTIME_INT_EVENT_6_ADDR A:0xfcb28474
y.create.l HWIO_TDS_STMR_RXTIME_INT_EVENT_7_ADDR A:0xfcb28478
y.create.l HWIO_TDS_STMR_RXTIME_INT_EVENT_8_ADDR A:0xfcb2847c
y.create.l HWIO_TDS_STMR_RXTIME_INT_EVENT_9_ADDR A:0xfcb28480
y.create.l HWIO_TDS_STMR_RXTIME_INT_STATUS_ADDR A:0xfcb2849c
y.create.l HWIO_TDS_STMR_RXTIME_INT_CMD_ADDR A:0xfcb284a0
y.create.l HWIO_TDS_STMR_STATUS_DUMP_CMD_ADDR A:0xfcb284a4
y.create.l HWIO_TDS_STMR_WALLTIME_COUNT_STATUS_ADDR A:0xfcb284a8
y.create.l HWIO_TDS_STMR_COMMON_PHASE_STATUS_ADDR A:0xfcb284ac
y.create.l HWIO_TDS_STMR_RXTIME_COUNT_STATUS_ADDR A:0xfcb284b0
y.create.l HWIO_TDS_STMR_TIME_SYNC_CTL_ADDR A:0xfcb284b4
y.create.l HWIO_VFR_EVENT_ADDR A:0xfcb284e8
y.create.l HWIO_UNIV_STMR_RESET_ADDR A:0xfcb28800
y.create.l HWIO_UNIV_STMR_ENABLE_ADDR A:0xfcb28804
y.create.l HWIO_UNIV_STMR_MSTMR_ADDR A:0xfcb28808
y.create.l HWIO_UNIV_STMR_SYNC_CMD_ADDR A:0xfcb2880c
y.create.l HWIO_UNIV_STMR_MODIFIER_ADJ_ADDR A:0xfcb28810
y.create.l HWIO_UNIV_STMR_STATUS_ADDR A:0xfcb28814
y.create.l HWIO_SYS_ONLINE_CTRL0_ADDR A:0xfcb28818
y.create.l HWIO_SYS_ONLINE_CTRL1_ADDR A:0xfcb2881c
y.create.l HWIO_SYS_ONLINE_CMD0_ADDR A:0xfcb28820
y.create.l HWIO_SYS_ONLINE_CMD1_ADDR A:0xfcb28824
y.create.l HWIO_SYS_ONLINE_TIME0_ADDR A:0xfcb28828
y.create.l HWIO_SYS_ONLINE_TIME1_ADDR A:0xfcb2882c
y.create.l HWIO_SYS_ONLINE_STATUS_ADDR A:0xfcb28830
y.create.l HWIO_UNIV_STMR_STATUS_DUMP_CMD_ADDR A:0xfcb28834
y.create.l HWIO_UNIV_STMR_TIME_STATUS_RD_ADDR A:0xfcb28838
y.create.l HWIO_O_STMR_TIME_STATUS_RD_ADDR A:0xfcb2883c
y.create.l HWIO_O_STMR_PHASE_STATUS_RD_ADDR A:0xfcb28840
y.create.l HWIO_RTC_1X_TIME_STATUS_RD_ADDR A:0xfcb28844
y.create.l HWIO_TX_1X_TIME_STATUS_RD_ADDR A:0xfcb28848
y.create.l HWIO_RTC_1X_PHASE_STATUS_RD_ADDR A:0xfcb2884c
y.create.l HWIO_RTC_HDR_TIME_STATUS_RD_ADDR A:0xfcb28850
y.create.l HWIO_RTC_HDR_PHASE_STATUS_RD_ADDR A:0xfcb28854
y.create.l HWIO_GSM_TIME_STATUS_RD_ADDR A:0xfcb28858
y.create.l HWIO_GSM_PHASE_STATUS_RD_ADDR A:0xfcb2885c
y.create.l HWIO_GSM_TIME_STATUS_RD_G1_ADDR A:0xfcb288f4
y.create.l HWIO_GSM_PHASE_STATUS_RD_G1_ADDR A:0xfcb288f8
y.create.l HWIO_UMTS_STMR_TIME_STATUS_RD_ADDR A:0xfcb28860
y.create.l HWIO_UMTS_TX_TIME_STATUS_RD_ADDR A:0xfcb28864
y.create.l HWIO_UMTS_STMR_PHASE_STATUS_RD_ADDR A:0xfcb28868
y.create.l HWIO_TDS_WALLTIME_STATUS_RD_ADDR A:0xfcb2886c
y.create.l HWIO_TDS_RXTIME_STATUS_RD_ADDR A:0xfcb28870
y.create.l HWIO_TDS_PHASE_STATUS_RD_ADDR A:0xfcb28874
y.create.l HWIO_RXFE_C0_TRIG_CMD_ADDR A:0xfcb28878
y.create.l HWIO_RXFE_C1_TRIG_CMD_ADDR A:0xfcb2887c
y.create.l HWIO_RXFE_C2_TRIG_CMD_ADDR A:0xfcb28880
y.create.l HWIO_RXFE_C3_TRIG_CMD_ADDR A:0xfcb28884
y.create.l HWIO_RXFE_C0_TRIG_VAL_ADDR A:0xfcb28888
y.create.l HWIO_RXFE_C1_TRIG_VAL_ADDR A:0xfcb2888c
y.create.l HWIO_RXFE_C2_TRIG_VAL_ADDR A:0xfcb28890
y.create.l HWIO_RXFE_C3_TRIG_VAL_ADDR A:0xfcb28894
y.create.l HWIO_RXFE_TRIG_STATUS_ADDR A:0xfcb28898
y.create.l HWIO_RXFE_C0_TRIG_RD_ADDR A:0xfcb2889c
y.create.l HWIO_RXFE_C1_TRIG_RD_ADDR A:0xfcb288a0
y.create.l HWIO_RXFE_C2_TRIG_RD_ADDR A:0xfcb288a4
y.create.l HWIO_RXFE_C3_TRIG_RD_ADDR A:0xfcb288a8
y.create.l HWIO_TX_C0_CTRL_SEL_ADDR A:0xfcb288ac
y.create.l HWIO_TX_C1_CTRL_SEL_ADDR A:0xfcb288b0
y.create.l HWIO_TX_C0_TRIG_CMD_ADDR A:0xfcb288b4
y.create.l HWIO_TX_C1_TRIG_CMD_ADDR A:0xfcb288b8
y.create.l HWIO_TX_C0_TRIG_VAL_ADDR A:0xfcb288bc
y.create.l HWIO_TX_C1_TRIG_VAL_ADDR A:0xfcb288c0
y.create.l HWIO_TX_TRIG_STATUS_ADDR A:0xfcb288c4
y.create.l HWIO_TX_C0_TRIG_RD_ADDR A:0xfcb288c8
y.create.l HWIO_TX_C1_TRIG_RD_ADDR A:0xfcb288cc
y.create.l HWIO_UNIV_STMR_TX_SYNC_TIME0_ADDR A:0xfcb288d0
y.create.l HWIO_UNIV_STMR_TX_SYNC_TIME1_ADDR A:0xfcb288d4
y.create.l HWIO_UNIV_STMR_TRIG_CTRL_ADDR A:0xfcb288d8
y.create.l HWIO_UNIV_STMR_TRIG_MASK_ADDR A:0xfcb288dc
y.create.l HWIO_VFR_SEL_ADDR A:0xfcb288e0
y.create.l HWIO_UNIV_STMR_SPARE_ADDR A:0xfcb288e4
y.create.l HWIO_SYS_SLEEP_STATUS_ADDR A:0xfcb288e8
y.create.l HWIO_UNIV_STMR_LD_CMD_ADDR A:0xfcb288ec
y.create.l HWIO_UNIV_STMR_MODIFIER_LD_ADDR A:0xfcb288f0
y.create.l HWIO_UMTS_STMR_ENABLE_ADDR A:0xfcb29000
y.create.l HWIO_UMTS_STMR_STATUS_ADDR A:0xfcb29004
y.create.l HWIO_STMR_FCW_CTL_ADDR A:0xfcb29008
y.create.l HWIO_STMR_RESET_ADDR A:0xfcb2900c
y.create.l HWIO_STMR_ST_EVENT_CTL_ADDR A:0xfcb29010
y.create.l HWIO_STMR_TIME_CMD_PRI_ADDR A:0xfcb29014
y.create.l HWIO_STMR_WALL_TIME_MODIFIER_ADDR A:0xfcb29018
y.create.l HWIO_STMR_STATUS_DUMP_CMD_PRI_ADDR A:0xfcb2901c
y.create.l HWIO_STMR_REF_COUNT_STATUS_PRI_ADDR A:0xfcb29020
y.create.l HWIO_STMR_TX_TIME_STATUS_PRI_ADDR A:0xfcb29024
y.create.l HWIO_STMR_C0_COUNT_STATUS_ADDR A:0xfcb29028
y.create.l HWIO_STMR_C1_COUNT_STATUS_ADDR A:0xfcb2902c
y.create.l HWIO_STMR_C2_COUNT_STATUS_ADDR A:0xfcb29030
y.create.l HWIO_STMR_PHASE_PRI_ADDR A:0xfcb29038
y.create.l HWIO_STMR_REF_COUNT_ADDR A:0xfcb2903c
y.create.l HWIO_STMR_REF_PHASE_ADDR A:0xfcb29318
y.create.l HWIO_STMR_COMBINER_COUNT0_PRI_ADDR A:0xfcb29040
y.create.l HWIO_STMR_COMBINER_COUNT1_PRI_ADDR A:0xfcb29044
y.create.l HWIO_STMR_COMBINER_COUNT2_PRI_ADDR A:0xfcb29048
y.create.l HWIO_STMR_CFN_COUNT0_ADDR A:0xfcb29050
y.create.l HWIO_STMR_CFN_COUNT1_ADDR A:0xfcb29054
y.create.l HWIO_STMR_CFN_COUNT2_ADDR A:0xfcb29058
y.create.l HWIO_STMR_TIME_SYNC_CTL_ADDR A:0xfcb29060
y.create.l HWIO_STMR_CN_MODIFIER_ON_LINE_ADDR A:0xfcb29064
y.create.l HWIO_STMR_MISC_CTL_ADDR A:0xfcb29068
y.create.l HWIO_STMR_TX_10MS_INT_OFFSET_ADDR A:0xfcb2906c
y.create.l HWIO_STMR_PROG_INT0_STATUS_ADDR A:0xfcb29070
y.create.l HWIO_STMR_PROG_INT1_STATUS_ADDR A:0xfcb29074
y.create.l HWIO_STMR_PROG_INT2_STATUS_ADDR A:0xfcb29078
y.create.l HWIO_STMR_PROG_INT0_CMD_ADDR A:0xfcb29080
y.create.l HWIO_STMR_PROG_INT1_CMD_ADDR A:0xfcb29084
y.create.l HWIO_STMR_PROG_INT2_CMD_ADDR A:0xfcb29088
y.create.l HWIO_STMR_PROG_INT0_CTL_ADDR A:0xfcb29090
y.create.l HWIO_STMR_PROG_INT1_CTL_ADDR A:0xfcb29094
y.create.l HWIO_STMR_PROG_INT2_CTL_ADDR A:0xfcb29098
y.create.l HWIO_STMR_INT0_EVENT_0_ADDR A:0xfcb290a0
y.create.l HWIO_STMR_INT0_EVENT_1_ADDR A:0xfcb290a4
y.create.l HWIO_STMR_INT0_EVENT_2_ADDR A:0xfcb290a8
y.create.l HWIO_STMR_INT0_EVENT_3_ADDR A:0xfcb290ac
y.create.l HWIO_STMR_INT0_EVENT_4_ADDR A:0xfcb290b0
y.create.l HWIO_STMR_INT0_EVENT_5_ADDR A:0xfcb290b4
y.create.l HWIO_STMR_INT0_EVENT_6_ADDR A:0xfcb290b8
y.create.l HWIO_STMR_INT0_EVENT_7_ADDR A:0xfcb290bc
y.create.l HWIO_STMR_INT0_EVENT_8_ADDR A:0xfcb290c0
y.create.l HWIO_STMR_INT0_EVENT_9_ADDR A:0xfcb290c4
y.create.l HWIO_STMR_INT1_EVENT_0_ADDR A:0xfcb290e0
y.create.l HWIO_STMR_INT1_EVENT_1_ADDR A:0xfcb290e4
y.create.l HWIO_STMR_INT1_EVENT_2_ADDR A:0xfcb290e8
y.create.l HWIO_STMR_INT1_EVENT_3_ADDR A:0xfcb290ec
y.create.l HWIO_STMR_INT1_EVENT_4_ADDR A:0xfcb290f0
y.create.l HWIO_STMR_INT1_EVENT_5_ADDR A:0xfcb290f4
y.create.l HWIO_STMR_INT1_EVENT_6_ADDR A:0xfcb290f8
y.create.l HWIO_STMR_INT1_EVENT_7_ADDR A:0xfcb290fc
y.create.l HWIO_STMR_INT1_EVENT_8_ADDR A:0xfcb29100
y.create.l HWIO_STMR_INT1_EVENT_9_ADDR A:0xfcb29104
y.create.l HWIO_STMR_INT2_EVENT_0_ADDR A:0xfcb29120
y.create.l HWIO_STMR_INT2_EVENT_1_ADDR A:0xfcb29124
y.create.l HWIO_STMR_INT2_EVENT_2_ADDR A:0xfcb29128
y.create.l HWIO_STMR_INT2_EVENT_3_ADDR A:0xfcb2912c
y.create.l HWIO_STMR_INT2_EVENT_4_ADDR A:0xfcb29130
y.create.l HWIO_STMR_INT2_EVENT_5_ADDR A:0xfcb29134
y.create.l HWIO_STMR_INT2_EVENT_6_ADDR A:0xfcb29138
y.create.l HWIO_STMR_INT2_EVENT_7_ADDR A:0xfcb2913c
y.create.l HWIO_STMR_INT2_EVENT_8_ADDR A:0xfcb29140
y.create.l HWIO_STMR_INT2_EVENT_9_ADDR A:0xfcb29144
y.create.l HWIO_STMR_TIME_CMD_SNP_ADDR A:0xfcb291a0
y.create.l HWIO_STMR_TX_TARGET_REF_COUNT_ADDR A:0xfcb291ac
y.create.l HWIO_STMR_TX_TIME_MODIFIER_ADDR A:0xfcb291b0
y.create.l HWIO_STMR_COMBINER_CMD_SNP_ADDR A:0xfcb291b4
y.create.l HWIO_STMR_C0_TARGET_REF_COUNT_ADDR A:0xfcb291b8
y.create.l HWIO_STMR_C1_TARGET_REF_COUNT_ADDR A:0xfcb291bc
y.create.l HWIO_STMR_C2_TARGET_REF_COUNT_ADDR A:0xfcb291c0
y.create.l HWIO_STMR_CFN0_MODIFIER_ADDR A:0xfcb29308
y.create.l HWIO_STMR_CFN1_MODIFIER_ADDR A:0xfcb2930c
y.create.l HWIO_STMR_CFN2_MODIFIER_ADDR A:0xfcb29310
y.create.l HWIO_STMR_C0_MODIFIER_ADDR A:0xfcb291c8
y.create.l HWIO_STMR_C1_MODIFIER_ADDR A:0xfcb291cc
y.create.l HWIO_STMR_C2_MODIFIER_ADDR A:0xfcb291d0
y.create.l HWIO_STMR_STATUS_DUMP_CMD_SNP_ADDR A:0xfcb291d8
y.create.l HWIO_STMR_TX_TIME_STATUS_SNP_ADDR A:0xfcb291dc
y.create.l HWIO_STMR_REF_COUNT_STATUS_SNP_ADDR A:0xfcb291e0
y.create.l HWIO_STMR_PHASE_SNP_ADDR A:0xfcb291e8
y.create.l HWIO_STMR_TX_TIME_SNP_ADDR A:0xfcb291ec
y.create.l HWIO_STMR_PROG_SNP_INT0_CTL_ADDR A:0xfcb29218
y.create.l HWIO_STMR_PROG_SNP_INT1_CTL_ADDR A:0xfcb2921c
y.create.l HWIO_STMR_SNP_INT0_EVENT_0_ADDR A:0xfcb29224
y.create.l HWIO_STMR_SNP_INT0_EVENT_1_ADDR A:0xfcb29228
y.create.l HWIO_STMR_SNP_INT0_EVENT_2_ADDR A:0xfcb2922c
y.create.l HWIO_STMR_SNP_INT0_EVENT_3_ADDR A:0xfcb29230
y.create.l HWIO_STMR_SNP_INT0_EVENT_4_ADDR A:0xfcb29234
y.create.l HWIO_STMR_SNP_INT0_EVENT_5_ADDR A:0xfcb29238
y.create.l HWIO_STMR_SNP_INT0_EVENT_6_ADDR A:0xfcb2923c
y.create.l HWIO_STMR_SNP_INT0_EVENT_7_ADDR A:0xfcb29240
y.create.l HWIO_STMR_SNP_INT1_EVENT_0_ADDR A:0xfcb29264
y.create.l HWIO_STMR_SNP_INT1_EVENT_1_ADDR A:0xfcb29268
y.create.l HWIO_STMR_SNP_INT1_EVENT_2_ADDR A:0xfcb2926c
y.create.l HWIO_STMR_SNP_INT1_EVENT_3_ADDR A:0xfcb29270
y.create.l HWIO_CDMA_RTC_ENABLE_ADDR A:0xfcb29800
y.create.l HWIO_RTC_FCW_CTL_ADDR A:0xfcb29804
y.create.l HWIO_RTC_CNT_1X_ADDR A:0xfcb29808
y.create.l HWIO_RTC_PHASE_ADDR A:0xfcb2994c
y.create.l HWIO_RTC_SLEEP_ADDR A:0xfcb2980c
y.create.l HWIO_RTC_OFFSET_ADDR A:0xfcb29810
y.create.l HWIO_RTC_LOAD_ADDR A:0xfcb29814
y.create.l HWIO_RTC_GP_COMPARE1_ADDR A:0xfcb29818
y.create.l HWIO_RTC_GP_COMPARE2_ADDR A:0xfcb2981c
y.create.l HWIO_CDMA_RTC_SYNC_ADDR A:0xfcb29820
y.create.l HWIO_CDMA_PHASE_SYNC_ADDR A:0xfcb29824
y.create.l HWIO_RTC_DIFF_1XHDR_ADDR A:0xfcb29830
y.create.l HWIO_RTC_CTL_ADDR A:0xfcb29834
y.create.l HWIO_RTC_TTRANS_CTL_1XHDR_ADDR A:0xfcb29848
y.create.l HWIO_RTC_DUMP_STATUS_1XHDR_ADDR A:0xfcb2984c
y.create.l HWIO_RTC_TTRANS_TRIG_1X_ADDR A:0xfcb29850
y.create.l HWIO_RTC_TTRANS_TRIG_HDR_ADDR A:0xfcb29854
y.create.l HWIO_RTC_DUMP_1X_ADDR A:0xfcb29858
y.create.l HWIO_RTC_DUMP_HDR_ADDR A:0xfcb2985c
y.create.l HWIO_PHASE_DUMP_1X_ADDR A:0xfcb29860
y.create.l HWIO_PHASE_DUMP_HDR_ADDR A:0xfcb29864
y.create.l HWIO_HDR_RTC_ENABLE_ADDR A:0xfcb29868
y.create.l HWIO_HDR_RTC_FCW_CTL_ADDR A:0xfcb2986c
y.create.l HWIO_HDR_RTC_CNT_ADDR A:0xfcb29870
y.create.l HWIO_HDR_RTC_PHASE_ADDR A:0xfcb29950
y.create.l HWIO_HDR_RTC_SLEEP_ADDR A:0xfcb29954
y.create.l HWIO_HDR_RTC_ADJ_ADDR A:0xfcb29874
y.create.l HWIO_HDR_RTC_MODIFIER_ADDR A:0xfcb29878
y.create.l HWIO_HDR_TX_COMPARE_CNT_ADDR A:0xfcb2987c
y.create.l HWIO_HDR_TX_CAPTURE_CNT_ADDR A:0xfcb29880
y.create.l HWIO_HDR_RX_COMPARE_CNT_ADDR A:0xfcb29884
y.create.l HWIO_HDR_RX_CAPTURE_CNT_ADDR A:0xfcb29888
y.create.l HWIO_HDR_MODTIME_REF_ADDR A:0xfcb2988c
y.create.l HWIO_HDR_MPTIME_REF_ADDR A:0xfcb29890
y.create.l HWIO_RTC_REVMOD_FRM_CNT_OFFSET_CTL_ADDR A:0xfcb29894
y.create.l HWIO_RTC_REVMOD_FRM_CNT_OFFSET_ADDR A:0xfcb29898
y.create.l HWIO_RTC_REVMOD_FRAME_INT_OFFSET_ADDR A:0xfcb2989c
y.create.l HWIO_RTC_REVMOD_TX_TIME_LATCH_ADDR A:0xfcb298a0
y.create.l HWIO_RTC_REVMOD_TX_TIME_RD_ADDR A:0xfcb298a4
y.create.l HWIO_RTC_REVMOD_TX_PHASE_RD_ADDR A:0xfcb298a8
y.create.l HWIO_RTC_REVMOD_TX_SYS_TIME_ADDR A:0xfcb29948
y.create.l HWIO_RTC_REVMOD_TIME_STAMP_CTL_ADDR A:0xfcb298b4
y.create.l HWIO_RTC_REVMOD_TIME_STAMP2_ADDR A:0xfcb298b8
y.create.l HWIO_RTC_REVMOD_TIME_STAMP_ADDR A:0xfcb298bc
y.create.l HWIO_RTC_MOD_LOAD_STMR_UPDATE_CTL_ADDR A:0xfcb298c0
y.create.l HWIO_RTC_MOD_TEST_POINT_DIN_ADDR A:0xfcb298c4
y.create.l HWIO_RTC_MOD_TEST_POINT_SEL_ADDR A:0xfcb298c8
y.create.l HWIO_RTC_MOD_STMR_CMD_ADDR A:0xfcb298cc
y.create.l HWIO_RTC_MOD_ADVRET_CMD_ADDR A:0xfcb298d0
y.create.l HWIO_RTC_MOD_STMR_MODIFIER_1_ADDR A:0xfcb298d4
y.create.l HWIO_RTC_MOD_STMR_MODIFIER_0_ADDR A:0xfcb298d8
y.create.l HWIO_RTC_MOD_TX_SYS_TIME_ADDR A:0xfcb298dc
y.create.l HWIO_RTC_MOD_TX_TIME_LATCH_ADDR A:0xfcb298e0
y.create.l HWIO_RTC_MOD_TX_TIME_RD_ADDR A:0xfcb298e4
y.create.l HWIO_RTC_MOD_TX_PHASE_RD_ADDR A:0xfcb298e8
y.create.l HWIO_RTC_MOD_TX_TIME_DUMP_ADDR A:0xfcb298f8
y.create.l HWIO_RTC_MOD_SLOT_IRQ_OFFSET_ADDR A:0xfcb298fc
y.create.l HWIO_RTC_MOD_SLOT_IRQ_ENABLE_ADDR A:0xfcb29900
y.create.l HWIO_RTC_TX_PCG_INT_ENABLE_ADDR A:0xfcb29904
y.create.l HWIO_RTC_TX_PCG_INT_CLEAR_ADDR A:0xfcb29908
y.create.l HWIO_RTC_TX_PCG_INT_STATUS_ADDR A:0xfcb2990c
y.create.l HWIO_RTC_TX_PCG_INT_OFFSET_ADDR A:0xfcb29910
y.create.l HWIO_RTC_MOD_SYM_IRQ_CTL_ADDR A:0xfcb29914
y.create.l HWIO_RTC_TX_1_25MS_INT_OFFSET_ADDR A:0xfcb2991c
y.create.l HWIO_RTC_MOD_SDO_MODE_ADDR A:0xfcb29938
y.create.l HWIO_RTC_MOD_SDO_CNTR_RESET_ADDR A:0xfcb2993c
y.create.l HWIO_RTC_MOD_DSP_SDO_RATE_ADDR A:0xfcb29940
y.create.l HWIO_RTC_MOD_SDO_SLOT_OFFSET_ADDR A:0xfcb29944
y.create.l HWIO_G_STMR_RESET_ADDR A:0xfcb29c00
y.create.l HWIO_G_STMR_ENABLE_ADDR A:0xfcb29c04
y.create.l HWIO_G_STMR_FCW_CTL_ADDR A:0xfcb29c08
y.create.l HWIO_G_STMR_DCO_PHASE_ADDR A:0xfcb29c0c
y.create.l HWIO_G_STMR_TIME_RD_ADDR A:0xfcb29c10
y.create.l HWIO_G_STMR_SW_IRQ_CONFIG_RW_ADDR A:0xfcb29c14
y.create.l HWIO_G_STMR_TIME_TC_VALUE_ADDR A:0xfcb29c18
y.create.l HWIO_G_STMR_TIME_ORIDE_TC_CMD_ADDR A:0xfcb29c1c
y.create.l HWIO_G_STMR_TIME_ORIDE_TC_RD_ADDR A:0xfcb29c20
y.create.l HWIO_G_STMR_VFR_IRQ_FRAME_ALIGN_CMD_ADDR A:0xfcb29c24
y.create.l HWIO_G_STMR_VFR_IRQ_FRAME_ALIGN_RD_ADDR A:0xfcb29c28
y.create.l HWIO_G_STMR_GEN_GO_TO_SLEEP_CMD_ADDR A:0xfcb29c2c
y.create.l HWIO_G_STMR_SLEEP_STATUS_RD_ADDR A:0xfcb29c30
y.create.l HWIO_G_STMR_TIME_SYNC_CTL_ADDR A:0xfcb29c34
y.create.l HWIO_G_STMR_TIME_ON_LINE_ADDR A:0xfcb29c38
y.create.l HWIO_G_STMR_FW_IRQ0_CONFIG_RW_ADDR A:0xfcb29c3c
y.create.l HWIO_G_STMR_FW_IRQ1_CONFIG_RW_ADDR A:0xfcb29c40
y.create.l HWIO_G_STMR_FW_IRQ2_CONFIG_RW_ADDR A:0xfcb29c44
y.create.l HWIO_G_STMR_FW_IRQ3_CONFIG_RW_ADDR A:0xfcb29c48
y.create.l HWIO_G_STMR_FW_IRQ4_CONFIG_RW_ADDR A:0xfcb29c4c
y.create.l HWIO_G_STMR_FW_IRQ5_CONFIG_RW_ADDR A:0xfcb29c50
y.create.l HWIO_G_STMR_FW_IRQ6_CONFIG_RW_ADDR A:0xfcb29c54
y.create.l HWIO_G_STMR_FW_IRQ7_CONFIG_RW_ADDR A:0xfcb29c58
y.create.l HWIO_G_STMR_FW_IRQ_ENA_ADDR A:0xfcb29c5c
y.create.l HWIO_G_STMR_FW_IRQ_STATUS_RD_ADDR A:0xfcb29c60
y.create.l HWIO_G_STMR_FW_IRQ_CLEAR_CMD_ADDR A:0xfcb29c64
y.create.l HWIO_G_STMR_RESET_G1_ADDR A:0xfcb2a000
y.create.l HWIO_G_STMR_ENABLE_G1_ADDR A:0xfcb2a004
y.create.l HWIO_G_STMR_FCW_CTL_G1_ADDR A:0xfcb2a008
y.create.l HWIO_G_STMR_DCO_PHASE_G1_ADDR A:0xfcb2a00c
y.create.l HWIO_G_STMR_TIME_RD_G1_ADDR A:0xfcb2a010
y.create.l HWIO_G_STMR_SW_IRQ_CONFIG_RW_G1_ADDR A:0xfcb2a014
y.create.l HWIO_G_STMR_TIME_TC_VALUE_G1_ADDR A:0xfcb2a018
y.create.l HWIO_G_STMR_TIME_ORIDE_TC_CMD_G1_ADDR A:0xfcb2a01c
y.create.l HWIO_G_STMR_TIME_ORIDE_TC_RD_G1_ADDR A:0xfcb2a020
y.create.l HWIO_G_STMR_VFR_IRQ_FRAME_ALIGN_CMD_G1_ADDR A:0xfcb2a024
y.create.l HWIO_G_STMR_VFR_IRQ_FRAME_ALIGN_RD_G1_ADDR A:0xfcb2a028
y.create.l HWIO_G_STMR_GEN_GO_TO_SLEEP_CMD_G1_ADDR A:0xfcb2a02c
y.create.l HWIO_G_STMR_SLEEP_STATUS_RD_G1_ADDR A:0xfcb2a030
y.create.l HWIO_G_STMR_TIME_SYNC_CTL_G1_ADDR A:0xfcb2a034
y.create.l HWIO_G_STMR_TIME_ON_LINE_G1_ADDR A:0xfcb2a038
y.create.l HWIO_G_STMR_FW_IRQ0_CONFIG_RW_G1_ADDR A:0xfcb2a03c
y.create.l HWIO_G_STMR_FW_IRQ1_CONFIG_RW_G1_ADDR A:0xfcb2a040
y.create.l HWIO_G_STMR_FW_IRQ2_CONFIG_RW_G1_ADDR A:0xfcb2a044
y.create.l HWIO_G_STMR_FW_IRQ3_CONFIG_RW_G1_ADDR A:0xfcb2a048
y.create.l HWIO_G_STMR_FW_IRQ4_CONFIG_RW_G1_ADDR A:0xfcb2a04c
y.create.l HWIO_G_STMR_FW_IRQ5_CONFIG_RW_G1_ADDR A:0xfcb2a050
y.create.l HWIO_G_STMR_FW_IRQ6_CONFIG_RW_G1_ADDR A:0xfcb2a054
y.create.l HWIO_G_STMR_FW_IRQ7_CONFIG_RW_G1_ADDR A:0xfcb2a058
y.create.l HWIO_G_STMR_FW_IRQ_ENA_G1_ADDR A:0xfcb2a05c
y.create.l HWIO_G_STMR_FW_IRQ_STATUS_RD_G1_ADDR A:0xfcb2a060
y.create.l HWIO_G_STMR_FW_IRQ_CLEAR_CMD_G1_ADDR A:0xfcb2a064
y.create.l HWIO_OCIMEM_HW_VERSION_ADDR A:0xfc488000
y.create.l HWIO_OCIMEM_HW_PROFILE_ADDR A:0xfc488004
y.create.l HWIO_OCIMEM_GEN_CTL_ADDR A:0xfc488008
y.create.l HWIO_OCIMEM_GEN_STAT_ADDR A:0xfc48800c
y.create.l HWIO_OCIMEM_INTC_CLR_ADDR A:0xfc488010
y.create.l HWIO_OCIMEM_INTC_MASK_ADDR A:0xfc488014
y.create.l HWIO_OCIMEM_INTC_STAT_ADDR A:0xfc488018
y.create.l HWIO_OCIMEM_OSW_STATUS_ADDR A:0xfc48801c
y.create.l HWIO_OCIMEM_PSCGC_TIMERS_ADDR A:0xfc488034
y.create.l HWIO_OCIMEM_PSCGC_STAT_ADDR A:0xfc488038
y.create.l HWIO_OCIMEM_PSCGC_M0_M7_CTL_ADDR A:0xfc48803c
y.create.l HWIO_OCIMEM_ERR_ADDRESS_ADDR A:0xfc488060
y.create.l HWIO_OCIMEM_AXI_ERR_SYNDROME_ADDR A:0xfc488064
y.create.l HWIO_OCIMEM_DEBUG_CTL_ADDR A:0xfc488068
y.create.l HWIO_OCIMEM_APU_XPU_SCR_ADDR A:0xfc48a000
y.create.l HWIO_OCIMEM_APU_XPU_SWDR_ADDR A:0xfc48a004
y.create.l HWIO_OCIMEM_APU_XPU_SEAR0_ADDR A:0xfc48a040
y.create.l HWIO_OCIMEM_APU_XPU_SESR_ADDR A:0xfc48a048
y.create.l HWIO_OCIMEM_APU_XPU_SESRRESTORE_ADDR A:0xfc48a04c
y.create.l HWIO_OCIMEM_APU_XPU_SESYNR0_ADDR A:0xfc48a050
y.create.l HWIO_OCIMEM_APU_XPU_SESYNR1_ADDR A:0xfc48a054
y.create.l HWIO_OCIMEM_APU_XPU_SESYNR2_ADDR A:0xfc48a058
y.create.l HWIO_OCIMEM_APU_XPU_MCR_ADDR A:0xfc48a100
y.create.l HWIO_OCIMEM_APU_XPU_MEAR0_ADDR A:0xfc48a140
y.create.l HWIO_OCIMEM_APU_XPU_MESR_ADDR A:0xfc48a148
y.create.l HWIO_OCIMEM_APU_XPU_MESRRESTORE_ADDR A:0xfc48a14c
y.create.l HWIO_OCIMEM_APU_XPU_MESYNR0_ADDR A:0xfc48a150
y.create.l HWIO_OCIMEM_APU_XPU_MESYNR1_ADDR A:0xfc48a154
y.create.l HWIO_OCIMEM_APU_XPU_MESYNR2_ADDR A:0xfc48a158
y.create.l HWIO_OCIMEM_APU_XPU_CR_ADDR A:0xfc48a080
y.create.l HWIO_OCIMEM_APU_XPU_RPU_ACR0_ADDR A:0xfc48a0a0
y.create.l HWIO_OCIMEM_APU_XPU_EAR0_ADDR A:0xfc48a0c0
y.create.l HWIO_OCIMEM_APU_XPU_ESR_ADDR A:0xfc48a0c8
y.create.l HWIO_OCIMEM_APU_XPU_ESRRESTORE_ADDR A:0xfc48a0cc
y.create.l HWIO_OCIMEM_APU_XPU_ESYNR0_ADDR A:0xfc48a0d0
y.create.l HWIO_OCIMEM_APU_XPU_ESYNR1_ADDR A:0xfc48a0d4
y.create.l HWIO_OCIMEM_APU_XPU_ESYNR2_ADDR A:0xfc48a0d8
y.create.l HWIO_OCIMEM_APU_XPU_IDR0_ADDR A:0xfc48a074
y.create.l HWIO_OCIMEM_APU_XPU_IDR1_ADDR A:0xfc48a078
y.create.l HWIO_OCIMEM_APU_XPU_REV_ADDR A:0xfc48a07c
y.create.l HWIO_OCIMEM_APU_XPU_RG0_RACR0_ADDR A:0xfc48a200
y.create.l HWIO_OCIMEM_APU_XPU_RG1_RACR0_ADDR A:0xfc48a280
y.create.l HWIO_OCIMEM_APU_XPU_RG0_WACR0_ADDR A:0xfc48a220
y.create.l HWIO_OCIMEM_APU_XPU_RG1_WACR0_ADDR A:0xfc48a2a0
y.create.l HWIO_OCIMEM_APU_XPU_RG0_SCR_ADDR A:0xfc48a250
y.create.l HWIO_OCIMEM_APU_XPU_RG1_SCR_ADDR A:0xfc48a2d0
y.create.l HWIO_OCIMEM_APU_XPU_RG0_MCR_ADDR A:0xfc48a254
y.create.l HWIO_OCIMEM_APU_XPU_RG1_MCR_ADDR A:0xfc48a2d4
y.create.l HWIO_OCIMEM_MPU_XPU_SCR_ADDR A:0xfc48b000
y.create.l HWIO_OCIMEM_MPU_XPU_SWDR_ADDR A:0xfc48b004
y.create.l HWIO_OCIMEM_MPU_XPU_PRTN_RACR_SSHADOW_ADDR A:0xfc48b008
y.create.l HWIO_OCIMEM_MPU_XPU_PRTN_WACR_SSHADOW_ADDR A:0xfc48b00c
y.create.l HWIO_OCIMEM_MPU_XPU_PRTN_START_SSHADOW0_ADDR A:0xfc48b010
y.create.l HWIO_OCIMEM_MPU_XPU_PRTN_END_SSHADOW0_ADDR A:0xfc48b018
y.create.l HWIO_OCIMEM_MPU_XPU_SEAR0_ADDR A:0xfc48b040
y.create.l HWIO_OCIMEM_MPU_XPU_SESR_ADDR A:0xfc48b048
y.create.l HWIO_OCIMEM_MPU_XPU_SESRRESTORE_ADDR A:0xfc48b04c
y.create.l HWIO_OCIMEM_MPU_XPU_SESYNR0_ADDR A:0xfc48b050
y.create.l HWIO_OCIMEM_MPU_XPU_SESYNR1_ADDR A:0xfc48b054
y.create.l HWIO_OCIMEM_MPU_XPU_SESYNR2_ADDR A:0xfc48b058
y.create.l HWIO_OCIMEM_MPU_XPU_MCR_ADDR A:0xfc48b100
y.create.l HWIO_OCIMEM_MPU_XPU_MEAR0_ADDR A:0xfc48b140
y.create.l HWIO_OCIMEM_MPU_XPU_MESR_ADDR A:0xfc48b148
y.create.l HWIO_OCIMEM_MPU_XPU_MESRRESTORE_ADDR A:0xfc48b14c
y.create.l HWIO_OCIMEM_MPU_XPU_MESYNR0_ADDR A:0xfc48b150
y.create.l HWIO_OCIMEM_MPU_XPU_MESYNR1_ADDR A:0xfc48b154
y.create.l HWIO_OCIMEM_MPU_XPU_MESYNR2_ADDR A:0xfc48b158
y.create.l HWIO_OCIMEM_MPU_XPU_CR_ADDR A:0xfc48b080
y.create.l HWIO_OCIMEM_MPU_XPU_PRTN_RACR_SHADOW_ADDR A:0xfc48b088
y.create.l HWIO_OCIMEM_MPU_XPU_PRTN_WACR_SHADOW_ADDR A:0xfc48b08c
y.create.l HWIO_OCIMEM_MPU_XPU_PRTN_START_SHADOW0_ADDR A:0xfc48b090
y.create.l HWIO_OCIMEM_MPU_XPU_PRTN_END_SHADOW0_ADDR A:0xfc48b098
y.create.l HWIO_OCIMEM_MPU_XPU_RPU_ACR0_ADDR A:0xfc48b0a0
y.create.l HWIO_OCIMEM_MPU_XPU_EAR0_ADDR A:0xfc48b0c0
y.create.l HWIO_OCIMEM_MPU_XPU_ESR_ADDR A:0xfc48b0c8
y.create.l HWIO_OCIMEM_MPU_XPU_ESRRESTORE_ADDR A:0xfc48b0cc
y.create.l HWIO_OCIMEM_MPU_XPU_ESYNR0_ADDR A:0xfc48b0d0
y.create.l HWIO_OCIMEM_MPU_XPU_ESYNR1_ADDR A:0xfc48b0d4
y.create.l HWIO_OCIMEM_MPU_XPU_ESYNR2_ADDR A:0xfc48b0d8
y.create.l HWIO_OCIMEM_MPU_XPU_UMR_RACR_ADDR A:0xfc48b0e0
y.create.l HWIO_OCIMEM_MPU_XPU_UMR_WACR_ADDR A:0xfc48b0e4
y.create.l HWIO_OCIMEM_MPU_XPU_IDR0_ADDR A:0xfc48b074
y.create.l HWIO_OCIMEM_MPU_XPU_IDR1_ADDR A:0xfc48b078
y.create.l HWIO_OCIMEM_MPU_XPU_REV_ADDR A:0xfc48b07c
y.create.l HWIO_OCIMEM_MPU_XPU_PRT0_RACR0_ADDR A:0xfc48b200
y.create.l HWIO_OCIMEM_MPU_XPU_PRT1_RACR0_ADDR A:0xfc48b280
y.create.l HWIO_OCIMEM_MPU_XPU_PRT2_RACR0_ADDR A:0xfc48b300
y.create.l HWIO_OCIMEM_MPU_XPU_PRT3_RACR0_ADDR A:0xfc48b380
y.create.l HWIO_OCIMEM_MPU_XPU_PRT4_RACR0_ADDR A:0xfc48b400
y.create.l HWIO_OCIMEM_MPU_XPU_PRT5_RACR0_ADDR A:0xfc48b480
y.create.l HWIO_OCIMEM_MPU_XPU_PRT6_RACR0_ADDR A:0xfc48b500
y.create.l HWIO_OCIMEM_MPU_XPU_PRT7_RACR0_ADDR A:0xfc48b580
y.create.l HWIO_OCIMEM_MPU_XPU_PRT0_WACR0_ADDR A:0xfc48b220
y.create.l HWIO_OCIMEM_MPU_XPU_PRT1_WACR0_ADDR A:0xfc48b2a0
y.create.l HWIO_OCIMEM_MPU_XPU_PRT2_WACR0_ADDR A:0xfc48b320
y.create.l HWIO_OCIMEM_MPU_XPU_PRT3_WACR0_ADDR A:0xfc48b3a0
y.create.l HWIO_OCIMEM_MPU_XPU_PRT4_WACR0_ADDR A:0xfc48b420
y.create.l HWIO_OCIMEM_MPU_XPU_PRT5_WACR0_ADDR A:0xfc48b4a0
y.create.l HWIO_OCIMEM_MPU_XPU_PRT6_WACR0_ADDR A:0xfc48b520
y.create.l HWIO_OCIMEM_MPU_XPU_PRT7_WACR0_ADDR A:0xfc48b5a0
y.create.l HWIO_OCIMEM_MPU_XPU_PRT0_START0_ADDR A:0xfc48b240
y.create.l HWIO_OCIMEM_MPU_XPU_PRT1_START0_ADDR A:0xfc48b2c0
y.create.l HWIO_OCIMEM_MPU_XPU_PRT2_START0_ADDR A:0xfc48b340
y.create.l HWIO_OCIMEM_MPU_XPU_PRT3_START0_ADDR A:0xfc48b3c0
y.create.l HWIO_OCIMEM_MPU_XPU_PRT4_START0_ADDR A:0xfc48b440
y.create.l HWIO_OCIMEM_MPU_XPU_PRT5_START0_ADDR A:0xfc48b4c0
y.create.l HWIO_OCIMEM_MPU_XPU_PRT6_START0_ADDR A:0xfc48b540
y.create.l HWIO_OCIMEM_MPU_XPU_PRT7_START0_ADDR A:0xfc48b5c0
y.create.l HWIO_OCIMEM_MPU_XPU_PRT0_END0_ADDR A:0xfc48b248
y.create.l HWIO_OCIMEM_MPU_XPU_PRT1_END0_ADDR A:0xfc48b2c8
y.create.l HWIO_OCIMEM_MPU_XPU_PRT2_END0_ADDR A:0xfc48b348
y.create.l HWIO_OCIMEM_MPU_XPU_PRT3_END0_ADDR A:0xfc48b3c8
y.create.l HWIO_OCIMEM_MPU_XPU_PRT4_END0_ADDR A:0xfc48b448
y.create.l HWIO_OCIMEM_MPU_XPU_PRT5_END0_ADDR A:0xfc48b4c8
y.create.l HWIO_OCIMEM_MPU_XPU_PRT6_END0_ADDR A:0xfc48b548
y.create.l HWIO_OCIMEM_MPU_XPU_PRT7_END0_ADDR A:0xfc48b5c8
y.create.l HWIO_OCIMEM_MPU_XPU_PRT0_SCR_ADDR A:0xfc48b250
y.create.l HWIO_OCIMEM_MPU_XPU_PRT1_SCR_ADDR A:0xfc48b2d0
y.create.l HWIO_OCIMEM_MPU_XPU_PRT2_SCR_ADDR A:0xfc48b350
y.create.l HWIO_OCIMEM_MPU_XPU_PRT3_SCR_ADDR A:0xfc48b3d0
y.create.l HWIO_OCIMEM_MPU_XPU_PRT4_SCR_ADDR A:0xfc48b450
y.create.l HWIO_OCIMEM_MPU_XPU_PRT5_SCR_ADDR A:0xfc48b4d0
y.create.l HWIO_OCIMEM_MPU_XPU_PRT6_SCR_ADDR A:0xfc48b550
y.create.l HWIO_OCIMEM_MPU_XPU_PRT7_SCR_ADDR A:0xfc48b5d0
y.create.l HWIO_OCIMEM_MPU_XPU_PRT0_MCR_ADDR A:0xfc48b254
y.create.l HWIO_OCIMEM_MPU_XPU_PRT1_MCR_ADDR A:0xfc48b2d4
y.create.l HWIO_OCIMEM_MPU_XPU_PRT2_MCR_ADDR A:0xfc48b354
y.create.l HWIO_OCIMEM_MPU_XPU_PRT3_MCR_ADDR A:0xfc48b3d4
y.create.l HWIO_OCIMEM_MPU_XPU_PRT4_MCR_ADDR A:0xfc48b454
y.create.l HWIO_OCIMEM_MPU_XPU_PRT5_MCR_ADDR A:0xfc48b4d4
y.create.l HWIO_OCIMEM_MPU_XPU_PRT6_MCR_ADDR A:0xfc48b554
y.create.l HWIO_OCIMEM_MPU_XPU_PRT7_MCR_ADDR A:0xfc48b5d4
y.create.l HWIO_OCIMEM_MPU_XPU_PRT0_CNTL0_ADDR A:0xfc48b258
y.create.l HWIO_OCIMEM_MPU_XPU_PRT1_CNTL0_ADDR A:0xfc48b2d8
y.create.l HWIO_OCIMEM_MPU_XPU_PRT2_CNTL0_ADDR A:0xfc48b358
y.create.l HWIO_OCIMEM_MPU_XPU_PRT3_CNTL0_ADDR A:0xfc48b3d8
y.create.l HWIO_OCIMEM_MPU_XPU_PRT4_CNTL0_ADDR A:0xfc48b458
y.create.l HWIO_OCIMEM_MPU_XPU_PRT5_CNTL0_ADDR A:0xfc48b4d8
y.create.l HWIO_OCIMEM_MPU_XPU_PRT6_CNTL0_ADDR A:0xfc48b558
y.create.l HWIO_OCIMEM_MPU_XPU_PRT7_CNTL0_ADDR A:0xfc48b5d8
y.create.l HWIO_OCIMEM_MPU_XPU_PRT0_CNTL1_ADDR A:0xfc48b25c
y.create.l HWIO_OCIMEM_MPU_XPU_PRT1_CNTL1_ADDR A:0xfc48b2dc
y.create.l HWIO_OCIMEM_MPU_XPU_PRT2_CNTL1_ADDR A:0xfc48b35c
y.create.l HWIO_OCIMEM_MPU_XPU_PRT3_CNTL1_ADDR A:0xfc48b3dc
y.create.l HWIO_OCIMEM_MPU_XPU_PRT4_CNTL1_ADDR A:0xfc48b45c
y.create.l HWIO_OCIMEM_MPU_XPU_PRT5_CNTL1_ADDR A:0xfc48b4dc
y.create.l HWIO_OCIMEM_MPU_XPU_PRT6_CNTL1_ADDR A:0xfc48b55c
y.create.l HWIO_OCIMEM_MPU_XPU_PRT7_CNTL1_ADDR A:0xfc48b5dc
y.create.l HWIO_PNOC_OBS_ID_COREID_ADDR A:0xfc468000
y.create.l HWIO_PNOC_OBS_ID_REVISIONID_ADDR A:0xfc468004
y.create.l HWIO_PNOC_OBS_ERRCTL_ADDR A:0xfc468008
y.create.l HWIO_PNOC_OBS_ERRSTATUS_ADDR A:0xfc46800c
y.create.l HWIO_PNOC_OBS_ERRLOG0_ADDR A:0xfc468010
y.create.l HWIO_PNOC_OBS_ERRLOG1_ADDR A:0xfc468014
y.create.l HWIO_PNOC_OBS_ERRLOG2_ADDR A:0xfc468018
y.create.l HWIO_PNOC_OBS_ERRLOG5_ADDR A:0xfc468024
y.create.l HWIO_PNOC_OBS_DBG_ID_COREID_ADDR A:0xfc468080
y.create.l HWIO_PNOC_OBS_DBG_ID_REVISIONID_ADDR A:0xfc468084
y.create.l HWIO_PNOC_OBS_DBG_ATBID_ADDR A:0xfc468088
y.create.l HWIO_PNOC_QHM0_TFILT_ID_COREID_ADDR A:0xfc469000
y.create.l HWIO_PNOC_QHM0_TFILT_ID_REVISIONID_ADDR A:0xfc469004
y.create.l HWIO_PNOC_QHM0_TFILT_MODE_ADDR A:0xfc469008
y.create.l HWIO_PNOC_QHM0_TFILT_ADDRBASE_LOW_ADDR A:0xfc46900c
y.create.l HWIO_PNOC_QHM0_TFILT_ADDRWINDOWSIZE_ADDR A:0xfc469014
y.create.l HWIO_PNOC_QHM0_TFILT_SRCIDBASE_ADDR A:0xfc469018
y.create.l HWIO_PNOC_QHM0_TFILT_SRCIDMASK_ADDR A:0xfc46901c
y.create.l HWIO_PNOC_QHM0_TFILT_OPCODE_ADDR A:0xfc469020
y.create.l HWIO_PNOC_QHM1_TFILT_ID_COREID_ADDR A:0xfc469180
y.create.l HWIO_PNOC_QHM1_TFILT_ID_REVISIONID_ADDR A:0xfc469184
y.create.l HWIO_PNOC_QHM1_TFILT_MODE_ADDR A:0xfc469188
y.create.l HWIO_PNOC_QHM1_TFILT_ADDRBASE_LOW_ADDR A:0xfc46918c
y.create.l HWIO_PNOC_QHM1_TFILT_ADDRWINDOWSIZE_ADDR A:0xfc469194
y.create.l HWIO_PNOC_QHM1_TFILT_SRCIDBASE_ADDR A:0xfc469198
y.create.l HWIO_PNOC_QHM1_TFILT_SRCIDMASK_ADDR A:0xfc46919c
y.create.l HWIO_PNOC_QHM1_TFILT_OPCODE_ADDR A:0xfc4691a0
y.create.l HWIO_PNOC_MDP_TFILT_ID_COREID_ADDR A:0xfc469200
y.create.l HWIO_PNOC_MDP_TFILT_ID_REVISIONID_ADDR A:0xfc469204
y.create.l HWIO_PNOC_MDP_TFILT_MODE_ADDR A:0xfc469208
y.create.l HWIO_PNOC_MDP_TFILT_ADDRBASE_LOW_ADDR A:0xfc46920c
y.create.l HWIO_PNOC_MDP_TFILT_ADDRWINDOWSIZE_ADDR A:0xfc469214
y.create.l HWIO_PNOC_MDP_TFILT_SRCIDBASE_ADDR A:0xfc469218
y.create.l HWIO_PNOC_MDP_TFILT_SRCIDMASK_ADDR A:0xfc46921c
y.create.l HWIO_PNOC_MDP_TFILT_OPCODE_ADDR A:0xfc469220
y.create.l HWIO_PNOC_QHM3_TFILT_ID_COREID_ADDR A:0xfc469280
y.create.l HWIO_PNOC_QHM3_TFILT_ID_REVISIONID_ADDR A:0xfc469284
y.create.l HWIO_PNOC_QHM3_TFILT_MODE_ADDR A:0xfc469288
y.create.l HWIO_PNOC_QHM3_TFILT_ADDRBASE_LOW_ADDR A:0xfc46928c
y.create.l HWIO_PNOC_QHM3_TFILT_ADDRWINDOWSIZE_ADDR A:0xfc469294
y.create.l HWIO_PNOC_QHM3_TFILT_SRCIDBASE_ADDR A:0xfc469298
y.create.l HWIO_PNOC_QHM3_TFILT_SRCIDMASK_ADDR A:0xfc46929c
y.create.l HWIO_PNOC_QHM3_TFILT_OPCODE_ADDR A:0xfc4692a0
y.create.l HWIO_PNOC_TPRB_TPROF_ID_COREID_ADDR A:0xfc469300
y.create.l HWIO_PNOC_TPRB_TPROF_ID_REVISIONID_ADDR A:0xfc469304
y.create.l HWIO_PNOC_TPRB_TPROF_EN_ADDR A:0xfc469308
y.create.l HWIO_PNOC_TPRB_TPROF_MODE_ADDR A:0xfc46930c
y.create.l HWIO_PNOC_TPRB_TPROF_OBSERVEDSEL_0_ADDR A:0xfc469310
y.create.l HWIO_PNOC_TPRB_TPROF_OBSERVEDSEL_1_ADDR A:0xfc469314
y.create.l HWIO_PNOC_TPRB_TPROF_NTENURELINES_0_ADDR A:0xfc469320
y.create.l HWIO_PNOC_TPRB_TPROF_THRESHOLDS_0_0_ADDR A:0xfc46932c
y.create.l HWIO_PNOC_TPRB_TPROF_THRESHOLDS_0_1_ADDR A:0xfc469330
y.create.l HWIO_PNOC_TPRB_TPROF_THRESHOLDS_0_2_ADDR A:0xfc469334
y.create.l HWIO_PNOC_TPRB_TPROF_THRESHOLDS_1_0_ADDR A:0xfc46933c
y.create.l HWIO_PNOC_TPRB_TPROF_THRESHOLDS_1_1_ADDR A:0xfc469340
y.create.l HWIO_PNOC_TPRB_TPROF_THRESHOLDS_1_2_ADDR A:0xfc469344
y.create.l HWIO_PNOC_TPRB_TPROF_OVERFLOWSTATUS_ADDR A:0xfc46936c
y.create.l HWIO_PNOC_TPRB_TPROF_OVERFLOWRESET_ADDR A:0xfc469370
y.create.l HWIO_PNOC_TPRB_TPROF_PENDINGEVENTMODE_ADDR A:0xfc469374
y.create.l HWIO_PNOC_TPRB_TPROF_PRESCALER_ADDR A:0xfc469378
y.create.l HWIO_PNOC_TPRB_SPROF_ID_COREID_ADDR A:0xfc469400
y.create.l HWIO_PNOC_TPRB_SPROF_ID_REVISIONID_ADDR A:0xfc469404
y.create.l HWIO_PNOC_TPRB_SPROF_MAINCTL_ADDR A:0xfc469408
y.create.l HWIO_PNOC_TPRB_SPROF_CFGCTL_ADDR A:0xfc46940c
y.create.l HWIO_PNOC_TPRB_SPROF_STATPERIOD_ADDR A:0xfc469424
y.create.l HWIO_PNOC_TPRB_SPROF_STATGO_ADDR A:0xfc469428
y.create.l HWIO_PNOC_TPRB_SPROF_STATALARMMIN_ADDR A:0xfc46942c
y.create.l HWIO_PNOC_TPRB_SPROF_STATALARMMAX_ADDR A:0xfc469430
y.create.l HWIO_PNOC_TPRB_SPROF_STATALARMSTATUS_ADDR A:0xfc469434
y.create.l HWIO_PNOC_TPRB_SPROF_STATALARMCLR_ADDR A:0xfc469438
y.create.l HWIO_PNOC_TPRB_SPROF_COUNTERS_0_SRC_ADDR A:0xfc469538
y.create.l HWIO_PNOC_TPRB_SPROF_COUNTERS_0_ALARMMODE_ADDR A:0xfc46953c
y.create.l HWIO_PNOC_TPRB_SPROF_COUNTERS_0_VAL_ADDR A:0xfc469540
y.create.l HWIO_PNOC_TPRB_SPROF_COUNTERS_1_SRC_ADDR A:0xfc46954c
y.create.l HWIO_PNOC_TPRB_SPROF_COUNTERS_1_ALARMMODE_ADDR A:0xfc469550
y.create.l HWIO_PNOC_TPRB_SPROF_COUNTERS_1_VAL_ADDR A:0xfc469554
y.create.l HWIO_PNOC_TPRB_SPROF_COUNTERS_2_SRC_ADDR A:0xfc469560
y.create.l HWIO_PNOC_TPRB_SPROF_COUNTERS_2_ALARMMODE_ADDR A:0xfc469564
y.create.l HWIO_PNOC_TPRB_SPROF_COUNTERS_2_VAL_ADDR A:0xfc469568
y.create.l HWIO_PNOC_TPRB_SPROF_COUNTERS_3_SRC_ADDR A:0xfc469574
y.create.l HWIO_PNOC_TPRB_SPROF_COUNTERS_3_ALARMMODE_ADDR A:0xfc469578
y.create.l HWIO_PNOC_TPRB_SPROF_COUNTERS_3_VAL_ADDR A:0xfc46957c
y.create.l HWIO_PNOC_TPRB_SPROF_COUNTERS_4_SRC_ADDR A:0xfc469588
y.create.l HWIO_PNOC_TPRB_SPROF_COUNTERS_4_ALARMMODE_ADDR A:0xfc46958c
y.create.l HWIO_PNOC_TPRB_SPROF_COUNTERS_4_VAL_ADDR A:0xfc469590
y.create.l HWIO_PNOC_TPRB_SPROF_COUNTERS_5_SRC_ADDR A:0xfc46959c
y.create.l HWIO_PNOC_TPRB_SPROF_COUNTERS_5_ALARMMODE_ADDR A:0xfc4695a0
y.create.l HWIO_PNOC_TPRB_SPROF_COUNTERS_5_VAL_ADDR A:0xfc4695a4
y.create.l HWIO_PNOC_TPRB_SPROF_COUNTERS_6_SRC_ADDR A:0xfc4695b0
y.create.l HWIO_PNOC_TPRB_SPROF_COUNTERS_6_ALARMMODE_ADDR A:0xfc4695b4
y.create.l HWIO_PNOC_TPRB_SPROF_COUNTERS_6_VAL_ADDR A:0xfc4695b8
y.create.l HWIO_PNOC_TPRB_SPROF_COUNTERS_7_SRC_ADDR A:0xfc4695c4
y.create.l HWIO_PNOC_TPRB_SPROF_COUNTERS_7_ALARMMODE_ADDR A:0xfc4695c8
y.create.l HWIO_PNOC_TPRB_SPROF_COUNTERS_7_VAL_ADDR A:0xfc4695cc
y.create.l HWIO_PNOC_TPRB_SPROF_COUNTERS_8_SRC_ADDR A:0xfc4695d8
y.create.l HWIO_PNOC_TPRB_SPROF_COUNTERS_8_ALARMMODE_ADDR A:0xfc4695dc
y.create.l HWIO_PNOC_TPRB_SPROF_COUNTERS_8_VAL_ADDR A:0xfc4695e0
y.create.l HWIO_PNOC_TPRB_SPROF_COUNTERS_9_SRC_ADDR A:0xfc4695ec
y.create.l HWIO_PNOC_TPRB_SPROF_COUNTERS_9_ALARMMODE_ADDR A:0xfc4695f0
y.create.l HWIO_PNOC_TPRB_SPROF_COUNTERS_9_VAL_ADDR A:0xfc4695f4
y.create.l HWIO_PNOC_TPRB_SPROF_COUNTERS_10_SRC_ADDR A:0xfc469600
y.create.l HWIO_PNOC_TPRB_SPROF_COUNTERS_10_ALARMMODE_ADDR A:0xfc469604
y.create.l HWIO_PNOC_TPRB_SPROF_COUNTERS_10_VAL_ADDR A:0xfc469608
y.create.l HWIO_PNOC_TPRB_SPROF_COUNTERS_11_SRC_ADDR A:0xfc469614
y.create.l HWIO_PNOC_TPRB_SPROF_COUNTERS_11_ALARMMODE_ADDR A:0xfc469618
y.create.l HWIO_PNOC_TPRB_SPROF_COUNTERS_11_VAL_ADDR A:0xfc46961c
y.create.l HWIO_PNOC_TPRB_SPROF_COUNTERS_12_SRC_ADDR A:0xfc469628
y.create.l HWIO_PNOC_TPRB_SPROF_COUNTERS_12_ALARMMODE_ADDR A:0xfc46962c
y.create.l HWIO_PNOC_TPRB_SPROF_COUNTERS_12_VAL_ADDR A:0xfc469630
y.create.l HWIO_PNOC_TPRB_SPROF_COUNTERS_13_SRC_ADDR A:0xfc46963c
y.create.l HWIO_PNOC_TPRB_SPROF_COUNTERS_13_ALARMMODE_ADDR A:0xfc469640
y.create.l HWIO_PNOC_TPRB_SPROF_COUNTERS_13_VAL_ADDR A:0xfc469644
y.create.l HWIO_PNOC_TPRB_SPROF_COUNTERS_14_SRC_ADDR A:0xfc469650
y.create.l HWIO_PNOC_TPRB_SPROF_COUNTERS_14_ALARMMODE_ADDR A:0xfc469654
y.create.l HWIO_PNOC_TPRB_SPROF_COUNTERS_14_VAL_ADDR A:0xfc469658
y.create.l HWIO_PNOC_TPRB_SPROF_COUNTERS_15_SRC_ADDR A:0xfc469664
y.create.l HWIO_PNOC_TPRB_SPROF_COUNTERS_15_ALARMMODE_ADDR A:0xfc469668
y.create.l HWIO_PNOC_TPRB_SPROF_COUNTERS_15_VAL_ADDR A:0xfc46966c
y.create.l HWIO_PNOC_EPRB_SPROF_ID_COREID_ADDR A:0xfc469800
y.create.l HWIO_PNOC_EPRB_SPROF_ID_REVISIONID_ADDR A:0xfc469804
y.create.l HWIO_PNOC_EPRB_SPROF_MAINCTL_ADDR A:0xfc469808
y.create.l HWIO_PNOC_EPRB_SPROF_CFGCTL_ADDR A:0xfc46980c
y.create.l HWIO_PNOC_EPRB_SPROF_FILTERLUT_ADDR A:0xfc469814
y.create.l HWIO_PNOC_EPRB_SPROF_TRACEALARMEN_ADDR A:0xfc469818
y.create.l HWIO_PNOC_EPRB_SPROF_TRACEALARMSTATUS_ADDR A:0xfc46981c
y.create.l HWIO_PNOC_EPRB_SPROF_TRACEALARMCLR_ADDR A:0xfc469820
y.create.l HWIO_PNOC_EPRB_SPROF_STATPERIOD_ADDR A:0xfc469824
y.create.l HWIO_PNOC_EPRB_SPROF_STATGO_ADDR A:0xfc469828
y.create.l HWIO_PNOC_EPRB_SPROF_STATALARMMIN_ADDR A:0xfc46982c
y.create.l HWIO_PNOC_EPRB_SPROF_STATALARMMAX_ADDR A:0xfc469830
y.create.l HWIO_PNOC_EPRB_SPROF_STATALARMSTATUS_ADDR A:0xfc469834
y.create.l HWIO_PNOC_EPRB_SPROF_STATALARMCLR_ADDR A:0xfc469838
y.create.l HWIO_PNOC_EPRB_SPROF_FILTERS_0_ROUTEIDBASE_ADDR A:0xfc469844
y.create.l HWIO_PNOC_EPRB_SPROF_FILTERS_0_ROUTEIDMASK_ADDR A:0xfc469848
y.create.l HWIO_PNOC_EPRB_SPROF_FILTERS_0_ADDRBASE_LOW_ADDR A:0xfc46984c
y.create.l HWIO_PNOC_EPRB_SPROF_FILTERS_0_WINDOWSIZE_ADDR A:0xfc469854
y.create.l HWIO_PNOC_EPRB_SPROF_FILTERS_0_OPCODE_ADDR A:0xfc469860
y.create.l HWIO_PNOC_EPRB_SPROF_FILTERS_0_STATUS_ADDR A:0xfc469864
y.create.l HWIO_PNOC_EPRB_SPROF_FILTERS_0_LENGTH_ADDR A:0xfc469868
y.create.l HWIO_PNOC_EPRB_SPROF_FILTERS_0_URGENCY_ADDR A:0xfc46986c
y.create.l HWIO_PNOC_EPRB_SPROF_FILTERS_1_ROUTEIDBASE_ADDR A:0xfc469880
y.create.l HWIO_PNOC_EPRB_SPROF_FILTERS_1_ROUTEIDMASK_ADDR A:0xfc469884
y.create.l HWIO_PNOC_EPRB_SPROF_FILTERS_1_ADDRBASE_LOW_ADDR A:0xfc469888
y.create.l HWIO_PNOC_EPRB_SPROF_FILTERS_1_WINDOWSIZE_ADDR A:0xfc469890
y.create.l HWIO_PNOC_EPRB_SPROF_FILTERS_1_OPCODE_ADDR A:0xfc46989c
y.create.l HWIO_PNOC_EPRB_SPROF_FILTERS_1_STATUS_ADDR A:0xfc4698a0
y.create.l HWIO_PNOC_EPRB_SPROF_FILTERS_1_LENGTH_ADDR A:0xfc4698a4
y.create.l HWIO_PNOC_EPRB_SPROF_FILTERS_1_URGENCY_ADDR A:0xfc4698a8
y.create.l HWIO_PNOC_EPRB_SPROF_COUNTERS_0_SRC_ADDR A:0xfc469938
y.create.l HWIO_PNOC_EPRB_SPROF_COUNTERS_0_ALARMMODE_ADDR A:0xfc46993c
y.create.l HWIO_PNOC_EPRB_SPROF_COUNTERS_0_VAL_ADDR A:0xfc469940
y.create.l HWIO_PNOC_EPRB_SPROF_COUNTERS_1_SRC_ADDR A:0xfc46994c
y.create.l HWIO_PNOC_EPRB_SPROF_COUNTERS_1_ALARMMODE_ADDR A:0xfc469950
y.create.l HWIO_PNOC_EPRB_SPROF_COUNTERS_1_VAL_ADDR A:0xfc469954
y.create.l HWIO_PNOC_EPRB_SPROF_COUNTERS_2_SRC_ADDR A:0xfc469960
y.create.l HWIO_PNOC_EPRB_SPROF_COUNTERS_2_ALARMMODE_ADDR A:0xfc469964
y.create.l HWIO_PNOC_EPRB_SPROF_COUNTERS_2_VAL_ADDR A:0xfc469968
y.create.l HWIO_PNOC_EPRB_SPROF_COUNTERS_3_SRC_ADDR A:0xfc469974
y.create.l HWIO_PNOC_EPRB_SPROF_COUNTERS_3_ALARMMODE_ADDR A:0xfc469978
y.create.l HWIO_PNOC_EPRB_SPROF_COUNTERS_3_VAL_ADDR A:0xfc46997c
y.create.l HWIO_PNOC_EPRB_SPROF_COUNTERS_4_SRC_ADDR A:0xfc469988
y.create.l HWIO_PNOC_EPRB_SPROF_COUNTERS_4_ALARMMODE_ADDR A:0xfc46998c
y.create.l HWIO_PNOC_EPRB_SPROF_COUNTERS_4_VAL_ADDR A:0xfc469990
y.create.l HWIO_PNOC_EPRB_SPROF_COUNTERS_5_SRC_ADDR A:0xfc46999c
y.create.l HWIO_PNOC_EPRB_SPROF_COUNTERS_5_ALARMMODE_ADDR A:0xfc4699a0
y.create.l HWIO_PNOC_EPRB_SPROF_COUNTERS_5_VAL_ADDR A:0xfc4699a4
y.create.l HWIO_PNOC_EPRB_SPROF_COUNTERS_6_SRC_ADDR A:0xfc4699b0
y.create.l HWIO_PNOC_EPRB_SPROF_COUNTERS_6_ALARMMODE_ADDR A:0xfc4699b4
y.create.l HWIO_PNOC_EPRB_SPROF_COUNTERS_6_VAL_ADDR A:0xfc4699b8
y.create.l HWIO_PNOC_EPRB_SPROF_COUNTERS_7_SRC_ADDR A:0xfc4699c4
y.create.l HWIO_PNOC_EPRB_SPROF_COUNTERS_7_ALARMMODE_ADDR A:0xfc4699c8
y.create.l HWIO_PNOC_EPRB_SPROF_COUNTERS_7_VAL_ADDR A:0xfc4699cc
y.create.l HWIO_PERIPH_SS_SDC1_SDCC_MCI_POWER_ADDR A:0xf9824000
y.create.l HWIO_PERIPH_SS_SDC1_SDCC_MCI_CLK_ADDR A:0xf9824004
y.create.l HWIO_PERIPH_SS_SDC1_SDCC_MCI_ARGUMENT_ADDR A:0xf9824008
y.create.l HWIO_PERIPH_SS_SDC1_SDCC_MCI_CMD_ADDR A:0xf982400c
y.create.l HWIO_PERIPH_SS_SDC1_SDCC_MCI_RESP_CMD_ADDR A:0xf9824010
y.create.l HWIO_PERIPH_SS_SDC1_SDCC_MCI_RESP0_ADDR A:0xf9824014
y.create.l HWIO_PERIPH_SS_SDC1_SDCC_MCI_RESP1_ADDR A:0xf9824018
y.create.l HWIO_PERIPH_SS_SDC1_SDCC_MCI_RESP2_ADDR A:0xf982401c
y.create.l HWIO_PERIPH_SS_SDC1_SDCC_MCI_RESP3_ADDR A:0xf9824020
y.create.l HWIO_PERIPH_SS_SDC1_SDCC_MCI_DATA_TIMER_ADDR A:0xf9824024
y.create.l HWIO_PERIPH_SS_SDC1_SDCC_MCI_DATA_LENGTH_ADDR A:0xf9824028
y.create.l HWIO_PERIPH_SS_SDC1_SDCC_MCI_DATA_CTL_ADDR A:0xf982402c
y.create.l HWIO_PERIPH_SS_SDC1_SDCC_MCI_DATA_COUNT_ADDR A:0xf9824030
y.create.l HWIO_PERIPH_SS_SDC1_SDCC_MCI_STATUS_ADDR A:0xf9824034
y.create.l HWIO_PERIPH_SS_SDC1_SDCC_MCI_CLEAR_ADDR A:0xf9824038
y.create.l HWIO_PERIPH_SS_SDC1_SDCC_MCI_INT_MASK0_ADDR A:0xf982403c
y.create.l HWIO_PERIPH_SS_SDC1_SDCC_MCI_INT_MASK1_ADDR A:0xf9824040
y.create.l HWIO_PERIPH_SS_SDC1_SDCC_MCI_FIFO_COUNT_ADDR A:0xf9824044
y.create.l HWIO_PERIPH_SS_SDC1_SDCC_MCI_BOOT_ADDR A:0xf9824048
y.create.l HWIO_PERIPH_SS_SDC1_SDCC_MCI_BOOT_ACK_TIMER_ADDR A:0xf982404c
y.create.l HWIO_PERIPH_SS_SDC1_SDCC_MCI_VERSION_ADDR A:0xf9824050
y.create.l HWIO_PERIPH_SS_SDC1_SDCC_MCI_EMULATION_DLY_LINE_ADDR A:0xf9824054
y.create.l HWIO_PERIPH_SS_SDC1_SDCC_MCI_CCS_TIMER_ADDR A:0xf9824058
y.create.l HWIO_PERIPH_SS_SDC1_SDCC_MCI_RESPONSE_MASK_ADDR A:0xf982405c
y.create.l HWIO_PERIPH_SS_SDC1_SDCC_MCI_DLL_CONFIG_ADDR A:0xf9824060
y.create.l HWIO_PERIPH_SS_SDC1_SDCC_MCI_DLL_TEST_CTL_ADDR A:0xf9824064
y.create.l HWIO_PERIPH_SS_SDC1_SDCC_MCI_DLL_STATUS_ADDR A:0xf9824068
y.create.l HWIO_PERIPH_SS_SDC1_SDCC_MCI_STATUS2_ADDR A:0xf982406c
y.create.l HWIO_PERIPH_SS_SDC1_SDCC_MCI_GENERICS_ADDR A:0xf9824070
y.create.l HWIO_PERIPH_SS_SDC1_SDCC_MCI_FIFO_STATUS_ADDR A:0xf9824074
y.create.l HWIO_PERIPH_SS_SDC1_SDCC_MCI_HC_MODE_ADDR A:0xf9824078
y.create.l HWIO_PERIPH_SS_SDC1_SDCC_MCI_FIFO0_ADDR A:0xf9824080
y.create.l HWIO_PERIPH_SS_SDC1_SDCC_MCI_FIFO1_ADDR A:0xf9824084
y.create.l HWIO_PERIPH_SS_SDC1_SDCC_MCI_FIFO2_ADDR A:0xf9824088
y.create.l HWIO_PERIPH_SS_SDC1_SDCC_MCI_FIFO3_ADDR A:0xf982408c
y.create.l HWIO_PERIPH_SS_SDC1_SDCC_MCI_FIFO4_ADDR A:0xf9824090
y.create.l HWIO_PERIPH_SS_SDC1_SDCC_MCI_FIFO5_ADDR A:0xf9824094
y.create.l HWIO_PERIPH_SS_SDC1_SDCC_MCI_FIFO6_ADDR A:0xf9824098
y.create.l HWIO_PERIPH_SS_SDC1_SDCC_MCI_FIFO7_ADDR A:0xf982409c
y.create.l HWIO_PERIPH_SS_SDC1_SDCC_MCI_FIFO8_ADDR A:0xf98240a0
y.create.l HWIO_PERIPH_SS_SDC1_SDCC_MCI_FIFO9_ADDR A:0xf98240a4
y.create.l HWIO_PERIPH_SS_SDC1_SDCC_MCI_TESTBUS_CONFIG_ADDR A:0xf98240cc
y.create.l HWIO_PERIPH_SS_SDC1_SDCC_MCI_TEST_CTL_ADDR A:0xf98240d0
y.create.l HWIO_PERIPH_SS_SDC1_SDCC_MCI_TEST_INPUT_ADDR A:0xf98240d4
y.create.l HWIO_PERIPH_SS_SDC1_SDCC_MCI_TEST_OUT_ADDR A:0xf98240d8
y.create.l HWIO_PERIPH_SS_SDC1_SDCC_MCI_PWRCTL_STATUS_REG_ADDR A:0xf98240dc
y.create.l HWIO_PERIPH_SS_SDC1_SDCC_MCI_PWRCTL_MASK_REG_ADDR A:0xf98240e0
y.create.l HWIO_PERIPH_SS_SDC1_SDCC_MCI_PWRCTL_CLEAR_REG_ADDR A:0xf98240e4
y.create.l HWIO_PERIPH_SS_SDC1_SDCC_MCI_PWRCTL_CTL_REG_ADDR A:0xf98240e8
y.create.l HWIO_PERIPH_SS_SDC1_SDCC_MCI_CLEAR2_ADDR A:0xf98240ec
y.create.l HWIO_PERIPH_SS_SDC1_SDCC_MCI_INT_MASKINT2_0_ADDR A:0xf98240f0
y.create.l HWIO_PERIPH_SS_SDC1_SDCC_MCI_INT_MASKINT2_1_ADDR A:0xf98240f4
y.create.l HWIO_PERIPH_SS_SDC1_SDCC_CHAR_CFG_ADDR A:0xf98240fc
y.create.l HWIO_PERIPH_SS_SDC1_SDCC_CHAR_CMD_ADDR A:0xf9824100
y.create.l HWIO_PERIPH_SS_SDC1_SDCC_CHAR_DATA_0_ADDR A:0xf9824104
y.create.l HWIO_PERIPH_SS_SDC1_SDCC_CHAR_DATA_1_ADDR A:0xf9824108
y.create.l HWIO_PERIPH_SS_SDC1_SDCC_CHAR_DATA_2_ADDR A:0xf982410c
y.create.l HWIO_PERIPH_SS_SDC1_SDCC_CHAR_DATA_3_ADDR A:0xf9824110
y.create.l HWIO_PERIPH_SS_SDC1_SDCC_CHAR_DATA_4_ADDR A:0xf9824114
y.create.l HWIO_PERIPH_SS_SDC1_SDCC_CHAR_DATA_5_ADDR A:0xf9824118
y.create.l HWIO_PERIPH_SS_SDC1_SDCC_CHAR_DATA_6_ADDR A:0xf982411c
y.create.l HWIO_PERIPH_SS_SDC1_SDCC_CHAR_DATA_7_ADDR A:0xf9824120
y.create.l HWIO_PERIPH_SS_SDC1_SDCC_DEBUG_REG_ADDR A:0xf9824124
y.create.l HWIO_PERIPH_SS_SDC1_SDCC_IP_CATALOG_ADDR A:0xf9824128
y.create.l HWIO_PERIPH_SS_SDC1_SDCC_QSB_VALUES_ADDR A:0xf982412c
y.create.l HWIO_PERIPH_SS_SDC1_SDCC_MCI_FIFO_ALT0_ADDR A:0xf9824400
y.create.l HWIO_PERIPH_SS_SDC1_SDCC_MCI_FIFO_ALT1_ADDR A:0xf9824404
y.create.l HWIO_PERIPH_SS_SDC1_SDCC_MCI_FIFO_ALT2_ADDR A:0xf9824408
y.create.l HWIO_PERIPH_SS_SDC1_SDCC_MCI_FIFO_ALT3_ADDR A:0xf982440c
y.create.l HWIO_PERIPH_SS_SDC1_SDCC_MCI_FIFO_ALT4_ADDR A:0xf9824410
y.create.l HWIO_PERIPH_SS_SDC1_SDCC_MCI_FIFO_ALT5_ADDR A:0xf9824414
y.create.l HWIO_PERIPH_SS_SDC1_SDCC_MCI_FIFO_ALT6_ADDR A:0xf9824418
y.create.l HWIO_PERIPH_SS_SDC1_SDCC_MCI_FIFO_ALT7_ADDR A:0xf982441c
y.create.l HWIO_PERIPH_SS_SDC1_SDCC_MCI_FIFO_ALT8_ADDR A:0xf9824420
y.create.l HWIO_PERIPH_SS_SDC1_SDCC_MCI_FIFO_ALT9_ADDR A:0xf9824424
y.create.l HWIO_PERIPH_SS_SDC1_SDCC_DML_CONFIG_ADDR A:0xf9824800
y.create.l HWIO_PERIPH_SS_SDC1_SDCC_DML_STATUS_ADDR A:0xf9824804
y.create.l HWIO_PERIPH_SS_SDC1_SDCC_DML_SW_RESET_ADDR A:0xf9824808
y.create.l HWIO_PERIPH_SS_SDC1_SDCC_DML_PRODUCER_START_ADDR A:0xf982480c
y.create.l HWIO_PERIPH_SS_SDC1_SDCC_DML_CONSUMER_START_ADDR A:0xf9824810
y.create.l HWIO_PERIPH_SS_SDC1_SDCC_DML_PRODUCER_PIPE_LOGICAL_SIZE_ADDR A:0xf9824814
y.create.l HWIO_PERIPH_SS_SDC1_SDCC_DML_CONSUMER_PIPE_LOGICAL_SIZE_ADDR A:0xf9824818
y.create.l HWIO_PERIPH_SS_SDC1_SDCC_DML_PIPE_ID_ADDR A:0xf982481c
y.create.l HWIO_PERIPH_SS_SDC1_SDCC_DML_PRODUCER_TRACKERS_ADDR A:0xf9824820
y.create.l HWIO_PERIPH_SS_SDC1_SDCC_DML_PRODUCER_BAM_BLOCK_SIZE_ADDR A:0xf9824824
y.create.l HWIO_PERIPH_SS_SDC1_SDCC_DML_PRODUCER_BAM_TRANS_SIZE_ADDR A:0xf9824828
y.create.l HWIO_PERIPH_SS_SDC1_SDCC_DML_DIRECT_MODE_BASE_ADDR_ADDR A:0xf982482c
y.create.l HWIO_PERIPH_SS_SDC1_SDCC_DML_DEBUG_ADDR A:0xf9824830
y.create.l HWIO_PERIPH_SS_SDC1_SDCC_DML_BAM_SIDE_STATUS_1_ADDR A:0xf9824834
y.create.l HWIO_PERIPH_SS_SDC1_SDCC_DML_BAM_SIDE_STATUS_2_ADDR A:0xf9824838
y.create.l HWIO_PERIPH_SS_SDC1_SDCC_DML_RTL_GENERICS_1_ADDR A:0xf982483c
y.create.l HWIO_PERIPH_SS_SDC1_SDCC_DML_RTL_GENERICS_2_ADDR A:0xf9824840
y.create.l HWIO_PERIPH_SS_SDC1_SDCC_DML_RTL_GENERICS_3_ADDR A:0xf9824844
y.create.l HWIO_PERIPH_SS_SDC1_SDCC_DML_INTERRUPT_ENABLE_ADDR A:0xf9824848
y.create.l HWIO_PERIPH_SS_SDC1_SDCC_DML_INTERRUPT_CLEAR_ADDR A:0xf982484c
y.create.l HWIO_PERIPH_SS_SDC1_SDCC_HC_REG_0_2_ADDR A:0xf9824900
y.create.l HWIO_PERIPH_SS_SDC1_SDCC_HC_REG_4_6_ADDR A:0xf9824904
y.create.l HWIO_PERIPH_SS_SDC1_SDCC_HC_REG_8_A_ADDR A:0xf9824908
y.create.l HWIO_PERIPH_SS_SDC1_SDCC_HC_REG_C_E_ADDR A:0xf982490c
y.create.l HWIO_PERIPH_SS_SDC1_SDCC_HC_REG_10_12_ADDR A:0xf9824910
y.create.l HWIO_PERIPH_SS_SDC1_SDCC_HC_REG_14_16_ADDR A:0xf9824914
y.create.l HWIO_PERIPH_SS_SDC1_SDCC_HC_REG_18_1A_ADDR A:0xf9824918
y.create.l HWIO_PERIPH_SS_SDC1_SDCC_HC_REG_1C_1E_ADDR A:0xf982491c
y.create.l HWIO_PERIPH_SS_SDC1_SDCC_HC_REG_20_22_ADDR A:0xf9824920
y.create.l HWIO_PERIPH_SS_SDC1_SDCC_HC_REG_24_26_ADDR A:0xf9824924
y.create.l HWIO_PERIPH_SS_SDC1_SDCC_HC_REG_28_2A_ADDR A:0xf9824928
y.create.l HWIO_PERIPH_SS_SDC1_SDCC_HC_REG_2C_2E_ADDR A:0xf982492c
y.create.l HWIO_PERIPH_SS_SDC1_SDCC_HC_REG_30_32_ADDR A:0xf9824930
y.create.l HWIO_PERIPH_SS_SDC1_SDCC_HC_REG_34_36_ADDR A:0xf9824934
y.create.l HWIO_PERIPH_SS_SDC1_SDCC_HC_REG_38_3A_ADDR A:0xf9824938
y.create.l HWIO_PERIPH_SS_SDC1_SDCC_HC_REG_3C_3E_ADDR A:0xf982493c
y.create.l HWIO_PERIPH_SS_SDC1_SDCC_HC_REG_40_42_ADDR A:0xf9824940
y.create.l HWIO_PERIPH_SS_SDC1_SDCC_HC_REG_44_46_ADDR A:0xf9824944
y.create.l HWIO_PERIPH_SS_SDC1_SDCC_HC_REG_48_4A_ADDR A:0xf9824948
y.create.l HWIO_PERIPH_SS_SDC1_SDCC_HC_REG_50_52_ADDR A:0xf9824950
y.create.l HWIO_PERIPH_SS_SDC1_SDCC_HC_REG_54_56_ADDR A:0xf9824954
y.create.l HWIO_PERIPH_SS_SDC1_SDCC_HC_REG_58_5A_ADDR A:0xf9824958
y.create.l HWIO_PERIPH_SS_SDC1_SDCC_HC_REG_5C_5E_ADDR A:0xf982495c
y.create.l HWIO_PERIPH_SS_SDC1_SDCC_HC_REG_60_62_ADDR A:0xf9824960
y.create.l HWIO_PERIPH_SS_SDC1_SDCC_HC_REG_64_66_ADDR A:0xf9824964
y.create.l HWIO_PERIPH_SS_SDC1_SDCC_HC_REG_68_6A_ADDR A:0xf9824968
y.create.l HWIO_PERIPH_SS_SDC1_SDCC_HC_REG_6C_6E_ADDR A:0xf982496c
y.create.l HWIO_PERIPH_SS_SDC1_SDCC_HC_REG_E0_E2_ADDR A:0xf98249e0
y.create.l HWIO_PERIPH_SS_SDC1_SDCC_HC_REG_FC_FE_ADDR A:0xf98249fc
y.create.l HWIO_PERIPH_SS_SDC1_SDCC_HC_REG_DLL_CONFIG_ADDR A:0xf9824a00
y.create.l HWIO_PERIPH_SS_SDC1_SDCC_HC_REG_DLL_TEST_CTL_ADDR A:0xf9824a04
y.create.l HWIO_PERIPH_SS_SDC1_SDCC_HC_REG_DLL_STATUS_ADDR A:0xf9824a08
y.create.l HWIO_PERIPH_SS_SDC1_SDCC_HC_VENDOR_SPECIFIC_FUNC_ADDR A:0xf9824a0c
y.create.l HWIO_PERIPH_SS_SDC1_SDCC_HC_VENDOR_SPECIFIC_ADMA_ERR_ADDR0_ADDR A:0xf9824a14
y.create.l HWIO_PERIPH_SS_SDC1_SDCC_HC_VENDOR_SPECIFIC_ADMA_ERR_ADDR1_ADDR A:0xf9824a18
y.create.l HWIO_PERIPH_SS_SDC1_SDCC_HC_VENDOR_SPECIFIC_CAPABILITIES0_ADDR A:0xf9824a1c
y.create.l HWIO_PERIPH_SS_SDC1_SDCC_HC_VENDOR_SPECIFIC_CAPABILITIES1_ADDR A:0xf9824a20
y.create.l HWIO_PERIPH_SS_SDC1_SDCC_BAM_CTRL_ADDR A:0xf9804000
y.create.l HWIO_PERIPH_SS_SDC1_SDCC_BAM_REVISION_ADDR A:0xf9804004
y.create.l HWIO_PERIPH_SS_SDC1_SDCC_BAM_SW_VERSION_ADDR A:0xf9804080
y.create.l HWIO_PERIPH_SS_SDC1_SDCC_BAM_NUM_PIPES_ADDR A:0xf980403c
y.create.l HWIO_PERIPH_SS_SDC1_SDCC_BAM_TIMER_ADDR A:0xf9804040
y.create.l HWIO_PERIPH_SS_SDC1_SDCC_BAM_TIMER_CTRL_ADDR A:0xf9804044
y.create.l HWIO_PERIPH_SS_SDC1_SDCC_BAM_DESC_CNT_TRSHLD_ADDR A:0xf9804008
y.create.l HWIO_PERIPH_SS_SDC1_SDCC_BAM_IRQ_SRCS_ADDR A:0xf980400c
y.create.l HWIO_PERIPH_SS_SDC1_SDCC_BAM_IRQ_SRCS_MSK_ADDR A:0xf9804010
y.create.l HWIO_PERIPH_SS_SDC1_SDCC_BAM_IRQ_SRCS_UNMASKED_ADDR A:0xf9804030
y.create.l HWIO_PERIPH_SS_SDC1_SDCC_BAM_IRQ_STTS_ADDR A:0xf9804014
y.create.l HWIO_PERIPH_SS_SDC1_SDCC_BAM_IRQ_CLR_ADDR A:0xf9804018
y.create.l HWIO_PERIPH_SS_SDC1_SDCC_BAM_IRQ_EN_ADDR A:0xf980401c
y.create.l HWIO_PERIPH_SS_SDC1_SDCC_BAM_AHB_MASTER_ERR_CTRLS_ADDR A:0xf9804024
y.create.l HWIO_PERIPH_SS_SDC1_SDCC_BAM_AHB_MASTER_ERR_ADDR_ADDR A:0xf9804028
y.create.l HWIO_PERIPH_SS_SDC1_SDCC_BAM_AHB_MASTER_ERR_DATA_ADDR A:0xf980402c
y.create.l HWIO_PERIPH_SS_SDC1_SDCC_BAM_TRUST_REG_ADDR A:0xf9804070
y.create.l HWIO_PERIPH_SS_SDC1_SDCC_BAM_TEST_BUS_SEL_ADDR A:0xf9804074
y.create.l HWIO_PERIPH_SS_SDC1_SDCC_BAM_TEST_BUS_REG_ADDR A:0xf9804078
y.create.l HWIO_PERIPH_SS_SDC1_SDCC_BAM_CNFG_BITS_ADDR A:0xf980407c
y.create.l HWIO_PERIPH_SS_SDC1_SDCC_BAM_IRQ_SRCS_EE0_ADDR A:0xf9804800
y.create.l HWIO_PERIPH_SS_SDC1_SDCC_BAM_IRQ_SRCS_EE1_ADDR A:0xf9804880
y.create.l HWIO_PERIPH_SS_SDC1_SDCC_BAM_IRQ_SRCS_EE2_ADDR A:0xf9804900
y.create.l HWIO_PERIPH_SS_SDC1_SDCC_BAM_IRQ_SRCS_EE3_ADDR A:0xf9804980
y.create.l HWIO_PERIPH_SS_SDC1_SDCC_BAM_IRQ_SRCS_EE4_ADDR A:0xf9804a00
y.create.l HWIO_PERIPH_SS_SDC1_SDCC_BAM_IRQ_SRCS_EE5_ADDR A:0xf9804a80
y.create.l HWIO_PERIPH_SS_SDC1_SDCC_BAM_IRQ_SRCS_EE6_ADDR A:0xf9804b00
y.create.l HWIO_PERIPH_SS_SDC1_SDCC_BAM_IRQ_SRCS_EE7_ADDR A:0xf9804b80
y.create.l HWIO_PERIPH_SS_SDC1_SDCC_BAM_IRQ_SRCS_MSK_EE0_ADDR A:0xf9804804
y.create.l HWIO_PERIPH_SS_SDC1_SDCC_BAM_IRQ_SRCS_MSK_EE1_ADDR A:0xf9804884
y.create.l HWIO_PERIPH_SS_SDC1_SDCC_BAM_IRQ_SRCS_MSK_EE2_ADDR A:0xf9804904
y.create.l HWIO_PERIPH_SS_SDC1_SDCC_BAM_IRQ_SRCS_MSK_EE3_ADDR A:0xf9804984
y.create.l HWIO_PERIPH_SS_SDC1_SDCC_BAM_IRQ_SRCS_MSK_EE4_ADDR A:0xf9804a04
y.create.l HWIO_PERIPH_SS_SDC1_SDCC_BAM_IRQ_SRCS_MSK_EE5_ADDR A:0xf9804a84
y.create.l HWIO_PERIPH_SS_SDC1_SDCC_BAM_IRQ_SRCS_MSK_EE6_ADDR A:0xf9804b04
y.create.l HWIO_PERIPH_SS_SDC1_SDCC_BAM_IRQ_SRCS_MSK_EE7_ADDR A:0xf9804b84
y.create.l HWIO_PERIPH_SS_SDC1_SDCC_BAM_IRQ_SRCS_UNMASKED_EE0_ADDR A:0xf9804808
y.create.l HWIO_PERIPH_SS_SDC1_SDCC_BAM_IRQ_SRCS_UNMASKED_EE1_ADDR A:0xf9804888
y.create.l HWIO_PERIPH_SS_SDC1_SDCC_BAM_IRQ_SRCS_UNMASKED_EE2_ADDR A:0xf9804908
y.create.l HWIO_PERIPH_SS_SDC1_SDCC_BAM_IRQ_SRCS_UNMASKED_EE3_ADDR A:0xf9804988
y.create.l HWIO_PERIPH_SS_SDC1_SDCC_BAM_IRQ_SRCS_UNMASKED_EE4_ADDR A:0xf9804a08
y.create.l HWIO_PERIPH_SS_SDC1_SDCC_BAM_IRQ_SRCS_UNMASKED_EE5_ADDR A:0xf9804a88
y.create.l HWIO_PERIPH_SS_SDC1_SDCC_BAM_IRQ_SRCS_UNMASKED_EE6_ADDR A:0xf9804b08
y.create.l HWIO_PERIPH_SS_SDC1_SDCC_BAM_IRQ_SRCS_UNMASKED_EE7_ADDR A:0xf9804b88
y.create.l HWIO_PERIPH_SS_SDC1_SDCC_BAM_P_CTRL0_ADDR A:0xf9805000
y.create.l HWIO_PERIPH_SS_SDC1_SDCC_BAM_P_CTRL1_ADDR A:0xf9806000
y.create.l HWIO_PERIPH_SS_SDC1_SDCC_BAM_P_CTRL2_ADDR A:0xf9807000
y.create.l HWIO_PERIPH_SS_SDC1_SDCC_BAM_P_CTRL3_ADDR A:0xf9808000
y.create.l HWIO_PERIPH_SS_SDC1_SDCC_BAM_P_CTRL4_ADDR A:0xf9809000
y.create.l HWIO_PERIPH_SS_SDC1_SDCC_BAM_P_CTRL5_ADDR A:0xf980a000
y.create.l HWIO_PERIPH_SS_SDC1_SDCC_BAM_P_RST0_ADDR A:0xf9805004
y.create.l HWIO_PERIPH_SS_SDC1_SDCC_BAM_P_RST1_ADDR A:0xf9806004
y.create.l HWIO_PERIPH_SS_SDC1_SDCC_BAM_P_RST2_ADDR A:0xf9807004
y.create.l HWIO_PERIPH_SS_SDC1_SDCC_BAM_P_RST3_ADDR A:0xf9808004
y.create.l HWIO_PERIPH_SS_SDC1_SDCC_BAM_P_RST4_ADDR A:0xf9809004
y.create.l HWIO_PERIPH_SS_SDC1_SDCC_BAM_P_RST5_ADDR A:0xf980a004
y.create.l HWIO_PERIPH_SS_SDC1_SDCC_BAM_P_HALT0_ADDR A:0xf9805008
y.create.l HWIO_PERIPH_SS_SDC1_SDCC_BAM_P_HALT1_ADDR A:0xf9806008
y.create.l HWIO_PERIPH_SS_SDC1_SDCC_BAM_P_HALT2_ADDR A:0xf9807008
y.create.l HWIO_PERIPH_SS_SDC1_SDCC_BAM_P_HALT3_ADDR A:0xf9808008
y.create.l HWIO_PERIPH_SS_SDC1_SDCC_BAM_P_HALT4_ADDR A:0xf9809008
y.create.l HWIO_PERIPH_SS_SDC1_SDCC_BAM_P_HALT5_ADDR A:0xf980a008
y.create.l HWIO_PERIPH_SS_SDC1_SDCC_BAM_P_TRUST_REG0_ADDR A:0xf9805030
y.create.l HWIO_PERIPH_SS_SDC1_SDCC_BAM_P_TRUST_REG1_ADDR A:0xf9806030
y.create.l HWIO_PERIPH_SS_SDC1_SDCC_BAM_P_TRUST_REG2_ADDR A:0xf9807030
y.create.l HWIO_PERIPH_SS_SDC1_SDCC_BAM_P_TRUST_REG3_ADDR A:0xf9808030
y.create.l HWIO_PERIPH_SS_SDC1_SDCC_BAM_P_TRUST_REG4_ADDR A:0xf9809030
y.create.l HWIO_PERIPH_SS_SDC1_SDCC_BAM_P_TRUST_REG5_ADDR A:0xf980a030
y.create.l HWIO_PERIPH_SS_SDC1_SDCC_BAM_P_IRQ_STTS0_ADDR A:0xf9805010
y.create.l HWIO_PERIPH_SS_SDC1_SDCC_BAM_P_IRQ_STTS1_ADDR A:0xf9806010
y.create.l HWIO_PERIPH_SS_SDC1_SDCC_BAM_P_IRQ_STTS2_ADDR A:0xf9807010
y.create.l HWIO_PERIPH_SS_SDC1_SDCC_BAM_P_IRQ_STTS3_ADDR A:0xf9808010
y.create.l HWIO_PERIPH_SS_SDC1_SDCC_BAM_P_IRQ_STTS4_ADDR A:0xf9809010
y.create.l HWIO_PERIPH_SS_SDC1_SDCC_BAM_P_IRQ_STTS5_ADDR A:0xf980a010
y.create.l HWIO_PERIPH_SS_SDC1_SDCC_BAM_P_IRQ_CLR0_ADDR A:0xf9805014
y.create.l HWIO_PERIPH_SS_SDC1_SDCC_BAM_P_IRQ_CLR1_ADDR A:0xf9806014
y.create.l HWIO_PERIPH_SS_SDC1_SDCC_BAM_P_IRQ_CLR2_ADDR A:0xf9807014
y.create.l HWIO_PERIPH_SS_SDC1_SDCC_BAM_P_IRQ_CLR3_ADDR A:0xf9808014
y.create.l HWIO_PERIPH_SS_SDC1_SDCC_BAM_P_IRQ_CLR4_ADDR A:0xf9809014
y.create.l HWIO_PERIPH_SS_SDC1_SDCC_BAM_P_IRQ_CLR5_ADDR A:0xf980a014
y.create.l HWIO_PERIPH_SS_SDC1_SDCC_BAM_P_IRQ_EN0_ADDR A:0xf9805018
y.create.l HWIO_PERIPH_SS_SDC1_SDCC_BAM_P_IRQ_EN1_ADDR A:0xf9806018
y.create.l HWIO_PERIPH_SS_SDC1_SDCC_BAM_P_IRQ_EN2_ADDR A:0xf9807018
y.create.l HWIO_PERIPH_SS_SDC1_SDCC_BAM_P_IRQ_EN3_ADDR A:0xf9808018
y.create.l HWIO_PERIPH_SS_SDC1_SDCC_BAM_P_IRQ_EN4_ADDR A:0xf9809018
y.create.l HWIO_PERIPH_SS_SDC1_SDCC_BAM_P_IRQ_EN5_ADDR A:0xf980a018
y.create.l HWIO_PERIPH_SS_SDC1_SDCC_BAM_P_TIMER0_ADDR A:0xf980501c
y.create.l HWIO_PERIPH_SS_SDC1_SDCC_BAM_P_TIMER1_ADDR A:0xf980601c
y.create.l HWIO_PERIPH_SS_SDC1_SDCC_BAM_P_TIMER2_ADDR A:0xf980701c
y.create.l HWIO_PERIPH_SS_SDC1_SDCC_BAM_P_TIMER3_ADDR A:0xf980801c
y.create.l HWIO_PERIPH_SS_SDC1_SDCC_BAM_P_TIMER4_ADDR A:0xf980901c
y.create.l HWIO_PERIPH_SS_SDC1_SDCC_BAM_P_TIMER5_ADDR A:0xf980a01c
y.create.l HWIO_PERIPH_SS_SDC1_SDCC_BAM_P_TIMER_CTRL0_ADDR A:0xf9805020
y.create.l HWIO_PERIPH_SS_SDC1_SDCC_BAM_P_TIMER_CTRL1_ADDR A:0xf9806020
y.create.l HWIO_PERIPH_SS_SDC1_SDCC_BAM_P_TIMER_CTRL2_ADDR A:0xf9807020
y.create.l HWIO_PERIPH_SS_SDC1_SDCC_BAM_P_TIMER_CTRL3_ADDR A:0xf9808020
y.create.l HWIO_PERIPH_SS_SDC1_SDCC_BAM_P_TIMER_CTRL4_ADDR A:0xf9809020
y.create.l HWIO_PERIPH_SS_SDC1_SDCC_BAM_P_TIMER_CTRL5_ADDR A:0xf980a020
y.create.l HWIO_PERIPH_SS_SDC1_SDCC_BAM_P_PRDCR_SDBND0_ADDR A:0xf9805024
y.create.l HWIO_PERIPH_SS_SDC1_SDCC_BAM_P_PRDCR_SDBND1_ADDR A:0xf9806024
y.create.l HWIO_PERIPH_SS_SDC1_SDCC_BAM_P_PRDCR_SDBND2_ADDR A:0xf9807024
y.create.l HWIO_PERIPH_SS_SDC1_SDCC_BAM_P_PRDCR_SDBND3_ADDR A:0xf9808024
y.create.l HWIO_PERIPH_SS_SDC1_SDCC_BAM_P_PRDCR_SDBND4_ADDR A:0xf9809024
y.create.l HWIO_PERIPH_SS_SDC1_SDCC_BAM_P_PRDCR_SDBND5_ADDR A:0xf980a024
y.create.l HWIO_PERIPH_SS_SDC1_SDCC_BAM_P_CNSMR_SDBND0_ADDR A:0xf9805028
y.create.l HWIO_PERIPH_SS_SDC1_SDCC_BAM_P_CNSMR_SDBND1_ADDR A:0xf9806028
y.create.l HWIO_PERIPH_SS_SDC1_SDCC_BAM_P_CNSMR_SDBND2_ADDR A:0xf9807028
y.create.l HWIO_PERIPH_SS_SDC1_SDCC_BAM_P_CNSMR_SDBND3_ADDR A:0xf9808028
y.create.l HWIO_PERIPH_SS_SDC1_SDCC_BAM_P_CNSMR_SDBND4_ADDR A:0xf9809028
y.create.l HWIO_PERIPH_SS_SDC1_SDCC_BAM_P_CNSMR_SDBND5_ADDR A:0xf980a028
y.create.l HWIO_PERIPH_SS_SDC1_SDCC_BAM_P_EVNT_DEST_ADDR0_ADDR A:0xf980582c
y.create.l HWIO_PERIPH_SS_SDC1_SDCC_BAM_P_EVNT_DEST_ADDR1_ADDR A:0xf980682c
y.create.l HWIO_PERIPH_SS_SDC1_SDCC_BAM_P_EVNT_DEST_ADDR2_ADDR A:0xf980782c
y.create.l HWIO_PERIPH_SS_SDC1_SDCC_BAM_P_EVNT_DEST_ADDR3_ADDR A:0xf980882c
y.create.l HWIO_PERIPH_SS_SDC1_SDCC_BAM_P_EVNT_DEST_ADDR4_ADDR A:0xf980982c
y.create.l HWIO_PERIPH_SS_SDC1_SDCC_BAM_P_EVNT_DEST_ADDR5_ADDR A:0xf980a82c
y.create.l HWIO_PERIPH_SS_SDC1_SDCC_BAM_P_EVNT_REG0_ADDR A:0xf9805818
y.create.l HWIO_PERIPH_SS_SDC1_SDCC_BAM_P_EVNT_REG1_ADDR A:0xf9806818
y.create.l HWIO_PERIPH_SS_SDC1_SDCC_BAM_P_EVNT_REG2_ADDR A:0xf9807818
y.create.l HWIO_PERIPH_SS_SDC1_SDCC_BAM_P_EVNT_REG3_ADDR A:0xf9808818
y.create.l HWIO_PERIPH_SS_SDC1_SDCC_BAM_P_EVNT_REG4_ADDR A:0xf9809818
y.create.l HWIO_PERIPH_SS_SDC1_SDCC_BAM_P_EVNT_REG5_ADDR A:0xf980a818
y.create.l HWIO_PERIPH_SS_SDC1_SDCC_BAM_P_SW_OFSTS0_ADDR A:0xf9805800
y.create.l HWIO_PERIPH_SS_SDC1_SDCC_BAM_P_SW_OFSTS1_ADDR A:0xf9806800
y.create.l HWIO_PERIPH_SS_SDC1_SDCC_BAM_P_SW_OFSTS2_ADDR A:0xf9807800
y.create.l HWIO_PERIPH_SS_SDC1_SDCC_BAM_P_SW_OFSTS3_ADDR A:0xf9808800
y.create.l HWIO_PERIPH_SS_SDC1_SDCC_BAM_P_SW_OFSTS4_ADDR A:0xf9809800
y.create.l HWIO_PERIPH_SS_SDC1_SDCC_BAM_P_SW_OFSTS5_ADDR A:0xf980a800
y.create.l HWIO_PERIPH_SS_SDC1_SDCC_BAM_P_DATA_FIFO_ADDR0_ADDR A:0xf9805824
y.create.l HWIO_PERIPH_SS_SDC1_SDCC_BAM_P_DATA_FIFO_ADDR1_ADDR A:0xf9806824
y.create.l HWIO_PERIPH_SS_SDC1_SDCC_BAM_P_DATA_FIFO_ADDR2_ADDR A:0xf9807824
y.create.l HWIO_PERIPH_SS_SDC1_SDCC_BAM_P_DATA_FIFO_ADDR3_ADDR A:0xf9808824
y.create.l HWIO_PERIPH_SS_SDC1_SDCC_BAM_P_DATA_FIFO_ADDR4_ADDR A:0xf9809824
y.create.l HWIO_PERIPH_SS_SDC1_SDCC_BAM_P_DATA_FIFO_ADDR5_ADDR A:0xf980a824
y.create.l HWIO_PERIPH_SS_SDC1_SDCC_BAM_P_DESC_FIFO_ADDR0_ADDR A:0xf980581c
y.create.l HWIO_PERIPH_SS_SDC1_SDCC_BAM_P_DESC_FIFO_ADDR1_ADDR A:0xf980681c
y.create.l HWIO_PERIPH_SS_SDC1_SDCC_BAM_P_DESC_FIFO_ADDR2_ADDR A:0xf980781c
y.create.l HWIO_PERIPH_SS_SDC1_SDCC_BAM_P_DESC_FIFO_ADDR3_ADDR A:0xf980881c
y.create.l HWIO_PERIPH_SS_SDC1_SDCC_BAM_P_DESC_FIFO_ADDR4_ADDR A:0xf980981c
y.create.l HWIO_PERIPH_SS_SDC1_SDCC_BAM_P_DESC_FIFO_ADDR5_ADDR A:0xf980a81c
y.create.l HWIO_PERIPH_SS_SDC1_SDCC_BAM_P_EVNT_GEN_TRSHLD0_ADDR A:0xf9805828
y.create.l HWIO_PERIPH_SS_SDC1_SDCC_BAM_P_EVNT_GEN_TRSHLD1_ADDR A:0xf9806828
y.create.l HWIO_PERIPH_SS_SDC1_SDCC_BAM_P_EVNT_GEN_TRSHLD2_ADDR A:0xf9807828
y.create.l HWIO_PERIPH_SS_SDC1_SDCC_BAM_P_EVNT_GEN_TRSHLD3_ADDR A:0xf9808828
y.create.l HWIO_PERIPH_SS_SDC1_SDCC_BAM_P_EVNT_GEN_TRSHLD4_ADDR A:0xf9809828
y.create.l HWIO_PERIPH_SS_SDC1_SDCC_BAM_P_EVNT_GEN_TRSHLD5_ADDR A:0xf980a828
y.create.l HWIO_PERIPH_SS_SDC1_SDCC_BAM_P_FIFO_SIZES0_ADDR A:0xf9805820
y.create.l HWIO_PERIPH_SS_SDC1_SDCC_BAM_P_FIFO_SIZES1_ADDR A:0xf9806820
y.create.l HWIO_PERIPH_SS_SDC1_SDCC_BAM_P_FIFO_SIZES2_ADDR A:0xf9807820
y.create.l HWIO_PERIPH_SS_SDC1_SDCC_BAM_P_FIFO_SIZES3_ADDR A:0xf9808820
y.create.l HWIO_PERIPH_SS_SDC1_SDCC_BAM_P_FIFO_SIZES4_ADDR A:0xf9809820
y.create.l HWIO_PERIPH_SS_SDC1_SDCC_BAM_P_FIFO_SIZES5_ADDR A:0xf980a820
y.create.l HWIO_PERIPH_SS_SDC1_SDCC_BAM_P_RETR_CNTXT_0_ADDR A:0xf9805834
y.create.l HWIO_PERIPH_SS_SDC1_SDCC_BAM_P_RETR_CNTXT_1_ADDR A:0xf9806834
y.create.l HWIO_PERIPH_SS_SDC1_SDCC_BAM_P_RETR_CNTXT_2_ADDR A:0xf9807834
y.create.l HWIO_PERIPH_SS_SDC1_SDCC_BAM_P_RETR_CNTXT_3_ADDR A:0xf9808834
y.create.l HWIO_PERIPH_SS_SDC1_SDCC_BAM_P_RETR_CNTXT_4_ADDR A:0xf9809834
y.create.l HWIO_PERIPH_SS_SDC1_SDCC_BAM_P_RETR_CNTXT_5_ADDR A:0xf980a834
y.create.l HWIO_PERIPH_SS_SDC1_SDCC_BAM_P_SI_CNTXT_0_ADDR A:0xf9805838
y.create.l HWIO_PERIPH_SS_SDC1_SDCC_BAM_P_SI_CNTXT_1_ADDR A:0xf9806838
y.create.l HWIO_PERIPH_SS_SDC1_SDCC_BAM_P_SI_CNTXT_2_ADDR A:0xf9807838
y.create.l HWIO_PERIPH_SS_SDC1_SDCC_BAM_P_SI_CNTXT_3_ADDR A:0xf9808838
y.create.l HWIO_PERIPH_SS_SDC1_SDCC_BAM_P_SI_CNTXT_4_ADDR A:0xf9809838
y.create.l HWIO_PERIPH_SS_SDC1_SDCC_BAM_P_SI_CNTXT_5_ADDR A:0xf980a838
y.create.l HWIO_PERIPH_SS_SDC1_SDCC_BAM_P_DF_CNTXT_0_ADDR A:0xf9805830
y.create.l HWIO_PERIPH_SS_SDC1_SDCC_BAM_P_DF_CNTXT_1_ADDR A:0xf9806830
y.create.l HWIO_PERIPH_SS_SDC1_SDCC_BAM_P_DF_CNTXT_2_ADDR A:0xf9807830
y.create.l HWIO_PERIPH_SS_SDC1_SDCC_BAM_P_DF_CNTXT_3_ADDR A:0xf9808830
y.create.l HWIO_PERIPH_SS_SDC1_SDCC_BAM_P_DF_CNTXT_4_ADDR A:0xf9809830
y.create.l HWIO_PERIPH_SS_SDC1_SDCC_BAM_P_DF_CNTXT_5_ADDR A:0xf980a830
y.create.l HWIO_PERIPH_SS_SDC1_SDCC_BAM_P_AU_PSM_CNTXT_1_0_ADDR A:0xf9805804
y.create.l HWIO_PERIPH_SS_SDC1_SDCC_BAM_P_AU_PSM_CNTXT_1_1_ADDR A:0xf9806804
y.create.l HWIO_PERIPH_SS_SDC1_SDCC_BAM_P_AU_PSM_CNTXT_1_2_ADDR A:0xf9807804
y.create.l HWIO_PERIPH_SS_SDC1_SDCC_BAM_P_AU_PSM_CNTXT_1_3_ADDR A:0xf9808804
y.create.l HWIO_PERIPH_SS_SDC1_SDCC_BAM_P_AU_PSM_CNTXT_1_4_ADDR A:0xf9809804
y.create.l HWIO_PERIPH_SS_SDC1_SDCC_BAM_P_AU_PSM_CNTXT_1_5_ADDR A:0xf980a804
y.create.l HWIO_PERIPH_SS_SDC1_SDCC_BAM_P_PSM_CNTXT_2_0_ADDR A:0xf9805808
y.create.l HWIO_PERIPH_SS_SDC1_SDCC_BAM_P_PSM_CNTXT_2_1_ADDR A:0xf9806808
y.create.l HWIO_PERIPH_SS_SDC1_SDCC_BAM_P_PSM_CNTXT_2_2_ADDR A:0xf9807808
y.create.l HWIO_PERIPH_SS_SDC1_SDCC_BAM_P_PSM_CNTXT_2_3_ADDR A:0xf9808808
y.create.l HWIO_PERIPH_SS_SDC1_SDCC_BAM_P_PSM_CNTXT_2_4_ADDR A:0xf9809808
y.create.l HWIO_PERIPH_SS_SDC1_SDCC_BAM_P_PSM_CNTXT_2_5_ADDR A:0xf980a808
y.create.l HWIO_PERIPH_SS_SDC1_SDCC_BAM_P_PSM_CNTXT_3_0_ADDR A:0xf980580c
y.create.l HWIO_PERIPH_SS_SDC1_SDCC_BAM_P_PSM_CNTXT_3_1_ADDR A:0xf980680c
y.create.l HWIO_PERIPH_SS_SDC1_SDCC_BAM_P_PSM_CNTXT_3_2_ADDR A:0xf980780c
y.create.l HWIO_PERIPH_SS_SDC1_SDCC_BAM_P_PSM_CNTXT_3_3_ADDR A:0xf980880c
y.create.l HWIO_PERIPH_SS_SDC1_SDCC_BAM_P_PSM_CNTXT_3_4_ADDR A:0xf980980c
y.create.l HWIO_PERIPH_SS_SDC1_SDCC_BAM_P_PSM_CNTXT_3_5_ADDR A:0xf980a80c
y.create.l HWIO_PERIPH_SS_SDC1_SDCC_BAM_P_PSM_CNTXT_4_0_ADDR A:0xf9805810
y.create.l HWIO_PERIPH_SS_SDC1_SDCC_BAM_P_PSM_CNTXT_4_1_ADDR A:0xf9806810
y.create.l HWIO_PERIPH_SS_SDC1_SDCC_BAM_P_PSM_CNTXT_4_2_ADDR A:0xf9807810
y.create.l HWIO_PERIPH_SS_SDC1_SDCC_BAM_P_PSM_CNTXT_4_3_ADDR A:0xf9808810
y.create.l HWIO_PERIPH_SS_SDC1_SDCC_BAM_P_PSM_CNTXT_4_4_ADDR A:0xf9809810
y.create.l HWIO_PERIPH_SS_SDC1_SDCC_BAM_P_PSM_CNTXT_4_5_ADDR A:0xf980a810
y.create.l HWIO_PERIPH_SS_SDC1_SDCC_BAM_P_PSM_CNTXT_5_0_ADDR A:0xf9805814
y.create.l HWIO_PERIPH_SS_SDC1_SDCC_BAM_P_PSM_CNTXT_5_1_ADDR A:0xf9806814
y.create.l HWIO_PERIPH_SS_SDC1_SDCC_BAM_P_PSM_CNTXT_5_2_ADDR A:0xf9807814
y.create.l HWIO_PERIPH_SS_SDC1_SDCC_BAM_P_PSM_CNTXT_5_3_ADDR A:0xf9808814
y.create.l HWIO_PERIPH_SS_SDC1_SDCC_BAM_P_PSM_CNTXT_5_4_ADDR A:0xf9809814
y.create.l HWIO_PERIPH_SS_SDC1_SDCC_BAM_P_PSM_CNTXT_5_5_ADDR A:0xf980a814
y.create.l HWIO_PERIPH_SS_SDC1_SDCC_XPU_SCR_ADDR A:0xf9802000
y.create.l HWIO_PERIPH_SS_SDC1_SDCC_XPU_SWDR_ADDR A:0xf9802004
y.create.l HWIO_PERIPH_SS_SDC1_SDCC_XPU_SEAR0_ADDR A:0xf9802040
y.create.l HWIO_PERIPH_SS_SDC1_SDCC_XPU_SESR_ADDR A:0xf9802048
y.create.l HWIO_PERIPH_SS_SDC1_SDCC_XPU_SESRRESTORE_ADDR A:0xf980204c
y.create.l HWIO_PERIPH_SS_SDC1_SDCC_XPU_SESYNR0_ADDR A:0xf9802050
y.create.l HWIO_PERIPH_SS_SDC1_SDCC_XPU_SESYNR1_ADDR A:0xf9802054
y.create.l HWIO_PERIPH_SS_SDC1_SDCC_XPU_SESYNR2_ADDR A:0xf9802058
y.create.l HWIO_PERIPH_SS_SDC1_SDCC_XPU_MCR_ADDR A:0xf9802100
y.create.l HWIO_PERIPH_SS_SDC1_SDCC_XPU_MEAR0_ADDR A:0xf9802140
y.create.l HWIO_PERIPH_SS_SDC1_SDCC_XPU_MESR_ADDR A:0xf9802148
y.create.l HWIO_PERIPH_SS_SDC1_SDCC_XPU_MESRRESTORE_ADDR A:0xf980214c
y.create.l HWIO_PERIPH_SS_SDC1_SDCC_XPU_MESYNR0_ADDR A:0xf9802150
y.create.l HWIO_PERIPH_SS_SDC1_SDCC_XPU_MESYNR1_ADDR A:0xf9802154
y.create.l HWIO_PERIPH_SS_SDC1_SDCC_XPU_MESYNR2_ADDR A:0xf9802158
y.create.l HWIO_PERIPH_SS_SDC1_SDCC_XPU_CR_ADDR A:0xf9802080
y.create.l HWIO_PERIPH_SS_SDC1_SDCC_XPU_RPU_ACR0_ADDR A:0xf98020a0
y.create.l HWIO_PERIPH_SS_SDC1_SDCC_XPU_EAR0_ADDR A:0xf98020c0
y.create.l HWIO_PERIPH_SS_SDC1_SDCC_XPU_ESR_ADDR A:0xf98020c8
y.create.l HWIO_PERIPH_SS_SDC1_SDCC_XPU_ESRRESTORE_ADDR A:0xf98020cc
y.create.l HWIO_PERIPH_SS_SDC1_SDCC_XPU_ESYNR0_ADDR A:0xf98020d0
y.create.l HWIO_PERIPH_SS_SDC1_SDCC_XPU_ESYNR1_ADDR A:0xf98020d4
y.create.l HWIO_PERIPH_SS_SDC1_SDCC_XPU_ESYNR2_ADDR A:0xf98020d8
y.create.l HWIO_PERIPH_SS_SDC1_SDCC_XPU_IDR0_ADDR A:0xf9802074
y.create.l HWIO_PERIPH_SS_SDC1_SDCC_XPU_IDR1_ADDR A:0xf9802078
y.create.l HWIO_PERIPH_SS_SDC1_SDCC_XPU_REV_ADDR A:0xf980207c
y.create.l HWIO_PERIPH_SS_SDC1_SDCC_XPU_RG0_RACR0_ADDR A:0xf9802200
y.create.l HWIO_PERIPH_SS_SDC1_SDCC_XPU_RG1_RACR0_ADDR A:0xf9802280
y.create.l HWIO_PERIPH_SS_SDC1_SDCC_XPU_RG2_RACR0_ADDR A:0xf9802300
y.create.l HWIO_PERIPH_SS_SDC1_SDCC_XPU_RG3_RACR0_ADDR A:0xf9802380
y.create.l HWIO_PERIPH_SS_SDC1_SDCC_XPU_RG4_RACR0_ADDR A:0xf9802400
y.create.l HWIO_PERIPH_SS_SDC1_SDCC_XPU_RG5_RACR0_ADDR A:0xf9802480
y.create.l HWIO_PERIPH_SS_SDC1_SDCC_XPU_RG6_RACR0_ADDR A:0xf9802500
y.create.l HWIO_PERIPH_SS_SDC1_SDCC_XPU_RG7_RACR0_ADDR A:0xf9802580
y.create.l HWIO_PERIPH_SS_SDC1_SDCC_XPU_RG8_RACR0_ADDR A:0xf9802600
y.create.l HWIO_PERIPH_SS_SDC1_SDCC_XPU_RG9_RACR0_ADDR A:0xf9802680
y.create.l HWIO_PERIPH_SS_SDC1_SDCC_XPU_RG0_SCR_ADDR A:0xf9802250
y.create.l HWIO_PERIPH_SS_SDC1_SDCC_XPU_RG1_SCR_ADDR A:0xf98022d0
y.create.l HWIO_PERIPH_SS_SDC1_SDCC_XPU_RG2_SCR_ADDR A:0xf9802350
y.create.l HWIO_PERIPH_SS_SDC1_SDCC_XPU_RG3_SCR_ADDR A:0xf98023d0
y.create.l HWIO_PERIPH_SS_SDC1_SDCC_XPU_RG4_SCR_ADDR A:0xf9802450
y.create.l HWIO_PERIPH_SS_SDC1_SDCC_XPU_RG5_SCR_ADDR A:0xf98024d0
y.create.l HWIO_PERIPH_SS_SDC1_SDCC_XPU_RG6_SCR_ADDR A:0xf9802550
y.create.l HWIO_PERIPH_SS_SDC1_SDCC_XPU_RG7_SCR_ADDR A:0xf98025d0
y.create.l HWIO_PERIPH_SS_SDC1_SDCC_XPU_RG8_SCR_ADDR A:0xf9802650
y.create.l HWIO_PERIPH_SS_SDC1_SDCC_XPU_RG9_SCR_ADDR A:0xf98026d0
y.create.l HWIO_PERIPH_SS_SDC1_SDCC_XPU_RG0_MCR_ADDR A:0xf9802254
y.create.l HWIO_PERIPH_SS_SDC1_SDCC_XPU_RG1_MCR_ADDR A:0xf98022d4
y.create.l HWIO_PERIPH_SS_SDC1_SDCC_XPU_RG2_MCR_ADDR A:0xf9802354
y.create.l HWIO_PERIPH_SS_SDC1_SDCC_XPU_RG3_MCR_ADDR A:0xf98023d4
y.create.l HWIO_PERIPH_SS_SDC1_SDCC_XPU_RG4_MCR_ADDR A:0xf9802454
y.create.l HWIO_PERIPH_SS_SDC1_SDCC_XPU_RG5_MCR_ADDR A:0xf98024d4
y.create.l HWIO_PERIPH_SS_SDC1_SDCC_XPU_RG6_MCR_ADDR A:0xf9802554
y.create.l HWIO_PERIPH_SS_SDC1_SDCC_XPU_RG7_MCR_ADDR A:0xf98025d4
y.create.l HWIO_PERIPH_SS_SDC1_SDCC_XPU_RG8_MCR_ADDR A:0xf9802654
y.create.l HWIO_PERIPH_SS_SDC1_SDCC_XPU_RG9_MCR_ADDR A:0xf98026d4
y.create.l HWIO_PERIPH_SS_SDC1_SDCC_VMIDMT_SCR0_ADDR A:0xf9800000
y.create.l HWIO_PERIPH_SS_SDC1_SDCC_VMIDMT_SCR1_ADDR A:0xf9800004
y.create.l HWIO_PERIPH_SS_SDC1_SDCC_VMIDMT_SCR2_ADDR A:0xf9800008
y.create.l HWIO_PERIPH_SS_SDC1_SDCC_VMIDMT_SACR_ADDR A:0xf9800010
y.create.l HWIO_PERIPH_SS_SDC1_SDCC_VMIDMT_SIDR0_ADDR A:0xf9800020
y.create.l HWIO_PERIPH_SS_SDC1_SDCC_VMIDMT_SIDR1_ADDR A:0xf9800024
y.create.l HWIO_PERIPH_SS_SDC1_SDCC_VMIDMT_SIDR2_ADDR A:0xf9800028
y.create.l HWIO_PERIPH_SS_SDC1_SDCC_VMIDMT_SIDR4_ADDR A:0xf9800030
y.create.l HWIO_PERIPH_SS_SDC1_SDCC_VMIDMT_SIDR5_ADDR A:0xf9800034
y.create.l HWIO_PERIPH_SS_SDC1_SDCC_VMIDMT_SIDR7_ADDR A:0xf980003c
y.create.l HWIO_PERIPH_SS_SDC1_SDCC_VMIDMT_SGFAR0_ADDR A:0xf9800040
y.create.l HWIO_PERIPH_SS_SDC1_SDCC_VMIDMT_SGFSR_ADDR A:0xf9800048
y.create.l HWIO_PERIPH_SS_SDC1_SDCC_VMIDMT_SGFSRRESTORE_ADDR A:0xf980004c
y.create.l HWIO_PERIPH_SS_SDC1_SDCC_VMIDMT_SGFSYNDR0_ADDR A:0xf9800050
y.create.l HWIO_PERIPH_SS_SDC1_SDCC_VMIDMT_SGFSYNDR1_ADDR A:0xf9800054
y.create.l HWIO_PERIPH_SS_SDC1_SDCC_VMIDMT_SGFSYNDR2_ADDR A:0xf9800058
y.create.l HWIO_PERIPH_SS_SDC1_SDCC_VMIDMT_VMIDMTSCR0_ADDR A:0xf9800090
y.create.l HWIO_PERIPH_SS_SDC1_SDCC_VMIDMT_CR0_ADDR A:0xf9800000
y.create.l HWIO_PERIPH_SS_SDC1_SDCC_VMIDMT_CR2_ADDR A:0xf9800008
y.create.l HWIO_PERIPH_SS_SDC1_SDCC_VMIDMT_ACR_ADDR A:0xf9800010
y.create.l HWIO_PERIPH_SS_SDC1_SDCC_VMIDMT_IDR0_ADDR A:0xf9800020
y.create.l HWIO_PERIPH_SS_SDC1_SDCC_VMIDMT_IDR1_ADDR A:0xf9800024
y.create.l HWIO_PERIPH_SS_SDC1_SDCC_VMIDMT_IDR2_ADDR A:0xf9800028
y.create.l HWIO_PERIPH_SS_SDC1_SDCC_VMIDMT_IDR4_ADDR A:0xf9800030
y.create.l HWIO_PERIPH_SS_SDC1_SDCC_VMIDMT_IDR5_ADDR A:0xf9800034
y.create.l HWIO_PERIPH_SS_SDC1_SDCC_VMIDMT_IDR7_ADDR A:0xf980003c
y.create.l HWIO_PERIPH_SS_SDC1_SDCC_VMIDMT_GFAR0_ADDR A:0xf9800040
y.create.l HWIO_PERIPH_SS_SDC1_SDCC_VMIDMT_GFSR_ADDR A:0xf9800048
y.create.l HWIO_PERIPH_SS_SDC1_SDCC_VMIDMT_GFSRRESTORE_ADDR A:0xf980004c
y.create.l HWIO_PERIPH_SS_SDC1_SDCC_VMIDMT_GFSYNDR0_ADDR A:0xf9800050
y.create.l HWIO_PERIPH_SS_SDC1_SDCC_VMIDMT_GFSYNDR1_ADDR A:0xf9800054
y.create.l HWIO_PERIPH_SS_SDC1_SDCC_VMIDMT_GFSYNDR2_ADDR A:0xf9800058
y.create.l HWIO_PERIPH_SS_SDC1_SDCC_VMIDMT_VMIDMTCR0_ADDR A:0xf9800090
y.create.l HWIO_PERIPH_SS_SDC1_SDCC_VMIDMT_VMIDMTACR_ADDR A:0xf980009c
y.create.l HWIO_PERIPH_SS_SDC1_SDCC_VMIDMT_NSCR0_ADDR A:0xf9800400
y.create.l HWIO_PERIPH_SS_SDC1_SDCC_VMIDMT_NSCR2_ADDR A:0xf9800408
y.create.l HWIO_PERIPH_SS_SDC1_SDCC_VMIDMT_NSACR_ADDR A:0xf9800410
y.create.l HWIO_PERIPH_SS_SDC1_SDCC_VMIDMT_NSGFAR0_ADDR A:0xf9800440
y.create.l HWIO_PERIPH_SS_SDC1_SDCC_VMIDMT_NSGFSR_ADDR A:0xf9800448
y.create.l HWIO_PERIPH_SS_SDC1_SDCC_VMIDMT_NSGFSRRESTORE_ADDR A:0xf980044c
y.create.l HWIO_PERIPH_SS_SDC1_SDCC_VMIDMT_NSGFSYNDR0_ADDR A:0xf9800450
y.create.l HWIO_PERIPH_SS_SDC1_SDCC_VMIDMT_NSGFSYNDR1_ADDR A:0xf9800454
y.create.l HWIO_PERIPH_SS_SDC1_SDCC_VMIDMT_NSGFSYNDR2_ADDR A:0xf9800458
y.create.l HWIO_PERIPH_SS_SDC1_SDCC_VMIDMT_NSVMIDMTCR0_ADDR A:0xf9800490
y.create.l HWIO_PERIPH_SS_SDC1_SDCC_VMIDMT_SSDR0_ADDR A:0xf9800080
y.create.l HWIO_PERIPH_SS_SDC1_SDCC_VMIDMT_MSDR0_ADDR A:0xf9800480
y.create.l HWIO_PERIPH_SS_SDC1_SDCC_VMIDMT_MCR_ADDR A:0xf9800494
y.create.l HWIO_PERIPH_SS_SDC1_SDCC_VMIDMT_S2VR0_ADDR A:0xf9800c00
y.create.l HWIO_PERIPH_SS_SDC1_SDCC_VMIDMT_S2VR1_ADDR A:0xf9800c04
y.create.l HWIO_PERIPH_SS_SDC1_SDCC_VMIDMT_S2VR2_ADDR A:0xf9800c08
y.create.l HWIO_PERIPH_SS_SDC1_SDCC_VMIDMT_S2VR3_ADDR A:0xf9800c0c
y.create.l HWIO_PERIPH_SS_SDC1_SDCC_VMIDMT_S2VR4_ADDR A:0xf9800c10
y.create.l HWIO_PERIPH_SS_SDC1_SDCC_VMIDMT_S2VR5_ADDR A:0xf9800c14
y.create.l HWIO_PERIPH_SS_SDC1_SDCC_VMIDMT_S2VR6_ADDR A:0xf9800c18
y.create.l HWIO_PERIPH_SS_SDC1_SDCC_VMIDMT_AS2VR0_ADDR A:0xf9800e00
y.create.l HWIO_PERIPH_SS_SDC1_SDCC_VMIDMT_AS2VR1_ADDR A:0xf9800e04
y.create.l HWIO_PERIPH_SS_SDC1_SDCC_VMIDMT_AS2VR2_ADDR A:0xf9800e08
y.create.l HWIO_PERIPH_SS_SDC1_SDCC_VMIDMT_AS2VR3_ADDR A:0xf9800e0c
y.create.l HWIO_PERIPH_SS_SDC1_SDCC_VMIDMT_AS2VR4_ADDR A:0xf9800e10
y.create.l HWIO_PERIPH_SS_SDC1_SDCC_VMIDMT_AS2VR5_ADDR A:0xf9800e14
y.create.l HWIO_PERIPH_SS_SDC1_SDCC_VMIDMT_AS2VR6_ADDR A:0xf9800e18
y.create.l HWIO_PERIPH_SS_SDC1_SDCC_VMIDMT_SMR0_ADDR A:0xf9800800
y.create.l HWIO_PERIPH_SS_SDC1_SDCC_VMIDMT_SMR1_ADDR A:0xf9800804
y.create.l HWIO_PERIPH_SS_SDC1_SDCC_VMIDMT_SMR2_ADDR A:0xf9800808
y.create.l HWIO_PERIPH_SS_SDC1_SDCC_VMIDMT_SMR3_ADDR A:0xf980080c
y.create.l HWIO_PERIPH_SS_SDC1_SDCC_VMIDMT_SMR4_ADDR A:0xf9800810
y.create.l HWIO_PERIPH_SS_SDC1_SDCC_VMIDMT_SMR5_ADDR A:0xf9800814
y.create.l HWIO_PERIPH_SS_SDC1_SDCC_VMIDMT_SMR6_ADDR A:0xf9800818
y.create.l HWIO_PERIPH_SS_SDC2_SDCC_MCI_POWER_ADDR A:0xf98a4000
y.create.l HWIO_PERIPH_SS_SDC2_SDCC_MCI_CLK_ADDR A:0xf98a4004
y.create.l HWIO_PERIPH_SS_SDC2_SDCC_MCI_ARGUMENT_ADDR A:0xf98a4008
y.create.l HWIO_PERIPH_SS_SDC2_SDCC_MCI_CMD_ADDR A:0xf98a400c
y.create.l HWIO_PERIPH_SS_SDC2_SDCC_MCI_RESP_CMD_ADDR A:0xf98a4010
y.create.l HWIO_PERIPH_SS_SDC2_SDCC_MCI_RESP0_ADDR A:0xf98a4014
y.create.l HWIO_PERIPH_SS_SDC2_SDCC_MCI_RESP1_ADDR A:0xf98a4018
y.create.l HWIO_PERIPH_SS_SDC2_SDCC_MCI_RESP2_ADDR A:0xf98a401c
y.create.l HWIO_PERIPH_SS_SDC2_SDCC_MCI_RESP3_ADDR A:0xf98a4020
y.create.l HWIO_PERIPH_SS_SDC2_SDCC_MCI_DATA_TIMER_ADDR A:0xf98a4024
y.create.l HWIO_PERIPH_SS_SDC2_SDCC_MCI_DATA_LENGTH_ADDR A:0xf98a4028
y.create.l HWIO_PERIPH_SS_SDC2_SDCC_MCI_DATA_CTL_ADDR A:0xf98a402c
y.create.l HWIO_PERIPH_SS_SDC2_SDCC_MCI_DATA_COUNT_ADDR A:0xf98a4030
y.create.l HWIO_PERIPH_SS_SDC2_SDCC_MCI_STATUS_ADDR A:0xf98a4034
y.create.l HWIO_PERIPH_SS_SDC2_SDCC_MCI_CLEAR_ADDR A:0xf98a4038
y.create.l HWIO_PERIPH_SS_SDC2_SDCC_MCI_INT_MASK0_ADDR A:0xf98a403c
y.create.l HWIO_PERIPH_SS_SDC2_SDCC_MCI_INT_MASK1_ADDR A:0xf98a4040
y.create.l HWIO_PERIPH_SS_SDC2_SDCC_MCI_FIFO_COUNT_ADDR A:0xf98a4044
y.create.l HWIO_PERIPH_SS_SDC2_SDCC_MCI_BOOT_ADDR A:0xf98a4048
y.create.l HWIO_PERIPH_SS_SDC2_SDCC_MCI_BOOT_ACK_TIMER_ADDR A:0xf98a404c
y.create.l HWIO_PERIPH_SS_SDC2_SDCC_MCI_VERSION_ADDR A:0xf98a4050
y.create.l HWIO_PERIPH_SS_SDC2_SDCC_MCI_EMULATION_DLY_LINE_ADDR A:0xf98a4054
y.create.l HWIO_PERIPH_SS_SDC2_SDCC_MCI_CCS_TIMER_ADDR A:0xf98a4058
y.create.l HWIO_PERIPH_SS_SDC2_SDCC_MCI_RESPONSE_MASK_ADDR A:0xf98a405c
y.create.l HWIO_PERIPH_SS_SDC2_SDCC_MCI_DLL_CONFIG_ADDR A:0xf98a4060
y.create.l HWIO_PERIPH_SS_SDC2_SDCC_MCI_DLL_TEST_CTL_ADDR A:0xf98a4064
y.create.l HWIO_PERIPH_SS_SDC2_SDCC_MCI_DLL_STATUS_ADDR A:0xf98a4068
y.create.l HWIO_PERIPH_SS_SDC2_SDCC_MCI_STATUS2_ADDR A:0xf98a406c
y.create.l HWIO_PERIPH_SS_SDC2_SDCC_MCI_GENERICS_ADDR A:0xf98a4070
y.create.l HWIO_PERIPH_SS_SDC2_SDCC_MCI_FIFO_STATUS_ADDR A:0xf98a4074
y.create.l HWIO_PERIPH_SS_SDC2_SDCC_MCI_HC_MODE_ADDR A:0xf98a4078
y.create.l HWIO_PERIPH_SS_SDC2_SDCC_MCI_FIFO0_ADDR A:0xf98a4080
y.create.l HWIO_PERIPH_SS_SDC2_SDCC_MCI_FIFO1_ADDR A:0xf98a4084
y.create.l HWIO_PERIPH_SS_SDC2_SDCC_MCI_FIFO2_ADDR A:0xf98a4088
y.create.l HWIO_PERIPH_SS_SDC2_SDCC_MCI_FIFO3_ADDR A:0xf98a408c
y.create.l HWIO_PERIPH_SS_SDC2_SDCC_MCI_FIFO4_ADDR A:0xf98a4090
y.create.l HWIO_PERIPH_SS_SDC2_SDCC_MCI_FIFO5_ADDR A:0xf98a4094
y.create.l HWIO_PERIPH_SS_SDC2_SDCC_MCI_FIFO6_ADDR A:0xf98a4098
y.create.l HWIO_PERIPH_SS_SDC2_SDCC_MCI_FIFO7_ADDR A:0xf98a409c
y.create.l HWIO_PERIPH_SS_SDC2_SDCC_MCI_FIFO8_ADDR A:0xf98a40a0
y.create.l HWIO_PERIPH_SS_SDC2_SDCC_MCI_FIFO9_ADDR A:0xf98a40a4
y.create.l HWIO_PERIPH_SS_SDC2_SDCC_MCI_TESTBUS_CONFIG_ADDR A:0xf98a40cc
y.create.l HWIO_PERIPH_SS_SDC2_SDCC_MCI_TEST_CTL_ADDR A:0xf98a40d0
y.create.l HWIO_PERIPH_SS_SDC2_SDCC_MCI_TEST_INPUT_ADDR A:0xf98a40d4
y.create.l HWIO_PERIPH_SS_SDC2_SDCC_MCI_TEST_OUT_ADDR A:0xf98a40d8
y.create.l HWIO_PERIPH_SS_SDC2_SDCC_MCI_PWRCTL_STATUS_REG_ADDR A:0xf98a40dc
y.create.l HWIO_PERIPH_SS_SDC2_SDCC_MCI_PWRCTL_MASK_REG_ADDR A:0xf98a40e0
y.create.l HWIO_PERIPH_SS_SDC2_SDCC_MCI_PWRCTL_CLEAR_REG_ADDR A:0xf98a40e4
y.create.l HWIO_PERIPH_SS_SDC2_SDCC_MCI_PWRCTL_CTL_REG_ADDR A:0xf98a40e8
y.create.l HWIO_PERIPH_SS_SDC2_SDCC_MCI_CLEAR2_ADDR A:0xf98a40ec
y.create.l HWIO_PERIPH_SS_SDC2_SDCC_MCI_INT_MASKINT2_0_ADDR A:0xf98a40f0
y.create.l HWIO_PERIPH_SS_SDC2_SDCC_MCI_INT_MASKINT2_1_ADDR A:0xf98a40f4
y.create.l HWIO_PERIPH_SS_SDC2_SDCC_CHAR_CFG_ADDR A:0xf98a40fc
y.create.l HWIO_PERIPH_SS_SDC2_SDCC_CHAR_CMD_ADDR A:0xf98a4100
y.create.l HWIO_PERIPH_SS_SDC2_SDCC_CHAR_DATA_0_ADDR A:0xf98a4104
y.create.l HWIO_PERIPH_SS_SDC2_SDCC_CHAR_DATA_1_ADDR A:0xf98a4108
y.create.l HWIO_PERIPH_SS_SDC2_SDCC_CHAR_DATA_2_ADDR A:0xf98a410c
y.create.l HWIO_PERIPH_SS_SDC2_SDCC_CHAR_DATA_3_ADDR A:0xf98a4110
y.create.l HWIO_PERIPH_SS_SDC2_SDCC_CHAR_DATA_4_ADDR A:0xf98a4114
y.create.l HWIO_PERIPH_SS_SDC2_SDCC_CHAR_DATA_5_ADDR A:0xf98a4118
y.create.l HWIO_PERIPH_SS_SDC2_SDCC_CHAR_DATA_6_ADDR A:0xf98a411c
y.create.l HWIO_PERIPH_SS_SDC2_SDCC_CHAR_DATA_7_ADDR A:0xf98a4120
y.create.l HWIO_PERIPH_SS_SDC2_SDCC_DEBUG_REG_ADDR A:0xf98a4124
y.create.l HWIO_PERIPH_SS_SDC2_SDCC_IP_CATALOG_ADDR A:0xf98a4128
y.create.l HWIO_PERIPH_SS_SDC2_SDCC_QSB_VALUES_ADDR A:0xf98a412c
y.create.l HWIO_PERIPH_SS_SDC2_SDCC_MCI_FIFO_ALT0_ADDR A:0xf98a4400
y.create.l HWIO_PERIPH_SS_SDC2_SDCC_MCI_FIFO_ALT1_ADDR A:0xf98a4404
y.create.l HWIO_PERIPH_SS_SDC2_SDCC_MCI_FIFO_ALT2_ADDR A:0xf98a4408
y.create.l HWIO_PERIPH_SS_SDC2_SDCC_MCI_FIFO_ALT3_ADDR A:0xf98a440c
y.create.l HWIO_PERIPH_SS_SDC2_SDCC_MCI_FIFO_ALT4_ADDR A:0xf98a4410
y.create.l HWIO_PERIPH_SS_SDC2_SDCC_MCI_FIFO_ALT5_ADDR A:0xf98a4414
y.create.l HWIO_PERIPH_SS_SDC2_SDCC_MCI_FIFO_ALT6_ADDR A:0xf98a4418
y.create.l HWIO_PERIPH_SS_SDC2_SDCC_MCI_FIFO_ALT7_ADDR A:0xf98a441c
y.create.l HWIO_PERIPH_SS_SDC2_SDCC_MCI_FIFO_ALT8_ADDR A:0xf98a4420
y.create.l HWIO_PERIPH_SS_SDC2_SDCC_MCI_FIFO_ALT9_ADDR A:0xf98a4424
y.create.l HWIO_PERIPH_SS_SDC2_SDCC_DML_CONFIG_ADDR A:0xf98a4800
y.create.l HWIO_PERIPH_SS_SDC2_SDCC_DML_STATUS_ADDR A:0xf98a4804
y.create.l HWIO_PERIPH_SS_SDC2_SDCC_DML_SW_RESET_ADDR A:0xf98a4808
y.create.l HWIO_PERIPH_SS_SDC2_SDCC_DML_PRODUCER_START_ADDR A:0xf98a480c
y.create.l HWIO_PERIPH_SS_SDC2_SDCC_DML_CONSUMER_START_ADDR A:0xf98a4810
y.create.l HWIO_PERIPH_SS_SDC2_SDCC_DML_PRODUCER_PIPE_LOGICAL_SIZE_ADDR A:0xf98a4814
y.create.l HWIO_PERIPH_SS_SDC2_SDCC_DML_CONSUMER_PIPE_LOGICAL_SIZE_ADDR A:0xf98a4818
y.create.l HWIO_PERIPH_SS_SDC2_SDCC_DML_PIPE_ID_ADDR A:0xf98a481c
y.create.l HWIO_PERIPH_SS_SDC2_SDCC_DML_PRODUCER_TRACKERS_ADDR A:0xf98a4820
y.create.l HWIO_PERIPH_SS_SDC2_SDCC_DML_PRODUCER_BAM_BLOCK_SIZE_ADDR A:0xf98a4824
y.create.l HWIO_PERIPH_SS_SDC2_SDCC_DML_PRODUCER_BAM_TRANS_SIZE_ADDR A:0xf98a4828
y.create.l HWIO_PERIPH_SS_SDC2_SDCC_DML_DIRECT_MODE_BASE_ADDR_ADDR A:0xf98a482c
y.create.l HWIO_PERIPH_SS_SDC2_SDCC_DML_DEBUG_ADDR A:0xf98a4830
y.create.l HWIO_PERIPH_SS_SDC2_SDCC_DML_BAM_SIDE_STATUS_1_ADDR A:0xf98a4834
y.create.l HWIO_PERIPH_SS_SDC2_SDCC_DML_BAM_SIDE_STATUS_2_ADDR A:0xf98a4838
y.create.l HWIO_PERIPH_SS_SDC2_SDCC_DML_RTL_GENERICS_1_ADDR A:0xf98a483c
y.create.l HWIO_PERIPH_SS_SDC2_SDCC_DML_RTL_GENERICS_2_ADDR A:0xf98a4840
y.create.l HWIO_PERIPH_SS_SDC2_SDCC_DML_RTL_GENERICS_3_ADDR A:0xf98a4844
y.create.l HWIO_PERIPH_SS_SDC2_SDCC_DML_INTERRUPT_ENABLE_ADDR A:0xf98a4848
y.create.l HWIO_PERIPH_SS_SDC2_SDCC_DML_INTERRUPT_CLEAR_ADDR A:0xf98a484c
y.create.l HWIO_PERIPH_SS_SDC2_SDCC_HC_REG_0_2_ADDR A:0xf98a4900
y.create.l HWIO_PERIPH_SS_SDC2_SDCC_HC_REG_4_6_ADDR A:0xf98a4904
y.create.l HWIO_PERIPH_SS_SDC2_SDCC_HC_REG_8_A_ADDR A:0xf98a4908
y.create.l HWIO_PERIPH_SS_SDC2_SDCC_HC_REG_C_E_ADDR A:0xf98a490c
y.create.l HWIO_PERIPH_SS_SDC2_SDCC_HC_REG_10_12_ADDR A:0xf98a4910
y.create.l HWIO_PERIPH_SS_SDC2_SDCC_HC_REG_14_16_ADDR A:0xf98a4914
y.create.l HWIO_PERIPH_SS_SDC2_SDCC_HC_REG_18_1A_ADDR A:0xf98a4918
y.create.l HWIO_PERIPH_SS_SDC2_SDCC_HC_REG_1C_1E_ADDR A:0xf98a491c
y.create.l HWIO_PERIPH_SS_SDC2_SDCC_HC_REG_20_22_ADDR A:0xf98a4920
y.create.l HWIO_PERIPH_SS_SDC2_SDCC_HC_REG_24_26_ADDR A:0xf98a4924
y.create.l HWIO_PERIPH_SS_SDC2_SDCC_HC_REG_28_2A_ADDR A:0xf98a4928
y.create.l HWIO_PERIPH_SS_SDC2_SDCC_HC_REG_2C_2E_ADDR A:0xf98a492c
y.create.l HWIO_PERIPH_SS_SDC2_SDCC_HC_REG_30_32_ADDR A:0xf98a4930
y.create.l HWIO_PERIPH_SS_SDC2_SDCC_HC_REG_34_36_ADDR A:0xf98a4934
y.create.l HWIO_PERIPH_SS_SDC2_SDCC_HC_REG_38_3A_ADDR A:0xf98a4938
y.create.l HWIO_PERIPH_SS_SDC2_SDCC_HC_REG_3C_3E_ADDR A:0xf98a493c
y.create.l HWIO_PERIPH_SS_SDC2_SDCC_HC_REG_40_42_ADDR A:0xf98a4940
y.create.l HWIO_PERIPH_SS_SDC2_SDCC_HC_REG_44_46_ADDR A:0xf98a4944
y.create.l HWIO_PERIPH_SS_SDC2_SDCC_HC_REG_48_4A_ADDR A:0xf98a4948
y.create.l HWIO_PERIPH_SS_SDC2_SDCC_HC_REG_50_52_ADDR A:0xf98a4950
y.create.l HWIO_PERIPH_SS_SDC2_SDCC_HC_REG_54_56_ADDR A:0xf98a4954
y.create.l HWIO_PERIPH_SS_SDC2_SDCC_HC_REG_58_5A_ADDR A:0xf98a4958
y.create.l HWIO_PERIPH_SS_SDC2_SDCC_HC_REG_5C_5E_ADDR A:0xf98a495c
y.create.l HWIO_PERIPH_SS_SDC2_SDCC_HC_REG_60_62_ADDR A:0xf98a4960
y.create.l HWIO_PERIPH_SS_SDC2_SDCC_HC_REG_64_66_ADDR A:0xf98a4964
y.create.l HWIO_PERIPH_SS_SDC2_SDCC_HC_REG_68_6A_ADDR A:0xf98a4968
y.create.l HWIO_PERIPH_SS_SDC2_SDCC_HC_REG_6C_6E_ADDR A:0xf98a496c
y.create.l HWIO_PERIPH_SS_SDC2_SDCC_HC_REG_E0_E2_ADDR A:0xf98a49e0
y.create.l HWIO_PERIPH_SS_SDC2_SDCC_HC_REG_FC_FE_ADDR A:0xf98a49fc
y.create.l HWIO_PERIPH_SS_SDC2_SDCC_HC_REG_DLL_CONFIG_ADDR A:0xf98a4a00
y.create.l HWIO_PERIPH_SS_SDC2_SDCC_HC_REG_DLL_TEST_CTL_ADDR A:0xf98a4a04
y.create.l HWIO_PERIPH_SS_SDC2_SDCC_HC_REG_DLL_STATUS_ADDR A:0xf98a4a08
y.create.l HWIO_PERIPH_SS_SDC2_SDCC_HC_VENDOR_SPECIFIC_FUNC_ADDR A:0xf98a4a0c
y.create.l HWIO_PERIPH_SS_SDC2_SDCC_HC_VENDOR_SPECIFIC_ADMA_ERR_ADDR0_ADDR A:0xf98a4a14
y.create.l HWIO_PERIPH_SS_SDC2_SDCC_HC_VENDOR_SPECIFIC_ADMA_ERR_ADDR1_ADDR A:0xf98a4a18
y.create.l HWIO_PERIPH_SS_SDC2_SDCC_HC_VENDOR_SPECIFIC_CAPABILITIES0_ADDR A:0xf98a4a1c
y.create.l HWIO_PERIPH_SS_SDC2_SDCC_HC_VENDOR_SPECIFIC_CAPABILITIES1_ADDR A:0xf98a4a20
y.create.l HWIO_PERIPH_SS_SDC2_SDCC_BAM_CTRL_ADDR A:0xf9884000
y.create.l HWIO_PERIPH_SS_SDC2_SDCC_BAM_REVISION_ADDR A:0xf9884004
y.create.l HWIO_PERIPH_SS_SDC2_SDCC_BAM_SW_VERSION_ADDR A:0xf9884080
y.create.l HWIO_PERIPH_SS_SDC2_SDCC_BAM_NUM_PIPES_ADDR A:0xf988403c
y.create.l HWIO_PERIPH_SS_SDC2_SDCC_BAM_TIMER_ADDR A:0xf9884040
y.create.l HWIO_PERIPH_SS_SDC2_SDCC_BAM_TIMER_CTRL_ADDR A:0xf9884044
y.create.l HWIO_PERIPH_SS_SDC2_SDCC_BAM_DESC_CNT_TRSHLD_ADDR A:0xf9884008
y.create.l HWIO_PERIPH_SS_SDC2_SDCC_BAM_IRQ_SRCS_ADDR A:0xf988400c
y.create.l HWIO_PERIPH_SS_SDC2_SDCC_BAM_IRQ_SRCS_MSK_ADDR A:0xf9884010
y.create.l HWIO_PERIPH_SS_SDC2_SDCC_BAM_IRQ_SRCS_UNMASKED_ADDR A:0xf9884030
y.create.l HWIO_PERIPH_SS_SDC2_SDCC_BAM_IRQ_STTS_ADDR A:0xf9884014
y.create.l HWIO_PERIPH_SS_SDC2_SDCC_BAM_IRQ_CLR_ADDR A:0xf9884018
y.create.l HWIO_PERIPH_SS_SDC2_SDCC_BAM_IRQ_EN_ADDR A:0xf988401c
y.create.l HWIO_PERIPH_SS_SDC2_SDCC_BAM_AHB_MASTER_ERR_CTRLS_ADDR A:0xf9884024
y.create.l HWIO_PERIPH_SS_SDC2_SDCC_BAM_AHB_MASTER_ERR_ADDR_ADDR A:0xf9884028
y.create.l HWIO_PERIPH_SS_SDC2_SDCC_BAM_AHB_MASTER_ERR_DATA_ADDR A:0xf988402c
y.create.l HWIO_PERIPH_SS_SDC2_SDCC_BAM_TRUST_REG_ADDR A:0xf9884070
y.create.l HWIO_PERIPH_SS_SDC2_SDCC_BAM_TEST_BUS_SEL_ADDR A:0xf9884074
y.create.l HWIO_PERIPH_SS_SDC2_SDCC_BAM_TEST_BUS_REG_ADDR A:0xf9884078
y.create.l HWIO_PERIPH_SS_SDC2_SDCC_BAM_CNFG_BITS_ADDR A:0xf988407c
y.create.l HWIO_PERIPH_SS_SDC2_SDCC_BAM_IRQ_SRCS_EE0_ADDR A:0xf9884800
y.create.l HWIO_PERIPH_SS_SDC2_SDCC_BAM_IRQ_SRCS_EE1_ADDR A:0xf9884880
y.create.l HWIO_PERIPH_SS_SDC2_SDCC_BAM_IRQ_SRCS_EE2_ADDR A:0xf9884900
y.create.l HWIO_PERIPH_SS_SDC2_SDCC_BAM_IRQ_SRCS_EE3_ADDR A:0xf9884980
y.create.l HWIO_PERIPH_SS_SDC2_SDCC_BAM_IRQ_SRCS_EE4_ADDR A:0xf9884a00
y.create.l HWIO_PERIPH_SS_SDC2_SDCC_BAM_IRQ_SRCS_EE5_ADDR A:0xf9884a80
y.create.l HWIO_PERIPH_SS_SDC2_SDCC_BAM_IRQ_SRCS_EE6_ADDR A:0xf9884b00
y.create.l HWIO_PERIPH_SS_SDC2_SDCC_BAM_IRQ_SRCS_EE7_ADDR A:0xf9884b80
y.create.l HWIO_PERIPH_SS_SDC2_SDCC_BAM_IRQ_SRCS_MSK_EE0_ADDR A:0xf9884804
y.create.l HWIO_PERIPH_SS_SDC2_SDCC_BAM_IRQ_SRCS_MSK_EE1_ADDR A:0xf9884884
y.create.l HWIO_PERIPH_SS_SDC2_SDCC_BAM_IRQ_SRCS_MSK_EE2_ADDR A:0xf9884904
y.create.l HWIO_PERIPH_SS_SDC2_SDCC_BAM_IRQ_SRCS_MSK_EE3_ADDR A:0xf9884984
y.create.l HWIO_PERIPH_SS_SDC2_SDCC_BAM_IRQ_SRCS_MSK_EE4_ADDR A:0xf9884a04
y.create.l HWIO_PERIPH_SS_SDC2_SDCC_BAM_IRQ_SRCS_MSK_EE5_ADDR A:0xf9884a84
y.create.l HWIO_PERIPH_SS_SDC2_SDCC_BAM_IRQ_SRCS_MSK_EE6_ADDR A:0xf9884b04
y.create.l HWIO_PERIPH_SS_SDC2_SDCC_BAM_IRQ_SRCS_MSK_EE7_ADDR A:0xf9884b84
y.create.l HWIO_PERIPH_SS_SDC2_SDCC_BAM_IRQ_SRCS_UNMASKED_EE0_ADDR A:0xf9884808
y.create.l HWIO_PERIPH_SS_SDC2_SDCC_BAM_IRQ_SRCS_UNMASKED_EE1_ADDR A:0xf9884888
y.create.l HWIO_PERIPH_SS_SDC2_SDCC_BAM_IRQ_SRCS_UNMASKED_EE2_ADDR A:0xf9884908
y.create.l HWIO_PERIPH_SS_SDC2_SDCC_BAM_IRQ_SRCS_UNMASKED_EE3_ADDR A:0xf9884988
y.create.l HWIO_PERIPH_SS_SDC2_SDCC_BAM_IRQ_SRCS_UNMASKED_EE4_ADDR A:0xf9884a08
y.create.l HWIO_PERIPH_SS_SDC2_SDCC_BAM_IRQ_SRCS_UNMASKED_EE5_ADDR A:0xf9884a88
y.create.l HWIO_PERIPH_SS_SDC2_SDCC_BAM_IRQ_SRCS_UNMASKED_EE6_ADDR A:0xf9884b08
y.create.l HWIO_PERIPH_SS_SDC2_SDCC_BAM_IRQ_SRCS_UNMASKED_EE7_ADDR A:0xf9884b88
y.create.l HWIO_PERIPH_SS_SDC2_SDCC_BAM_P_CTRL0_ADDR A:0xf9885000
y.create.l HWIO_PERIPH_SS_SDC2_SDCC_BAM_P_CTRL1_ADDR A:0xf9886000
y.create.l HWIO_PERIPH_SS_SDC2_SDCC_BAM_P_CTRL2_ADDR A:0xf9887000
y.create.l HWIO_PERIPH_SS_SDC2_SDCC_BAM_P_CTRL3_ADDR A:0xf9888000
y.create.l HWIO_PERIPH_SS_SDC2_SDCC_BAM_P_CTRL4_ADDR A:0xf9889000
y.create.l HWIO_PERIPH_SS_SDC2_SDCC_BAM_P_CTRL5_ADDR A:0xf988a000
y.create.l HWIO_PERIPH_SS_SDC2_SDCC_BAM_P_RST0_ADDR A:0xf9885004
y.create.l HWIO_PERIPH_SS_SDC2_SDCC_BAM_P_RST1_ADDR A:0xf9886004
y.create.l HWIO_PERIPH_SS_SDC2_SDCC_BAM_P_RST2_ADDR A:0xf9887004
y.create.l HWIO_PERIPH_SS_SDC2_SDCC_BAM_P_RST3_ADDR A:0xf9888004
y.create.l HWIO_PERIPH_SS_SDC2_SDCC_BAM_P_RST4_ADDR A:0xf9889004
y.create.l HWIO_PERIPH_SS_SDC2_SDCC_BAM_P_RST5_ADDR A:0xf988a004
y.create.l HWIO_PERIPH_SS_SDC2_SDCC_BAM_P_HALT0_ADDR A:0xf9885008
y.create.l HWIO_PERIPH_SS_SDC2_SDCC_BAM_P_HALT1_ADDR A:0xf9886008
y.create.l HWIO_PERIPH_SS_SDC2_SDCC_BAM_P_HALT2_ADDR A:0xf9887008
y.create.l HWIO_PERIPH_SS_SDC2_SDCC_BAM_P_HALT3_ADDR A:0xf9888008
y.create.l HWIO_PERIPH_SS_SDC2_SDCC_BAM_P_HALT4_ADDR A:0xf9889008
y.create.l HWIO_PERIPH_SS_SDC2_SDCC_BAM_P_HALT5_ADDR A:0xf988a008
y.create.l HWIO_PERIPH_SS_SDC2_SDCC_BAM_P_TRUST_REG0_ADDR A:0xf9885030
y.create.l HWIO_PERIPH_SS_SDC2_SDCC_BAM_P_TRUST_REG1_ADDR A:0xf9886030
y.create.l HWIO_PERIPH_SS_SDC2_SDCC_BAM_P_TRUST_REG2_ADDR A:0xf9887030
y.create.l HWIO_PERIPH_SS_SDC2_SDCC_BAM_P_TRUST_REG3_ADDR A:0xf9888030
y.create.l HWIO_PERIPH_SS_SDC2_SDCC_BAM_P_TRUST_REG4_ADDR A:0xf9889030
y.create.l HWIO_PERIPH_SS_SDC2_SDCC_BAM_P_TRUST_REG5_ADDR A:0xf988a030
y.create.l HWIO_PERIPH_SS_SDC2_SDCC_BAM_P_IRQ_STTS0_ADDR A:0xf9885010
y.create.l HWIO_PERIPH_SS_SDC2_SDCC_BAM_P_IRQ_STTS1_ADDR A:0xf9886010
y.create.l HWIO_PERIPH_SS_SDC2_SDCC_BAM_P_IRQ_STTS2_ADDR A:0xf9887010
y.create.l HWIO_PERIPH_SS_SDC2_SDCC_BAM_P_IRQ_STTS3_ADDR A:0xf9888010
y.create.l HWIO_PERIPH_SS_SDC2_SDCC_BAM_P_IRQ_STTS4_ADDR A:0xf9889010
y.create.l HWIO_PERIPH_SS_SDC2_SDCC_BAM_P_IRQ_STTS5_ADDR A:0xf988a010
y.create.l HWIO_PERIPH_SS_SDC2_SDCC_BAM_P_IRQ_CLR0_ADDR A:0xf9885014
y.create.l HWIO_PERIPH_SS_SDC2_SDCC_BAM_P_IRQ_CLR1_ADDR A:0xf9886014
y.create.l HWIO_PERIPH_SS_SDC2_SDCC_BAM_P_IRQ_CLR2_ADDR A:0xf9887014
y.create.l HWIO_PERIPH_SS_SDC2_SDCC_BAM_P_IRQ_CLR3_ADDR A:0xf9888014
y.create.l HWIO_PERIPH_SS_SDC2_SDCC_BAM_P_IRQ_CLR4_ADDR A:0xf9889014
y.create.l HWIO_PERIPH_SS_SDC2_SDCC_BAM_P_IRQ_CLR5_ADDR A:0xf988a014
y.create.l HWIO_PERIPH_SS_SDC2_SDCC_BAM_P_IRQ_EN0_ADDR A:0xf9885018
y.create.l HWIO_PERIPH_SS_SDC2_SDCC_BAM_P_IRQ_EN1_ADDR A:0xf9886018
y.create.l HWIO_PERIPH_SS_SDC2_SDCC_BAM_P_IRQ_EN2_ADDR A:0xf9887018
y.create.l HWIO_PERIPH_SS_SDC2_SDCC_BAM_P_IRQ_EN3_ADDR A:0xf9888018
y.create.l HWIO_PERIPH_SS_SDC2_SDCC_BAM_P_IRQ_EN4_ADDR A:0xf9889018
y.create.l HWIO_PERIPH_SS_SDC2_SDCC_BAM_P_IRQ_EN5_ADDR A:0xf988a018
y.create.l HWIO_PERIPH_SS_SDC2_SDCC_BAM_P_TIMER0_ADDR A:0xf988501c
y.create.l HWIO_PERIPH_SS_SDC2_SDCC_BAM_P_TIMER1_ADDR A:0xf988601c
y.create.l HWIO_PERIPH_SS_SDC2_SDCC_BAM_P_TIMER2_ADDR A:0xf988701c
y.create.l HWIO_PERIPH_SS_SDC2_SDCC_BAM_P_TIMER3_ADDR A:0xf988801c
y.create.l HWIO_PERIPH_SS_SDC2_SDCC_BAM_P_TIMER4_ADDR A:0xf988901c
y.create.l HWIO_PERIPH_SS_SDC2_SDCC_BAM_P_TIMER5_ADDR A:0xf988a01c
y.create.l HWIO_PERIPH_SS_SDC2_SDCC_BAM_P_TIMER_CTRL0_ADDR A:0xf9885020
y.create.l HWIO_PERIPH_SS_SDC2_SDCC_BAM_P_TIMER_CTRL1_ADDR A:0xf9886020
y.create.l HWIO_PERIPH_SS_SDC2_SDCC_BAM_P_TIMER_CTRL2_ADDR A:0xf9887020
y.create.l HWIO_PERIPH_SS_SDC2_SDCC_BAM_P_TIMER_CTRL3_ADDR A:0xf9888020
y.create.l HWIO_PERIPH_SS_SDC2_SDCC_BAM_P_TIMER_CTRL4_ADDR A:0xf9889020
y.create.l HWIO_PERIPH_SS_SDC2_SDCC_BAM_P_TIMER_CTRL5_ADDR A:0xf988a020
y.create.l HWIO_PERIPH_SS_SDC2_SDCC_BAM_P_PRDCR_SDBND0_ADDR A:0xf9885024
y.create.l HWIO_PERIPH_SS_SDC2_SDCC_BAM_P_PRDCR_SDBND1_ADDR A:0xf9886024
y.create.l HWIO_PERIPH_SS_SDC2_SDCC_BAM_P_PRDCR_SDBND2_ADDR A:0xf9887024
y.create.l HWIO_PERIPH_SS_SDC2_SDCC_BAM_P_PRDCR_SDBND3_ADDR A:0xf9888024
y.create.l HWIO_PERIPH_SS_SDC2_SDCC_BAM_P_PRDCR_SDBND4_ADDR A:0xf9889024
y.create.l HWIO_PERIPH_SS_SDC2_SDCC_BAM_P_PRDCR_SDBND5_ADDR A:0xf988a024
y.create.l HWIO_PERIPH_SS_SDC2_SDCC_BAM_P_CNSMR_SDBND0_ADDR A:0xf9885028
y.create.l HWIO_PERIPH_SS_SDC2_SDCC_BAM_P_CNSMR_SDBND1_ADDR A:0xf9886028
y.create.l HWIO_PERIPH_SS_SDC2_SDCC_BAM_P_CNSMR_SDBND2_ADDR A:0xf9887028
y.create.l HWIO_PERIPH_SS_SDC2_SDCC_BAM_P_CNSMR_SDBND3_ADDR A:0xf9888028
y.create.l HWIO_PERIPH_SS_SDC2_SDCC_BAM_P_CNSMR_SDBND4_ADDR A:0xf9889028
y.create.l HWIO_PERIPH_SS_SDC2_SDCC_BAM_P_CNSMR_SDBND5_ADDR A:0xf988a028
y.create.l HWIO_PERIPH_SS_SDC2_SDCC_BAM_P_EVNT_DEST_ADDR0_ADDR A:0xf988582c
y.create.l HWIO_PERIPH_SS_SDC2_SDCC_BAM_P_EVNT_DEST_ADDR1_ADDR A:0xf988682c
y.create.l HWIO_PERIPH_SS_SDC2_SDCC_BAM_P_EVNT_DEST_ADDR2_ADDR A:0xf988782c
y.create.l HWIO_PERIPH_SS_SDC2_SDCC_BAM_P_EVNT_DEST_ADDR3_ADDR A:0xf988882c
y.create.l HWIO_PERIPH_SS_SDC2_SDCC_BAM_P_EVNT_DEST_ADDR4_ADDR A:0xf988982c
y.create.l HWIO_PERIPH_SS_SDC2_SDCC_BAM_P_EVNT_DEST_ADDR5_ADDR A:0xf988a82c
y.create.l HWIO_PERIPH_SS_SDC2_SDCC_BAM_P_EVNT_REG0_ADDR A:0xf9885818
y.create.l HWIO_PERIPH_SS_SDC2_SDCC_BAM_P_EVNT_REG1_ADDR A:0xf9886818
y.create.l HWIO_PERIPH_SS_SDC2_SDCC_BAM_P_EVNT_REG2_ADDR A:0xf9887818
y.create.l HWIO_PERIPH_SS_SDC2_SDCC_BAM_P_EVNT_REG3_ADDR A:0xf9888818
y.create.l HWIO_PERIPH_SS_SDC2_SDCC_BAM_P_EVNT_REG4_ADDR A:0xf9889818
y.create.l HWIO_PERIPH_SS_SDC2_SDCC_BAM_P_EVNT_REG5_ADDR A:0xf988a818
y.create.l HWIO_PERIPH_SS_SDC2_SDCC_BAM_P_SW_OFSTS0_ADDR A:0xf9885800
y.create.l HWIO_PERIPH_SS_SDC2_SDCC_BAM_P_SW_OFSTS1_ADDR A:0xf9886800
y.create.l HWIO_PERIPH_SS_SDC2_SDCC_BAM_P_SW_OFSTS2_ADDR A:0xf9887800
y.create.l HWIO_PERIPH_SS_SDC2_SDCC_BAM_P_SW_OFSTS3_ADDR A:0xf9888800
y.create.l HWIO_PERIPH_SS_SDC2_SDCC_BAM_P_SW_OFSTS4_ADDR A:0xf9889800
y.create.l HWIO_PERIPH_SS_SDC2_SDCC_BAM_P_SW_OFSTS5_ADDR A:0xf988a800
y.create.l HWIO_PERIPH_SS_SDC2_SDCC_BAM_P_DATA_FIFO_ADDR0_ADDR A:0xf9885824
y.create.l HWIO_PERIPH_SS_SDC2_SDCC_BAM_P_DATA_FIFO_ADDR1_ADDR A:0xf9886824
y.create.l HWIO_PERIPH_SS_SDC2_SDCC_BAM_P_DATA_FIFO_ADDR2_ADDR A:0xf9887824
y.create.l HWIO_PERIPH_SS_SDC2_SDCC_BAM_P_DATA_FIFO_ADDR3_ADDR A:0xf9888824
y.create.l HWIO_PERIPH_SS_SDC2_SDCC_BAM_P_DATA_FIFO_ADDR4_ADDR A:0xf9889824
y.create.l HWIO_PERIPH_SS_SDC2_SDCC_BAM_P_DATA_FIFO_ADDR5_ADDR A:0xf988a824
y.create.l HWIO_PERIPH_SS_SDC2_SDCC_BAM_P_DESC_FIFO_ADDR0_ADDR A:0xf988581c
y.create.l HWIO_PERIPH_SS_SDC2_SDCC_BAM_P_DESC_FIFO_ADDR1_ADDR A:0xf988681c
y.create.l HWIO_PERIPH_SS_SDC2_SDCC_BAM_P_DESC_FIFO_ADDR2_ADDR A:0xf988781c
y.create.l HWIO_PERIPH_SS_SDC2_SDCC_BAM_P_DESC_FIFO_ADDR3_ADDR A:0xf988881c
y.create.l HWIO_PERIPH_SS_SDC2_SDCC_BAM_P_DESC_FIFO_ADDR4_ADDR A:0xf988981c
y.create.l HWIO_PERIPH_SS_SDC2_SDCC_BAM_P_DESC_FIFO_ADDR5_ADDR A:0xf988a81c
y.create.l HWIO_PERIPH_SS_SDC2_SDCC_BAM_P_EVNT_GEN_TRSHLD0_ADDR A:0xf9885828
y.create.l HWIO_PERIPH_SS_SDC2_SDCC_BAM_P_EVNT_GEN_TRSHLD1_ADDR A:0xf9886828
y.create.l HWIO_PERIPH_SS_SDC2_SDCC_BAM_P_EVNT_GEN_TRSHLD2_ADDR A:0xf9887828
y.create.l HWIO_PERIPH_SS_SDC2_SDCC_BAM_P_EVNT_GEN_TRSHLD3_ADDR A:0xf9888828
y.create.l HWIO_PERIPH_SS_SDC2_SDCC_BAM_P_EVNT_GEN_TRSHLD4_ADDR A:0xf9889828
y.create.l HWIO_PERIPH_SS_SDC2_SDCC_BAM_P_EVNT_GEN_TRSHLD5_ADDR A:0xf988a828
y.create.l HWIO_PERIPH_SS_SDC2_SDCC_BAM_P_FIFO_SIZES0_ADDR A:0xf9885820
y.create.l HWIO_PERIPH_SS_SDC2_SDCC_BAM_P_FIFO_SIZES1_ADDR A:0xf9886820
y.create.l HWIO_PERIPH_SS_SDC2_SDCC_BAM_P_FIFO_SIZES2_ADDR A:0xf9887820
y.create.l HWIO_PERIPH_SS_SDC2_SDCC_BAM_P_FIFO_SIZES3_ADDR A:0xf9888820
y.create.l HWIO_PERIPH_SS_SDC2_SDCC_BAM_P_FIFO_SIZES4_ADDR A:0xf9889820
y.create.l HWIO_PERIPH_SS_SDC2_SDCC_BAM_P_FIFO_SIZES5_ADDR A:0xf988a820
y.create.l HWIO_PERIPH_SS_SDC2_SDCC_BAM_P_RETR_CNTXT_0_ADDR A:0xf9885834
y.create.l HWIO_PERIPH_SS_SDC2_SDCC_BAM_P_RETR_CNTXT_1_ADDR A:0xf9886834
y.create.l HWIO_PERIPH_SS_SDC2_SDCC_BAM_P_RETR_CNTXT_2_ADDR A:0xf9887834
y.create.l HWIO_PERIPH_SS_SDC2_SDCC_BAM_P_RETR_CNTXT_3_ADDR A:0xf9888834
y.create.l HWIO_PERIPH_SS_SDC2_SDCC_BAM_P_RETR_CNTXT_4_ADDR A:0xf9889834
y.create.l HWIO_PERIPH_SS_SDC2_SDCC_BAM_P_RETR_CNTXT_5_ADDR A:0xf988a834
y.create.l HWIO_PERIPH_SS_SDC2_SDCC_BAM_P_SI_CNTXT_0_ADDR A:0xf9885838
y.create.l HWIO_PERIPH_SS_SDC2_SDCC_BAM_P_SI_CNTXT_1_ADDR A:0xf9886838
y.create.l HWIO_PERIPH_SS_SDC2_SDCC_BAM_P_SI_CNTXT_2_ADDR A:0xf9887838
y.create.l HWIO_PERIPH_SS_SDC2_SDCC_BAM_P_SI_CNTXT_3_ADDR A:0xf9888838
y.create.l HWIO_PERIPH_SS_SDC2_SDCC_BAM_P_SI_CNTXT_4_ADDR A:0xf9889838
y.create.l HWIO_PERIPH_SS_SDC2_SDCC_BAM_P_SI_CNTXT_5_ADDR A:0xf988a838
y.create.l HWIO_PERIPH_SS_SDC2_SDCC_BAM_P_DF_CNTXT_0_ADDR A:0xf9885830
y.create.l HWIO_PERIPH_SS_SDC2_SDCC_BAM_P_DF_CNTXT_1_ADDR A:0xf9886830
y.create.l HWIO_PERIPH_SS_SDC2_SDCC_BAM_P_DF_CNTXT_2_ADDR A:0xf9887830
y.create.l HWIO_PERIPH_SS_SDC2_SDCC_BAM_P_DF_CNTXT_3_ADDR A:0xf9888830
y.create.l HWIO_PERIPH_SS_SDC2_SDCC_BAM_P_DF_CNTXT_4_ADDR A:0xf9889830
y.create.l HWIO_PERIPH_SS_SDC2_SDCC_BAM_P_DF_CNTXT_5_ADDR A:0xf988a830
y.create.l HWIO_PERIPH_SS_SDC2_SDCC_BAM_P_AU_PSM_CNTXT_1_0_ADDR A:0xf9885804
y.create.l HWIO_PERIPH_SS_SDC2_SDCC_BAM_P_AU_PSM_CNTXT_1_1_ADDR A:0xf9886804
y.create.l HWIO_PERIPH_SS_SDC2_SDCC_BAM_P_AU_PSM_CNTXT_1_2_ADDR A:0xf9887804
y.create.l HWIO_PERIPH_SS_SDC2_SDCC_BAM_P_AU_PSM_CNTXT_1_3_ADDR A:0xf9888804
y.create.l HWIO_PERIPH_SS_SDC2_SDCC_BAM_P_AU_PSM_CNTXT_1_4_ADDR A:0xf9889804
y.create.l HWIO_PERIPH_SS_SDC2_SDCC_BAM_P_AU_PSM_CNTXT_1_5_ADDR A:0xf988a804
y.create.l HWIO_PERIPH_SS_SDC2_SDCC_BAM_P_PSM_CNTXT_2_0_ADDR A:0xf9885808
y.create.l HWIO_PERIPH_SS_SDC2_SDCC_BAM_P_PSM_CNTXT_2_1_ADDR A:0xf9886808
y.create.l HWIO_PERIPH_SS_SDC2_SDCC_BAM_P_PSM_CNTXT_2_2_ADDR A:0xf9887808
y.create.l HWIO_PERIPH_SS_SDC2_SDCC_BAM_P_PSM_CNTXT_2_3_ADDR A:0xf9888808
y.create.l HWIO_PERIPH_SS_SDC2_SDCC_BAM_P_PSM_CNTXT_2_4_ADDR A:0xf9889808
y.create.l HWIO_PERIPH_SS_SDC2_SDCC_BAM_P_PSM_CNTXT_2_5_ADDR A:0xf988a808
y.create.l HWIO_PERIPH_SS_SDC2_SDCC_BAM_P_PSM_CNTXT_3_0_ADDR A:0xf988580c
y.create.l HWIO_PERIPH_SS_SDC2_SDCC_BAM_P_PSM_CNTXT_3_1_ADDR A:0xf988680c
y.create.l HWIO_PERIPH_SS_SDC2_SDCC_BAM_P_PSM_CNTXT_3_2_ADDR A:0xf988780c
y.create.l HWIO_PERIPH_SS_SDC2_SDCC_BAM_P_PSM_CNTXT_3_3_ADDR A:0xf988880c
y.create.l HWIO_PERIPH_SS_SDC2_SDCC_BAM_P_PSM_CNTXT_3_4_ADDR A:0xf988980c
y.create.l HWIO_PERIPH_SS_SDC2_SDCC_BAM_P_PSM_CNTXT_3_5_ADDR A:0xf988a80c
y.create.l HWIO_PERIPH_SS_SDC2_SDCC_BAM_P_PSM_CNTXT_4_0_ADDR A:0xf9885810
y.create.l HWIO_PERIPH_SS_SDC2_SDCC_BAM_P_PSM_CNTXT_4_1_ADDR A:0xf9886810
y.create.l HWIO_PERIPH_SS_SDC2_SDCC_BAM_P_PSM_CNTXT_4_2_ADDR A:0xf9887810
y.create.l HWIO_PERIPH_SS_SDC2_SDCC_BAM_P_PSM_CNTXT_4_3_ADDR A:0xf9888810
y.create.l HWIO_PERIPH_SS_SDC2_SDCC_BAM_P_PSM_CNTXT_4_4_ADDR A:0xf9889810
y.create.l HWIO_PERIPH_SS_SDC2_SDCC_BAM_P_PSM_CNTXT_4_5_ADDR A:0xf988a810
y.create.l HWIO_PERIPH_SS_SDC2_SDCC_BAM_P_PSM_CNTXT_5_0_ADDR A:0xf9885814
y.create.l HWIO_PERIPH_SS_SDC2_SDCC_BAM_P_PSM_CNTXT_5_1_ADDR A:0xf9886814
y.create.l HWIO_PERIPH_SS_SDC2_SDCC_BAM_P_PSM_CNTXT_5_2_ADDR A:0xf9887814
y.create.l HWIO_PERIPH_SS_SDC2_SDCC_BAM_P_PSM_CNTXT_5_3_ADDR A:0xf9888814
y.create.l HWIO_PERIPH_SS_SDC2_SDCC_BAM_P_PSM_CNTXT_5_4_ADDR A:0xf9889814
y.create.l HWIO_PERIPH_SS_SDC2_SDCC_BAM_P_PSM_CNTXT_5_5_ADDR A:0xf988a814
y.create.l HWIO_PERIPH_SS_SDC2_SDCC_XPU_SCR_ADDR A:0xf9882000
y.create.l HWIO_PERIPH_SS_SDC2_SDCC_XPU_SWDR_ADDR A:0xf9882004
y.create.l HWIO_PERIPH_SS_SDC2_SDCC_XPU_SEAR0_ADDR A:0xf9882040
y.create.l HWIO_PERIPH_SS_SDC2_SDCC_XPU_SESR_ADDR A:0xf9882048
y.create.l HWIO_PERIPH_SS_SDC2_SDCC_XPU_SESRRESTORE_ADDR A:0xf988204c
y.create.l HWIO_PERIPH_SS_SDC2_SDCC_XPU_SESYNR0_ADDR A:0xf9882050
y.create.l HWIO_PERIPH_SS_SDC2_SDCC_XPU_SESYNR1_ADDR A:0xf9882054
y.create.l HWIO_PERIPH_SS_SDC2_SDCC_XPU_SESYNR2_ADDR A:0xf9882058
y.create.l HWIO_PERIPH_SS_SDC2_SDCC_XPU_MCR_ADDR A:0xf9882100
y.create.l HWIO_PERIPH_SS_SDC2_SDCC_XPU_MEAR0_ADDR A:0xf9882140
y.create.l HWIO_PERIPH_SS_SDC2_SDCC_XPU_MESR_ADDR A:0xf9882148
y.create.l HWIO_PERIPH_SS_SDC2_SDCC_XPU_MESRRESTORE_ADDR A:0xf988214c
y.create.l HWIO_PERIPH_SS_SDC2_SDCC_XPU_MESYNR0_ADDR A:0xf9882150
y.create.l HWIO_PERIPH_SS_SDC2_SDCC_XPU_MESYNR1_ADDR A:0xf9882154
y.create.l HWIO_PERIPH_SS_SDC2_SDCC_XPU_MESYNR2_ADDR A:0xf9882158
y.create.l HWIO_PERIPH_SS_SDC2_SDCC_XPU_CR_ADDR A:0xf9882080
y.create.l HWIO_PERIPH_SS_SDC2_SDCC_XPU_RPU_ACR0_ADDR A:0xf98820a0
y.create.l HWIO_PERIPH_SS_SDC2_SDCC_XPU_EAR0_ADDR A:0xf98820c0
y.create.l HWIO_PERIPH_SS_SDC2_SDCC_XPU_ESR_ADDR A:0xf98820c8
y.create.l HWIO_PERIPH_SS_SDC2_SDCC_XPU_ESRRESTORE_ADDR A:0xf98820cc
y.create.l HWIO_PERIPH_SS_SDC2_SDCC_XPU_ESYNR0_ADDR A:0xf98820d0
y.create.l HWIO_PERIPH_SS_SDC2_SDCC_XPU_ESYNR1_ADDR A:0xf98820d4
y.create.l HWIO_PERIPH_SS_SDC2_SDCC_XPU_ESYNR2_ADDR A:0xf98820d8
y.create.l HWIO_PERIPH_SS_SDC2_SDCC_XPU_IDR0_ADDR A:0xf9882074
y.create.l HWIO_PERIPH_SS_SDC2_SDCC_XPU_IDR1_ADDR A:0xf9882078
y.create.l HWIO_PERIPH_SS_SDC2_SDCC_XPU_REV_ADDR A:0xf988207c
y.create.l HWIO_PERIPH_SS_SDC2_SDCC_XPU_RG0_RACR0_ADDR A:0xf9882200
y.create.l HWIO_PERIPH_SS_SDC2_SDCC_XPU_RG1_RACR0_ADDR A:0xf9882280
y.create.l HWIO_PERIPH_SS_SDC2_SDCC_XPU_RG2_RACR0_ADDR A:0xf9882300
y.create.l HWIO_PERIPH_SS_SDC2_SDCC_XPU_RG3_RACR0_ADDR A:0xf9882380
y.create.l HWIO_PERIPH_SS_SDC2_SDCC_XPU_RG4_RACR0_ADDR A:0xf9882400
y.create.l HWIO_PERIPH_SS_SDC2_SDCC_XPU_RG5_RACR0_ADDR A:0xf9882480
y.create.l HWIO_PERIPH_SS_SDC2_SDCC_XPU_RG6_RACR0_ADDR A:0xf9882500
y.create.l HWIO_PERIPH_SS_SDC2_SDCC_XPU_RG7_RACR0_ADDR A:0xf9882580
y.create.l HWIO_PERIPH_SS_SDC2_SDCC_XPU_RG8_RACR0_ADDR A:0xf9882600
y.create.l HWIO_PERIPH_SS_SDC2_SDCC_XPU_RG9_RACR0_ADDR A:0xf9882680
y.create.l HWIO_PERIPH_SS_SDC2_SDCC_XPU_RG0_SCR_ADDR A:0xf9882250
y.create.l HWIO_PERIPH_SS_SDC2_SDCC_XPU_RG1_SCR_ADDR A:0xf98822d0
y.create.l HWIO_PERIPH_SS_SDC2_SDCC_XPU_RG2_SCR_ADDR A:0xf9882350
y.create.l HWIO_PERIPH_SS_SDC2_SDCC_XPU_RG3_SCR_ADDR A:0xf98823d0
y.create.l HWIO_PERIPH_SS_SDC2_SDCC_XPU_RG4_SCR_ADDR A:0xf9882450
y.create.l HWIO_PERIPH_SS_SDC2_SDCC_XPU_RG5_SCR_ADDR A:0xf98824d0
y.create.l HWIO_PERIPH_SS_SDC2_SDCC_XPU_RG6_SCR_ADDR A:0xf9882550
y.create.l HWIO_PERIPH_SS_SDC2_SDCC_XPU_RG7_SCR_ADDR A:0xf98825d0
y.create.l HWIO_PERIPH_SS_SDC2_SDCC_XPU_RG8_SCR_ADDR A:0xf9882650
y.create.l HWIO_PERIPH_SS_SDC2_SDCC_XPU_RG9_SCR_ADDR A:0xf98826d0
y.create.l HWIO_PERIPH_SS_SDC2_SDCC_XPU_RG0_MCR_ADDR A:0xf9882254
y.create.l HWIO_PERIPH_SS_SDC2_SDCC_XPU_RG1_MCR_ADDR A:0xf98822d4
y.create.l HWIO_PERIPH_SS_SDC2_SDCC_XPU_RG2_MCR_ADDR A:0xf9882354
y.create.l HWIO_PERIPH_SS_SDC2_SDCC_XPU_RG3_MCR_ADDR A:0xf98823d4
y.create.l HWIO_PERIPH_SS_SDC2_SDCC_XPU_RG4_MCR_ADDR A:0xf9882454
y.create.l HWIO_PERIPH_SS_SDC2_SDCC_XPU_RG5_MCR_ADDR A:0xf98824d4
y.create.l HWIO_PERIPH_SS_SDC2_SDCC_XPU_RG6_MCR_ADDR A:0xf9882554
y.create.l HWIO_PERIPH_SS_SDC2_SDCC_XPU_RG7_MCR_ADDR A:0xf98825d4
y.create.l HWIO_PERIPH_SS_SDC2_SDCC_XPU_RG8_MCR_ADDR A:0xf9882654
y.create.l HWIO_PERIPH_SS_SDC2_SDCC_XPU_RG9_MCR_ADDR A:0xf98826d4
y.create.l HWIO_PERIPH_SS_SDC2_SDCC_VMIDMT_SCR0_ADDR A:0xf9880000
y.create.l HWIO_PERIPH_SS_SDC2_SDCC_VMIDMT_SCR1_ADDR A:0xf9880004
y.create.l HWIO_PERIPH_SS_SDC2_SDCC_VMIDMT_SCR2_ADDR A:0xf9880008
y.create.l HWIO_PERIPH_SS_SDC2_SDCC_VMIDMT_SACR_ADDR A:0xf9880010
y.create.l HWIO_PERIPH_SS_SDC2_SDCC_VMIDMT_SIDR0_ADDR A:0xf9880020
y.create.l HWIO_PERIPH_SS_SDC2_SDCC_VMIDMT_SIDR1_ADDR A:0xf9880024
y.create.l HWIO_PERIPH_SS_SDC2_SDCC_VMIDMT_SIDR2_ADDR A:0xf9880028
y.create.l HWIO_PERIPH_SS_SDC2_SDCC_VMIDMT_SIDR4_ADDR A:0xf9880030
y.create.l HWIO_PERIPH_SS_SDC2_SDCC_VMIDMT_SIDR5_ADDR A:0xf9880034
y.create.l HWIO_PERIPH_SS_SDC2_SDCC_VMIDMT_SIDR7_ADDR A:0xf988003c
y.create.l HWIO_PERIPH_SS_SDC2_SDCC_VMIDMT_SGFAR0_ADDR A:0xf9880040
y.create.l HWIO_PERIPH_SS_SDC2_SDCC_VMIDMT_SGFSR_ADDR A:0xf9880048
y.create.l HWIO_PERIPH_SS_SDC2_SDCC_VMIDMT_SGFSRRESTORE_ADDR A:0xf988004c
y.create.l HWIO_PERIPH_SS_SDC2_SDCC_VMIDMT_SGFSYNDR0_ADDR A:0xf9880050
y.create.l HWIO_PERIPH_SS_SDC2_SDCC_VMIDMT_SGFSYNDR1_ADDR A:0xf9880054
y.create.l HWIO_PERIPH_SS_SDC2_SDCC_VMIDMT_SGFSYNDR2_ADDR A:0xf9880058
y.create.l HWIO_PERIPH_SS_SDC2_SDCC_VMIDMT_VMIDMTSCR0_ADDR A:0xf9880090
y.create.l HWIO_PERIPH_SS_SDC2_SDCC_VMIDMT_CR0_ADDR A:0xf9880000
y.create.l HWIO_PERIPH_SS_SDC2_SDCC_VMIDMT_CR2_ADDR A:0xf9880008
y.create.l HWIO_PERIPH_SS_SDC2_SDCC_VMIDMT_ACR_ADDR A:0xf9880010
y.create.l HWIO_PERIPH_SS_SDC2_SDCC_VMIDMT_IDR0_ADDR A:0xf9880020
y.create.l HWIO_PERIPH_SS_SDC2_SDCC_VMIDMT_IDR1_ADDR A:0xf9880024
y.create.l HWIO_PERIPH_SS_SDC2_SDCC_VMIDMT_IDR2_ADDR A:0xf9880028
y.create.l HWIO_PERIPH_SS_SDC2_SDCC_VMIDMT_IDR4_ADDR A:0xf9880030
y.create.l HWIO_PERIPH_SS_SDC2_SDCC_VMIDMT_IDR5_ADDR A:0xf9880034
y.create.l HWIO_PERIPH_SS_SDC2_SDCC_VMIDMT_IDR7_ADDR A:0xf988003c
y.create.l HWIO_PERIPH_SS_SDC2_SDCC_VMIDMT_GFAR0_ADDR A:0xf9880040
y.create.l HWIO_PERIPH_SS_SDC2_SDCC_VMIDMT_GFSR_ADDR A:0xf9880048
y.create.l HWIO_PERIPH_SS_SDC2_SDCC_VMIDMT_GFSRRESTORE_ADDR A:0xf988004c
y.create.l HWIO_PERIPH_SS_SDC2_SDCC_VMIDMT_GFSYNDR0_ADDR A:0xf9880050
y.create.l HWIO_PERIPH_SS_SDC2_SDCC_VMIDMT_GFSYNDR1_ADDR A:0xf9880054
y.create.l HWIO_PERIPH_SS_SDC2_SDCC_VMIDMT_GFSYNDR2_ADDR A:0xf9880058
y.create.l HWIO_PERIPH_SS_SDC2_SDCC_VMIDMT_VMIDMTCR0_ADDR A:0xf9880090
y.create.l HWIO_PERIPH_SS_SDC2_SDCC_VMIDMT_VMIDMTACR_ADDR A:0xf988009c
y.create.l HWIO_PERIPH_SS_SDC2_SDCC_VMIDMT_NSCR0_ADDR A:0xf9880400
y.create.l HWIO_PERIPH_SS_SDC2_SDCC_VMIDMT_NSCR2_ADDR A:0xf9880408
y.create.l HWIO_PERIPH_SS_SDC2_SDCC_VMIDMT_NSACR_ADDR A:0xf9880410
y.create.l HWIO_PERIPH_SS_SDC2_SDCC_VMIDMT_NSGFAR0_ADDR A:0xf9880440
y.create.l HWIO_PERIPH_SS_SDC2_SDCC_VMIDMT_NSGFSR_ADDR A:0xf9880448
y.create.l HWIO_PERIPH_SS_SDC2_SDCC_VMIDMT_NSGFSRRESTORE_ADDR A:0xf988044c
y.create.l HWIO_PERIPH_SS_SDC2_SDCC_VMIDMT_NSGFSYNDR0_ADDR A:0xf9880450
y.create.l HWIO_PERIPH_SS_SDC2_SDCC_VMIDMT_NSGFSYNDR1_ADDR A:0xf9880454
y.create.l HWIO_PERIPH_SS_SDC2_SDCC_VMIDMT_NSGFSYNDR2_ADDR A:0xf9880458
y.create.l HWIO_PERIPH_SS_SDC2_SDCC_VMIDMT_NSVMIDMTCR0_ADDR A:0xf9880490
y.create.l HWIO_PERIPH_SS_SDC2_SDCC_VMIDMT_SSDR0_ADDR A:0xf9880080
y.create.l HWIO_PERIPH_SS_SDC2_SDCC_VMIDMT_MSDR0_ADDR A:0xf9880480
y.create.l HWIO_PERIPH_SS_SDC2_SDCC_VMIDMT_MCR_ADDR A:0xf9880494
y.create.l HWIO_PERIPH_SS_SDC2_SDCC_VMIDMT_S2VR0_ADDR A:0xf9880c00
y.create.l HWIO_PERIPH_SS_SDC2_SDCC_VMIDMT_S2VR1_ADDR A:0xf9880c04
y.create.l HWIO_PERIPH_SS_SDC2_SDCC_VMIDMT_S2VR2_ADDR A:0xf9880c08
y.create.l HWIO_PERIPH_SS_SDC2_SDCC_VMIDMT_S2VR3_ADDR A:0xf9880c0c
y.create.l HWIO_PERIPH_SS_SDC2_SDCC_VMIDMT_S2VR4_ADDR A:0xf9880c10
y.create.l HWIO_PERIPH_SS_SDC2_SDCC_VMIDMT_S2VR5_ADDR A:0xf9880c14
y.create.l HWIO_PERIPH_SS_SDC2_SDCC_VMIDMT_S2VR6_ADDR A:0xf9880c18
y.create.l HWIO_PERIPH_SS_SDC2_SDCC_VMIDMT_AS2VR0_ADDR A:0xf9880e00
y.create.l HWIO_PERIPH_SS_SDC2_SDCC_VMIDMT_AS2VR1_ADDR A:0xf9880e04
y.create.l HWIO_PERIPH_SS_SDC2_SDCC_VMIDMT_AS2VR2_ADDR A:0xf9880e08
y.create.l HWIO_PERIPH_SS_SDC2_SDCC_VMIDMT_AS2VR3_ADDR A:0xf9880e0c
y.create.l HWIO_PERIPH_SS_SDC2_SDCC_VMIDMT_AS2VR4_ADDR A:0xf9880e10
y.create.l HWIO_PERIPH_SS_SDC2_SDCC_VMIDMT_AS2VR5_ADDR A:0xf9880e14
y.create.l HWIO_PERIPH_SS_SDC2_SDCC_VMIDMT_AS2VR6_ADDR A:0xf9880e18
y.create.l HWIO_PERIPH_SS_SDC2_SDCC_VMIDMT_SMR0_ADDR A:0xf9880800
y.create.l HWIO_PERIPH_SS_SDC2_SDCC_VMIDMT_SMR1_ADDR A:0xf9880804
y.create.l HWIO_PERIPH_SS_SDC2_SDCC_VMIDMT_SMR2_ADDR A:0xf9880808
y.create.l HWIO_PERIPH_SS_SDC2_SDCC_VMIDMT_SMR3_ADDR A:0xf988080c
y.create.l HWIO_PERIPH_SS_SDC2_SDCC_VMIDMT_SMR4_ADDR A:0xf9880810
y.create.l HWIO_PERIPH_SS_SDC2_SDCC_VMIDMT_SMR5_ADDR A:0xf9880814
y.create.l HWIO_PERIPH_SS_SDC2_SDCC_VMIDMT_SMR6_ADDR A:0xf9880818
y.create.l HWIO_PERIPH_SS_BLSP1_BLSP_BAM_BAM_CTRL_ADDR A:0xf9904000
y.create.l HWIO_PERIPH_SS_BLSP1_BLSP_BAM_BAM_REVISION_ADDR A:0xf9904004
y.create.l HWIO_PERIPH_SS_BLSP1_BLSP_BAM_BAM_SW_VERSION_ADDR A:0xf9904080
y.create.l HWIO_PERIPH_SS_BLSP1_BLSP_BAM_BAM_NUM_PIPES_ADDR A:0xf990403c
y.create.l HWIO_PERIPH_SS_BLSP1_BLSP_BAM_BAM_TIMER_ADDR A:0xf9904040
y.create.l HWIO_PERIPH_SS_BLSP1_BLSP_BAM_BAM_TIMER_CTRL_ADDR A:0xf9904044
y.create.l HWIO_PERIPH_SS_BLSP1_BLSP_BAM_BAM_DESC_CNT_TRSHLD_ADDR A:0xf9904008
y.create.l HWIO_PERIPH_SS_BLSP1_BLSP_BAM_BAM_IRQ_SRCS_ADDR A:0xf990400c
y.create.l HWIO_PERIPH_SS_BLSP1_BLSP_BAM_BAM_IRQ_SRCS_MSK_ADDR A:0xf9904010
y.create.l HWIO_PERIPH_SS_BLSP1_BLSP_BAM_BAM_IRQ_SRCS_UNMASKED_ADDR A:0xf9904030
y.create.l HWIO_PERIPH_SS_BLSP1_BLSP_BAM_BAM_IRQ_STTS_ADDR A:0xf9904014
y.create.l HWIO_PERIPH_SS_BLSP1_BLSP_BAM_BAM_IRQ_CLR_ADDR A:0xf9904018
y.create.l HWIO_PERIPH_SS_BLSP1_BLSP_BAM_BAM_IRQ_EN_ADDR A:0xf990401c
y.create.l HWIO_PERIPH_SS_BLSP1_BLSP_BAM_BAM_AHB_MASTER_ERR_CTRLS_ADDR A:0xf9904024
y.create.l HWIO_PERIPH_SS_BLSP1_BLSP_BAM_BAM_AHB_MASTER_ERR_ADDR_ADDR A:0xf9904028
y.create.l HWIO_PERIPH_SS_BLSP1_BLSP_BAM_BAM_AHB_MASTER_ERR_DATA_ADDR A:0xf990402c
y.create.l HWIO_PERIPH_SS_BLSP1_BLSP_BAM_BAM_TRUST_REG_ADDR A:0xf9904070
y.create.l HWIO_PERIPH_SS_BLSP1_BLSP_BAM_BAM_TEST_BUS_SEL_ADDR A:0xf9904074
y.create.l HWIO_PERIPH_SS_BLSP1_BLSP_BAM_BAM_TEST_BUS_REG_ADDR A:0xf9904078
y.create.l HWIO_PERIPH_SS_BLSP1_BLSP_BAM_BAM_CNFG_BITS_ADDR A:0xf990407c
y.create.l HWIO_PERIPH_SS_BLSP1_BLSP_BAM_BAM_IRQ_SRCS_EE0_ADDR A:0xf9904800
y.create.l HWIO_PERIPH_SS_BLSP1_BLSP_BAM_BAM_IRQ_SRCS_EE1_ADDR A:0xf9904880
y.create.l HWIO_PERIPH_SS_BLSP1_BLSP_BAM_BAM_IRQ_SRCS_EE2_ADDR A:0xf9904900
y.create.l HWIO_PERIPH_SS_BLSP1_BLSP_BAM_BAM_IRQ_SRCS_EE3_ADDR A:0xf9904980
y.create.l HWIO_PERIPH_SS_BLSP1_BLSP_BAM_BAM_IRQ_SRCS_EE4_ADDR A:0xf9904a00
y.create.l HWIO_PERIPH_SS_BLSP1_BLSP_BAM_BAM_IRQ_SRCS_EE5_ADDR A:0xf9904a80
y.create.l HWIO_PERIPH_SS_BLSP1_BLSP_BAM_BAM_IRQ_SRCS_EE6_ADDR A:0xf9904b00
y.create.l HWIO_PERIPH_SS_BLSP1_BLSP_BAM_BAM_IRQ_SRCS_EE7_ADDR A:0xf9904b80
y.create.l HWIO_PERIPH_SS_BLSP1_BLSP_BAM_BAM_IRQ_SRCS_MSK_EE0_ADDR A:0xf9904804
y.create.l HWIO_PERIPH_SS_BLSP1_BLSP_BAM_BAM_IRQ_SRCS_MSK_EE1_ADDR A:0xf9904884
y.create.l HWIO_PERIPH_SS_BLSP1_BLSP_BAM_BAM_IRQ_SRCS_MSK_EE2_ADDR A:0xf9904904
y.create.l HWIO_PERIPH_SS_BLSP1_BLSP_BAM_BAM_IRQ_SRCS_MSK_EE3_ADDR A:0xf9904984
y.create.l HWIO_PERIPH_SS_BLSP1_BLSP_BAM_BAM_IRQ_SRCS_MSK_EE4_ADDR A:0xf9904a04
y.create.l HWIO_PERIPH_SS_BLSP1_BLSP_BAM_BAM_IRQ_SRCS_MSK_EE5_ADDR A:0xf9904a84
y.create.l HWIO_PERIPH_SS_BLSP1_BLSP_BAM_BAM_IRQ_SRCS_MSK_EE6_ADDR A:0xf9904b04
y.create.l HWIO_PERIPH_SS_BLSP1_BLSP_BAM_BAM_IRQ_SRCS_MSK_EE7_ADDR A:0xf9904b84
y.create.l HWIO_PERIPH_SS_BLSP1_BLSP_BAM_BAM_IRQ_SRCS_UNMASKED_EE0_ADDR A:0xf9904808
y.create.l HWIO_PERIPH_SS_BLSP1_BLSP_BAM_BAM_IRQ_SRCS_UNMASKED_EE1_ADDR A:0xf9904888
y.create.l HWIO_PERIPH_SS_BLSP1_BLSP_BAM_BAM_IRQ_SRCS_UNMASKED_EE2_ADDR A:0xf9904908
y.create.l HWIO_PERIPH_SS_BLSP1_BLSP_BAM_BAM_IRQ_SRCS_UNMASKED_EE3_ADDR A:0xf9904988
y.create.l HWIO_PERIPH_SS_BLSP1_BLSP_BAM_BAM_IRQ_SRCS_UNMASKED_EE4_ADDR A:0xf9904a08
y.create.l HWIO_PERIPH_SS_BLSP1_BLSP_BAM_BAM_IRQ_SRCS_UNMASKED_EE5_ADDR A:0xf9904a88
y.create.l HWIO_PERIPH_SS_BLSP1_BLSP_BAM_BAM_IRQ_SRCS_UNMASKED_EE6_ADDR A:0xf9904b08
y.create.l HWIO_PERIPH_SS_BLSP1_BLSP_BAM_BAM_IRQ_SRCS_UNMASKED_EE7_ADDR A:0xf9904b88
y.create.l HWIO_PERIPH_SS_BLSP1_BLSP_BAM_BAM_P_CTRL0_ADDR A:0xf9905000
y.create.l HWIO_PERIPH_SS_BLSP1_BLSP_BAM_BAM_P_CTRL1_ADDR A:0xf9906000
y.create.l HWIO_PERIPH_SS_BLSP1_BLSP_BAM_BAM_P_CTRL2_ADDR A:0xf9907000
y.create.l HWIO_PERIPH_SS_BLSP1_BLSP_BAM_BAM_P_CTRL3_ADDR A:0xf9908000
y.create.l HWIO_PERIPH_SS_BLSP1_BLSP_BAM_BAM_P_CTRL4_ADDR A:0xf9909000
y.create.l HWIO_PERIPH_SS_BLSP1_BLSP_BAM_BAM_P_CTRL5_ADDR A:0xf990a000
y.create.l HWIO_PERIPH_SS_BLSP1_BLSP_BAM_BAM_P_CTRL6_ADDR A:0xf990b000
y.create.l HWIO_PERIPH_SS_BLSP1_BLSP_BAM_BAM_P_CTRL7_ADDR A:0xf990c000
y.create.l HWIO_PERIPH_SS_BLSP1_BLSP_BAM_BAM_P_CTRL8_ADDR A:0xf990d000
y.create.l HWIO_PERIPH_SS_BLSP1_BLSP_BAM_BAM_P_CTRL9_ADDR A:0xf990e000
y.create.l HWIO_PERIPH_SS_BLSP1_BLSP_BAM_BAM_P_RST0_ADDR A:0xf9905004
y.create.l HWIO_PERIPH_SS_BLSP1_BLSP_BAM_BAM_P_RST1_ADDR A:0xf9906004
y.create.l HWIO_PERIPH_SS_BLSP1_BLSP_BAM_BAM_P_RST2_ADDR A:0xf9907004
y.create.l HWIO_PERIPH_SS_BLSP1_BLSP_BAM_BAM_P_RST3_ADDR A:0xf9908004
y.create.l HWIO_PERIPH_SS_BLSP1_BLSP_BAM_BAM_P_RST4_ADDR A:0xf9909004
y.create.l HWIO_PERIPH_SS_BLSP1_BLSP_BAM_BAM_P_RST5_ADDR A:0xf990a004
y.create.l HWIO_PERIPH_SS_BLSP1_BLSP_BAM_BAM_P_RST6_ADDR A:0xf990b004
y.create.l HWIO_PERIPH_SS_BLSP1_BLSP_BAM_BAM_P_RST7_ADDR A:0xf990c004
y.create.l HWIO_PERIPH_SS_BLSP1_BLSP_BAM_BAM_P_RST8_ADDR A:0xf990d004
y.create.l HWIO_PERIPH_SS_BLSP1_BLSP_BAM_BAM_P_RST9_ADDR A:0xf990e004
y.create.l HWIO_PERIPH_SS_BLSP1_BLSP_BAM_BAM_P_HALT0_ADDR A:0xf9905008
y.create.l HWIO_PERIPH_SS_BLSP1_BLSP_BAM_BAM_P_HALT1_ADDR A:0xf9906008
y.create.l HWIO_PERIPH_SS_BLSP1_BLSP_BAM_BAM_P_HALT2_ADDR A:0xf9907008
y.create.l HWIO_PERIPH_SS_BLSP1_BLSP_BAM_BAM_P_HALT3_ADDR A:0xf9908008
y.create.l HWIO_PERIPH_SS_BLSP1_BLSP_BAM_BAM_P_HALT4_ADDR A:0xf9909008
y.create.l HWIO_PERIPH_SS_BLSP1_BLSP_BAM_BAM_P_HALT5_ADDR A:0xf990a008
y.create.l HWIO_PERIPH_SS_BLSP1_BLSP_BAM_BAM_P_HALT6_ADDR A:0xf990b008
y.create.l HWIO_PERIPH_SS_BLSP1_BLSP_BAM_BAM_P_HALT7_ADDR A:0xf990c008
y.create.l HWIO_PERIPH_SS_BLSP1_BLSP_BAM_BAM_P_HALT8_ADDR A:0xf990d008
y.create.l HWIO_PERIPH_SS_BLSP1_BLSP_BAM_BAM_P_HALT9_ADDR A:0xf990e008
y.create.l HWIO_PERIPH_SS_BLSP1_BLSP_BAM_BAM_P_TRUST_REG0_ADDR A:0xf9905030
y.create.l HWIO_PERIPH_SS_BLSP1_BLSP_BAM_BAM_P_TRUST_REG1_ADDR A:0xf9906030
y.create.l HWIO_PERIPH_SS_BLSP1_BLSP_BAM_BAM_P_TRUST_REG2_ADDR A:0xf9907030
y.create.l HWIO_PERIPH_SS_BLSP1_BLSP_BAM_BAM_P_TRUST_REG3_ADDR A:0xf9908030
y.create.l HWIO_PERIPH_SS_BLSP1_BLSP_BAM_BAM_P_TRUST_REG4_ADDR A:0xf9909030
y.create.l HWIO_PERIPH_SS_BLSP1_BLSP_BAM_BAM_P_TRUST_REG5_ADDR A:0xf990a030
y.create.l HWIO_PERIPH_SS_BLSP1_BLSP_BAM_BAM_P_TRUST_REG6_ADDR A:0xf990b030
y.create.l HWIO_PERIPH_SS_BLSP1_BLSP_BAM_BAM_P_TRUST_REG7_ADDR A:0xf990c030
y.create.l HWIO_PERIPH_SS_BLSP1_BLSP_BAM_BAM_P_TRUST_REG8_ADDR A:0xf990d030
y.create.l HWIO_PERIPH_SS_BLSP1_BLSP_BAM_BAM_P_TRUST_REG9_ADDR A:0xf990e030
y.create.l HWIO_PERIPH_SS_BLSP1_BLSP_BAM_BAM_P_IRQ_STTS0_ADDR A:0xf9905010
y.create.l HWIO_PERIPH_SS_BLSP1_BLSP_BAM_BAM_P_IRQ_STTS1_ADDR A:0xf9906010
y.create.l HWIO_PERIPH_SS_BLSP1_BLSP_BAM_BAM_P_IRQ_STTS2_ADDR A:0xf9907010
y.create.l HWIO_PERIPH_SS_BLSP1_BLSP_BAM_BAM_P_IRQ_STTS3_ADDR A:0xf9908010
y.create.l HWIO_PERIPH_SS_BLSP1_BLSP_BAM_BAM_P_IRQ_STTS4_ADDR A:0xf9909010
y.create.l HWIO_PERIPH_SS_BLSP1_BLSP_BAM_BAM_P_IRQ_STTS5_ADDR A:0xf990a010
y.create.l HWIO_PERIPH_SS_BLSP1_BLSP_BAM_BAM_P_IRQ_STTS6_ADDR A:0xf990b010
y.create.l HWIO_PERIPH_SS_BLSP1_BLSP_BAM_BAM_P_IRQ_STTS7_ADDR A:0xf990c010
y.create.l HWIO_PERIPH_SS_BLSP1_BLSP_BAM_BAM_P_IRQ_STTS8_ADDR A:0xf990d010
y.create.l HWIO_PERIPH_SS_BLSP1_BLSP_BAM_BAM_P_IRQ_STTS9_ADDR A:0xf990e010
y.create.l HWIO_PERIPH_SS_BLSP1_BLSP_BAM_BAM_P_IRQ_CLR0_ADDR A:0xf9905014
y.create.l HWIO_PERIPH_SS_BLSP1_BLSP_BAM_BAM_P_IRQ_CLR1_ADDR A:0xf9906014
y.create.l HWIO_PERIPH_SS_BLSP1_BLSP_BAM_BAM_P_IRQ_CLR2_ADDR A:0xf9907014
y.create.l HWIO_PERIPH_SS_BLSP1_BLSP_BAM_BAM_P_IRQ_CLR3_ADDR A:0xf9908014
y.create.l HWIO_PERIPH_SS_BLSP1_BLSP_BAM_BAM_P_IRQ_CLR4_ADDR A:0xf9909014
y.create.l HWIO_PERIPH_SS_BLSP1_BLSP_BAM_BAM_P_IRQ_CLR5_ADDR A:0xf990a014
y.create.l HWIO_PERIPH_SS_BLSP1_BLSP_BAM_BAM_P_IRQ_CLR6_ADDR A:0xf990b014
y.create.l HWIO_PERIPH_SS_BLSP1_BLSP_BAM_BAM_P_IRQ_CLR7_ADDR A:0xf990c014
y.create.l HWIO_PERIPH_SS_BLSP1_BLSP_BAM_BAM_P_IRQ_CLR8_ADDR A:0xf990d014
y.create.l HWIO_PERIPH_SS_BLSP1_BLSP_BAM_BAM_P_IRQ_CLR9_ADDR A:0xf990e014
y.create.l HWIO_PERIPH_SS_BLSP1_BLSP_BAM_BAM_P_IRQ_EN0_ADDR A:0xf9905018
y.create.l HWIO_PERIPH_SS_BLSP1_BLSP_BAM_BAM_P_IRQ_EN1_ADDR A:0xf9906018
y.create.l HWIO_PERIPH_SS_BLSP1_BLSP_BAM_BAM_P_IRQ_EN2_ADDR A:0xf9907018
y.create.l HWIO_PERIPH_SS_BLSP1_BLSP_BAM_BAM_P_IRQ_EN3_ADDR A:0xf9908018
y.create.l HWIO_PERIPH_SS_BLSP1_BLSP_BAM_BAM_P_IRQ_EN4_ADDR A:0xf9909018
y.create.l HWIO_PERIPH_SS_BLSP1_BLSP_BAM_BAM_P_IRQ_EN5_ADDR A:0xf990a018
y.create.l HWIO_PERIPH_SS_BLSP1_BLSP_BAM_BAM_P_IRQ_EN6_ADDR A:0xf990b018
y.create.l HWIO_PERIPH_SS_BLSP1_BLSP_BAM_BAM_P_IRQ_EN7_ADDR A:0xf990c018
y.create.l HWIO_PERIPH_SS_BLSP1_BLSP_BAM_BAM_P_IRQ_EN8_ADDR A:0xf990d018
y.create.l HWIO_PERIPH_SS_BLSP1_BLSP_BAM_BAM_P_IRQ_EN9_ADDR A:0xf990e018
y.create.l HWIO_PERIPH_SS_BLSP1_BLSP_BAM_BAM_P_TIMER0_ADDR A:0xf990501c
y.create.l HWIO_PERIPH_SS_BLSP1_BLSP_BAM_BAM_P_TIMER1_ADDR A:0xf990601c
y.create.l HWIO_PERIPH_SS_BLSP1_BLSP_BAM_BAM_P_TIMER2_ADDR A:0xf990701c
y.create.l HWIO_PERIPH_SS_BLSP1_BLSP_BAM_BAM_P_TIMER3_ADDR A:0xf990801c
y.create.l HWIO_PERIPH_SS_BLSP1_BLSP_BAM_BAM_P_TIMER4_ADDR A:0xf990901c
y.create.l HWIO_PERIPH_SS_BLSP1_BLSP_BAM_BAM_P_TIMER5_ADDR A:0xf990a01c
y.create.l HWIO_PERIPH_SS_BLSP1_BLSP_BAM_BAM_P_TIMER6_ADDR A:0xf990b01c
y.create.l HWIO_PERIPH_SS_BLSP1_BLSP_BAM_BAM_P_TIMER7_ADDR A:0xf990c01c
y.create.l HWIO_PERIPH_SS_BLSP1_BLSP_BAM_BAM_P_TIMER8_ADDR A:0xf990d01c
y.create.l HWIO_PERIPH_SS_BLSP1_BLSP_BAM_BAM_P_TIMER9_ADDR A:0xf990e01c
y.create.l HWIO_PERIPH_SS_BLSP1_BLSP_BAM_BAM_P_TIMER_CTRL0_ADDR A:0xf9905020
y.create.l HWIO_PERIPH_SS_BLSP1_BLSP_BAM_BAM_P_TIMER_CTRL1_ADDR A:0xf9906020
y.create.l HWIO_PERIPH_SS_BLSP1_BLSP_BAM_BAM_P_TIMER_CTRL2_ADDR A:0xf9907020
y.create.l HWIO_PERIPH_SS_BLSP1_BLSP_BAM_BAM_P_TIMER_CTRL3_ADDR A:0xf9908020
y.create.l HWIO_PERIPH_SS_BLSP1_BLSP_BAM_BAM_P_TIMER_CTRL4_ADDR A:0xf9909020
y.create.l HWIO_PERIPH_SS_BLSP1_BLSP_BAM_BAM_P_TIMER_CTRL5_ADDR A:0xf990a020
y.create.l HWIO_PERIPH_SS_BLSP1_BLSP_BAM_BAM_P_TIMER_CTRL6_ADDR A:0xf990b020
y.create.l HWIO_PERIPH_SS_BLSP1_BLSP_BAM_BAM_P_TIMER_CTRL7_ADDR A:0xf990c020
y.create.l HWIO_PERIPH_SS_BLSP1_BLSP_BAM_BAM_P_TIMER_CTRL8_ADDR A:0xf990d020
y.create.l HWIO_PERIPH_SS_BLSP1_BLSP_BAM_BAM_P_TIMER_CTRL9_ADDR A:0xf990e020
y.create.l HWIO_PERIPH_SS_BLSP1_BLSP_BAM_BAM_P_PRDCR_SDBND0_ADDR A:0xf9905024
y.create.l HWIO_PERIPH_SS_BLSP1_BLSP_BAM_BAM_P_PRDCR_SDBND1_ADDR A:0xf9906024
y.create.l HWIO_PERIPH_SS_BLSP1_BLSP_BAM_BAM_P_PRDCR_SDBND2_ADDR A:0xf9907024
y.create.l HWIO_PERIPH_SS_BLSP1_BLSP_BAM_BAM_P_PRDCR_SDBND3_ADDR A:0xf9908024
y.create.l HWIO_PERIPH_SS_BLSP1_BLSP_BAM_BAM_P_PRDCR_SDBND4_ADDR A:0xf9909024
y.create.l HWIO_PERIPH_SS_BLSP1_BLSP_BAM_BAM_P_PRDCR_SDBND5_ADDR A:0xf990a024
y.create.l HWIO_PERIPH_SS_BLSP1_BLSP_BAM_BAM_P_PRDCR_SDBND6_ADDR A:0xf990b024
y.create.l HWIO_PERIPH_SS_BLSP1_BLSP_BAM_BAM_P_PRDCR_SDBND7_ADDR A:0xf990c024
y.create.l HWIO_PERIPH_SS_BLSP1_BLSP_BAM_BAM_P_PRDCR_SDBND8_ADDR A:0xf990d024
y.create.l HWIO_PERIPH_SS_BLSP1_BLSP_BAM_BAM_P_PRDCR_SDBND9_ADDR A:0xf990e024
y.create.l HWIO_PERIPH_SS_BLSP1_BLSP_BAM_BAM_P_CNSMR_SDBND0_ADDR A:0xf9905028
y.create.l HWIO_PERIPH_SS_BLSP1_BLSP_BAM_BAM_P_CNSMR_SDBND1_ADDR A:0xf9906028
y.create.l HWIO_PERIPH_SS_BLSP1_BLSP_BAM_BAM_P_CNSMR_SDBND2_ADDR A:0xf9907028
y.create.l HWIO_PERIPH_SS_BLSP1_BLSP_BAM_BAM_P_CNSMR_SDBND3_ADDR A:0xf9908028
y.create.l HWIO_PERIPH_SS_BLSP1_BLSP_BAM_BAM_P_CNSMR_SDBND4_ADDR A:0xf9909028
y.create.l HWIO_PERIPH_SS_BLSP1_BLSP_BAM_BAM_P_CNSMR_SDBND5_ADDR A:0xf990a028
y.create.l HWIO_PERIPH_SS_BLSP1_BLSP_BAM_BAM_P_CNSMR_SDBND6_ADDR A:0xf990b028
y.create.l HWIO_PERIPH_SS_BLSP1_BLSP_BAM_BAM_P_CNSMR_SDBND7_ADDR A:0xf990c028
y.create.l HWIO_PERIPH_SS_BLSP1_BLSP_BAM_BAM_P_CNSMR_SDBND8_ADDR A:0xf990d028
y.create.l HWIO_PERIPH_SS_BLSP1_BLSP_BAM_BAM_P_CNSMR_SDBND9_ADDR A:0xf990e028
y.create.l HWIO_PERIPH_SS_BLSP1_BLSP_BAM_BAM_P_EVNT_DEST_ADDR0_ADDR A:0xf990582c
y.create.l HWIO_PERIPH_SS_BLSP1_BLSP_BAM_BAM_P_EVNT_DEST_ADDR1_ADDR A:0xf990682c
y.create.l HWIO_PERIPH_SS_BLSP1_BLSP_BAM_BAM_P_EVNT_DEST_ADDR2_ADDR A:0xf990782c
y.create.l HWIO_PERIPH_SS_BLSP1_BLSP_BAM_BAM_P_EVNT_DEST_ADDR3_ADDR A:0xf990882c
y.create.l HWIO_PERIPH_SS_BLSP1_BLSP_BAM_BAM_P_EVNT_DEST_ADDR4_ADDR A:0xf990982c
y.create.l HWIO_PERIPH_SS_BLSP1_BLSP_BAM_BAM_P_EVNT_DEST_ADDR5_ADDR A:0xf990a82c
y.create.l HWIO_PERIPH_SS_BLSP1_BLSP_BAM_BAM_P_EVNT_DEST_ADDR6_ADDR A:0xf990b82c
y.create.l HWIO_PERIPH_SS_BLSP1_BLSP_BAM_BAM_P_EVNT_DEST_ADDR7_ADDR A:0xf990c82c
y.create.l HWIO_PERIPH_SS_BLSP1_BLSP_BAM_BAM_P_EVNT_DEST_ADDR8_ADDR A:0xf990d82c
y.create.l HWIO_PERIPH_SS_BLSP1_BLSP_BAM_BAM_P_EVNT_DEST_ADDR9_ADDR A:0xf990e82c
y.create.l HWIO_PERIPH_SS_BLSP1_BLSP_BAM_BAM_P_EVNT_REG0_ADDR A:0xf9905818
y.create.l HWIO_PERIPH_SS_BLSP1_BLSP_BAM_BAM_P_EVNT_REG1_ADDR A:0xf9906818
y.create.l HWIO_PERIPH_SS_BLSP1_BLSP_BAM_BAM_P_EVNT_REG2_ADDR A:0xf9907818
y.create.l HWIO_PERIPH_SS_BLSP1_BLSP_BAM_BAM_P_EVNT_REG3_ADDR A:0xf9908818
y.create.l HWIO_PERIPH_SS_BLSP1_BLSP_BAM_BAM_P_EVNT_REG4_ADDR A:0xf9909818
y.create.l HWIO_PERIPH_SS_BLSP1_BLSP_BAM_BAM_P_EVNT_REG5_ADDR A:0xf990a818
y.create.l HWIO_PERIPH_SS_BLSP1_BLSP_BAM_BAM_P_EVNT_REG6_ADDR A:0xf990b818
y.create.l HWIO_PERIPH_SS_BLSP1_BLSP_BAM_BAM_P_EVNT_REG7_ADDR A:0xf990c818
y.create.l HWIO_PERIPH_SS_BLSP1_BLSP_BAM_BAM_P_EVNT_REG8_ADDR A:0xf990d818
y.create.l HWIO_PERIPH_SS_BLSP1_BLSP_BAM_BAM_P_EVNT_REG9_ADDR A:0xf990e818
y.create.l HWIO_PERIPH_SS_BLSP1_BLSP_BAM_BAM_P_SW_OFSTS0_ADDR A:0xf9905800
y.create.l HWIO_PERIPH_SS_BLSP1_BLSP_BAM_BAM_P_SW_OFSTS1_ADDR A:0xf9906800
y.create.l HWIO_PERIPH_SS_BLSP1_BLSP_BAM_BAM_P_SW_OFSTS2_ADDR A:0xf9907800
y.create.l HWIO_PERIPH_SS_BLSP1_BLSP_BAM_BAM_P_SW_OFSTS3_ADDR A:0xf9908800
y.create.l HWIO_PERIPH_SS_BLSP1_BLSP_BAM_BAM_P_SW_OFSTS4_ADDR A:0xf9909800
y.create.l HWIO_PERIPH_SS_BLSP1_BLSP_BAM_BAM_P_SW_OFSTS5_ADDR A:0xf990a800
y.create.l HWIO_PERIPH_SS_BLSP1_BLSP_BAM_BAM_P_SW_OFSTS6_ADDR A:0xf990b800
y.create.l HWIO_PERIPH_SS_BLSP1_BLSP_BAM_BAM_P_SW_OFSTS7_ADDR A:0xf990c800
y.create.l HWIO_PERIPH_SS_BLSP1_BLSP_BAM_BAM_P_SW_OFSTS8_ADDR A:0xf990d800
y.create.l HWIO_PERIPH_SS_BLSP1_BLSP_BAM_BAM_P_SW_OFSTS9_ADDR A:0xf990e800
y.create.l HWIO_PERIPH_SS_BLSP1_BLSP_BAM_BAM_P_DATA_FIFO_ADDR0_ADDR A:0xf9905824
y.create.l HWIO_PERIPH_SS_BLSP1_BLSP_BAM_BAM_P_DATA_FIFO_ADDR1_ADDR A:0xf9906824
y.create.l HWIO_PERIPH_SS_BLSP1_BLSP_BAM_BAM_P_DATA_FIFO_ADDR2_ADDR A:0xf9907824
y.create.l HWIO_PERIPH_SS_BLSP1_BLSP_BAM_BAM_P_DATA_FIFO_ADDR3_ADDR A:0xf9908824
y.create.l HWIO_PERIPH_SS_BLSP1_BLSP_BAM_BAM_P_DATA_FIFO_ADDR4_ADDR A:0xf9909824
y.create.l HWIO_PERIPH_SS_BLSP1_BLSP_BAM_BAM_P_DATA_FIFO_ADDR5_ADDR A:0xf990a824
y.create.l HWIO_PERIPH_SS_BLSP1_BLSP_BAM_BAM_P_DATA_FIFO_ADDR6_ADDR A:0xf990b824
y.create.l HWIO_PERIPH_SS_BLSP1_BLSP_BAM_BAM_P_DATA_FIFO_ADDR7_ADDR A:0xf990c824
y.create.l HWIO_PERIPH_SS_BLSP1_BLSP_BAM_BAM_P_DATA_FIFO_ADDR8_ADDR A:0xf990d824
y.create.l HWIO_PERIPH_SS_BLSP1_BLSP_BAM_BAM_P_DATA_FIFO_ADDR9_ADDR A:0xf990e824
y.create.l HWIO_PERIPH_SS_BLSP1_BLSP_BAM_BAM_P_DESC_FIFO_ADDR0_ADDR A:0xf990581c
y.create.l HWIO_PERIPH_SS_BLSP1_BLSP_BAM_BAM_P_DESC_FIFO_ADDR1_ADDR A:0xf990681c
y.create.l HWIO_PERIPH_SS_BLSP1_BLSP_BAM_BAM_P_DESC_FIFO_ADDR2_ADDR A:0xf990781c
y.create.l HWIO_PERIPH_SS_BLSP1_BLSP_BAM_BAM_P_DESC_FIFO_ADDR3_ADDR A:0xf990881c
y.create.l HWIO_PERIPH_SS_BLSP1_BLSP_BAM_BAM_P_DESC_FIFO_ADDR4_ADDR A:0xf990981c
y.create.l HWIO_PERIPH_SS_BLSP1_BLSP_BAM_BAM_P_DESC_FIFO_ADDR5_ADDR A:0xf990a81c
y.create.l HWIO_PERIPH_SS_BLSP1_BLSP_BAM_BAM_P_DESC_FIFO_ADDR6_ADDR A:0xf990b81c
y.create.l HWIO_PERIPH_SS_BLSP1_BLSP_BAM_BAM_P_DESC_FIFO_ADDR7_ADDR A:0xf990c81c
y.create.l HWIO_PERIPH_SS_BLSP1_BLSP_BAM_BAM_P_DESC_FIFO_ADDR8_ADDR A:0xf990d81c
y.create.l HWIO_PERIPH_SS_BLSP1_BLSP_BAM_BAM_P_DESC_FIFO_ADDR9_ADDR A:0xf990e81c
y.create.l HWIO_PERIPH_SS_BLSP1_BLSP_BAM_BAM_P_EVNT_GEN_TRSHLD0_ADDR A:0xf9905828
y.create.l HWIO_PERIPH_SS_BLSP1_BLSP_BAM_BAM_P_EVNT_GEN_TRSHLD1_ADDR A:0xf9906828
y.create.l HWIO_PERIPH_SS_BLSP1_BLSP_BAM_BAM_P_EVNT_GEN_TRSHLD2_ADDR A:0xf9907828
y.create.l HWIO_PERIPH_SS_BLSP1_BLSP_BAM_BAM_P_EVNT_GEN_TRSHLD3_ADDR A:0xf9908828
y.create.l HWIO_PERIPH_SS_BLSP1_BLSP_BAM_BAM_P_EVNT_GEN_TRSHLD4_ADDR A:0xf9909828
y.create.l HWIO_PERIPH_SS_BLSP1_BLSP_BAM_BAM_P_EVNT_GEN_TRSHLD5_ADDR A:0xf990a828
y.create.l HWIO_PERIPH_SS_BLSP1_BLSP_BAM_BAM_P_EVNT_GEN_TRSHLD6_ADDR A:0xf990b828
y.create.l HWIO_PERIPH_SS_BLSP1_BLSP_BAM_BAM_P_EVNT_GEN_TRSHLD7_ADDR A:0xf990c828
y.create.l HWIO_PERIPH_SS_BLSP1_BLSP_BAM_BAM_P_EVNT_GEN_TRSHLD8_ADDR A:0xf990d828
y.create.l HWIO_PERIPH_SS_BLSP1_BLSP_BAM_BAM_P_EVNT_GEN_TRSHLD9_ADDR A:0xf990e828
y.create.l HWIO_PERIPH_SS_BLSP1_BLSP_BAM_BAM_P_FIFO_SIZES0_ADDR A:0xf9905820
y.create.l HWIO_PERIPH_SS_BLSP1_BLSP_BAM_BAM_P_FIFO_SIZES1_ADDR A:0xf9906820
y.create.l HWIO_PERIPH_SS_BLSP1_BLSP_BAM_BAM_P_FIFO_SIZES2_ADDR A:0xf9907820
y.create.l HWIO_PERIPH_SS_BLSP1_BLSP_BAM_BAM_P_FIFO_SIZES3_ADDR A:0xf9908820
y.create.l HWIO_PERIPH_SS_BLSP1_BLSP_BAM_BAM_P_FIFO_SIZES4_ADDR A:0xf9909820
y.create.l HWIO_PERIPH_SS_BLSP1_BLSP_BAM_BAM_P_FIFO_SIZES5_ADDR A:0xf990a820
y.create.l HWIO_PERIPH_SS_BLSP1_BLSP_BAM_BAM_P_FIFO_SIZES6_ADDR A:0xf990b820
y.create.l HWIO_PERIPH_SS_BLSP1_BLSP_BAM_BAM_P_FIFO_SIZES7_ADDR A:0xf990c820
y.create.l HWIO_PERIPH_SS_BLSP1_BLSP_BAM_BAM_P_FIFO_SIZES8_ADDR A:0xf990d820
y.create.l HWIO_PERIPH_SS_BLSP1_BLSP_BAM_BAM_P_FIFO_SIZES9_ADDR A:0xf990e820
y.create.l HWIO_PERIPH_SS_BLSP1_BLSP_BAM_BAM_P_RETR_CNTXT_0_ADDR A:0xf9905834
y.create.l HWIO_PERIPH_SS_BLSP1_BLSP_BAM_BAM_P_RETR_CNTXT_1_ADDR A:0xf9906834
y.create.l HWIO_PERIPH_SS_BLSP1_BLSP_BAM_BAM_P_RETR_CNTXT_2_ADDR A:0xf9907834
y.create.l HWIO_PERIPH_SS_BLSP1_BLSP_BAM_BAM_P_RETR_CNTXT_3_ADDR A:0xf9908834
y.create.l HWIO_PERIPH_SS_BLSP1_BLSP_BAM_BAM_P_RETR_CNTXT_4_ADDR A:0xf9909834
y.create.l HWIO_PERIPH_SS_BLSP1_BLSP_BAM_BAM_P_RETR_CNTXT_5_ADDR A:0xf990a834
y.create.l HWIO_PERIPH_SS_BLSP1_BLSP_BAM_BAM_P_RETR_CNTXT_6_ADDR A:0xf990b834
y.create.l HWIO_PERIPH_SS_BLSP1_BLSP_BAM_BAM_P_RETR_CNTXT_7_ADDR A:0xf990c834
y.create.l HWIO_PERIPH_SS_BLSP1_BLSP_BAM_BAM_P_RETR_CNTXT_8_ADDR A:0xf990d834
y.create.l HWIO_PERIPH_SS_BLSP1_BLSP_BAM_BAM_P_RETR_CNTXT_9_ADDR A:0xf990e834
y.create.l HWIO_PERIPH_SS_BLSP1_BLSP_BAM_BAM_P_SI_CNTXT_0_ADDR A:0xf9905838
y.create.l HWIO_PERIPH_SS_BLSP1_BLSP_BAM_BAM_P_SI_CNTXT_1_ADDR A:0xf9906838
y.create.l HWIO_PERIPH_SS_BLSP1_BLSP_BAM_BAM_P_SI_CNTXT_2_ADDR A:0xf9907838
y.create.l HWIO_PERIPH_SS_BLSP1_BLSP_BAM_BAM_P_SI_CNTXT_3_ADDR A:0xf9908838
y.create.l HWIO_PERIPH_SS_BLSP1_BLSP_BAM_BAM_P_SI_CNTXT_4_ADDR A:0xf9909838
y.create.l HWIO_PERIPH_SS_BLSP1_BLSP_BAM_BAM_P_SI_CNTXT_5_ADDR A:0xf990a838
y.create.l HWIO_PERIPH_SS_BLSP1_BLSP_BAM_BAM_P_SI_CNTXT_6_ADDR A:0xf990b838
y.create.l HWIO_PERIPH_SS_BLSP1_BLSP_BAM_BAM_P_SI_CNTXT_7_ADDR A:0xf990c838
y.create.l HWIO_PERIPH_SS_BLSP1_BLSP_BAM_BAM_P_SI_CNTXT_8_ADDR A:0xf990d838
y.create.l HWIO_PERIPH_SS_BLSP1_BLSP_BAM_BAM_P_SI_CNTXT_9_ADDR A:0xf990e838
y.create.l HWIO_PERIPH_SS_BLSP1_BLSP_BAM_BAM_P_DF_CNTXT_0_ADDR A:0xf9905830
y.create.l HWIO_PERIPH_SS_BLSP1_BLSP_BAM_BAM_P_DF_CNTXT_1_ADDR A:0xf9906830
y.create.l HWIO_PERIPH_SS_BLSP1_BLSP_BAM_BAM_P_DF_CNTXT_2_ADDR A:0xf9907830
y.create.l HWIO_PERIPH_SS_BLSP1_BLSP_BAM_BAM_P_DF_CNTXT_3_ADDR A:0xf9908830
y.create.l HWIO_PERIPH_SS_BLSP1_BLSP_BAM_BAM_P_DF_CNTXT_4_ADDR A:0xf9909830
y.create.l HWIO_PERIPH_SS_BLSP1_BLSP_BAM_BAM_P_DF_CNTXT_5_ADDR A:0xf990a830
y.create.l HWIO_PERIPH_SS_BLSP1_BLSP_BAM_BAM_P_DF_CNTXT_6_ADDR A:0xf990b830
y.create.l HWIO_PERIPH_SS_BLSP1_BLSP_BAM_BAM_P_DF_CNTXT_7_ADDR A:0xf990c830
y.create.l HWIO_PERIPH_SS_BLSP1_BLSP_BAM_BAM_P_DF_CNTXT_8_ADDR A:0xf990d830
y.create.l HWIO_PERIPH_SS_BLSP1_BLSP_BAM_BAM_P_DF_CNTXT_9_ADDR A:0xf990e830
y.create.l HWIO_PERIPH_SS_BLSP1_BLSP_BAM_BAM_P_AU_PSM_CNTXT_1_0_ADDR A:0xf9905804
y.create.l HWIO_PERIPH_SS_BLSP1_BLSP_BAM_BAM_P_AU_PSM_CNTXT_1_1_ADDR A:0xf9906804
y.create.l HWIO_PERIPH_SS_BLSP1_BLSP_BAM_BAM_P_AU_PSM_CNTXT_1_2_ADDR A:0xf9907804
y.create.l HWIO_PERIPH_SS_BLSP1_BLSP_BAM_BAM_P_AU_PSM_CNTXT_1_3_ADDR A:0xf9908804
y.create.l HWIO_PERIPH_SS_BLSP1_BLSP_BAM_BAM_P_AU_PSM_CNTXT_1_4_ADDR A:0xf9909804
y.create.l HWIO_PERIPH_SS_BLSP1_BLSP_BAM_BAM_P_AU_PSM_CNTXT_1_5_ADDR A:0xf990a804
y.create.l HWIO_PERIPH_SS_BLSP1_BLSP_BAM_BAM_P_AU_PSM_CNTXT_1_6_ADDR A:0xf990b804
y.create.l HWIO_PERIPH_SS_BLSP1_BLSP_BAM_BAM_P_AU_PSM_CNTXT_1_7_ADDR A:0xf990c804
y.create.l HWIO_PERIPH_SS_BLSP1_BLSP_BAM_BAM_P_AU_PSM_CNTXT_1_8_ADDR A:0xf990d804
y.create.l HWIO_PERIPH_SS_BLSP1_BLSP_BAM_BAM_P_AU_PSM_CNTXT_1_9_ADDR A:0xf990e804
y.create.l HWIO_PERIPH_SS_BLSP1_BLSP_BAM_BAM_P_PSM_CNTXT_2_0_ADDR A:0xf9905808
y.create.l HWIO_PERIPH_SS_BLSP1_BLSP_BAM_BAM_P_PSM_CNTXT_2_1_ADDR A:0xf9906808
y.create.l HWIO_PERIPH_SS_BLSP1_BLSP_BAM_BAM_P_PSM_CNTXT_2_2_ADDR A:0xf9907808
y.create.l HWIO_PERIPH_SS_BLSP1_BLSP_BAM_BAM_P_PSM_CNTXT_2_3_ADDR A:0xf9908808
y.create.l HWIO_PERIPH_SS_BLSP1_BLSP_BAM_BAM_P_PSM_CNTXT_2_4_ADDR A:0xf9909808
y.create.l HWIO_PERIPH_SS_BLSP1_BLSP_BAM_BAM_P_PSM_CNTXT_2_5_ADDR A:0xf990a808
y.create.l HWIO_PERIPH_SS_BLSP1_BLSP_BAM_BAM_P_PSM_CNTXT_2_6_ADDR A:0xf990b808
y.create.l HWIO_PERIPH_SS_BLSP1_BLSP_BAM_BAM_P_PSM_CNTXT_2_7_ADDR A:0xf990c808
y.create.l HWIO_PERIPH_SS_BLSP1_BLSP_BAM_BAM_P_PSM_CNTXT_2_8_ADDR A:0xf990d808
y.create.l HWIO_PERIPH_SS_BLSP1_BLSP_BAM_BAM_P_PSM_CNTXT_2_9_ADDR A:0xf990e808
y.create.l HWIO_PERIPH_SS_BLSP1_BLSP_BAM_BAM_P_PSM_CNTXT_3_0_ADDR A:0xf990580c
y.create.l HWIO_PERIPH_SS_BLSP1_BLSP_BAM_BAM_P_PSM_CNTXT_3_1_ADDR A:0xf990680c
y.create.l HWIO_PERIPH_SS_BLSP1_BLSP_BAM_BAM_P_PSM_CNTXT_3_2_ADDR A:0xf990780c
y.create.l HWIO_PERIPH_SS_BLSP1_BLSP_BAM_BAM_P_PSM_CNTXT_3_3_ADDR A:0xf990880c
y.create.l HWIO_PERIPH_SS_BLSP1_BLSP_BAM_BAM_P_PSM_CNTXT_3_4_ADDR A:0xf990980c
y.create.l HWIO_PERIPH_SS_BLSP1_BLSP_BAM_BAM_P_PSM_CNTXT_3_5_ADDR A:0xf990a80c
y.create.l HWIO_PERIPH_SS_BLSP1_BLSP_BAM_BAM_P_PSM_CNTXT_3_6_ADDR A:0xf990b80c
y.create.l HWIO_PERIPH_SS_BLSP1_BLSP_BAM_BAM_P_PSM_CNTXT_3_7_ADDR A:0xf990c80c
y.create.l HWIO_PERIPH_SS_BLSP1_BLSP_BAM_BAM_P_PSM_CNTXT_3_8_ADDR A:0xf990d80c
y.create.l HWIO_PERIPH_SS_BLSP1_BLSP_BAM_BAM_P_PSM_CNTXT_3_9_ADDR A:0xf990e80c
y.create.l HWIO_PERIPH_SS_BLSP1_BLSP_BAM_BAM_P_PSM_CNTXT_4_0_ADDR A:0xf9905810
y.create.l HWIO_PERIPH_SS_BLSP1_BLSP_BAM_BAM_P_PSM_CNTXT_4_1_ADDR A:0xf9906810
y.create.l HWIO_PERIPH_SS_BLSP1_BLSP_BAM_BAM_P_PSM_CNTXT_4_2_ADDR A:0xf9907810
y.create.l HWIO_PERIPH_SS_BLSP1_BLSP_BAM_BAM_P_PSM_CNTXT_4_3_ADDR A:0xf9908810
y.create.l HWIO_PERIPH_SS_BLSP1_BLSP_BAM_BAM_P_PSM_CNTXT_4_4_ADDR A:0xf9909810
y.create.l HWIO_PERIPH_SS_BLSP1_BLSP_BAM_BAM_P_PSM_CNTXT_4_5_ADDR A:0xf990a810
y.create.l HWIO_PERIPH_SS_BLSP1_BLSP_BAM_BAM_P_PSM_CNTXT_4_6_ADDR A:0xf990b810
y.create.l HWIO_PERIPH_SS_BLSP1_BLSP_BAM_BAM_P_PSM_CNTXT_4_7_ADDR A:0xf990c810
y.create.l HWIO_PERIPH_SS_BLSP1_BLSP_BAM_BAM_P_PSM_CNTXT_4_8_ADDR A:0xf990d810
y.create.l HWIO_PERIPH_SS_BLSP1_BLSP_BAM_BAM_P_PSM_CNTXT_4_9_ADDR A:0xf990e810
y.create.l HWIO_PERIPH_SS_BLSP1_BLSP_BAM_BAM_P_PSM_CNTXT_5_0_ADDR A:0xf9905814
y.create.l HWIO_PERIPH_SS_BLSP1_BLSP_BAM_BAM_P_PSM_CNTXT_5_1_ADDR A:0xf9906814
y.create.l HWIO_PERIPH_SS_BLSP1_BLSP_BAM_BAM_P_PSM_CNTXT_5_2_ADDR A:0xf9907814
y.create.l HWIO_PERIPH_SS_BLSP1_BLSP_BAM_BAM_P_PSM_CNTXT_5_3_ADDR A:0xf9908814
y.create.l HWIO_PERIPH_SS_BLSP1_BLSP_BAM_BAM_P_PSM_CNTXT_5_4_ADDR A:0xf9909814
y.create.l HWIO_PERIPH_SS_BLSP1_BLSP_BAM_BAM_P_PSM_CNTXT_5_5_ADDR A:0xf990a814
y.create.l HWIO_PERIPH_SS_BLSP1_BLSP_BAM_BAM_P_PSM_CNTXT_5_6_ADDR A:0xf990b814
y.create.l HWIO_PERIPH_SS_BLSP1_BLSP_BAM_BAM_P_PSM_CNTXT_5_7_ADDR A:0xf990c814
y.create.l HWIO_PERIPH_SS_BLSP1_BLSP_BAM_BAM_P_PSM_CNTXT_5_8_ADDR A:0xf990d814
y.create.l HWIO_PERIPH_SS_BLSP1_BLSP_BAM_BAM_P_PSM_CNTXT_5_9_ADDR A:0xf990e814
y.create.l HWIO_PERIPH_SS_BLSP1_BLSP_BAM_XPU_SCR_ADDR A:0xf9902000
y.create.l HWIO_PERIPH_SS_BLSP1_BLSP_BAM_XPU_SWDR_ADDR A:0xf9902004
y.create.l HWIO_PERIPH_SS_BLSP1_BLSP_BAM_XPU_SEAR0_ADDR A:0xf9902040
y.create.l HWIO_PERIPH_SS_BLSP1_BLSP_BAM_XPU_SESR_ADDR A:0xf9902048
y.create.l HWIO_PERIPH_SS_BLSP1_BLSP_BAM_XPU_SESRRESTORE_ADDR A:0xf990204c
y.create.l HWIO_PERIPH_SS_BLSP1_BLSP_BAM_XPU_SESYNR0_ADDR A:0xf9902050
y.create.l HWIO_PERIPH_SS_BLSP1_BLSP_BAM_XPU_SESYNR1_ADDR A:0xf9902054
y.create.l HWIO_PERIPH_SS_BLSP1_BLSP_BAM_XPU_SESYNR2_ADDR A:0xf9902058
y.create.l HWIO_PERIPH_SS_BLSP1_BLSP_BAM_XPU_MCR_ADDR A:0xf9902100
y.create.l HWIO_PERIPH_SS_BLSP1_BLSP_BAM_XPU_MEAR0_ADDR A:0xf9902140
y.create.l HWIO_PERIPH_SS_BLSP1_BLSP_BAM_XPU_MESR_ADDR A:0xf9902148
y.create.l HWIO_PERIPH_SS_BLSP1_BLSP_BAM_XPU_MESRRESTORE_ADDR A:0xf990214c
y.create.l HWIO_PERIPH_SS_BLSP1_BLSP_BAM_XPU_MESYNR0_ADDR A:0xf9902150
y.create.l HWIO_PERIPH_SS_BLSP1_BLSP_BAM_XPU_MESYNR1_ADDR A:0xf9902154
y.create.l HWIO_PERIPH_SS_BLSP1_BLSP_BAM_XPU_MESYNR2_ADDR A:0xf9902158
y.create.l HWIO_PERIPH_SS_BLSP1_BLSP_BAM_XPU_CR_ADDR A:0xf9902080
y.create.l HWIO_PERIPH_SS_BLSP1_BLSP_BAM_XPU_RPU_ACR0_ADDR A:0xf99020a0
y.create.l HWIO_PERIPH_SS_BLSP1_BLSP_BAM_XPU_EAR0_ADDR A:0xf99020c0
y.create.l HWIO_PERIPH_SS_BLSP1_BLSP_BAM_XPU_ESR_ADDR A:0xf99020c8
y.create.l HWIO_PERIPH_SS_BLSP1_BLSP_BAM_XPU_ESRRESTORE_ADDR A:0xf99020cc
y.create.l HWIO_PERIPH_SS_BLSP1_BLSP_BAM_XPU_ESYNR0_ADDR A:0xf99020d0
y.create.l HWIO_PERIPH_SS_BLSP1_BLSP_BAM_XPU_ESYNR1_ADDR A:0xf99020d4
y.create.l HWIO_PERIPH_SS_BLSP1_BLSP_BAM_XPU_ESYNR2_ADDR A:0xf99020d8
y.create.l HWIO_PERIPH_SS_BLSP1_BLSP_BAM_XPU_IDR0_ADDR A:0xf9902074
y.create.l HWIO_PERIPH_SS_BLSP1_BLSP_BAM_XPU_IDR1_ADDR A:0xf9902078
y.create.l HWIO_PERIPH_SS_BLSP1_BLSP_BAM_XPU_REV_ADDR A:0xf990207c
y.create.l HWIO_PERIPH_SS_BLSP1_BLSP_BAM_XPU_RG0_RACR0_ADDR A:0xf9902200
y.create.l HWIO_PERIPH_SS_BLSP1_BLSP_BAM_XPU_RG1_RACR0_ADDR A:0xf9902280
y.create.l HWIO_PERIPH_SS_BLSP1_BLSP_BAM_XPU_RG2_RACR0_ADDR A:0xf9902300
y.create.l HWIO_PERIPH_SS_BLSP1_BLSP_BAM_XPU_RG3_RACR0_ADDR A:0xf9902380
y.create.l HWIO_PERIPH_SS_BLSP1_BLSP_BAM_XPU_RG4_RACR0_ADDR A:0xf9902400
y.create.l HWIO_PERIPH_SS_BLSP1_BLSP_BAM_XPU_RG5_RACR0_ADDR A:0xf9902480
y.create.l HWIO_PERIPH_SS_BLSP1_BLSP_BAM_XPU_RG6_RACR0_ADDR A:0xf9902500
y.create.l HWIO_PERIPH_SS_BLSP1_BLSP_BAM_XPU_RG7_RACR0_ADDR A:0xf9902580
y.create.l HWIO_PERIPH_SS_BLSP1_BLSP_BAM_XPU_RG8_RACR0_ADDR A:0xf9902600
y.create.l HWIO_PERIPH_SS_BLSP1_BLSP_BAM_XPU_RG9_RACR0_ADDR A:0xf9902680
y.create.l HWIO_PERIPH_SS_BLSP1_BLSP_BAM_XPU_RG0_SCR_ADDR A:0xf9902250
y.create.l HWIO_PERIPH_SS_BLSP1_BLSP_BAM_XPU_RG1_SCR_ADDR A:0xf99022d0
y.create.l HWIO_PERIPH_SS_BLSP1_BLSP_BAM_XPU_RG2_SCR_ADDR A:0xf9902350
y.create.l HWIO_PERIPH_SS_BLSP1_BLSP_BAM_XPU_RG3_SCR_ADDR A:0xf99023d0
y.create.l HWIO_PERIPH_SS_BLSP1_BLSP_BAM_XPU_RG4_SCR_ADDR A:0xf9902450
y.create.l HWIO_PERIPH_SS_BLSP1_BLSP_BAM_XPU_RG5_SCR_ADDR A:0xf99024d0
y.create.l HWIO_PERIPH_SS_BLSP1_BLSP_BAM_XPU_RG6_SCR_ADDR A:0xf9902550
y.create.l HWIO_PERIPH_SS_BLSP1_BLSP_BAM_XPU_RG7_SCR_ADDR A:0xf99025d0
y.create.l HWIO_PERIPH_SS_BLSP1_BLSP_BAM_XPU_RG8_SCR_ADDR A:0xf9902650
y.create.l HWIO_PERIPH_SS_BLSP1_BLSP_BAM_XPU_RG9_SCR_ADDR A:0xf99026d0
y.create.l HWIO_PERIPH_SS_BLSP1_BLSP_BAM_XPU_RG0_MCR_ADDR A:0xf9902254
y.create.l HWIO_PERIPH_SS_BLSP1_BLSP_BAM_XPU_RG1_MCR_ADDR A:0xf99022d4
y.create.l HWIO_PERIPH_SS_BLSP1_BLSP_BAM_XPU_RG2_MCR_ADDR A:0xf9902354
y.create.l HWIO_PERIPH_SS_BLSP1_BLSP_BAM_XPU_RG3_MCR_ADDR A:0xf99023d4
y.create.l HWIO_PERIPH_SS_BLSP1_BLSP_BAM_XPU_RG4_MCR_ADDR A:0xf9902454
y.create.l HWIO_PERIPH_SS_BLSP1_BLSP_BAM_XPU_RG5_MCR_ADDR A:0xf99024d4
y.create.l HWIO_PERIPH_SS_BLSP1_BLSP_BAM_XPU_RG6_MCR_ADDR A:0xf9902554
y.create.l HWIO_PERIPH_SS_BLSP1_BLSP_BAM_XPU_RG7_MCR_ADDR A:0xf99025d4
y.create.l HWIO_PERIPH_SS_BLSP1_BLSP_BAM_XPU_RG8_MCR_ADDR A:0xf9902654
y.create.l HWIO_PERIPH_SS_BLSP1_BLSP_BAM_XPU_RG9_MCR_ADDR A:0xf99026d4
y.create.l HWIO_PERIPH_SS_BLSP1_BLSP_BAM_VMIDMT_SCR0_ADDR A:0xf9900000
y.create.l HWIO_PERIPH_SS_BLSP1_BLSP_BAM_VMIDMT_SCR1_ADDR A:0xf9900004
y.create.l HWIO_PERIPH_SS_BLSP1_BLSP_BAM_VMIDMT_SCR2_ADDR A:0xf9900008
y.create.l HWIO_PERIPH_SS_BLSP1_BLSP_BAM_VMIDMT_SACR_ADDR A:0xf9900010
y.create.l HWIO_PERIPH_SS_BLSP1_BLSP_BAM_VMIDMT_SIDR0_ADDR A:0xf9900020
y.create.l HWIO_PERIPH_SS_BLSP1_BLSP_BAM_VMIDMT_SIDR1_ADDR A:0xf9900024
y.create.l HWIO_PERIPH_SS_BLSP1_BLSP_BAM_VMIDMT_SIDR2_ADDR A:0xf9900028
y.create.l HWIO_PERIPH_SS_BLSP1_BLSP_BAM_VMIDMT_SIDR4_ADDR A:0xf9900030
y.create.l HWIO_PERIPH_SS_BLSP1_BLSP_BAM_VMIDMT_SIDR5_ADDR A:0xf9900034
y.create.l HWIO_PERIPH_SS_BLSP1_BLSP_BAM_VMIDMT_SIDR7_ADDR A:0xf990003c
y.create.l HWIO_PERIPH_SS_BLSP1_BLSP_BAM_VMIDMT_SGFAR0_ADDR A:0xf9900040
y.create.l HWIO_PERIPH_SS_BLSP1_BLSP_BAM_VMIDMT_SGFSR_ADDR A:0xf9900048
y.create.l HWIO_PERIPH_SS_BLSP1_BLSP_BAM_VMIDMT_SGFSRRESTORE_ADDR A:0xf990004c
y.create.l HWIO_PERIPH_SS_BLSP1_BLSP_BAM_VMIDMT_SGFSYNDR0_ADDR A:0xf9900050
y.create.l HWIO_PERIPH_SS_BLSP1_BLSP_BAM_VMIDMT_SGFSYNDR1_ADDR A:0xf9900054
y.create.l HWIO_PERIPH_SS_BLSP1_BLSP_BAM_VMIDMT_SGFSYNDR2_ADDR A:0xf9900058
y.create.l HWIO_PERIPH_SS_BLSP1_BLSP_BAM_VMIDMT_VMIDMTSCR0_ADDR A:0xf9900090
y.create.l HWIO_PERIPH_SS_BLSP1_BLSP_BAM_VMIDMT_CR0_ADDR A:0xf9900000
y.create.l HWIO_PERIPH_SS_BLSP1_BLSP_BAM_VMIDMT_CR2_ADDR A:0xf9900008
y.create.l HWIO_PERIPH_SS_BLSP1_BLSP_BAM_VMIDMT_ACR_ADDR A:0xf9900010
y.create.l HWIO_PERIPH_SS_BLSP1_BLSP_BAM_VMIDMT_IDR0_ADDR A:0xf9900020
y.create.l HWIO_PERIPH_SS_BLSP1_BLSP_BAM_VMIDMT_IDR1_ADDR A:0xf9900024
y.create.l HWIO_PERIPH_SS_BLSP1_BLSP_BAM_VMIDMT_IDR2_ADDR A:0xf9900028
y.create.l HWIO_PERIPH_SS_BLSP1_BLSP_BAM_VMIDMT_IDR4_ADDR A:0xf9900030
y.create.l HWIO_PERIPH_SS_BLSP1_BLSP_BAM_VMIDMT_IDR5_ADDR A:0xf9900034
y.create.l HWIO_PERIPH_SS_BLSP1_BLSP_BAM_VMIDMT_IDR7_ADDR A:0xf990003c
y.create.l HWIO_PERIPH_SS_BLSP1_BLSP_BAM_VMIDMT_GFAR0_ADDR A:0xf9900040
y.create.l HWIO_PERIPH_SS_BLSP1_BLSP_BAM_VMIDMT_GFSR_ADDR A:0xf9900048
y.create.l HWIO_PERIPH_SS_BLSP1_BLSP_BAM_VMIDMT_GFSRRESTORE_ADDR A:0xf990004c
y.create.l HWIO_PERIPH_SS_BLSP1_BLSP_BAM_VMIDMT_GFSYNDR0_ADDR A:0xf9900050
y.create.l HWIO_PERIPH_SS_BLSP1_BLSP_BAM_VMIDMT_GFSYNDR1_ADDR A:0xf9900054
y.create.l HWIO_PERIPH_SS_BLSP1_BLSP_BAM_VMIDMT_GFSYNDR2_ADDR A:0xf9900058
y.create.l HWIO_PERIPH_SS_BLSP1_BLSP_BAM_VMIDMT_VMIDMTCR0_ADDR A:0xf9900090
y.create.l HWIO_PERIPH_SS_BLSP1_BLSP_BAM_VMIDMT_VMIDMTACR_ADDR A:0xf990009c
y.create.l HWIO_PERIPH_SS_BLSP1_BLSP_BAM_VMIDMT_NSCR0_ADDR A:0xf9900400
y.create.l HWIO_PERIPH_SS_BLSP1_BLSP_BAM_VMIDMT_NSCR2_ADDR A:0xf9900408
y.create.l HWIO_PERIPH_SS_BLSP1_BLSP_BAM_VMIDMT_NSACR_ADDR A:0xf9900410
y.create.l HWIO_PERIPH_SS_BLSP1_BLSP_BAM_VMIDMT_NSGFAR0_ADDR A:0xf9900440
y.create.l HWIO_PERIPH_SS_BLSP1_BLSP_BAM_VMIDMT_NSGFSR_ADDR A:0xf9900448
y.create.l HWIO_PERIPH_SS_BLSP1_BLSP_BAM_VMIDMT_NSGFSRRESTORE_ADDR A:0xf990044c
y.create.l HWIO_PERIPH_SS_BLSP1_BLSP_BAM_VMIDMT_NSGFSYNDR0_ADDR A:0xf9900450
y.create.l HWIO_PERIPH_SS_BLSP1_BLSP_BAM_VMIDMT_NSGFSYNDR1_ADDR A:0xf9900454
y.create.l HWIO_PERIPH_SS_BLSP1_BLSP_BAM_VMIDMT_NSGFSYNDR2_ADDR A:0xf9900458
y.create.l HWIO_PERIPH_SS_BLSP1_BLSP_BAM_VMIDMT_NSVMIDMTCR0_ADDR A:0xf9900490
y.create.l HWIO_PERIPH_SS_BLSP1_BLSP_BAM_VMIDMT_SSDR0_ADDR A:0xf9900080
y.create.l HWIO_PERIPH_SS_BLSP1_BLSP_BAM_VMIDMT_MSDR0_ADDR A:0xf9900480
y.create.l HWIO_PERIPH_SS_BLSP1_BLSP_BAM_VMIDMT_MCR_ADDR A:0xf9900494
y.create.l HWIO_PERIPH_SS_BLSP1_BLSP_BAM_VMIDMT_S2VR0_ADDR A:0xf9900c00
y.create.l HWIO_PERIPH_SS_BLSP1_BLSP_BAM_VMIDMT_S2VR1_ADDR A:0xf9900c04
y.create.l HWIO_PERIPH_SS_BLSP1_BLSP_BAM_VMIDMT_S2VR2_ADDR A:0xf9900c08
y.create.l HWIO_PERIPH_SS_BLSP1_BLSP_BAM_VMIDMT_S2VR3_ADDR A:0xf9900c0c
y.create.l HWIO_PERIPH_SS_BLSP1_BLSP_BAM_VMIDMT_S2VR4_ADDR A:0xf9900c10
y.create.l HWIO_PERIPH_SS_BLSP1_BLSP_BAM_VMIDMT_S2VR5_ADDR A:0xf9900c14
y.create.l HWIO_PERIPH_SS_BLSP1_BLSP_BAM_VMIDMT_S2VR6_ADDR A:0xf9900c18
y.create.l HWIO_PERIPH_SS_BLSP1_BLSP_BAM_VMIDMT_S2VR7_ADDR A:0xf9900c1c
y.create.l HWIO_PERIPH_SS_BLSP1_BLSP_BAM_VMIDMT_S2VR8_ADDR A:0xf9900c20
y.create.l HWIO_PERIPH_SS_BLSP1_BLSP_BAM_VMIDMT_S2VR9_ADDR A:0xf9900c24
y.create.l HWIO_PERIPH_SS_BLSP1_BLSP_BAM_VMIDMT_AS2VR0_ADDR A:0xf9900e00
y.create.l HWIO_PERIPH_SS_BLSP1_BLSP_BAM_VMIDMT_AS2VR1_ADDR A:0xf9900e04
y.create.l HWIO_PERIPH_SS_BLSP1_BLSP_BAM_VMIDMT_AS2VR2_ADDR A:0xf9900e08
y.create.l HWIO_PERIPH_SS_BLSP1_BLSP_BAM_VMIDMT_AS2VR3_ADDR A:0xf9900e0c
y.create.l HWIO_PERIPH_SS_BLSP1_BLSP_BAM_VMIDMT_AS2VR4_ADDR A:0xf9900e10
y.create.l HWIO_PERIPH_SS_BLSP1_BLSP_BAM_VMIDMT_AS2VR5_ADDR A:0xf9900e14
y.create.l HWIO_PERIPH_SS_BLSP1_BLSP_BAM_VMIDMT_AS2VR6_ADDR A:0xf9900e18
y.create.l HWIO_PERIPH_SS_BLSP1_BLSP_BAM_VMIDMT_AS2VR7_ADDR A:0xf9900e1c
y.create.l HWIO_PERIPH_SS_BLSP1_BLSP_BAM_VMIDMT_AS2VR8_ADDR A:0xf9900e20
y.create.l HWIO_PERIPH_SS_BLSP1_BLSP_BAM_VMIDMT_AS2VR9_ADDR A:0xf9900e24
y.create.l HWIO_PERIPH_SS_BLSP1_BLSP_BAM_VMIDMT_SMR0_ADDR A:0xf9900800
y.create.l HWIO_PERIPH_SS_BLSP1_BLSP_BAM_VMIDMT_SMR1_ADDR A:0xf9900804
y.create.l HWIO_PERIPH_SS_BLSP1_BLSP_BAM_VMIDMT_SMR2_ADDR A:0xf9900808
y.create.l HWIO_PERIPH_SS_BLSP1_BLSP_BAM_VMIDMT_SMR3_ADDR A:0xf990080c
y.create.l HWIO_PERIPH_SS_BLSP1_BLSP_BAM_VMIDMT_SMR4_ADDR A:0xf9900810
y.create.l HWIO_PERIPH_SS_BLSP1_BLSP_BAM_VMIDMT_SMR5_ADDR A:0xf9900814
y.create.l HWIO_PERIPH_SS_BLSP1_BLSP_BAM_VMIDMT_SMR6_ADDR A:0xf9900818
y.create.l HWIO_PERIPH_SS_BLSP1_BLSP_BAM_VMIDMT_SMR7_ADDR A:0xf990081c
y.create.l HWIO_PERIPH_SS_BLSP1_BLSP_BAM_VMIDMT_SMR8_ADDR A:0xf9900820
y.create.l HWIO_PERIPH_SS_BLSP1_BLSP_BAM_VMIDMT_SMR9_ADDR A:0xf9900824
y.create.l HWIO_PERIPH_SS_BLSP1_BLSP_UART0_UART_DM_MR1_ADDR A:0xf991d000
y.create.l HWIO_PERIPH_SS_BLSP1_BLSP_UART0_UART_DM_MR2_ADDR A:0xf991d004
y.create.l HWIO_PERIPH_SS_BLSP1_BLSP_UART0_UART_DM_CSR_SR_DEPRECATED_ADDR A:0xf991d008
y.create.l HWIO_PERIPH_SS_BLSP1_BLSP_UART0_UART_DM_CR_MISR_DEPRECATED_ADDR A:0xf991d010
y.create.l HWIO_PERIPH_SS_BLSP1_BLSP_UART0_UART_DM_IMR_ISR_DEPRECATED_ADDR A:0xf991d014
y.create.l HWIO_PERIPH_SS_BLSP1_BLSP_UART0_UART_DM_IPR_ADDR A:0xf991d018
y.create.l HWIO_PERIPH_SS_BLSP1_BLSP_UART0_UART_DM_TFWR_ADDR A:0xf991d01c
y.create.l HWIO_PERIPH_SS_BLSP1_BLSP_UART0_UART_DM_RFWR_ADDR A:0xf991d020
y.create.l HWIO_PERIPH_SS_BLSP1_BLSP_UART0_UART_DM_HCR_ADDR A:0xf991d024
y.create.l HWIO_PERIPH_SS_BLSP1_BLSP_UART0_UART_DM_DMRX_ADDR A:0xf991d034
y.create.l HWIO_PERIPH_SS_BLSP1_BLSP_UART0_UART_DM_IRDA_RX_TOTAL_SNAP_DEPRECATED_ADDR A:0xf991d038
y.create.l HWIO_PERIPH_SS_BLSP1_BLSP_UART0_UART_DM_DMEN_ADDR A:0xf991d03c
y.create.l HWIO_PERIPH_SS_BLSP1_BLSP_UART0_UART_DM_NO_CHARS_FOR_TX_ADDR A:0xf991d040
y.create.l HWIO_PERIPH_SS_BLSP1_BLSP_UART0_UART_DM_BADR_ADDR A:0xf991d044
y.create.l HWIO_PERIPH_SS_BLSP1_BLSP_UART0_UART_DM_TESTSL_ADDR A:0xf991d048
y.create.l HWIO_PERIPH_SS_BLSP1_BLSP_UART0_UART_DM_TXFS_ADDR A:0xf991d04c
y.create.l HWIO_PERIPH_SS_BLSP1_BLSP_UART0_UART_DM_RXFS_ADDR A:0xf991d050
y.create.l HWIO_PERIPH_SS_BLSP1_BLSP_UART0_UART_DM_MISR_MODE_ADDR A:0xf991d060
y.create.l HWIO_PERIPH_SS_BLSP1_BLSP_UART0_UART_DM_MISR_RESET_ADDR A:0xf991d064
y.create.l HWIO_PERIPH_SS_BLSP1_BLSP_UART0_UART_DM_MISR_EXPORT_ADDR A:0xf991d068
y.create.l HWIO_PERIPH_SS_BLSP1_BLSP_UART0_UART_DM_MISR_VAL_ADDR A:0xf991d06c
y.create.l HWIO_PERIPH_SS_BLSP1_BLSP_UART0_UART_DM_TF_RF_DEPRECATED_ADDR A:0xf991d070
y.create.l HWIO_PERIPH_SS_BLSP1_BLSP_UART0_UART_DM_TF_RF_2_DEPRECATED_ADDR A:0xf991d074
y.create.l HWIO_PERIPH_SS_BLSP1_BLSP_UART0_UART_DM_TF_RF_3_DEPRECATED_ADDR A:0xf991d078
y.create.l HWIO_PERIPH_SS_BLSP1_BLSP_UART0_UART_DM_TF_RF_4_DEPRECATED_ADDR A:0xf991d07c
y.create.l HWIO_PERIPH_SS_BLSP1_BLSP_UART0_UART_DM_SIM_CFG_ADDR A:0xf991d080
y.create.l HWIO_PERIPH_SS_BLSP1_BLSP_UART0_UART_DM_TEST_WR_ADDR_ADDR A:0xf991d084
y.create.l HWIO_PERIPH_SS_BLSP1_BLSP_UART0_UART_DM_TEST_WR_DATA_ADDR A:0xf991d088
y.create.l HWIO_PERIPH_SS_BLSP1_BLSP_UART0_UART_DM_TEST_RD_ADDR_ADDR A:0xf991d08c
y.create.l HWIO_PERIPH_SS_BLSP1_BLSP_UART0_UART_DM_TEST_RD_DATA_ADDR A:0xf991d090
y.create.l HWIO_PERIPH_SS_BLSP1_BLSP_UART0_UART_DM_CSR_ADDR A:0xf991d0a0
y.create.l HWIO_PERIPH_SS_BLSP1_BLSP_UART0_UART_DM_SR_ADDR A:0xf991d0a4
y.create.l HWIO_PERIPH_SS_BLSP1_BLSP_UART0_UART_DM_CR_ADDR A:0xf991d0a8
y.create.l HWIO_PERIPH_SS_BLSP1_BLSP_UART0_UART_DM_MISR_ADDR A:0xf991d0ac
y.create.l HWIO_PERIPH_SS_BLSP1_BLSP_UART0_UART_DM_IMR_ADDR A:0xf991d0b0
y.create.l HWIO_PERIPH_SS_BLSP1_BLSP_UART0_UART_DM_ISR_ADDR A:0xf991d0b4
y.create.l HWIO_PERIPH_SS_BLSP1_BLSP_UART0_UART_DM_IRDA_ADDR A:0xf991d0b8
y.create.l HWIO_PERIPH_SS_BLSP1_BLSP_UART0_UART_DM_RX_TOTAL_SNAP_ADDR A:0xf991d0bc
y.create.l HWIO_PERIPH_SS_BLSP1_BLSP_UART0_UART_DM_WWT_TIMEOUT_ADDR A:0xf991d0c0
y.create.l HWIO_PERIPH_SS_BLSP1_BLSP_UART0_UART_DM_CLK_CTRL_ADDR A:0xf991d0c4
y.create.l HWIO_PERIPH_SS_BLSP1_BLSP_UART0_UART_DM_BCR_ADDR A:0xf991d0c8
y.create.l HWIO_PERIPH_SS_BLSP1_BLSP_UART0_UART_DM_RX_TRANS_CTRL_ADDR A:0xf991d0cc
y.create.l HWIO_PERIPH_SS_BLSP1_BLSP_UART0_UART_DM_DMRX_DBG_ADDR A:0xf991d0d0
y.create.l HWIO_PERIPH_SS_BLSP1_BLSP_UART0_UART_DM_FSM_STATUS_ADDR A:0xf991d0d4
y.create.l HWIO_PERIPH_SS_BLSP1_BLSP_UART0_UART_DM_HW_VERSION_ADDR A:0xf991d0d8
y.create.l HWIO_PERIPH_SS_BLSP1_BLSP_UART0_UART_DM_GENERICS_ADDR A:0xf991d0dc
y.create.l HWIO_PERIPH_SS_BLSP1_BLSP_UART0_UART_DM_TF_ADDR A:0xf991d100
y.create.l HWIO_PERIPH_SS_BLSP1_BLSP_UART0_UART_DM_TF_2_ADDR A:0xf991d104
y.create.l HWIO_PERIPH_SS_BLSP1_BLSP_UART0_UART_DM_TF_3_ADDR A:0xf991d108
y.create.l HWIO_PERIPH_SS_BLSP1_BLSP_UART0_UART_DM_TF_4_ADDR A:0xf991d10c
y.create.l HWIO_PERIPH_SS_BLSP1_BLSP_UART0_UART_DM_TF_5_ADDR A:0xf991d110
y.create.l HWIO_PERIPH_SS_BLSP1_BLSP_UART0_UART_DM_TF_6_ADDR A:0xf991d114
y.create.l HWIO_PERIPH_SS_BLSP1_BLSP_UART0_UART_DM_TF_7_ADDR A:0xf991d118
y.create.l HWIO_PERIPH_SS_BLSP1_BLSP_UART0_UART_DM_TF_8_ADDR A:0xf991d11c
y.create.l HWIO_PERIPH_SS_BLSP1_BLSP_UART0_UART_DM_TF_9_ADDR A:0xf991d120
y.create.l HWIO_PERIPH_SS_BLSP1_BLSP_UART0_UART_DM_TF_10_ADDR A:0xf991d124
y.create.l HWIO_PERIPH_SS_BLSP1_BLSP_UART0_UART_DM_TF_11_ADDR A:0xf991d128
y.create.l HWIO_PERIPH_SS_BLSP1_BLSP_UART0_UART_DM_TF_12_ADDR A:0xf991d12c
y.create.l HWIO_PERIPH_SS_BLSP1_BLSP_UART0_UART_DM_TF_13_ADDR A:0xf991d130
y.create.l HWIO_PERIPH_SS_BLSP1_BLSP_UART0_UART_DM_TF_14_ADDR A:0xf991d134
y.create.l HWIO_PERIPH_SS_BLSP1_BLSP_UART0_UART_DM_TF_15_ADDR A:0xf991d138
y.create.l HWIO_PERIPH_SS_BLSP1_BLSP_UART0_UART_DM_TF_16_ADDR A:0xf991d13c
y.create.l HWIO_PERIPH_SS_BLSP1_BLSP_UART0_UART_DM_RF_ADDR A:0xf991d140
y.create.l HWIO_PERIPH_SS_BLSP1_BLSP_UART0_UART_DM_RF_2_ADDR A:0xf991d144
y.create.l HWIO_PERIPH_SS_BLSP1_BLSP_UART0_UART_DM_RF_3_ADDR A:0xf991d148
y.create.l HWIO_PERIPH_SS_BLSP1_BLSP_UART0_UART_DM_RF_4_ADDR A:0xf991d14c
y.create.l HWIO_PERIPH_SS_BLSP1_BLSP_UART0_UART_DM_RF_5_ADDR A:0xf991d150
y.create.l HWIO_PERIPH_SS_BLSP1_BLSP_UART0_UART_DM_RF_6_ADDR A:0xf991d154
y.create.l HWIO_PERIPH_SS_BLSP1_BLSP_UART0_UART_DM_RF_7_ADDR A:0xf991d158
y.create.l HWIO_PERIPH_SS_BLSP1_BLSP_UART0_UART_DM_RF_8_ADDR A:0xf991d15c
y.create.l HWIO_PERIPH_SS_BLSP1_BLSP_UART0_UART_DM_RF_9_ADDR A:0xf991d160
y.create.l HWIO_PERIPH_SS_BLSP1_BLSP_UART0_UART_DM_RF_10_ADDR A:0xf991d164
y.create.l HWIO_PERIPH_SS_BLSP1_BLSP_UART0_UART_DM_RF_11_ADDR A:0xf991d168
y.create.l HWIO_PERIPH_SS_BLSP1_BLSP_UART0_UART_DM_RF_12_ADDR A:0xf991d16c
y.create.l HWIO_PERIPH_SS_BLSP1_BLSP_UART0_UART_DM_RF_13_ADDR A:0xf991d170
y.create.l HWIO_PERIPH_SS_BLSP1_BLSP_UART0_UART_DM_RF_14_ADDR A:0xf991d174
y.create.l HWIO_PERIPH_SS_BLSP1_BLSP_UART0_UART_DM_RF_15_ADDR A:0xf991d178
y.create.l HWIO_PERIPH_SS_BLSP1_BLSP_UART0_UART_DM_RF_16_ADDR A:0xf991d17c
y.create.l HWIO_PERIPH_SS_BLSP1_BLSP_UART0_UART_DM_UIM_CFG_ADDR A:0xf991d180
y.create.l HWIO_PERIPH_SS_BLSP1_BLSP_UART0_UART_DM_UIM_CMD_ADDR A:0xf991d184
y.create.l HWIO_PERIPH_SS_BLSP1_BLSP_UART0_UART_DM_UIM_IO_STATUS_ADDR A:0xf991d188
y.create.l HWIO_PERIPH_SS_BLSP1_BLSP_UART0_UART_DM_UIM_IRQ_ISR_ADDR A:0xf991d18c
y.create.l HWIO_PERIPH_SS_BLSP1_BLSP_UART0_UART_DM_UIM_IRQ_MISR_ADDR A:0xf991d190
y.create.l HWIO_PERIPH_SS_BLSP1_BLSP_UART0_UART_DM_UIM_IRQ_CLR_ADDR A:0xf991d194
y.create.l HWIO_PERIPH_SS_BLSP1_BLSP_UART0_UART_DM_UIM_IRQ_IMR_ADDR A:0xf991d198
y.create.l HWIO_PERIPH_SS_BLSP1_BLSP_UART0_UART_DM_UIM_IRQ_IMR_SET_ADDR A:0xf991d19c
y.create.l HWIO_PERIPH_SS_BLSP1_BLSP_UART0_UART_DM_UIM_IRQ_IMR_CLR_ADDR A:0xf991d1a0
y.create.l HWIO_PERIPH_SS_BLSP1_BLSP_UART1_UART_DM_MR1_ADDR A:0xf991e000
y.create.l HWIO_PERIPH_SS_BLSP1_BLSP_UART1_UART_DM_MR2_ADDR A:0xf991e004
y.create.l HWIO_PERIPH_SS_BLSP1_BLSP_UART1_UART_DM_CSR_SR_DEPRECATED_ADDR A:0xf991e008
y.create.l HWIO_PERIPH_SS_BLSP1_BLSP_UART1_UART_DM_CR_MISR_DEPRECATED_ADDR A:0xf991e010
y.create.l HWIO_PERIPH_SS_BLSP1_BLSP_UART1_UART_DM_IMR_ISR_DEPRECATED_ADDR A:0xf991e014
y.create.l HWIO_PERIPH_SS_BLSP1_BLSP_UART1_UART_DM_IPR_ADDR A:0xf991e018
y.create.l HWIO_PERIPH_SS_BLSP1_BLSP_UART1_UART_DM_TFWR_ADDR A:0xf991e01c
y.create.l HWIO_PERIPH_SS_BLSP1_BLSP_UART1_UART_DM_RFWR_ADDR A:0xf991e020
y.create.l HWIO_PERIPH_SS_BLSP1_BLSP_UART1_UART_DM_HCR_ADDR A:0xf991e024
y.create.l HWIO_PERIPH_SS_BLSP1_BLSP_UART1_UART_DM_DMRX_ADDR A:0xf991e034
y.create.l HWIO_PERIPH_SS_BLSP1_BLSP_UART1_UART_DM_IRDA_RX_TOTAL_SNAP_DEPRECATED_ADDR A:0xf991e038
y.create.l HWIO_PERIPH_SS_BLSP1_BLSP_UART1_UART_DM_DMEN_ADDR A:0xf991e03c
y.create.l HWIO_PERIPH_SS_BLSP1_BLSP_UART1_UART_DM_NO_CHARS_FOR_TX_ADDR A:0xf991e040
y.create.l HWIO_PERIPH_SS_BLSP1_BLSP_UART1_UART_DM_BADR_ADDR A:0xf991e044
y.create.l HWIO_PERIPH_SS_BLSP1_BLSP_UART1_UART_DM_TESTSL_ADDR A:0xf991e048
y.create.l HWIO_PERIPH_SS_BLSP1_BLSP_UART1_UART_DM_TXFS_ADDR A:0xf991e04c
y.create.l HWIO_PERIPH_SS_BLSP1_BLSP_UART1_UART_DM_RXFS_ADDR A:0xf991e050
y.create.l HWIO_PERIPH_SS_BLSP1_BLSP_UART1_UART_DM_MISR_MODE_ADDR A:0xf991e060
y.create.l HWIO_PERIPH_SS_BLSP1_BLSP_UART1_UART_DM_MISR_RESET_ADDR A:0xf991e064
y.create.l HWIO_PERIPH_SS_BLSP1_BLSP_UART1_UART_DM_MISR_EXPORT_ADDR A:0xf991e068
y.create.l HWIO_PERIPH_SS_BLSP1_BLSP_UART1_UART_DM_MISR_VAL_ADDR A:0xf991e06c
y.create.l HWIO_PERIPH_SS_BLSP1_BLSP_UART1_UART_DM_TF_RF_DEPRECATED_ADDR A:0xf991e070
y.create.l HWIO_PERIPH_SS_BLSP1_BLSP_UART1_UART_DM_TF_RF_2_DEPRECATED_ADDR A:0xf991e074
y.create.l HWIO_PERIPH_SS_BLSP1_BLSP_UART1_UART_DM_TF_RF_3_DEPRECATED_ADDR A:0xf991e078
y.create.l HWIO_PERIPH_SS_BLSP1_BLSP_UART1_UART_DM_TF_RF_4_DEPRECATED_ADDR A:0xf991e07c
y.create.l HWIO_PERIPH_SS_BLSP1_BLSP_UART1_UART_DM_SIM_CFG_ADDR A:0xf991e080
y.create.l HWIO_PERIPH_SS_BLSP1_BLSP_UART1_UART_DM_TEST_WR_ADDR_ADDR A:0xf991e084
y.create.l HWIO_PERIPH_SS_BLSP1_BLSP_UART1_UART_DM_TEST_WR_DATA_ADDR A:0xf991e088
y.create.l HWIO_PERIPH_SS_BLSP1_BLSP_UART1_UART_DM_TEST_RD_ADDR_ADDR A:0xf991e08c
y.create.l HWIO_PERIPH_SS_BLSP1_BLSP_UART1_UART_DM_TEST_RD_DATA_ADDR A:0xf991e090
y.create.l HWIO_PERIPH_SS_BLSP1_BLSP_UART1_UART_DM_CSR_ADDR A:0xf991e0a0
y.create.l HWIO_PERIPH_SS_BLSP1_BLSP_UART1_UART_DM_SR_ADDR A:0xf991e0a4
y.create.l HWIO_PERIPH_SS_BLSP1_BLSP_UART1_UART_DM_CR_ADDR A:0xf991e0a8
y.create.l HWIO_PERIPH_SS_BLSP1_BLSP_UART1_UART_DM_MISR_ADDR A:0xf991e0ac
y.create.l HWIO_PERIPH_SS_BLSP1_BLSP_UART1_UART_DM_IMR_ADDR A:0xf991e0b0
y.create.l HWIO_PERIPH_SS_BLSP1_BLSP_UART1_UART_DM_ISR_ADDR A:0xf991e0b4
y.create.l HWIO_PERIPH_SS_BLSP1_BLSP_UART1_UART_DM_IRDA_ADDR A:0xf991e0b8
y.create.l HWIO_PERIPH_SS_BLSP1_BLSP_UART1_UART_DM_RX_TOTAL_SNAP_ADDR A:0xf991e0bc
y.create.l HWIO_PERIPH_SS_BLSP1_BLSP_UART1_UART_DM_WWT_TIMEOUT_ADDR A:0xf991e0c0
y.create.l HWIO_PERIPH_SS_BLSP1_BLSP_UART1_UART_DM_CLK_CTRL_ADDR A:0xf991e0c4
y.create.l HWIO_PERIPH_SS_BLSP1_BLSP_UART1_UART_DM_BCR_ADDR A:0xf991e0c8
y.create.l HWIO_PERIPH_SS_BLSP1_BLSP_UART1_UART_DM_RX_TRANS_CTRL_ADDR A:0xf991e0cc
y.create.l HWIO_PERIPH_SS_BLSP1_BLSP_UART1_UART_DM_DMRX_DBG_ADDR A:0xf991e0d0
y.create.l HWIO_PERIPH_SS_BLSP1_BLSP_UART1_UART_DM_FSM_STATUS_ADDR A:0xf991e0d4
y.create.l HWIO_PERIPH_SS_BLSP1_BLSP_UART1_UART_DM_HW_VERSION_ADDR A:0xf991e0d8
y.create.l HWIO_PERIPH_SS_BLSP1_BLSP_UART1_UART_DM_GENERICS_ADDR A:0xf991e0dc
y.create.l HWIO_PERIPH_SS_BLSP1_BLSP_UART1_UART_DM_TF_ADDR A:0xf991e100
y.create.l HWIO_PERIPH_SS_BLSP1_BLSP_UART1_UART_DM_TF_2_ADDR A:0xf991e104
y.create.l HWIO_PERIPH_SS_BLSP1_BLSP_UART1_UART_DM_TF_3_ADDR A:0xf991e108
y.create.l HWIO_PERIPH_SS_BLSP1_BLSP_UART1_UART_DM_TF_4_ADDR A:0xf991e10c
y.create.l HWIO_PERIPH_SS_BLSP1_BLSP_UART1_UART_DM_TF_5_ADDR A:0xf991e110
y.create.l HWIO_PERIPH_SS_BLSP1_BLSP_UART1_UART_DM_TF_6_ADDR A:0xf991e114
y.create.l HWIO_PERIPH_SS_BLSP1_BLSP_UART1_UART_DM_TF_7_ADDR A:0xf991e118
y.create.l HWIO_PERIPH_SS_BLSP1_BLSP_UART1_UART_DM_TF_8_ADDR A:0xf991e11c
y.create.l HWIO_PERIPH_SS_BLSP1_BLSP_UART1_UART_DM_TF_9_ADDR A:0xf991e120
y.create.l HWIO_PERIPH_SS_BLSP1_BLSP_UART1_UART_DM_TF_10_ADDR A:0xf991e124
y.create.l HWIO_PERIPH_SS_BLSP1_BLSP_UART1_UART_DM_TF_11_ADDR A:0xf991e128
y.create.l HWIO_PERIPH_SS_BLSP1_BLSP_UART1_UART_DM_TF_12_ADDR A:0xf991e12c
y.create.l HWIO_PERIPH_SS_BLSP1_BLSP_UART1_UART_DM_TF_13_ADDR A:0xf991e130
y.create.l HWIO_PERIPH_SS_BLSP1_BLSP_UART1_UART_DM_TF_14_ADDR A:0xf991e134
y.create.l HWIO_PERIPH_SS_BLSP1_BLSP_UART1_UART_DM_TF_15_ADDR A:0xf991e138
y.create.l HWIO_PERIPH_SS_BLSP1_BLSP_UART1_UART_DM_TF_16_ADDR A:0xf991e13c
y.create.l HWIO_PERIPH_SS_BLSP1_BLSP_UART1_UART_DM_RF_ADDR A:0xf991e140
y.create.l HWIO_PERIPH_SS_BLSP1_BLSP_UART1_UART_DM_RF_2_ADDR A:0xf991e144
y.create.l HWIO_PERIPH_SS_BLSP1_BLSP_UART1_UART_DM_RF_3_ADDR A:0xf991e148
y.create.l HWIO_PERIPH_SS_BLSP1_BLSP_UART1_UART_DM_RF_4_ADDR A:0xf991e14c
y.create.l HWIO_PERIPH_SS_BLSP1_BLSP_UART1_UART_DM_RF_5_ADDR A:0xf991e150
y.create.l HWIO_PERIPH_SS_BLSP1_BLSP_UART1_UART_DM_RF_6_ADDR A:0xf991e154
y.create.l HWIO_PERIPH_SS_BLSP1_BLSP_UART1_UART_DM_RF_7_ADDR A:0xf991e158
y.create.l HWIO_PERIPH_SS_BLSP1_BLSP_UART1_UART_DM_RF_8_ADDR A:0xf991e15c
y.create.l HWIO_PERIPH_SS_BLSP1_BLSP_UART1_UART_DM_RF_9_ADDR A:0xf991e160
y.create.l HWIO_PERIPH_SS_BLSP1_BLSP_UART1_UART_DM_RF_10_ADDR A:0xf991e164
y.create.l HWIO_PERIPH_SS_BLSP1_BLSP_UART1_UART_DM_RF_11_ADDR A:0xf991e168
y.create.l HWIO_PERIPH_SS_BLSP1_BLSP_UART1_UART_DM_RF_12_ADDR A:0xf991e16c
y.create.l HWIO_PERIPH_SS_BLSP1_BLSP_UART1_UART_DM_RF_13_ADDR A:0xf991e170
y.create.l HWIO_PERIPH_SS_BLSP1_BLSP_UART1_UART_DM_RF_14_ADDR A:0xf991e174
y.create.l HWIO_PERIPH_SS_BLSP1_BLSP_UART1_UART_DM_RF_15_ADDR A:0xf991e178
y.create.l HWIO_PERIPH_SS_BLSP1_BLSP_UART1_UART_DM_RF_16_ADDR A:0xf991e17c
y.create.l HWIO_PERIPH_SS_BLSP1_BLSP_UART1_UART_DM_UIM_CFG_ADDR A:0xf991e180
y.create.l HWIO_PERIPH_SS_BLSP1_BLSP_UART1_UART_DM_UIM_CMD_ADDR A:0xf991e184
y.create.l HWIO_PERIPH_SS_BLSP1_BLSP_UART1_UART_DM_UIM_IO_STATUS_ADDR A:0xf991e188
y.create.l HWIO_PERIPH_SS_BLSP1_BLSP_UART1_UART_DM_UIM_IRQ_ISR_ADDR A:0xf991e18c
y.create.l HWIO_PERIPH_SS_BLSP1_BLSP_UART1_UART_DM_UIM_IRQ_MISR_ADDR A:0xf991e190
y.create.l HWIO_PERIPH_SS_BLSP1_BLSP_UART1_UART_DM_UIM_IRQ_CLR_ADDR A:0xf991e194
y.create.l HWIO_PERIPH_SS_BLSP1_BLSP_UART1_UART_DM_UIM_IRQ_IMR_ADDR A:0xf991e198
y.create.l HWIO_PERIPH_SS_BLSP1_BLSP_UART1_UART_DM_UIM_IRQ_IMR_SET_ADDR A:0xf991e19c
y.create.l HWIO_PERIPH_SS_BLSP1_BLSP_UART1_UART_DM_UIM_IRQ_IMR_CLR_ADDR A:0xf991e1a0
y.create.l HWIO_PERIPH_SS_BLSP1_BLSP_UART2_UART_DM_MR1_ADDR A:0xf991f000
y.create.l HWIO_PERIPH_SS_BLSP1_BLSP_UART2_UART_DM_MR2_ADDR A:0xf991f004
y.create.l HWIO_PERIPH_SS_BLSP1_BLSP_UART2_UART_DM_CSR_SR_DEPRECATED_ADDR A:0xf991f008
y.create.l HWIO_PERIPH_SS_BLSP1_BLSP_UART2_UART_DM_CR_MISR_DEPRECATED_ADDR A:0xf991f010
y.create.l HWIO_PERIPH_SS_BLSP1_BLSP_UART2_UART_DM_IMR_ISR_DEPRECATED_ADDR A:0xf991f014
y.create.l HWIO_PERIPH_SS_BLSP1_BLSP_UART2_UART_DM_IPR_ADDR A:0xf991f018
y.create.l HWIO_PERIPH_SS_BLSP1_BLSP_UART2_UART_DM_TFWR_ADDR A:0xf991f01c
y.create.l HWIO_PERIPH_SS_BLSP1_BLSP_UART2_UART_DM_RFWR_ADDR A:0xf991f020
y.create.l HWIO_PERIPH_SS_BLSP1_BLSP_UART2_UART_DM_HCR_ADDR A:0xf991f024
y.create.l HWIO_PERIPH_SS_BLSP1_BLSP_UART2_UART_DM_DMRX_ADDR A:0xf991f034
y.create.l HWIO_PERIPH_SS_BLSP1_BLSP_UART2_UART_DM_IRDA_RX_TOTAL_SNAP_DEPRECATED_ADDR A:0xf991f038
y.create.l HWIO_PERIPH_SS_BLSP1_BLSP_UART2_UART_DM_DMEN_ADDR A:0xf991f03c
y.create.l HWIO_PERIPH_SS_BLSP1_BLSP_UART2_UART_DM_NO_CHARS_FOR_TX_ADDR A:0xf991f040
y.create.l HWIO_PERIPH_SS_BLSP1_BLSP_UART2_UART_DM_BADR_ADDR A:0xf991f044
y.create.l HWIO_PERIPH_SS_BLSP1_BLSP_UART2_UART_DM_TESTSL_ADDR A:0xf991f048
y.create.l HWIO_PERIPH_SS_BLSP1_BLSP_UART2_UART_DM_TXFS_ADDR A:0xf991f04c
y.create.l HWIO_PERIPH_SS_BLSP1_BLSP_UART2_UART_DM_RXFS_ADDR A:0xf991f050
y.create.l HWIO_PERIPH_SS_BLSP1_BLSP_UART2_UART_DM_MISR_MODE_ADDR A:0xf991f060
y.create.l HWIO_PERIPH_SS_BLSP1_BLSP_UART2_UART_DM_MISR_RESET_ADDR A:0xf991f064
y.create.l HWIO_PERIPH_SS_BLSP1_BLSP_UART2_UART_DM_MISR_EXPORT_ADDR A:0xf991f068
y.create.l HWIO_PERIPH_SS_BLSP1_BLSP_UART2_UART_DM_MISR_VAL_ADDR A:0xf991f06c
y.create.l HWIO_PERIPH_SS_BLSP1_BLSP_UART2_UART_DM_TF_RF_DEPRECATED_ADDR A:0xf991f070
y.create.l HWIO_PERIPH_SS_BLSP1_BLSP_UART2_UART_DM_TF_RF_2_DEPRECATED_ADDR A:0xf991f074
y.create.l HWIO_PERIPH_SS_BLSP1_BLSP_UART2_UART_DM_TF_RF_3_DEPRECATED_ADDR A:0xf991f078
y.create.l HWIO_PERIPH_SS_BLSP1_BLSP_UART2_UART_DM_TF_RF_4_DEPRECATED_ADDR A:0xf991f07c
y.create.l HWIO_PERIPH_SS_BLSP1_BLSP_UART2_UART_DM_SIM_CFG_ADDR A:0xf991f080
y.create.l HWIO_PERIPH_SS_BLSP1_BLSP_UART2_UART_DM_TEST_WR_ADDR_ADDR A:0xf991f084
y.create.l HWIO_PERIPH_SS_BLSP1_BLSP_UART2_UART_DM_TEST_WR_DATA_ADDR A:0xf991f088
y.create.l HWIO_PERIPH_SS_BLSP1_BLSP_UART2_UART_DM_TEST_RD_ADDR_ADDR A:0xf991f08c
y.create.l HWIO_PERIPH_SS_BLSP1_BLSP_UART2_UART_DM_TEST_RD_DATA_ADDR A:0xf991f090
y.create.l HWIO_PERIPH_SS_BLSP1_BLSP_UART2_UART_DM_CSR_ADDR A:0xf991f0a0
y.create.l HWIO_PERIPH_SS_BLSP1_BLSP_UART2_UART_DM_SR_ADDR A:0xf991f0a4
y.create.l HWIO_PERIPH_SS_BLSP1_BLSP_UART2_UART_DM_CR_ADDR A:0xf991f0a8
y.create.l HWIO_PERIPH_SS_BLSP1_BLSP_UART2_UART_DM_MISR_ADDR A:0xf991f0ac
y.create.l HWIO_PERIPH_SS_BLSP1_BLSP_UART2_UART_DM_IMR_ADDR A:0xf991f0b0
y.create.l HWIO_PERIPH_SS_BLSP1_BLSP_UART2_UART_DM_ISR_ADDR A:0xf991f0b4
y.create.l HWIO_PERIPH_SS_BLSP1_BLSP_UART2_UART_DM_IRDA_ADDR A:0xf991f0b8
y.create.l HWIO_PERIPH_SS_BLSP1_BLSP_UART2_UART_DM_RX_TOTAL_SNAP_ADDR A:0xf991f0bc
y.create.l HWIO_PERIPH_SS_BLSP1_BLSP_UART2_UART_DM_WWT_TIMEOUT_ADDR A:0xf991f0c0
y.create.l HWIO_PERIPH_SS_BLSP1_BLSP_UART2_UART_DM_CLK_CTRL_ADDR A:0xf991f0c4
y.create.l HWIO_PERIPH_SS_BLSP1_BLSP_UART2_UART_DM_BCR_ADDR A:0xf991f0c8
y.create.l HWIO_PERIPH_SS_BLSP1_BLSP_UART2_UART_DM_RX_TRANS_CTRL_ADDR A:0xf991f0cc
y.create.l HWIO_PERIPH_SS_BLSP1_BLSP_UART2_UART_DM_DMRX_DBG_ADDR A:0xf991f0d0
y.create.l HWIO_PERIPH_SS_BLSP1_BLSP_UART2_UART_DM_FSM_STATUS_ADDR A:0xf991f0d4
y.create.l HWIO_PERIPH_SS_BLSP1_BLSP_UART2_UART_DM_HW_VERSION_ADDR A:0xf991f0d8
y.create.l HWIO_PERIPH_SS_BLSP1_BLSP_UART2_UART_DM_GENERICS_ADDR A:0xf991f0dc
y.create.l HWIO_PERIPH_SS_BLSP1_BLSP_UART2_UART_DM_TF_ADDR A:0xf991f100
y.create.l HWIO_PERIPH_SS_BLSP1_BLSP_UART2_UART_DM_TF_2_ADDR A:0xf991f104
y.create.l HWIO_PERIPH_SS_BLSP1_BLSP_UART2_UART_DM_TF_3_ADDR A:0xf991f108
y.create.l HWIO_PERIPH_SS_BLSP1_BLSP_UART2_UART_DM_TF_4_ADDR A:0xf991f10c
y.create.l HWIO_PERIPH_SS_BLSP1_BLSP_UART2_UART_DM_TF_5_ADDR A:0xf991f110
y.create.l HWIO_PERIPH_SS_BLSP1_BLSP_UART2_UART_DM_TF_6_ADDR A:0xf991f114
y.create.l HWIO_PERIPH_SS_BLSP1_BLSP_UART2_UART_DM_TF_7_ADDR A:0xf991f118
y.create.l HWIO_PERIPH_SS_BLSP1_BLSP_UART2_UART_DM_TF_8_ADDR A:0xf991f11c
y.create.l HWIO_PERIPH_SS_BLSP1_BLSP_UART2_UART_DM_TF_9_ADDR A:0xf991f120
y.create.l HWIO_PERIPH_SS_BLSP1_BLSP_UART2_UART_DM_TF_10_ADDR A:0xf991f124
y.create.l HWIO_PERIPH_SS_BLSP1_BLSP_UART2_UART_DM_TF_11_ADDR A:0xf991f128
y.create.l HWIO_PERIPH_SS_BLSP1_BLSP_UART2_UART_DM_TF_12_ADDR A:0xf991f12c
y.create.l HWIO_PERIPH_SS_BLSP1_BLSP_UART2_UART_DM_TF_13_ADDR A:0xf991f130
y.create.l HWIO_PERIPH_SS_BLSP1_BLSP_UART2_UART_DM_TF_14_ADDR A:0xf991f134
y.create.l HWIO_PERIPH_SS_BLSP1_BLSP_UART2_UART_DM_TF_15_ADDR A:0xf991f138
y.create.l HWIO_PERIPH_SS_BLSP1_BLSP_UART2_UART_DM_TF_16_ADDR A:0xf991f13c
y.create.l HWIO_PERIPH_SS_BLSP1_BLSP_UART2_UART_DM_RF_ADDR A:0xf991f140
y.create.l HWIO_PERIPH_SS_BLSP1_BLSP_UART2_UART_DM_RF_2_ADDR A:0xf991f144
y.create.l HWIO_PERIPH_SS_BLSP1_BLSP_UART2_UART_DM_RF_3_ADDR A:0xf991f148
y.create.l HWIO_PERIPH_SS_BLSP1_BLSP_UART2_UART_DM_RF_4_ADDR A:0xf991f14c
y.create.l HWIO_PERIPH_SS_BLSP1_BLSP_UART2_UART_DM_RF_5_ADDR A:0xf991f150
y.create.l HWIO_PERIPH_SS_BLSP1_BLSP_UART2_UART_DM_RF_6_ADDR A:0xf991f154
y.create.l HWIO_PERIPH_SS_BLSP1_BLSP_UART2_UART_DM_RF_7_ADDR A:0xf991f158
y.create.l HWIO_PERIPH_SS_BLSP1_BLSP_UART2_UART_DM_RF_8_ADDR A:0xf991f15c
y.create.l HWIO_PERIPH_SS_BLSP1_BLSP_UART2_UART_DM_RF_9_ADDR A:0xf991f160
y.create.l HWIO_PERIPH_SS_BLSP1_BLSP_UART2_UART_DM_RF_10_ADDR A:0xf991f164
y.create.l HWIO_PERIPH_SS_BLSP1_BLSP_UART2_UART_DM_RF_11_ADDR A:0xf991f168
y.create.l HWIO_PERIPH_SS_BLSP1_BLSP_UART2_UART_DM_RF_12_ADDR A:0xf991f16c
y.create.l HWIO_PERIPH_SS_BLSP1_BLSP_UART2_UART_DM_RF_13_ADDR A:0xf991f170
y.create.l HWIO_PERIPH_SS_BLSP1_BLSP_UART2_UART_DM_RF_14_ADDR A:0xf991f174
y.create.l HWIO_PERIPH_SS_BLSP1_BLSP_UART2_UART_DM_RF_15_ADDR A:0xf991f178
y.create.l HWIO_PERIPH_SS_BLSP1_BLSP_UART2_UART_DM_RF_16_ADDR A:0xf991f17c
y.create.l HWIO_PERIPH_SS_BLSP1_BLSP_UART2_UART_DM_UIM_CFG_ADDR A:0xf991f180
y.create.l HWIO_PERIPH_SS_BLSP1_BLSP_UART2_UART_DM_UIM_CMD_ADDR A:0xf991f184
y.create.l HWIO_PERIPH_SS_BLSP1_BLSP_UART2_UART_DM_UIM_IO_STATUS_ADDR A:0xf991f188
y.create.l HWIO_PERIPH_SS_BLSP1_BLSP_UART2_UART_DM_UIM_IRQ_ISR_ADDR A:0xf991f18c
y.create.l HWIO_PERIPH_SS_BLSP1_BLSP_UART2_UART_DM_UIM_IRQ_MISR_ADDR A:0xf991f190
y.create.l HWIO_PERIPH_SS_BLSP1_BLSP_UART2_UART_DM_UIM_IRQ_CLR_ADDR A:0xf991f194
y.create.l HWIO_PERIPH_SS_BLSP1_BLSP_UART2_UART_DM_UIM_IRQ_IMR_ADDR A:0xf991f198
y.create.l HWIO_PERIPH_SS_BLSP1_BLSP_UART2_UART_DM_UIM_IRQ_IMR_SET_ADDR A:0xf991f19c
y.create.l HWIO_PERIPH_SS_BLSP1_BLSP_UART2_UART_DM_UIM_IRQ_IMR_CLR_ADDR A:0xf991f1a0
y.create.l HWIO_PERIPH_SS_BLSP1_BLSP_UART3_UART_DM_MR1_ADDR A:0xf9920000
y.create.l HWIO_PERIPH_SS_BLSP1_BLSP_UART3_UART_DM_MR2_ADDR A:0xf9920004
y.create.l HWIO_PERIPH_SS_BLSP1_BLSP_UART3_UART_DM_CSR_SR_DEPRECATED_ADDR A:0xf9920008
y.create.l HWIO_PERIPH_SS_BLSP1_BLSP_UART3_UART_DM_CR_MISR_DEPRECATED_ADDR A:0xf9920010
y.create.l HWIO_PERIPH_SS_BLSP1_BLSP_UART3_UART_DM_IMR_ISR_DEPRECATED_ADDR A:0xf9920014
y.create.l HWIO_PERIPH_SS_BLSP1_BLSP_UART3_UART_DM_IPR_ADDR A:0xf9920018
y.create.l HWIO_PERIPH_SS_BLSP1_BLSP_UART3_UART_DM_TFWR_ADDR A:0xf992001c
y.create.l HWIO_PERIPH_SS_BLSP1_BLSP_UART3_UART_DM_RFWR_ADDR A:0xf9920020
y.create.l HWIO_PERIPH_SS_BLSP1_BLSP_UART3_UART_DM_HCR_ADDR A:0xf9920024
y.create.l HWIO_PERIPH_SS_BLSP1_BLSP_UART3_UART_DM_DMRX_ADDR A:0xf9920034
y.create.l HWIO_PERIPH_SS_BLSP1_BLSP_UART3_UART_DM_IRDA_RX_TOTAL_SNAP_DEPRECATED_ADDR A:0xf9920038
y.create.l HWIO_PERIPH_SS_BLSP1_BLSP_UART3_UART_DM_DMEN_ADDR A:0xf992003c
y.create.l HWIO_PERIPH_SS_BLSP1_BLSP_UART3_UART_DM_NO_CHARS_FOR_TX_ADDR A:0xf9920040
y.create.l HWIO_PERIPH_SS_BLSP1_BLSP_UART3_UART_DM_BADR_ADDR A:0xf9920044
y.create.l HWIO_PERIPH_SS_BLSP1_BLSP_UART3_UART_DM_TESTSL_ADDR A:0xf9920048
y.create.l HWIO_PERIPH_SS_BLSP1_BLSP_UART3_UART_DM_TXFS_ADDR A:0xf992004c
y.create.l HWIO_PERIPH_SS_BLSP1_BLSP_UART3_UART_DM_RXFS_ADDR A:0xf9920050
y.create.l HWIO_PERIPH_SS_BLSP1_BLSP_UART3_UART_DM_MISR_MODE_ADDR A:0xf9920060
y.create.l HWIO_PERIPH_SS_BLSP1_BLSP_UART3_UART_DM_MISR_RESET_ADDR A:0xf9920064
y.create.l HWIO_PERIPH_SS_BLSP1_BLSP_UART3_UART_DM_MISR_EXPORT_ADDR A:0xf9920068
y.create.l HWIO_PERIPH_SS_BLSP1_BLSP_UART3_UART_DM_MISR_VAL_ADDR A:0xf992006c
y.create.l HWIO_PERIPH_SS_BLSP1_BLSP_UART3_UART_DM_TF_RF_DEPRECATED_ADDR A:0xf9920070
y.create.l HWIO_PERIPH_SS_BLSP1_BLSP_UART3_UART_DM_TF_RF_2_DEPRECATED_ADDR A:0xf9920074
y.create.l HWIO_PERIPH_SS_BLSP1_BLSP_UART3_UART_DM_TF_RF_3_DEPRECATED_ADDR A:0xf9920078
y.create.l HWIO_PERIPH_SS_BLSP1_BLSP_UART3_UART_DM_TF_RF_4_DEPRECATED_ADDR A:0xf992007c
y.create.l HWIO_PERIPH_SS_BLSP1_BLSP_UART3_UART_DM_SIM_CFG_ADDR A:0xf9920080
y.create.l HWIO_PERIPH_SS_BLSP1_BLSP_UART3_UART_DM_TEST_WR_ADDR_ADDR A:0xf9920084
y.create.l HWIO_PERIPH_SS_BLSP1_BLSP_UART3_UART_DM_TEST_WR_DATA_ADDR A:0xf9920088
y.create.l HWIO_PERIPH_SS_BLSP1_BLSP_UART3_UART_DM_TEST_RD_ADDR_ADDR A:0xf992008c
y.create.l HWIO_PERIPH_SS_BLSP1_BLSP_UART3_UART_DM_TEST_RD_DATA_ADDR A:0xf9920090
y.create.l HWIO_PERIPH_SS_BLSP1_BLSP_UART3_UART_DM_CSR_ADDR A:0xf99200a0
y.create.l HWIO_PERIPH_SS_BLSP1_BLSP_UART3_UART_DM_SR_ADDR A:0xf99200a4
y.create.l HWIO_PERIPH_SS_BLSP1_BLSP_UART3_UART_DM_CR_ADDR A:0xf99200a8
y.create.l HWIO_PERIPH_SS_BLSP1_BLSP_UART3_UART_DM_MISR_ADDR A:0xf99200ac
y.create.l HWIO_PERIPH_SS_BLSP1_BLSP_UART3_UART_DM_IMR_ADDR A:0xf99200b0
y.create.l HWIO_PERIPH_SS_BLSP1_BLSP_UART3_UART_DM_ISR_ADDR A:0xf99200b4
y.create.l HWIO_PERIPH_SS_BLSP1_BLSP_UART3_UART_DM_IRDA_ADDR A:0xf99200b8
y.create.l HWIO_PERIPH_SS_BLSP1_BLSP_UART3_UART_DM_RX_TOTAL_SNAP_ADDR A:0xf99200bc
y.create.l HWIO_PERIPH_SS_BLSP1_BLSP_UART3_UART_DM_WWT_TIMEOUT_ADDR A:0xf99200c0
y.create.l HWIO_PERIPH_SS_BLSP1_BLSP_UART3_UART_DM_CLK_CTRL_ADDR A:0xf99200c4
y.create.l HWIO_PERIPH_SS_BLSP1_BLSP_UART3_UART_DM_BCR_ADDR A:0xf99200c8
y.create.l HWIO_PERIPH_SS_BLSP1_BLSP_UART3_UART_DM_RX_TRANS_CTRL_ADDR A:0xf99200cc
y.create.l HWIO_PERIPH_SS_BLSP1_BLSP_UART3_UART_DM_DMRX_DBG_ADDR A:0xf99200d0
y.create.l HWIO_PERIPH_SS_BLSP1_BLSP_UART3_UART_DM_FSM_STATUS_ADDR A:0xf99200d4
y.create.l HWIO_PERIPH_SS_BLSP1_BLSP_UART3_UART_DM_HW_VERSION_ADDR A:0xf99200d8
y.create.l HWIO_PERIPH_SS_BLSP1_BLSP_UART3_UART_DM_GENERICS_ADDR A:0xf99200dc
y.create.l HWIO_PERIPH_SS_BLSP1_BLSP_UART3_UART_DM_TF_ADDR A:0xf9920100
y.create.l HWIO_PERIPH_SS_BLSP1_BLSP_UART3_UART_DM_TF_2_ADDR A:0xf9920104
y.create.l HWIO_PERIPH_SS_BLSP1_BLSP_UART3_UART_DM_TF_3_ADDR A:0xf9920108
y.create.l HWIO_PERIPH_SS_BLSP1_BLSP_UART3_UART_DM_TF_4_ADDR A:0xf992010c
y.create.l HWIO_PERIPH_SS_BLSP1_BLSP_UART3_UART_DM_TF_5_ADDR A:0xf9920110
y.create.l HWIO_PERIPH_SS_BLSP1_BLSP_UART3_UART_DM_TF_6_ADDR A:0xf9920114
y.create.l HWIO_PERIPH_SS_BLSP1_BLSP_UART3_UART_DM_TF_7_ADDR A:0xf9920118
y.create.l HWIO_PERIPH_SS_BLSP1_BLSP_UART3_UART_DM_TF_8_ADDR A:0xf992011c
y.create.l HWIO_PERIPH_SS_BLSP1_BLSP_UART3_UART_DM_TF_9_ADDR A:0xf9920120
y.create.l HWIO_PERIPH_SS_BLSP1_BLSP_UART3_UART_DM_TF_10_ADDR A:0xf9920124
y.create.l HWIO_PERIPH_SS_BLSP1_BLSP_UART3_UART_DM_TF_11_ADDR A:0xf9920128
y.create.l HWIO_PERIPH_SS_BLSP1_BLSP_UART3_UART_DM_TF_12_ADDR A:0xf992012c
y.create.l HWIO_PERIPH_SS_BLSP1_BLSP_UART3_UART_DM_TF_13_ADDR A:0xf9920130
y.create.l HWIO_PERIPH_SS_BLSP1_BLSP_UART3_UART_DM_TF_14_ADDR A:0xf9920134
y.create.l HWIO_PERIPH_SS_BLSP1_BLSP_UART3_UART_DM_TF_15_ADDR A:0xf9920138
y.create.l HWIO_PERIPH_SS_BLSP1_BLSP_UART3_UART_DM_TF_16_ADDR A:0xf992013c
y.create.l HWIO_PERIPH_SS_BLSP1_BLSP_UART3_UART_DM_RF_ADDR A:0xf9920140
y.create.l HWIO_PERIPH_SS_BLSP1_BLSP_UART3_UART_DM_RF_2_ADDR A:0xf9920144
y.create.l HWIO_PERIPH_SS_BLSP1_BLSP_UART3_UART_DM_RF_3_ADDR A:0xf9920148
y.create.l HWIO_PERIPH_SS_BLSP1_BLSP_UART3_UART_DM_RF_4_ADDR A:0xf992014c
y.create.l HWIO_PERIPH_SS_BLSP1_BLSP_UART3_UART_DM_RF_5_ADDR A:0xf9920150
y.create.l HWIO_PERIPH_SS_BLSP1_BLSP_UART3_UART_DM_RF_6_ADDR A:0xf9920154
y.create.l HWIO_PERIPH_SS_BLSP1_BLSP_UART3_UART_DM_RF_7_ADDR A:0xf9920158
y.create.l HWIO_PERIPH_SS_BLSP1_BLSP_UART3_UART_DM_RF_8_ADDR A:0xf992015c
y.create.l HWIO_PERIPH_SS_BLSP1_BLSP_UART3_UART_DM_RF_9_ADDR A:0xf9920160
y.create.l HWIO_PERIPH_SS_BLSP1_BLSP_UART3_UART_DM_RF_10_ADDR A:0xf9920164
y.create.l HWIO_PERIPH_SS_BLSP1_BLSP_UART3_UART_DM_RF_11_ADDR A:0xf9920168
y.create.l HWIO_PERIPH_SS_BLSP1_BLSP_UART3_UART_DM_RF_12_ADDR A:0xf992016c
y.create.l HWIO_PERIPH_SS_BLSP1_BLSP_UART3_UART_DM_RF_13_ADDR A:0xf9920170
y.create.l HWIO_PERIPH_SS_BLSP1_BLSP_UART3_UART_DM_RF_14_ADDR A:0xf9920174
y.create.l HWIO_PERIPH_SS_BLSP1_BLSP_UART3_UART_DM_RF_15_ADDR A:0xf9920178
y.create.l HWIO_PERIPH_SS_BLSP1_BLSP_UART3_UART_DM_RF_16_ADDR A:0xf992017c
y.create.l HWIO_PERIPH_SS_BLSP1_BLSP_UART3_UART_DM_UIM_CFG_ADDR A:0xf9920180
y.create.l HWIO_PERIPH_SS_BLSP1_BLSP_UART3_UART_DM_UIM_CMD_ADDR A:0xf9920184
y.create.l HWIO_PERIPH_SS_BLSP1_BLSP_UART3_UART_DM_UIM_IO_STATUS_ADDR A:0xf9920188
y.create.l HWIO_PERIPH_SS_BLSP1_BLSP_UART3_UART_DM_UIM_IRQ_ISR_ADDR A:0xf992018c
y.create.l HWIO_PERIPH_SS_BLSP1_BLSP_UART3_UART_DM_UIM_IRQ_MISR_ADDR A:0xf9920190
y.create.l HWIO_PERIPH_SS_BLSP1_BLSP_UART3_UART_DM_UIM_IRQ_CLR_ADDR A:0xf9920194
y.create.l HWIO_PERIPH_SS_BLSP1_BLSP_UART3_UART_DM_UIM_IRQ_IMR_ADDR A:0xf9920198
y.create.l HWIO_PERIPH_SS_BLSP1_BLSP_UART3_UART_DM_UIM_IRQ_IMR_SET_ADDR A:0xf992019c
y.create.l HWIO_PERIPH_SS_BLSP1_BLSP_UART3_UART_DM_UIM_IRQ_IMR_CLR_ADDR A:0xf99201a0
y.create.l HWIO_PERIPH_SS_BLSP1_BLSP_UART4_UART_DM_MR1_ADDR A:0xf9921000
y.create.l HWIO_PERIPH_SS_BLSP1_BLSP_UART4_UART_DM_MR2_ADDR A:0xf9921004
y.create.l HWIO_PERIPH_SS_BLSP1_BLSP_UART4_UART_DM_CSR_SR_DEPRECATED_ADDR A:0xf9921008
y.create.l HWIO_PERIPH_SS_BLSP1_BLSP_UART4_UART_DM_CR_MISR_DEPRECATED_ADDR A:0xf9921010
y.create.l HWIO_PERIPH_SS_BLSP1_BLSP_UART4_UART_DM_IMR_ISR_DEPRECATED_ADDR A:0xf9921014
y.create.l HWIO_PERIPH_SS_BLSP1_BLSP_UART4_UART_DM_IPR_ADDR A:0xf9921018
y.create.l HWIO_PERIPH_SS_BLSP1_BLSP_UART4_UART_DM_TFWR_ADDR A:0xf992101c
y.create.l HWIO_PERIPH_SS_BLSP1_BLSP_UART4_UART_DM_RFWR_ADDR A:0xf9921020
y.create.l HWIO_PERIPH_SS_BLSP1_BLSP_UART4_UART_DM_HCR_ADDR A:0xf9921024
y.create.l HWIO_PERIPH_SS_BLSP1_BLSP_UART4_UART_DM_DMRX_ADDR A:0xf9921034
y.create.l HWIO_PERIPH_SS_BLSP1_BLSP_UART4_UART_DM_IRDA_RX_TOTAL_SNAP_DEPRECATED_ADDR A:0xf9921038
y.create.l HWIO_PERIPH_SS_BLSP1_BLSP_UART4_UART_DM_DMEN_ADDR A:0xf992103c
y.create.l HWIO_PERIPH_SS_BLSP1_BLSP_UART4_UART_DM_NO_CHARS_FOR_TX_ADDR A:0xf9921040
y.create.l HWIO_PERIPH_SS_BLSP1_BLSP_UART4_UART_DM_BADR_ADDR A:0xf9921044
y.create.l HWIO_PERIPH_SS_BLSP1_BLSP_UART4_UART_DM_TESTSL_ADDR A:0xf9921048
y.create.l HWIO_PERIPH_SS_BLSP1_BLSP_UART4_UART_DM_TXFS_ADDR A:0xf992104c
y.create.l HWIO_PERIPH_SS_BLSP1_BLSP_UART4_UART_DM_RXFS_ADDR A:0xf9921050
y.create.l HWIO_PERIPH_SS_BLSP1_BLSP_UART4_UART_DM_MISR_MODE_ADDR A:0xf9921060
y.create.l HWIO_PERIPH_SS_BLSP1_BLSP_UART4_UART_DM_MISR_RESET_ADDR A:0xf9921064
y.create.l HWIO_PERIPH_SS_BLSP1_BLSP_UART4_UART_DM_MISR_EXPORT_ADDR A:0xf9921068
y.create.l HWIO_PERIPH_SS_BLSP1_BLSP_UART4_UART_DM_MISR_VAL_ADDR A:0xf992106c
y.create.l HWIO_PERIPH_SS_BLSP1_BLSP_UART4_UART_DM_TF_RF_DEPRECATED_ADDR A:0xf9921070
y.create.l HWIO_PERIPH_SS_BLSP1_BLSP_UART4_UART_DM_TF_RF_2_DEPRECATED_ADDR A:0xf9921074
y.create.l HWIO_PERIPH_SS_BLSP1_BLSP_UART4_UART_DM_TF_RF_3_DEPRECATED_ADDR A:0xf9921078
y.create.l HWIO_PERIPH_SS_BLSP1_BLSP_UART4_UART_DM_TF_RF_4_DEPRECATED_ADDR A:0xf992107c
y.create.l HWIO_PERIPH_SS_BLSP1_BLSP_UART4_UART_DM_SIM_CFG_ADDR A:0xf9921080
y.create.l HWIO_PERIPH_SS_BLSP1_BLSP_UART4_UART_DM_TEST_WR_ADDR_ADDR A:0xf9921084
y.create.l HWIO_PERIPH_SS_BLSP1_BLSP_UART4_UART_DM_TEST_WR_DATA_ADDR A:0xf9921088
y.create.l HWIO_PERIPH_SS_BLSP1_BLSP_UART4_UART_DM_TEST_RD_ADDR_ADDR A:0xf992108c
y.create.l HWIO_PERIPH_SS_BLSP1_BLSP_UART4_UART_DM_TEST_RD_DATA_ADDR A:0xf9921090
y.create.l HWIO_PERIPH_SS_BLSP1_BLSP_UART4_UART_DM_CSR_ADDR A:0xf99210a0
y.create.l HWIO_PERIPH_SS_BLSP1_BLSP_UART4_UART_DM_SR_ADDR A:0xf99210a4
y.create.l HWIO_PERIPH_SS_BLSP1_BLSP_UART4_UART_DM_CR_ADDR A:0xf99210a8
y.create.l HWIO_PERIPH_SS_BLSP1_BLSP_UART4_UART_DM_MISR_ADDR A:0xf99210ac
y.create.l HWIO_PERIPH_SS_BLSP1_BLSP_UART4_UART_DM_IMR_ADDR A:0xf99210b0
y.create.l HWIO_PERIPH_SS_BLSP1_BLSP_UART4_UART_DM_ISR_ADDR A:0xf99210b4
y.create.l HWIO_PERIPH_SS_BLSP1_BLSP_UART4_UART_DM_IRDA_ADDR A:0xf99210b8
y.create.l HWIO_PERIPH_SS_BLSP1_BLSP_UART4_UART_DM_RX_TOTAL_SNAP_ADDR A:0xf99210bc
y.create.l HWIO_PERIPH_SS_BLSP1_BLSP_UART4_UART_DM_WWT_TIMEOUT_ADDR A:0xf99210c0
y.create.l HWIO_PERIPH_SS_BLSP1_BLSP_UART4_UART_DM_CLK_CTRL_ADDR A:0xf99210c4
y.create.l HWIO_PERIPH_SS_BLSP1_BLSP_UART4_UART_DM_BCR_ADDR A:0xf99210c8
y.create.l HWIO_PERIPH_SS_BLSP1_BLSP_UART4_UART_DM_RX_TRANS_CTRL_ADDR A:0xf99210cc
y.create.l HWIO_PERIPH_SS_BLSP1_BLSP_UART4_UART_DM_DMRX_DBG_ADDR A:0xf99210d0
y.create.l HWIO_PERIPH_SS_BLSP1_BLSP_UART4_UART_DM_FSM_STATUS_ADDR A:0xf99210d4
y.create.l HWIO_PERIPH_SS_BLSP1_BLSP_UART4_UART_DM_HW_VERSION_ADDR A:0xf99210d8
y.create.l HWIO_PERIPH_SS_BLSP1_BLSP_UART4_UART_DM_GENERICS_ADDR A:0xf99210dc
y.create.l HWIO_PERIPH_SS_BLSP1_BLSP_UART4_UART_DM_TF_ADDR A:0xf9921100
y.create.l HWIO_PERIPH_SS_BLSP1_BLSP_UART4_UART_DM_TF_2_ADDR A:0xf9921104
y.create.l HWIO_PERIPH_SS_BLSP1_BLSP_UART4_UART_DM_TF_3_ADDR A:0xf9921108
y.create.l HWIO_PERIPH_SS_BLSP1_BLSP_UART4_UART_DM_TF_4_ADDR A:0xf992110c
y.create.l HWIO_PERIPH_SS_BLSP1_BLSP_UART4_UART_DM_TF_5_ADDR A:0xf9921110
y.create.l HWIO_PERIPH_SS_BLSP1_BLSP_UART4_UART_DM_TF_6_ADDR A:0xf9921114
y.create.l HWIO_PERIPH_SS_BLSP1_BLSP_UART4_UART_DM_TF_7_ADDR A:0xf9921118
y.create.l HWIO_PERIPH_SS_BLSP1_BLSP_UART4_UART_DM_TF_8_ADDR A:0xf992111c
y.create.l HWIO_PERIPH_SS_BLSP1_BLSP_UART4_UART_DM_TF_9_ADDR A:0xf9921120
y.create.l HWIO_PERIPH_SS_BLSP1_BLSP_UART4_UART_DM_TF_10_ADDR A:0xf9921124
y.create.l HWIO_PERIPH_SS_BLSP1_BLSP_UART4_UART_DM_TF_11_ADDR A:0xf9921128
y.create.l HWIO_PERIPH_SS_BLSP1_BLSP_UART4_UART_DM_TF_12_ADDR A:0xf992112c
y.create.l HWIO_PERIPH_SS_BLSP1_BLSP_UART4_UART_DM_TF_13_ADDR A:0xf9921130
y.create.l HWIO_PERIPH_SS_BLSP1_BLSP_UART4_UART_DM_TF_14_ADDR A:0xf9921134
y.create.l HWIO_PERIPH_SS_BLSP1_BLSP_UART4_UART_DM_TF_15_ADDR A:0xf9921138
y.create.l HWIO_PERIPH_SS_BLSP1_BLSP_UART4_UART_DM_TF_16_ADDR A:0xf992113c
y.create.l HWIO_PERIPH_SS_BLSP1_BLSP_UART4_UART_DM_RF_ADDR A:0xf9921140
y.create.l HWIO_PERIPH_SS_BLSP1_BLSP_UART4_UART_DM_RF_2_ADDR A:0xf9921144
y.create.l HWIO_PERIPH_SS_BLSP1_BLSP_UART4_UART_DM_RF_3_ADDR A:0xf9921148
y.create.l HWIO_PERIPH_SS_BLSP1_BLSP_UART4_UART_DM_RF_4_ADDR A:0xf992114c
y.create.l HWIO_PERIPH_SS_BLSP1_BLSP_UART4_UART_DM_RF_5_ADDR A:0xf9921150
y.create.l HWIO_PERIPH_SS_BLSP1_BLSP_UART4_UART_DM_RF_6_ADDR A:0xf9921154
y.create.l HWIO_PERIPH_SS_BLSP1_BLSP_UART4_UART_DM_RF_7_ADDR A:0xf9921158
y.create.l HWIO_PERIPH_SS_BLSP1_BLSP_UART4_UART_DM_RF_8_ADDR A:0xf992115c
y.create.l HWIO_PERIPH_SS_BLSP1_BLSP_UART4_UART_DM_RF_9_ADDR A:0xf9921160
y.create.l HWIO_PERIPH_SS_BLSP1_BLSP_UART4_UART_DM_RF_10_ADDR A:0xf9921164
y.create.l HWIO_PERIPH_SS_BLSP1_BLSP_UART4_UART_DM_RF_11_ADDR A:0xf9921168
y.create.l HWIO_PERIPH_SS_BLSP1_BLSP_UART4_UART_DM_RF_12_ADDR A:0xf992116c
y.create.l HWIO_PERIPH_SS_BLSP1_BLSP_UART4_UART_DM_RF_13_ADDR A:0xf9921170
y.create.l HWIO_PERIPH_SS_BLSP1_BLSP_UART4_UART_DM_RF_14_ADDR A:0xf9921174
y.create.l HWIO_PERIPH_SS_BLSP1_BLSP_UART4_UART_DM_RF_15_ADDR A:0xf9921178
y.create.l HWIO_PERIPH_SS_BLSP1_BLSP_UART4_UART_DM_RF_16_ADDR A:0xf992117c
y.create.l HWIO_PERIPH_SS_BLSP1_BLSP_UART4_UART_DM_UIM_CFG_ADDR A:0xf9921180
y.create.l HWIO_PERIPH_SS_BLSP1_BLSP_UART4_UART_DM_UIM_CMD_ADDR A:0xf9921184
y.create.l HWIO_PERIPH_SS_BLSP1_BLSP_UART4_UART_DM_UIM_IO_STATUS_ADDR A:0xf9921188
y.create.l HWIO_PERIPH_SS_BLSP1_BLSP_UART4_UART_DM_UIM_IRQ_ISR_ADDR A:0xf992118c
y.create.l HWIO_PERIPH_SS_BLSP1_BLSP_UART4_UART_DM_UIM_IRQ_MISR_ADDR A:0xf9921190
y.create.l HWIO_PERIPH_SS_BLSP1_BLSP_UART4_UART_DM_UIM_IRQ_CLR_ADDR A:0xf9921194
y.create.l HWIO_PERIPH_SS_BLSP1_BLSP_UART4_UART_DM_UIM_IRQ_IMR_ADDR A:0xf9921198
y.create.l HWIO_PERIPH_SS_BLSP1_BLSP_UART4_UART_DM_UIM_IRQ_IMR_SET_ADDR A:0xf992119c
y.create.l HWIO_PERIPH_SS_BLSP1_BLSP_UART4_UART_DM_UIM_IRQ_IMR_CLR_ADDR A:0xf99211a0
y.create.l HWIO_PERIPH_SS_BLSP1_BLSP_UART5_UART_DM_MR1_ADDR A:0xf9922000
y.create.l HWIO_PERIPH_SS_BLSP1_BLSP_UART5_UART_DM_MR2_ADDR A:0xf9922004
y.create.l HWIO_PERIPH_SS_BLSP1_BLSP_UART5_UART_DM_CSR_SR_DEPRECATED_ADDR A:0xf9922008
y.create.l HWIO_PERIPH_SS_BLSP1_BLSP_UART5_UART_DM_CR_MISR_DEPRECATED_ADDR A:0xf9922010
y.create.l HWIO_PERIPH_SS_BLSP1_BLSP_UART5_UART_DM_IMR_ISR_DEPRECATED_ADDR A:0xf9922014
y.create.l HWIO_PERIPH_SS_BLSP1_BLSP_UART5_UART_DM_IPR_ADDR A:0xf9922018
y.create.l HWIO_PERIPH_SS_BLSP1_BLSP_UART5_UART_DM_TFWR_ADDR A:0xf992201c
y.create.l HWIO_PERIPH_SS_BLSP1_BLSP_UART5_UART_DM_RFWR_ADDR A:0xf9922020
y.create.l HWIO_PERIPH_SS_BLSP1_BLSP_UART5_UART_DM_HCR_ADDR A:0xf9922024
y.create.l HWIO_PERIPH_SS_BLSP1_BLSP_UART5_UART_DM_DMRX_ADDR A:0xf9922034
y.create.l HWIO_PERIPH_SS_BLSP1_BLSP_UART5_UART_DM_IRDA_RX_TOTAL_SNAP_DEPRECATED_ADDR A:0xf9922038
y.create.l HWIO_PERIPH_SS_BLSP1_BLSP_UART5_UART_DM_DMEN_ADDR A:0xf992203c
y.create.l HWIO_PERIPH_SS_BLSP1_BLSP_UART5_UART_DM_NO_CHARS_FOR_TX_ADDR A:0xf9922040
y.create.l HWIO_PERIPH_SS_BLSP1_BLSP_UART5_UART_DM_BADR_ADDR A:0xf9922044
y.create.l HWIO_PERIPH_SS_BLSP1_BLSP_UART5_UART_DM_TESTSL_ADDR A:0xf9922048
y.create.l HWIO_PERIPH_SS_BLSP1_BLSP_UART5_UART_DM_TXFS_ADDR A:0xf992204c
y.create.l HWIO_PERIPH_SS_BLSP1_BLSP_UART5_UART_DM_RXFS_ADDR A:0xf9922050
y.create.l HWIO_PERIPH_SS_BLSP1_BLSP_UART5_UART_DM_MISR_MODE_ADDR A:0xf9922060
y.create.l HWIO_PERIPH_SS_BLSP1_BLSP_UART5_UART_DM_MISR_RESET_ADDR A:0xf9922064
y.create.l HWIO_PERIPH_SS_BLSP1_BLSP_UART5_UART_DM_MISR_EXPORT_ADDR A:0xf9922068
y.create.l HWIO_PERIPH_SS_BLSP1_BLSP_UART5_UART_DM_MISR_VAL_ADDR A:0xf992206c
y.create.l HWIO_PERIPH_SS_BLSP1_BLSP_UART5_UART_DM_TF_RF_DEPRECATED_ADDR A:0xf9922070
y.create.l HWIO_PERIPH_SS_BLSP1_BLSP_UART5_UART_DM_TF_RF_2_DEPRECATED_ADDR A:0xf9922074
y.create.l HWIO_PERIPH_SS_BLSP1_BLSP_UART5_UART_DM_TF_RF_3_DEPRECATED_ADDR A:0xf9922078
y.create.l HWIO_PERIPH_SS_BLSP1_BLSP_UART5_UART_DM_TF_RF_4_DEPRECATED_ADDR A:0xf992207c
y.create.l HWIO_PERIPH_SS_BLSP1_BLSP_UART5_UART_DM_SIM_CFG_ADDR A:0xf9922080
y.create.l HWIO_PERIPH_SS_BLSP1_BLSP_UART5_UART_DM_TEST_WR_ADDR_ADDR A:0xf9922084
y.create.l HWIO_PERIPH_SS_BLSP1_BLSP_UART5_UART_DM_TEST_WR_DATA_ADDR A:0xf9922088
y.create.l HWIO_PERIPH_SS_BLSP1_BLSP_UART5_UART_DM_TEST_RD_ADDR_ADDR A:0xf992208c
y.create.l HWIO_PERIPH_SS_BLSP1_BLSP_UART5_UART_DM_TEST_RD_DATA_ADDR A:0xf9922090
y.create.l HWIO_PERIPH_SS_BLSP1_BLSP_UART5_UART_DM_CSR_ADDR A:0xf99220a0
y.create.l HWIO_PERIPH_SS_BLSP1_BLSP_UART5_UART_DM_SR_ADDR A:0xf99220a4
y.create.l HWIO_PERIPH_SS_BLSP1_BLSP_UART5_UART_DM_CR_ADDR A:0xf99220a8
y.create.l HWIO_PERIPH_SS_BLSP1_BLSP_UART5_UART_DM_MISR_ADDR A:0xf99220ac
y.create.l HWIO_PERIPH_SS_BLSP1_BLSP_UART5_UART_DM_IMR_ADDR A:0xf99220b0
y.create.l HWIO_PERIPH_SS_BLSP1_BLSP_UART5_UART_DM_ISR_ADDR A:0xf99220b4
y.create.l HWIO_PERIPH_SS_BLSP1_BLSP_UART5_UART_DM_IRDA_ADDR A:0xf99220b8
y.create.l HWIO_PERIPH_SS_BLSP1_BLSP_UART5_UART_DM_RX_TOTAL_SNAP_ADDR A:0xf99220bc
y.create.l HWIO_PERIPH_SS_BLSP1_BLSP_UART5_UART_DM_WWT_TIMEOUT_ADDR A:0xf99220c0
y.create.l HWIO_PERIPH_SS_BLSP1_BLSP_UART5_UART_DM_CLK_CTRL_ADDR A:0xf99220c4
y.create.l HWIO_PERIPH_SS_BLSP1_BLSP_UART5_UART_DM_BCR_ADDR A:0xf99220c8
y.create.l HWIO_PERIPH_SS_BLSP1_BLSP_UART5_UART_DM_RX_TRANS_CTRL_ADDR A:0xf99220cc
y.create.l HWIO_PERIPH_SS_BLSP1_BLSP_UART5_UART_DM_DMRX_DBG_ADDR A:0xf99220d0
y.create.l HWIO_PERIPH_SS_BLSP1_BLSP_UART5_UART_DM_FSM_STATUS_ADDR A:0xf99220d4
y.create.l HWIO_PERIPH_SS_BLSP1_BLSP_UART5_UART_DM_HW_VERSION_ADDR A:0xf99220d8
y.create.l HWIO_PERIPH_SS_BLSP1_BLSP_UART5_UART_DM_GENERICS_ADDR A:0xf99220dc
y.create.l HWIO_PERIPH_SS_BLSP1_BLSP_UART5_UART_DM_TF_ADDR A:0xf9922100
y.create.l HWIO_PERIPH_SS_BLSP1_BLSP_UART5_UART_DM_TF_2_ADDR A:0xf9922104
y.create.l HWIO_PERIPH_SS_BLSP1_BLSP_UART5_UART_DM_TF_3_ADDR A:0xf9922108
y.create.l HWIO_PERIPH_SS_BLSP1_BLSP_UART5_UART_DM_TF_4_ADDR A:0xf992210c
y.create.l HWIO_PERIPH_SS_BLSP1_BLSP_UART5_UART_DM_TF_5_ADDR A:0xf9922110
y.create.l HWIO_PERIPH_SS_BLSP1_BLSP_UART5_UART_DM_TF_6_ADDR A:0xf9922114
y.create.l HWIO_PERIPH_SS_BLSP1_BLSP_UART5_UART_DM_TF_7_ADDR A:0xf9922118
y.create.l HWIO_PERIPH_SS_BLSP1_BLSP_UART5_UART_DM_TF_8_ADDR A:0xf992211c
y.create.l HWIO_PERIPH_SS_BLSP1_BLSP_UART5_UART_DM_TF_9_ADDR A:0xf9922120
y.create.l HWIO_PERIPH_SS_BLSP1_BLSP_UART5_UART_DM_TF_10_ADDR A:0xf9922124
y.create.l HWIO_PERIPH_SS_BLSP1_BLSP_UART5_UART_DM_TF_11_ADDR A:0xf9922128
y.create.l HWIO_PERIPH_SS_BLSP1_BLSP_UART5_UART_DM_TF_12_ADDR A:0xf992212c
y.create.l HWIO_PERIPH_SS_BLSP1_BLSP_UART5_UART_DM_TF_13_ADDR A:0xf9922130
y.create.l HWIO_PERIPH_SS_BLSP1_BLSP_UART5_UART_DM_TF_14_ADDR A:0xf9922134
y.create.l HWIO_PERIPH_SS_BLSP1_BLSP_UART5_UART_DM_TF_15_ADDR A:0xf9922138
y.create.l HWIO_PERIPH_SS_BLSP1_BLSP_UART5_UART_DM_TF_16_ADDR A:0xf992213c
y.create.l HWIO_PERIPH_SS_BLSP1_BLSP_UART5_UART_DM_RF_ADDR A:0xf9922140
y.create.l HWIO_PERIPH_SS_BLSP1_BLSP_UART5_UART_DM_RF_2_ADDR A:0xf9922144
y.create.l HWIO_PERIPH_SS_BLSP1_BLSP_UART5_UART_DM_RF_3_ADDR A:0xf9922148
y.create.l HWIO_PERIPH_SS_BLSP1_BLSP_UART5_UART_DM_RF_4_ADDR A:0xf992214c
y.create.l HWIO_PERIPH_SS_BLSP1_BLSP_UART5_UART_DM_RF_5_ADDR A:0xf9922150
y.create.l HWIO_PERIPH_SS_BLSP1_BLSP_UART5_UART_DM_RF_6_ADDR A:0xf9922154
y.create.l HWIO_PERIPH_SS_BLSP1_BLSP_UART5_UART_DM_RF_7_ADDR A:0xf9922158
y.create.l HWIO_PERIPH_SS_BLSP1_BLSP_UART5_UART_DM_RF_8_ADDR A:0xf992215c
y.create.l HWIO_PERIPH_SS_BLSP1_BLSP_UART5_UART_DM_RF_9_ADDR A:0xf9922160
y.create.l HWIO_PERIPH_SS_BLSP1_BLSP_UART5_UART_DM_RF_10_ADDR A:0xf9922164
y.create.l HWIO_PERIPH_SS_BLSP1_BLSP_UART5_UART_DM_RF_11_ADDR A:0xf9922168
y.create.l HWIO_PERIPH_SS_BLSP1_BLSP_UART5_UART_DM_RF_12_ADDR A:0xf992216c
y.create.l HWIO_PERIPH_SS_BLSP1_BLSP_UART5_UART_DM_RF_13_ADDR A:0xf9922170
y.create.l HWIO_PERIPH_SS_BLSP1_BLSP_UART5_UART_DM_RF_14_ADDR A:0xf9922174
y.create.l HWIO_PERIPH_SS_BLSP1_BLSP_UART5_UART_DM_RF_15_ADDR A:0xf9922178
y.create.l HWIO_PERIPH_SS_BLSP1_BLSP_UART5_UART_DM_RF_16_ADDR A:0xf992217c
y.create.l HWIO_PERIPH_SS_BLSP1_BLSP_UART5_UART_DM_UIM_CFG_ADDR A:0xf9922180
y.create.l HWIO_PERIPH_SS_BLSP1_BLSP_UART5_UART_DM_UIM_CMD_ADDR A:0xf9922184
y.create.l HWIO_PERIPH_SS_BLSP1_BLSP_UART5_UART_DM_UIM_IO_STATUS_ADDR A:0xf9922188
y.create.l HWIO_PERIPH_SS_BLSP1_BLSP_UART5_UART_DM_UIM_IRQ_ISR_ADDR A:0xf992218c
y.create.l HWIO_PERIPH_SS_BLSP1_BLSP_UART5_UART_DM_UIM_IRQ_MISR_ADDR A:0xf9922190
y.create.l HWIO_PERIPH_SS_BLSP1_BLSP_UART5_UART_DM_UIM_IRQ_CLR_ADDR A:0xf9922194
y.create.l HWIO_PERIPH_SS_BLSP1_BLSP_UART5_UART_DM_UIM_IRQ_IMR_ADDR A:0xf9922198
y.create.l HWIO_PERIPH_SS_BLSP1_BLSP_UART5_UART_DM_UIM_IRQ_IMR_SET_ADDR A:0xf992219c
y.create.l HWIO_PERIPH_SS_BLSP1_BLSP_UART5_UART_DM_UIM_IRQ_IMR_CLR_ADDR A:0xf99221a0
y.create.l HWIO_PERIPH_SS_BLSP1_BLSP_QUP0_QUP_CONFIG_ADDR A:0xf9923000
y.create.l HWIO_PERIPH_SS_BLSP1_BLSP_QUP0_QUP_STATE_ADDR A:0xf9923004
y.create.l HWIO_PERIPH_SS_BLSP1_BLSP_QUP0_QUP_IO_MODES_ADDR A:0xf9923008
y.create.l HWIO_PERIPH_SS_BLSP1_BLSP_QUP0_QUP_SW_RESET_ADDR A:0xf992300c
y.create.l HWIO_PERIPH_SS_BLSP1_BLSP_QUP0_QUP_OPERATIONAL_ADDR A:0xf9923018
y.create.l HWIO_PERIPH_SS_BLSP1_BLSP_QUP0_QUP_ERROR_FLAGS_ADDR A:0xf992301c
y.create.l HWIO_PERIPH_SS_BLSP1_BLSP_QUP0_QUP_ERROR_FLAGS_EN_ADDR A:0xf9923020
y.create.l HWIO_PERIPH_SS_BLSP1_BLSP_QUP0_QUP_TEST_CTRL_ADDR A:0xf9923024
y.create.l HWIO_PERIPH_SS_BLSP1_BLSP_QUP0_QUP_OPERATIONAL_MASK_ADDR A:0xf9923028
y.create.l HWIO_PERIPH_SS_BLSP1_BLSP_QUP0_QUP_HW_VERSION_ADDR A:0xf9923030
y.create.l HWIO_PERIPH_SS_BLSP1_BLSP_QUP0_QUP_MX_OUTPUT_COUNT_ADDR A:0xf9923100
y.create.l HWIO_PERIPH_SS_BLSP1_BLSP_QUP0_QUP_MX_OUTPUT_CNT_CURRENT_ADDR A:0xf9923104
y.create.l HWIO_PERIPH_SS_BLSP1_BLSP_QUP0_QUP_OUTPUT_DEBUG_ADDR A:0xf9923108
y.create.l HWIO_PERIPH_SS_BLSP1_BLSP_QUP0_QUP_OUTPUT_FIFO_WORD_CNT_ADDR A:0xf992310c
y.create.l HWIO_PERIPH_SS_BLSP1_BLSP_QUP0_QUP_OUTPUT_FIFO0_ADDR A:0xf9923110
y.create.l HWIO_PERIPH_SS_BLSP1_BLSP_QUP0_QUP_OUTPUT_FIFO1_ADDR A:0xf9923114
y.create.l HWIO_PERIPH_SS_BLSP1_BLSP_QUP0_QUP_OUTPUT_FIFO2_ADDR A:0xf9923118
y.create.l HWIO_PERIPH_SS_BLSP1_BLSP_QUP0_QUP_OUTPUT_FIFO3_ADDR A:0xf992311c
y.create.l HWIO_PERIPH_SS_BLSP1_BLSP_QUP0_QUP_OUTPUT_FIFO4_ADDR A:0xf9923120
y.create.l HWIO_PERIPH_SS_BLSP1_BLSP_QUP0_QUP_OUTPUT_FIFO5_ADDR A:0xf9923124
y.create.l HWIO_PERIPH_SS_BLSP1_BLSP_QUP0_QUP_OUTPUT_FIFO6_ADDR A:0xf9923128
y.create.l HWIO_PERIPH_SS_BLSP1_BLSP_QUP0_QUP_OUTPUT_FIFO7_ADDR A:0xf992312c
y.create.l HWIO_PERIPH_SS_BLSP1_BLSP_QUP0_QUP_OUTPUT_FIFO8_ADDR A:0xf9923130
y.create.l HWIO_PERIPH_SS_BLSP1_BLSP_QUP0_QUP_OUTPUT_FIFO9_ADDR A:0xf9923134
y.create.l HWIO_PERIPH_SS_BLSP1_BLSP_QUP0_QUP_MX_WRITE_COUNT_ADDR A:0xf9923150
y.create.l HWIO_PERIPH_SS_BLSP1_BLSP_QUP0_QUP_MX_WRITE_CNT_CURRENT_ADDR A:0xf9923154
y.create.l HWIO_PERIPH_SS_BLSP1_BLSP_QUP0_QUP_MX_INPUT_COUNT_ADDR A:0xf9923200
y.create.l HWIO_PERIPH_SS_BLSP1_BLSP_QUP0_QUP_MX_INPUT_CNT_CURRENT_ADDR A:0xf9923204
y.create.l HWIO_PERIPH_SS_BLSP1_BLSP_QUP0_QUP_MX_READ_COUNT_ADDR A:0xf9923208
y.create.l HWIO_PERIPH_SS_BLSP1_BLSP_QUP0_QUP_MX_READ_CNT_CURRENT_ADDR A:0xf992320c
y.create.l HWIO_PERIPH_SS_BLSP1_BLSP_QUP0_QUP_INPUT_DEBUG_ADDR A:0xf9923210
y.create.l HWIO_PERIPH_SS_BLSP1_BLSP_QUP0_QUP_INPUT_FIFO_WORD_CNT_ADDR A:0xf9923214
y.create.l HWIO_PERIPH_SS_BLSP1_BLSP_QUP0_QUP_INPUT_FIFO0_ADDR A:0xf9923218
y.create.l HWIO_PERIPH_SS_BLSP1_BLSP_QUP0_QUP_INPUT_FIFO1_ADDR A:0xf992321c
y.create.l HWIO_PERIPH_SS_BLSP1_BLSP_QUP0_QUP_INPUT_FIFO2_ADDR A:0xf9923220
y.create.l HWIO_PERIPH_SS_BLSP1_BLSP_QUP0_QUP_INPUT_FIFO3_ADDR A:0xf9923224
y.create.l HWIO_PERIPH_SS_BLSP1_BLSP_QUP0_QUP_INPUT_FIFO4_ADDR A:0xf9923228
y.create.l HWIO_PERIPH_SS_BLSP1_BLSP_QUP0_QUP_INPUT_FIFO5_ADDR A:0xf992322c
y.create.l HWIO_PERIPH_SS_BLSP1_BLSP_QUP0_QUP_INPUT_FIFO6_ADDR A:0xf9923230
y.create.l HWIO_PERIPH_SS_BLSP1_BLSP_QUP0_QUP_INPUT_FIFO7_ADDR A:0xf9923234
y.create.l HWIO_PERIPH_SS_BLSP1_BLSP_QUP0_QUP_INPUT_FIFO8_ADDR A:0xf9923238
y.create.l HWIO_PERIPH_SS_BLSP1_BLSP_QUP0_QUP_INPUT_FIFO9_ADDR A:0xf992323c
y.create.l HWIO_PERIPH_SS_BLSP1_BLSP_QUP0_SPI_CONFIG_ADDR A:0xf9923300
y.create.l HWIO_PERIPH_SS_BLSP1_BLSP_QUP0_SPI_IO_CONTROL_ADDR A:0xf9923304
y.create.l HWIO_PERIPH_SS_BLSP1_BLSP_QUP0_SPI_ERROR_FLAGS_ADDR A:0xf9923308
y.create.l HWIO_PERIPH_SS_BLSP1_BLSP_QUP0_SPI_ERROR_FLAGS_EN_ADDR A:0xf992330c
y.create.l HWIO_PERIPH_SS_BLSP1_BLSP_QUP0_SPI_DEASSERT_WAIT_ADDR A:0xf9923310
y.create.l HWIO_PERIPH_SS_BLSP1_BLSP_QUP0_SPI_CHAR_CFG_ADDR A:0xf9923320
y.create.l HWIO_PERIPH_SS_BLSP1_BLSP_QUP0_SPI_CHAR_DATA_SPI_CS_ADDR A:0xf9923324
y.create.l HWIO_PERIPH_SS_BLSP1_BLSP_QUP0_SPI_CHAR_DATA_SPI_MOSI_ADDR A:0xf9923328
y.create.l HWIO_PERIPH_SS_BLSP1_BLSP_QUP0_SPI_CHAR_DATA_SPI_MISO_ADDR A:0xf992332c
y.create.l HWIO_PERIPH_SS_BLSP1_BLSP_QUP0_I2C_MASTER_CLK_CTL_ADDR A:0xf9923400
y.create.l HWIO_PERIPH_SS_BLSP1_BLSP_QUP0_I2C_MASTER_STATUS_ADDR A:0xf9923404
y.create.l HWIO_PERIPH_SS_BLSP1_BLSP_QUP0_I2C_MASTER_CONFIG_ADDR A:0xf9923408
y.create.l HWIO_PERIPH_SS_BLSP1_BLSP_QUP0_I2C_MASTER_BUS_CLEAR_ADDR A:0xf992340c
y.create.l HWIO_PERIPH_SS_BLSP1_BLSP_QUP0_I2C_MASTER_LOCAL_ID_ADDR A:0xf9923410
y.create.l HWIO_PERIPH_SS_BLSP1_BLSP_QUP1_QUP_CONFIG_ADDR A:0xf9924000
y.create.l HWIO_PERIPH_SS_BLSP1_BLSP_QUP1_QUP_STATE_ADDR A:0xf9924004
y.create.l HWIO_PERIPH_SS_BLSP1_BLSP_QUP1_QUP_IO_MODES_ADDR A:0xf9924008
y.create.l HWIO_PERIPH_SS_BLSP1_BLSP_QUP1_QUP_SW_RESET_ADDR A:0xf992400c
y.create.l HWIO_PERIPH_SS_BLSP1_BLSP_QUP1_QUP_OPERATIONAL_ADDR A:0xf9924018
y.create.l HWIO_PERIPH_SS_BLSP1_BLSP_QUP1_QUP_ERROR_FLAGS_ADDR A:0xf992401c
y.create.l HWIO_PERIPH_SS_BLSP1_BLSP_QUP1_QUP_ERROR_FLAGS_EN_ADDR A:0xf9924020
y.create.l HWIO_PERIPH_SS_BLSP1_BLSP_QUP1_QUP_TEST_CTRL_ADDR A:0xf9924024
y.create.l HWIO_PERIPH_SS_BLSP1_BLSP_QUP1_QUP_OPERATIONAL_MASK_ADDR A:0xf9924028
y.create.l HWIO_PERIPH_SS_BLSP1_BLSP_QUP1_QUP_HW_VERSION_ADDR A:0xf9924030
y.create.l HWIO_PERIPH_SS_BLSP1_BLSP_QUP1_QUP_MX_OUTPUT_COUNT_ADDR A:0xf9924100
y.create.l HWIO_PERIPH_SS_BLSP1_BLSP_QUP1_QUP_MX_OUTPUT_CNT_CURRENT_ADDR A:0xf9924104
y.create.l HWIO_PERIPH_SS_BLSP1_BLSP_QUP1_QUP_OUTPUT_DEBUG_ADDR A:0xf9924108
y.create.l HWIO_PERIPH_SS_BLSP1_BLSP_QUP1_QUP_OUTPUT_FIFO_WORD_CNT_ADDR A:0xf992410c
y.create.l HWIO_PERIPH_SS_BLSP1_BLSP_QUP1_QUP_OUTPUT_FIFO0_ADDR A:0xf9924110
y.create.l HWIO_PERIPH_SS_BLSP1_BLSP_QUP1_QUP_OUTPUT_FIFO1_ADDR A:0xf9924114
y.create.l HWIO_PERIPH_SS_BLSP1_BLSP_QUP1_QUP_OUTPUT_FIFO2_ADDR A:0xf9924118
y.create.l HWIO_PERIPH_SS_BLSP1_BLSP_QUP1_QUP_OUTPUT_FIFO3_ADDR A:0xf992411c
y.create.l HWIO_PERIPH_SS_BLSP1_BLSP_QUP1_QUP_OUTPUT_FIFO4_ADDR A:0xf9924120
y.create.l HWIO_PERIPH_SS_BLSP1_BLSP_QUP1_QUP_OUTPUT_FIFO5_ADDR A:0xf9924124
y.create.l HWIO_PERIPH_SS_BLSP1_BLSP_QUP1_QUP_OUTPUT_FIFO6_ADDR A:0xf9924128
y.create.l HWIO_PERIPH_SS_BLSP1_BLSP_QUP1_QUP_OUTPUT_FIFO7_ADDR A:0xf992412c
y.create.l HWIO_PERIPH_SS_BLSP1_BLSP_QUP1_QUP_OUTPUT_FIFO8_ADDR A:0xf9924130
y.create.l HWIO_PERIPH_SS_BLSP1_BLSP_QUP1_QUP_OUTPUT_FIFO9_ADDR A:0xf9924134
y.create.l HWIO_PERIPH_SS_BLSP1_BLSP_QUP1_QUP_MX_WRITE_COUNT_ADDR A:0xf9924150
y.create.l HWIO_PERIPH_SS_BLSP1_BLSP_QUP1_QUP_MX_WRITE_CNT_CURRENT_ADDR A:0xf9924154
y.create.l HWIO_PERIPH_SS_BLSP1_BLSP_QUP1_QUP_MX_INPUT_COUNT_ADDR A:0xf9924200
y.create.l HWIO_PERIPH_SS_BLSP1_BLSP_QUP1_QUP_MX_INPUT_CNT_CURRENT_ADDR A:0xf9924204
y.create.l HWIO_PERIPH_SS_BLSP1_BLSP_QUP1_QUP_MX_READ_COUNT_ADDR A:0xf9924208
y.create.l HWIO_PERIPH_SS_BLSP1_BLSP_QUP1_QUP_MX_READ_CNT_CURRENT_ADDR A:0xf992420c
y.create.l HWIO_PERIPH_SS_BLSP1_BLSP_QUP1_QUP_INPUT_DEBUG_ADDR A:0xf9924210
y.create.l HWIO_PERIPH_SS_BLSP1_BLSP_QUP1_QUP_INPUT_FIFO_WORD_CNT_ADDR A:0xf9924214
y.create.l HWIO_PERIPH_SS_BLSP1_BLSP_QUP1_QUP_INPUT_FIFO0_ADDR A:0xf9924218
y.create.l HWIO_PERIPH_SS_BLSP1_BLSP_QUP1_QUP_INPUT_FIFO1_ADDR A:0xf992421c
y.create.l HWIO_PERIPH_SS_BLSP1_BLSP_QUP1_QUP_INPUT_FIFO2_ADDR A:0xf9924220
y.create.l HWIO_PERIPH_SS_BLSP1_BLSP_QUP1_QUP_INPUT_FIFO3_ADDR A:0xf9924224
y.create.l HWIO_PERIPH_SS_BLSP1_BLSP_QUP1_QUP_INPUT_FIFO4_ADDR A:0xf9924228
y.create.l HWIO_PERIPH_SS_BLSP1_BLSP_QUP1_QUP_INPUT_FIFO5_ADDR A:0xf992422c
y.create.l HWIO_PERIPH_SS_BLSP1_BLSP_QUP1_QUP_INPUT_FIFO6_ADDR A:0xf9924230
y.create.l HWIO_PERIPH_SS_BLSP1_BLSP_QUP1_QUP_INPUT_FIFO7_ADDR A:0xf9924234
y.create.l HWIO_PERIPH_SS_BLSP1_BLSP_QUP1_QUP_INPUT_FIFO8_ADDR A:0xf9924238
y.create.l HWIO_PERIPH_SS_BLSP1_BLSP_QUP1_QUP_INPUT_FIFO9_ADDR A:0xf992423c
y.create.l HWIO_PERIPH_SS_BLSP1_BLSP_QUP1_SPI_CONFIG_ADDR A:0xf9924300
y.create.l HWIO_PERIPH_SS_BLSP1_BLSP_QUP1_SPI_IO_CONTROL_ADDR A:0xf9924304
y.create.l HWIO_PERIPH_SS_BLSP1_BLSP_QUP1_SPI_ERROR_FLAGS_ADDR A:0xf9924308
y.create.l HWIO_PERIPH_SS_BLSP1_BLSP_QUP1_SPI_ERROR_FLAGS_EN_ADDR A:0xf992430c
y.create.l HWIO_PERIPH_SS_BLSP1_BLSP_QUP1_SPI_DEASSERT_WAIT_ADDR A:0xf9924310
y.create.l HWIO_PERIPH_SS_BLSP1_BLSP_QUP1_SPI_CHAR_CFG_ADDR A:0xf9924320
y.create.l HWIO_PERIPH_SS_BLSP1_BLSP_QUP1_SPI_CHAR_DATA_SPI_CS_ADDR A:0xf9924324
y.create.l HWIO_PERIPH_SS_BLSP1_BLSP_QUP1_SPI_CHAR_DATA_SPI_MOSI_ADDR A:0xf9924328
y.create.l HWIO_PERIPH_SS_BLSP1_BLSP_QUP1_SPI_CHAR_DATA_SPI_MISO_ADDR A:0xf992432c
y.create.l HWIO_PERIPH_SS_BLSP1_BLSP_QUP1_I2C_MASTER_CLK_CTL_ADDR A:0xf9924400
y.create.l HWIO_PERIPH_SS_BLSP1_BLSP_QUP1_I2C_MASTER_STATUS_ADDR A:0xf9924404
y.create.l HWIO_PERIPH_SS_BLSP1_BLSP_QUP1_I2C_MASTER_CONFIG_ADDR A:0xf9924408
y.create.l HWIO_PERIPH_SS_BLSP1_BLSP_QUP1_I2C_MASTER_BUS_CLEAR_ADDR A:0xf992440c
y.create.l HWIO_PERIPH_SS_BLSP1_BLSP_QUP1_I2C_MASTER_LOCAL_ID_ADDR A:0xf9924410
y.create.l HWIO_PERIPH_SS_BLSP1_BLSP_QUP2_QUP_CONFIG_ADDR A:0xf9925000
y.create.l HWIO_PERIPH_SS_BLSP1_BLSP_QUP2_QUP_STATE_ADDR A:0xf9925004
y.create.l HWIO_PERIPH_SS_BLSP1_BLSP_QUP2_QUP_IO_MODES_ADDR A:0xf9925008
y.create.l HWIO_PERIPH_SS_BLSP1_BLSP_QUP2_QUP_SW_RESET_ADDR A:0xf992500c
y.create.l HWIO_PERIPH_SS_BLSP1_BLSP_QUP2_QUP_OPERATIONAL_ADDR A:0xf9925018
y.create.l HWIO_PERIPH_SS_BLSP1_BLSP_QUP2_QUP_ERROR_FLAGS_ADDR A:0xf992501c
y.create.l HWIO_PERIPH_SS_BLSP1_BLSP_QUP2_QUP_ERROR_FLAGS_EN_ADDR A:0xf9925020
y.create.l HWIO_PERIPH_SS_BLSP1_BLSP_QUP2_QUP_TEST_CTRL_ADDR A:0xf9925024
y.create.l HWIO_PERIPH_SS_BLSP1_BLSP_QUP2_QUP_OPERATIONAL_MASK_ADDR A:0xf9925028
y.create.l HWIO_PERIPH_SS_BLSP1_BLSP_QUP2_QUP_HW_VERSION_ADDR A:0xf9925030
y.create.l HWIO_PERIPH_SS_BLSP1_BLSP_QUP2_QUP_MX_OUTPUT_COUNT_ADDR A:0xf9925100
y.create.l HWIO_PERIPH_SS_BLSP1_BLSP_QUP2_QUP_MX_OUTPUT_CNT_CURRENT_ADDR A:0xf9925104
y.create.l HWIO_PERIPH_SS_BLSP1_BLSP_QUP2_QUP_OUTPUT_DEBUG_ADDR A:0xf9925108
y.create.l HWIO_PERIPH_SS_BLSP1_BLSP_QUP2_QUP_OUTPUT_FIFO_WORD_CNT_ADDR A:0xf992510c
y.create.l HWIO_PERIPH_SS_BLSP1_BLSP_QUP2_QUP_OUTPUT_FIFO0_ADDR A:0xf9925110
y.create.l HWIO_PERIPH_SS_BLSP1_BLSP_QUP2_QUP_OUTPUT_FIFO1_ADDR A:0xf9925114
y.create.l HWIO_PERIPH_SS_BLSP1_BLSP_QUP2_QUP_OUTPUT_FIFO2_ADDR A:0xf9925118
y.create.l HWIO_PERIPH_SS_BLSP1_BLSP_QUP2_QUP_OUTPUT_FIFO3_ADDR A:0xf992511c
y.create.l HWIO_PERIPH_SS_BLSP1_BLSP_QUP2_QUP_OUTPUT_FIFO4_ADDR A:0xf9925120
y.create.l HWIO_PERIPH_SS_BLSP1_BLSP_QUP2_QUP_OUTPUT_FIFO5_ADDR A:0xf9925124
y.create.l HWIO_PERIPH_SS_BLSP1_BLSP_QUP2_QUP_OUTPUT_FIFO6_ADDR A:0xf9925128
y.create.l HWIO_PERIPH_SS_BLSP1_BLSP_QUP2_QUP_OUTPUT_FIFO7_ADDR A:0xf992512c
y.create.l HWIO_PERIPH_SS_BLSP1_BLSP_QUP2_QUP_OUTPUT_FIFO8_ADDR A:0xf9925130
y.create.l HWIO_PERIPH_SS_BLSP1_BLSP_QUP2_QUP_OUTPUT_FIFO9_ADDR A:0xf9925134
y.create.l HWIO_PERIPH_SS_BLSP1_BLSP_QUP2_QUP_MX_WRITE_COUNT_ADDR A:0xf9925150
y.create.l HWIO_PERIPH_SS_BLSP1_BLSP_QUP2_QUP_MX_WRITE_CNT_CURRENT_ADDR A:0xf9925154
y.create.l HWIO_PERIPH_SS_BLSP1_BLSP_QUP2_QUP_MX_INPUT_COUNT_ADDR A:0xf9925200
y.create.l HWIO_PERIPH_SS_BLSP1_BLSP_QUP2_QUP_MX_INPUT_CNT_CURRENT_ADDR A:0xf9925204
y.create.l HWIO_PERIPH_SS_BLSP1_BLSP_QUP2_QUP_MX_READ_COUNT_ADDR A:0xf9925208
y.create.l HWIO_PERIPH_SS_BLSP1_BLSP_QUP2_QUP_MX_READ_CNT_CURRENT_ADDR A:0xf992520c
y.create.l HWIO_PERIPH_SS_BLSP1_BLSP_QUP2_QUP_INPUT_DEBUG_ADDR A:0xf9925210
y.create.l HWIO_PERIPH_SS_BLSP1_BLSP_QUP2_QUP_INPUT_FIFO_WORD_CNT_ADDR A:0xf9925214
y.create.l HWIO_PERIPH_SS_BLSP1_BLSP_QUP2_QUP_INPUT_FIFO0_ADDR A:0xf9925218
y.create.l HWIO_PERIPH_SS_BLSP1_BLSP_QUP2_QUP_INPUT_FIFO1_ADDR A:0xf992521c
y.create.l HWIO_PERIPH_SS_BLSP1_BLSP_QUP2_QUP_INPUT_FIFO2_ADDR A:0xf9925220
y.create.l HWIO_PERIPH_SS_BLSP1_BLSP_QUP2_QUP_INPUT_FIFO3_ADDR A:0xf9925224
y.create.l HWIO_PERIPH_SS_BLSP1_BLSP_QUP2_QUP_INPUT_FIFO4_ADDR A:0xf9925228
y.create.l HWIO_PERIPH_SS_BLSP1_BLSP_QUP2_QUP_INPUT_FIFO5_ADDR A:0xf992522c
y.create.l HWIO_PERIPH_SS_BLSP1_BLSP_QUP2_QUP_INPUT_FIFO6_ADDR A:0xf9925230
y.create.l HWIO_PERIPH_SS_BLSP1_BLSP_QUP2_QUP_INPUT_FIFO7_ADDR A:0xf9925234
y.create.l HWIO_PERIPH_SS_BLSP1_BLSP_QUP2_QUP_INPUT_FIFO8_ADDR A:0xf9925238
y.create.l HWIO_PERIPH_SS_BLSP1_BLSP_QUP2_QUP_INPUT_FIFO9_ADDR A:0xf992523c
y.create.l HWIO_PERIPH_SS_BLSP1_BLSP_QUP2_SPI_CONFIG_ADDR A:0xf9925300
y.create.l HWIO_PERIPH_SS_BLSP1_BLSP_QUP2_SPI_IO_CONTROL_ADDR A:0xf9925304
y.create.l HWIO_PERIPH_SS_BLSP1_BLSP_QUP2_SPI_ERROR_FLAGS_ADDR A:0xf9925308
y.create.l HWIO_PERIPH_SS_BLSP1_BLSP_QUP2_SPI_ERROR_FLAGS_EN_ADDR A:0xf992530c
y.create.l HWIO_PERIPH_SS_BLSP1_BLSP_QUP2_SPI_DEASSERT_WAIT_ADDR A:0xf9925310
y.create.l HWIO_PERIPH_SS_BLSP1_BLSP_QUP2_SPI_CHAR_CFG_ADDR A:0xf9925320
y.create.l HWIO_PERIPH_SS_BLSP1_BLSP_QUP2_SPI_CHAR_DATA_SPI_CS_ADDR A:0xf9925324
y.create.l HWIO_PERIPH_SS_BLSP1_BLSP_QUP2_SPI_CHAR_DATA_SPI_MOSI_ADDR A:0xf9925328
y.create.l HWIO_PERIPH_SS_BLSP1_BLSP_QUP2_SPI_CHAR_DATA_SPI_MISO_ADDR A:0xf992532c
y.create.l HWIO_PERIPH_SS_BLSP1_BLSP_QUP2_I2C_MASTER_CLK_CTL_ADDR A:0xf9925400
y.create.l HWIO_PERIPH_SS_BLSP1_BLSP_QUP2_I2C_MASTER_STATUS_ADDR A:0xf9925404
y.create.l HWIO_PERIPH_SS_BLSP1_BLSP_QUP2_I2C_MASTER_CONFIG_ADDR A:0xf9925408
y.create.l HWIO_PERIPH_SS_BLSP1_BLSP_QUP2_I2C_MASTER_BUS_CLEAR_ADDR A:0xf992540c
y.create.l HWIO_PERIPH_SS_BLSP1_BLSP_QUP2_I2C_MASTER_LOCAL_ID_ADDR A:0xf9925410
y.create.l HWIO_PERIPH_SS_BLSP1_BLSP_QUP3_QUP_CONFIG_ADDR A:0xf9926000
y.create.l HWIO_PERIPH_SS_BLSP1_BLSP_QUP3_QUP_STATE_ADDR A:0xf9926004
y.create.l HWIO_PERIPH_SS_BLSP1_BLSP_QUP3_QUP_IO_MODES_ADDR A:0xf9926008
y.create.l HWIO_PERIPH_SS_BLSP1_BLSP_QUP3_QUP_SW_RESET_ADDR A:0xf992600c
y.create.l HWIO_PERIPH_SS_BLSP1_BLSP_QUP3_QUP_OPERATIONAL_ADDR A:0xf9926018
y.create.l HWIO_PERIPH_SS_BLSP1_BLSP_QUP3_QUP_ERROR_FLAGS_ADDR A:0xf992601c
y.create.l HWIO_PERIPH_SS_BLSP1_BLSP_QUP3_QUP_ERROR_FLAGS_EN_ADDR A:0xf9926020
y.create.l HWIO_PERIPH_SS_BLSP1_BLSP_QUP3_QUP_TEST_CTRL_ADDR A:0xf9926024
y.create.l HWIO_PERIPH_SS_BLSP1_BLSP_QUP3_QUP_OPERATIONAL_MASK_ADDR A:0xf9926028
y.create.l HWIO_PERIPH_SS_BLSP1_BLSP_QUP3_QUP_HW_VERSION_ADDR A:0xf9926030
y.create.l HWIO_PERIPH_SS_BLSP1_BLSP_QUP3_QUP_MX_OUTPUT_COUNT_ADDR A:0xf9926100
y.create.l HWIO_PERIPH_SS_BLSP1_BLSP_QUP3_QUP_MX_OUTPUT_CNT_CURRENT_ADDR A:0xf9926104
y.create.l HWIO_PERIPH_SS_BLSP1_BLSP_QUP3_QUP_OUTPUT_DEBUG_ADDR A:0xf9926108
y.create.l HWIO_PERIPH_SS_BLSP1_BLSP_QUP3_QUP_OUTPUT_FIFO_WORD_CNT_ADDR A:0xf992610c
y.create.l HWIO_PERIPH_SS_BLSP1_BLSP_QUP3_QUP_OUTPUT_FIFO0_ADDR A:0xf9926110
y.create.l HWIO_PERIPH_SS_BLSP1_BLSP_QUP3_QUP_OUTPUT_FIFO1_ADDR A:0xf9926114
y.create.l HWIO_PERIPH_SS_BLSP1_BLSP_QUP3_QUP_OUTPUT_FIFO2_ADDR A:0xf9926118
y.create.l HWIO_PERIPH_SS_BLSP1_BLSP_QUP3_QUP_OUTPUT_FIFO3_ADDR A:0xf992611c
y.create.l HWIO_PERIPH_SS_BLSP1_BLSP_QUP3_QUP_OUTPUT_FIFO4_ADDR A:0xf9926120
y.create.l HWIO_PERIPH_SS_BLSP1_BLSP_QUP3_QUP_OUTPUT_FIFO5_ADDR A:0xf9926124
y.create.l HWIO_PERIPH_SS_BLSP1_BLSP_QUP3_QUP_OUTPUT_FIFO6_ADDR A:0xf9926128
y.create.l HWIO_PERIPH_SS_BLSP1_BLSP_QUP3_QUP_OUTPUT_FIFO7_ADDR A:0xf992612c
y.create.l HWIO_PERIPH_SS_BLSP1_BLSP_QUP3_QUP_OUTPUT_FIFO8_ADDR A:0xf9926130
y.create.l HWIO_PERIPH_SS_BLSP1_BLSP_QUP3_QUP_OUTPUT_FIFO9_ADDR A:0xf9926134
y.create.l HWIO_PERIPH_SS_BLSP1_BLSP_QUP3_QUP_MX_WRITE_COUNT_ADDR A:0xf9926150
y.create.l HWIO_PERIPH_SS_BLSP1_BLSP_QUP3_QUP_MX_WRITE_CNT_CURRENT_ADDR A:0xf9926154
y.create.l HWIO_PERIPH_SS_BLSP1_BLSP_QUP3_QUP_MX_INPUT_COUNT_ADDR A:0xf9926200
y.create.l HWIO_PERIPH_SS_BLSP1_BLSP_QUP3_QUP_MX_INPUT_CNT_CURRENT_ADDR A:0xf9926204
y.create.l HWIO_PERIPH_SS_BLSP1_BLSP_QUP3_QUP_MX_READ_COUNT_ADDR A:0xf9926208
y.create.l HWIO_PERIPH_SS_BLSP1_BLSP_QUP3_QUP_MX_READ_CNT_CURRENT_ADDR A:0xf992620c
y.create.l HWIO_PERIPH_SS_BLSP1_BLSP_QUP3_QUP_INPUT_DEBUG_ADDR A:0xf9926210
y.create.l HWIO_PERIPH_SS_BLSP1_BLSP_QUP3_QUP_INPUT_FIFO_WORD_CNT_ADDR A:0xf9926214
y.create.l HWIO_PERIPH_SS_BLSP1_BLSP_QUP3_QUP_INPUT_FIFO0_ADDR A:0xf9926218
y.create.l HWIO_PERIPH_SS_BLSP1_BLSP_QUP3_QUP_INPUT_FIFO1_ADDR A:0xf992621c
y.create.l HWIO_PERIPH_SS_BLSP1_BLSP_QUP3_QUP_INPUT_FIFO2_ADDR A:0xf9926220
y.create.l HWIO_PERIPH_SS_BLSP1_BLSP_QUP3_QUP_INPUT_FIFO3_ADDR A:0xf9926224
y.create.l HWIO_PERIPH_SS_BLSP1_BLSP_QUP3_QUP_INPUT_FIFO4_ADDR A:0xf9926228
y.create.l HWIO_PERIPH_SS_BLSP1_BLSP_QUP3_QUP_INPUT_FIFO5_ADDR A:0xf992622c
y.create.l HWIO_PERIPH_SS_BLSP1_BLSP_QUP3_QUP_INPUT_FIFO6_ADDR A:0xf9926230
y.create.l HWIO_PERIPH_SS_BLSP1_BLSP_QUP3_QUP_INPUT_FIFO7_ADDR A:0xf9926234
y.create.l HWIO_PERIPH_SS_BLSP1_BLSP_QUP3_QUP_INPUT_FIFO8_ADDR A:0xf9926238
y.create.l HWIO_PERIPH_SS_BLSP1_BLSP_QUP3_QUP_INPUT_FIFO9_ADDR A:0xf992623c
y.create.l HWIO_PERIPH_SS_BLSP1_BLSP_QUP3_SPI_CONFIG_ADDR A:0xf9926300
y.create.l HWIO_PERIPH_SS_BLSP1_BLSP_QUP3_SPI_IO_CONTROL_ADDR A:0xf9926304
y.create.l HWIO_PERIPH_SS_BLSP1_BLSP_QUP3_SPI_ERROR_FLAGS_ADDR A:0xf9926308
y.create.l HWIO_PERIPH_SS_BLSP1_BLSP_QUP3_SPI_ERROR_FLAGS_EN_ADDR A:0xf992630c
y.create.l HWIO_PERIPH_SS_BLSP1_BLSP_QUP3_SPI_DEASSERT_WAIT_ADDR A:0xf9926310
y.create.l HWIO_PERIPH_SS_BLSP1_BLSP_QUP3_SPI_CHAR_CFG_ADDR A:0xf9926320
y.create.l HWIO_PERIPH_SS_BLSP1_BLSP_QUP3_SPI_CHAR_DATA_SPI_CS_ADDR A:0xf9926324
y.create.l HWIO_PERIPH_SS_BLSP1_BLSP_QUP3_SPI_CHAR_DATA_SPI_MOSI_ADDR A:0xf9926328
y.create.l HWIO_PERIPH_SS_BLSP1_BLSP_QUP3_SPI_CHAR_DATA_SPI_MISO_ADDR A:0xf992632c
y.create.l HWIO_PERIPH_SS_BLSP1_BLSP_QUP3_I2C_MASTER_CLK_CTL_ADDR A:0xf9926400
y.create.l HWIO_PERIPH_SS_BLSP1_BLSP_QUP3_I2C_MASTER_STATUS_ADDR A:0xf9926404
y.create.l HWIO_PERIPH_SS_BLSP1_BLSP_QUP3_I2C_MASTER_CONFIG_ADDR A:0xf9926408
y.create.l HWIO_PERIPH_SS_BLSP1_BLSP_QUP3_I2C_MASTER_BUS_CLEAR_ADDR A:0xf992640c
y.create.l HWIO_PERIPH_SS_BLSP1_BLSP_QUP3_I2C_MASTER_LOCAL_ID_ADDR A:0xf9926410
y.create.l HWIO_PERIPH_SS_BLSP1_BLSP_QUP4_QUP_CONFIG_ADDR A:0xf9927000
y.create.l HWIO_PERIPH_SS_BLSP1_BLSP_QUP4_QUP_STATE_ADDR A:0xf9927004
y.create.l HWIO_PERIPH_SS_BLSP1_BLSP_QUP4_QUP_IO_MODES_ADDR A:0xf9927008
y.create.l HWIO_PERIPH_SS_BLSP1_BLSP_QUP4_QUP_SW_RESET_ADDR A:0xf992700c
y.create.l HWIO_PERIPH_SS_BLSP1_BLSP_QUP4_QUP_OPERATIONAL_ADDR A:0xf9927018
y.create.l HWIO_PERIPH_SS_BLSP1_BLSP_QUP4_QUP_ERROR_FLAGS_ADDR A:0xf992701c
y.create.l HWIO_PERIPH_SS_BLSP1_BLSP_QUP4_QUP_ERROR_FLAGS_EN_ADDR A:0xf9927020
y.create.l HWIO_PERIPH_SS_BLSP1_BLSP_QUP4_QUP_TEST_CTRL_ADDR A:0xf9927024
y.create.l HWIO_PERIPH_SS_BLSP1_BLSP_QUP4_QUP_OPERATIONAL_MASK_ADDR A:0xf9927028
y.create.l HWIO_PERIPH_SS_BLSP1_BLSP_QUP4_QUP_HW_VERSION_ADDR A:0xf9927030
y.create.l HWIO_PERIPH_SS_BLSP1_BLSP_QUP4_QUP_MX_OUTPUT_COUNT_ADDR A:0xf9927100
y.create.l HWIO_PERIPH_SS_BLSP1_BLSP_QUP4_QUP_MX_OUTPUT_CNT_CURRENT_ADDR A:0xf9927104
y.create.l HWIO_PERIPH_SS_BLSP1_BLSP_QUP4_QUP_OUTPUT_DEBUG_ADDR A:0xf9927108
y.create.l HWIO_PERIPH_SS_BLSP1_BLSP_QUP4_QUP_OUTPUT_FIFO_WORD_CNT_ADDR A:0xf992710c
y.create.l HWIO_PERIPH_SS_BLSP1_BLSP_QUP4_QUP_OUTPUT_FIFO0_ADDR A:0xf9927110
y.create.l HWIO_PERIPH_SS_BLSP1_BLSP_QUP4_QUP_OUTPUT_FIFO1_ADDR A:0xf9927114
y.create.l HWIO_PERIPH_SS_BLSP1_BLSP_QUP4_QUP_OUTPUT_FIFO2_ADDR A:0xf9927118
y.create.l HWIO_PERIPH_SS_BLSP1_BLSP_QUP4_QUP_OUTPUT_FIFO3_ADDR A:0xf992711c
y.create.l HWIO_PERIPH_SS_BLSP1_BLSP_QUP4_QUP_OUTPUT_FIFO4_ADDR A:0xf9927120
y.create.l HWIO_PERIPH_SS_BLSP1_BLSP_QUP4_QUP_OUTPUT_FIFO5_ADDR A:0xf9927124
y.create.l HWIO_PERIPH_SS_BLSP1_BLSP_QUP4_QUP_OUTPUT_FIFO6_ADDR A:0xf9927128
y.create.l HWIO_PERIPH_SS_BLSP1_BLSP_QUP4_QUP_OUTPUT_FIFO7_ADDR A:0xf992712c
y.create.l HWIO_PERIPH_SS_BLSP1_BLSP_QUP4_QUP_OUTPUT_FIFO8_ADDR A:0xf9927130
y.create.l HWIO_PERIPH_SS_BLSP1_BLSP_QUP4_QUP_OUTPUT_FIFO9_ADDR A:0xf9927134
y.create.l HWIO_PERIPH_SS_BLSP1_BLSP_QUP4_QUP_MX_WRITE_COUNT_ADDR A:0xf9927150
y.create.l HWIO_PERIPH_SS_BLSP1_BLSP_QUP4_QUP_MX_WRITE_CNT_CURRENT_ADDR A:0xf9927154
y.create.l HWIO_PERIPH_SS_BLSP1_BLSP_QUP4_QUP_MX_INPUT_COUNT_ADDR A:0xf9927200
y.create.l HWIO_PERIPH_SS_BLSP1_BLSP_QUP4_QUP_MX_INPUT_CNT_CURRENT_ADDR A:0xf9927204
y.create.l HWIO_PERIPH_SS_BLSP1_BLSP_QUP4_QUP_MX_READ_COUNT_ADDR A:0xf9927208
y.create.l HWIO_PERIPH_SS_BLSP1_BLSP_QUP4_QUP_MX_READ_CNT_CURRENT_ADDR A:0xf992720c
y.create.l HWIO_PERIPH_SS_BLSP1_BLSP_QUP4_QUP_INPUT_DEBUG_ADDR A:0xf9927210
y.create.l HWIO_PERIPH_SS_BLSP1_BLSP_QUP4_QUP_INPUT_FIFO_WORD_CNT_ADDR A:0xf9927214
y.create.l HWIO_PERIPH_SS_BLSP1_BLSP_QUP4_QUP_INPUT_FIFO0_ADDR A:0xf9927218
y.create.l HWIO_PERIPH_SS_BLSP1_BLSP_QUP4_QUP_INPUT_FIFO1_ADDR A:0xf992721c
y.create.l HWIO_PERIPH_SS_BLSP1_BLSP_QUP4_QUP_INPUT_FIFO2_ADDR A:0xf9927220
y.create.l HWIO_PERIPH_SS_BLSP1_BLSP_QUP4_QUP_INPUT_FIFO3_ADDR A:0xf9927224
y.create.l HWIO_PERIPH_SS_BLSP1_BLSP_QUP4_QUP_INPUT_FIFO4_ADDR A:0xf9927228
y.create.l HWIO_PERIPH_SS_BLSP1_BLSP_QUP4_QUP_INPUT_FIFO5_ADDR A:0xf992722c
y.create.l HWIO_PERIPH_SS_BLSP1_BLSP_QUP4_QUP_INPUT_FIFO6_ADDR A:0xf9927230
y.create.l HWIO_PERIPH_SS_BLSP1_BLSP_QUP4_QUP_INPUT_FIFO7_ADDR A:0xf9927234
y.create.l HWIO_PERIPH_SS_BLSP1_BLSP_QUP4_QUP_INPUT_FIFO8_ADDR A:0xf9927238
y.create.l HWIO_PERIPH_SS_BLSP1_BLSP_QUP4_QUP_INPUT_FIFO9_ADDR A:0xf992723c
y.create.l HWIO_PERIPH_SS_BLSP1_BLSP_QUP4_SPI_CONFIG_ADDR A:0xf9927300
y.create.l HWIO_PERIPH_SS_BLSP1_BLSP_QUP4_SPI_IO_CONTROL_ADDR A:0xf9927304
y.create.l HWIO_PERIPH_SS_BLSP1_BLSP_QUP4_SPI_ERROR_FLAGS_ADDR A:0xf9927308
y.create.l HWIO_PERIPH_SS_BLSP1_BLSP_QUP4_SPI_ERROR_FLAGS_EN_ADDR A:0xf992730c
y.create.l HWIO_PERIPH_SS_BLSP1_BLSP_QUP4_SPI_DEASSERT_WAIT_ADDR A:0xf9927310
y.create.l HWIO_PERIPH_SS_BLSP1_BLSP_QUP4_SPI_CHAR_CFG_ADDR A:0xf9927320
y.create.l HWIO_PERIPH_SS_BLSP1_BLSP_QUP4_SPI_CHAR_DATA_SPI_CS_ADDR A:0xf9927324
y.create.l HWIO_PERIPH_SS_BLSP1_BLSP_QUP4_SPI_CHAR_DATA_SPI_MOSI_ADDR A:0xf9927328
y.create.l HWIO_PERIPH_SS_BLSP1_BLSP_QUP4_SPI_CHAR_DATA_SPI_MISO_ADDR A:0xf992732c
y.create.l HWIO_PERIPH_SS_BLSP1_BLSP_QUP4_I2C_MASTER_CLK_CTL_ADDR A:0xf9927400
y.create.l HWIO_PERIPH_SS_BLSP1_BLSP_QUP4_I2C_MASTER_STATUS_ADDR A:0xf9927404
y.create.l HWIO_PERIPH_SS_BLSP1_BLSP_QUP4_I2C_MASTER_CONFIG_ADDR A:0xf9927408
y.create.l HWIO_PERIPH_SS_BLSP1_BLSP_QUP4_I2C_MASTER_BUS_CLEAR_ADDR A:0xf992740c
y.create.l HWIO_PERIPH_SS_BLSP1_BLSP_QUP4_I2C_MASTER_LOCAL_ID_ADDR A:0xf9927410
y.create.l HWIO_PERIPH_SS_BLSP1_BLSP_QUP5_QUP_CONFIG_ADDR A:0xf9928000
y.create.l HWIO_PERIPH_SS_BLSP1_BLSP_QUP5_QUP_STATE_ADDR A:0xf9928004
y.create.l HWIO_PERIPH_SS_BLSP1_BLSP_QUP5_QUP_IO_MODES_ADDR A:0xf9928008
y.create.l HWIO_PERIPH_SS_BLSP1_BLSP_QUP5_QUP_SW_RESET_ADDR A:0xf992800c
y.create.l HWIO_PERIPH_SS_BLSP1_BLSP_QUP5_QUP_OPERATIONAL_ADDR A:0xf9928018
y.create.l HWIO_PERIPH_SS_BLSP1_BLSP_QUP5_QUP_ERROR_FLAGS_ADDR A:0xf992801c
y.create.l HWIO_PERIPH_SS_BLSP1_BLSP_QUP5_QUP_ERROR_FLAGS_EN_ADDR A:0xf9928020
y.create.l HWIO_PERIPH_SS_BLSP1_BLSP_QUP5_QUP_TEST_CTRL_ADDR A:0xf9928024
y.create.l HWIO_PERIPH_SS_BLSP1_BLSP_QUP5_QUP_OPERATIONAL_MASK_ADDR A:0xf9928028
y.create.l HWIO_PERIPH_SS_BLSP1_BLSP_QUP5_QUP_HW_VERSION_ADDR A:0xf9928030
y.create.l HWIO_PERIPH_SS_BLSP1_BLSP_QUP5_QUP_MX_OUTPUT_COUNT_ADDR A:0xf9928100
y.create.l HWIO_PERIPH_SS_BLSP1_BLSP_QUP5_QUP_MX_OUTPUT_CNT_CURRENT_ADDR A:0xf9928104
y.create.l HWIO_PERIPH_SS_BLSP1_BLSP_QUP5_QUP_OUTPUT_DEBUG_ADDR A:0xf9928108
y.create.l HWIO_PERIPH_SS_BLSP1_BLSP_QUP5_QUP_OUTPUT_FIFO_WORD_CNT_ADDR A:0xf992810c
y.create.l HWIO_PERIPH_SS_BLSP1_BLSP_QUP5_QUP_OUTPUT_FIFO0_ADDR A:0xf9928110
y.create.l HWIO_PERIPH_SS_BLSP1_BLSP_QUP5_QUP_OUTPUT_FIFO1_ADDR A:0xf9928114
y.create.l HWIO_PERIPH_SS_BLSP1_BLSP_QUP5_QUP_OUTPUT_FIFO2_ADDR A:0xf9928118
y.create.l HWIO_PERIPH_SS_BLSP1_BLSP_QUP5_QUP_OUTPUT_FIFO3_ADDR A:0xf992811c
y.create.l HWIO_PERIPH_SS_BLSP1_BLSP_QUP5_QUP_OUTPUT_FIFO4_ADDR A:0xf9928120
y.create.l HWIO_PERIPH_SS_BLSP1_BLSP_QUP5_QUP_OUTPUT_FIFO5_ADDR A:0xf9928124
y.create.l HWIO_PERIPH_SS_BLSP1_BLSP_QUP5_QUP_OUTPUT_FIFO6_ADDR A:0xf9928128
y.create.l HWIO_PERIPH_SS_BLSP1_BLSP_QUP5_QUP_OUTPUT_FIFO7_ADDR A:0xf992812c
y.create.l HWIO_PERIPH_SS_BLSP1_BLSP_QUP5_QUP_OUTPUT_FIFO8_ADDR A:0xf9928130
y.create.l HWIO_PERIPH_SS_BLSP1_BLSP_QUP5_QUP_OUTPUT_FIFO9_ADDR A:0xf9928134
y.create.l HWIO_PERIPH_SS_BLSP1_BLSP_QUP5_QUP_MX_WRITE_COUNT_ADDR A:0xf9928150
y.create.l HWIO_PERIPH_SS_BLSP1_BLSP_QUP5_QUP_MX_WRITE_CNT_CURRENT_ADDR A:0xf9928154
y.create.l HWIO_PERIPH_SS_BLSP1_BLSP_QUP5_QUP_MX_INPUT_COUNT_ADDR A:0xf9928200
y.create.l HWIO_PERIPH_SS_BLSP1_BLSP_QUP5_QUP_MX_INPUT_CNT_CURRENT_ADDR A:0xf9928204
y.create.l HWIO_PERIPH_SS_BLSP1_BLSP_QUP5_QUP_MX_READ_COUNT_ADDR A:0xf9928208
y.create.l HWIO_PERIPH_SS_BLSP1_BLSP_QUP5_QUP_MX_READ_CNT_CURRENT_ADDR A:0xf992820c
y.create.l HWIO_PERIPH_SS_BLSP1_BLSP_QUP5_QUP_INPUT_DEBUG_ADDR A:0xf9928210
y.create.l HWIO_PERIPH_SS_BLSP1_BLSP_QUP5_QUP_INPUT_FIFO_WORD_CNT_ADDR A:0xf9928214
y.create.l HWIO_PERIPH_SS_BLSP1_BLSP_QUP5_QUP_INPUT_FIFO0_ADDR A:0xf9928218
y.create.l HWIO_PERIPH_SS_BLSP1_BLSP_QUP5_QUP_INPUT_FIFO1_ADDR A:0xf992821c
y.create.l HWIO_PERIPH_SS_BLSP1_BLSP_QUP5_QUP_INPUT_FIFO2_ADDR A:0xf9928220
y.create.l HWIO_PERIPH_SS_BLSP1_BLSP_QUP5_QUP_INPUT_FIFO3_ADDR A:0xf9928224
y.create.l HWIO_PERIPH_SS_BLSP1_BLSP_QUP5_QUP_INPUT_FIFO4_ADDR A:0xf9928228
y.create.l HWIO_PERIPH_SS_BLSP1_BLSP_QUP5_QUP_INPUT_FIFO5_ADDR A:0xf992822c
y.create.l HWIO_PERIPH_SS_BLSP1_BLSP_QUP5_QUP_INPUT_FIFO6_ADDR A:0xf9928230
y.create.l HWIO_PERIPH_SS_BLSP1_BLSP_QUP5_QUP_INPUT_FIFO7_ADDR A:0xf9928234
y.create.l HWIO_PERIPH_SS_BLSP1_BLSP_QUP5_QUP_INPUT_FIFO8_ADDR A:0xf9928238
y.create.l HWIO_PERIPH_SS_BLSP1_BLSP_QUP5_QUP_INPUT_FIFO9_ADDR A:0xf992823c
y.create.l HWIO_PERIPH_SS_BLSP1_BLSP_QUP5_SPI_CONFIG_ADDR A:0xf9928300
y.create.l HWIO_PERIPH_SS_BLSP1_BLSP_QUP5_SPI_IO_CONTROL_ADDR A:0xf9928304
y.create.l HWIO_PERIPH_SS_BLSP1_BLSP_QUP5_SPI_ERROR_FLAGS_ADDR A:0xf9928308
y.create.l HWIO_PERIPH_SS_BLSP1_BLSP_QUP5_SPI_ERROR_FLAGS_EN_ADDR A:0xf992830c
y.create.l HWIO_PERIPH_SS_BLSP1_BLSP_QUP5_SPI_DEASSERT_WAIT_ADDR A:0xf9928310
y.create.l HWIO_PERIPH_SS_BLSP1_BLSP_QUP5_SPI_CHAR_CFG_ADDR A:0xf9928320
y.create.l HWIO_PERIPH_SS_BLSP1_BLSP_QUP5_SPI_CHAR_DATA_SPI_CS_ADDR A:0xf9928324
y.create.l HWIO_PERIPH_SS_BLSP1_BLSP_QUP5_SPI_CHAR_DATA_SPI_MOSI_ADDR A:0xf9928328
y.create.l HWIO_PERIPH_SS_BLSP1_BLSP_QUP5_SPI_CHAR_DATA_SPI_MISO_ADDR A:0xf992832c
y.create.l HWIO_PERIPH_SS_BLSP1_BLSP_QUP5_I2C_MASTER_CLK_CTL_ADDR A:0xf9928400
y.create.l HWIO_PERIPH_SS_BLSP1_BLSP_QUP5_I2C_MASTER_STATUS_ADDR A:0xf9928404
y.create.l HWIO_PERIPH_SS_BLSP1_BLSP_QUP5_I2C_MASTER_CONFIG_ADDR A:0xf9928408
y.create.l HWIO_PERIPH_SS_BLSP1_BLSP_QUP5_I2C_MASTER_BUS_CLEAR_ADDR A:0xf992840c
y.create.l HWIO_PERIPH_SS_BLSP1_BLSP_QUP5_I2C_MASTER_LOCAL_ID_ADDR A:0xf9928410
y.create.l HWIO_PERIPH_SS_USB1_HS_USB_OTG_HS_ID_ADDR A:0xf9a55000
y.create.l HWIO_PERIPH_SS_USB1_HS_USB_OTG_HS_HWGENERAL_ADDR A:0xf9a55004
y.create.l HWIO_PERIPH_SS_USB1_HS_USB_OTG_HS_HWHOST_ADDR A:0xf9a55008
y.create.l HWIO_PERIPH_SS_USB1_HS_USB_OTG_HS_HWDEVICE_ADDR A:0xf9a5500c
y.create.l HWIO_PERIPH_SS_USB1_HS_USB_OTG_HS_HWTXBUF_ADDR A:0xf9a55010
y.create.l HWIO_PERIPH_SS_USB1_HS_USB_OTG_HS_HWRXBUF_ADDR A:0xf9a55014
y.create.l HWIO_PERIPH_SS_USB1_HS_USB_OTG_HS_SCRATCH_RAM0_ADDR A:0xf9a55040
y.create.l HWIO_PERIPH_SS_USB1_HS_USB_OTG_HS_SCRATCH_RAM1_ADDR A:0xf9a55044
y.create.l HWIO_PERIPH_SS_USB1_HS_USB_OTG_HS_SCRATCH_RAM2_ADDR A:0xf9a55048
y.create.l HWIO_PERIPH_SS_USB1_HS_USB_OTG_HS_SCRATCH_RAM3_ADDR A:0xf9a5504c
y.create.l HWIO_PERIPH_SS_USB1_HS_USB_OTG_HS_SCRATCH_RAM4_ADDR A:0xf9a55050
y.create.l HWIO_PERIPH_SS_USB1_HS_USB_OTG_HS_SCRATCH_RAM5_ADDR A:0xf9a55054
y.create.l HWIO_PERIPH_SS_USB1_HS_USB_OTG_HS_SCRATCH_RAM6_ADDR A:0xf9a55058
y.create.l HWIO_PERIPH_SS_USB1_HS_USB_OTG_HS_SCRATCH_RAM7_ADDR A:0xf9a5505c
y.create.l HWIO_PERIPH_SS_USB1_HS_USB_OTG_HS_SCRATCH_RAM8_ADDR A:0xf9a55060
y.create.l HWIO_PERIPH_SS_USB1_HS_USB_OTG_HS_SCRATCH_RAM9_ADDR A:0xf9a55064
y.create.l HWIO_PERIPH_SS_USB1_HS_USB_OTG_HS_GPTIMER0LD_ADDR A:0xf9a55080
y.create.l HWIO_PERIPH_SS_USB1_HS_USB_OTG_HS_GPTIMER0CTRL_ADDR A:0xf9a55084
y.create.l HWIO_PERIPH_SS_USB1_HS_USB_OTG_HS_GPTIMER1LD_ADDR A:0xf9a55088
y.create.l HWIO_PERIPH_SS_USB1_HS_USB_OTG_HS_GPTIMER1CTRL_ADDR A:0xf9a5508c
y.create.l HWIO_PERIPH_SS_USB1_HS_USB_OTG_HS_AHB_BURST_ADDR A:0xf9a55090
y.create.l HWIO_PERIPH_SS_USB1_HS_USB_OTG_HS_XTOR_STS_ADDR A:0xf9a55094
y.create.l HWIO_PERIPH_SS_USB1_HS_USB_OTG_HS_AHB_MODE_ADDR A:0xf9a55098
y.create.l HWIO_PERIPH_SS_USB1_HS_USB_OTG_HS_GEN_CONFIG_ADDR A:0xf9a5509c
y.create.l HWIO_PERIPH_SS_USB1_HS_USB_OTG_HS_GEN_CONFIG_2_ADDR A:0xf9a550a0
y.create.l HWIO_PERIPH_SS_USB1_HS_USB_OTG_HS_CAPLENGTH_ADDR A:0xf9a55100
y.create.l HWIO_PERIPH_SS_USB1_HS_USB_OTG_HS_HCSPARAMS_ADDR A:0xf9a55104
y.create.l HWIO_PERIPH_SS_USB1_HS_USB_OTG_HS_HCCPARAMS_ADDR A:0xf9a55108
y.create.l HWIO_PERIPH_SS_USB1_HS_USB_OTG_HS_DCIVERSION_ADDR A:0xf9a55120
y.create.l HWIO_PERIPH_SS_USB1_HS_USB_OTG_HS_DCCPARAMS_ADDR A:0xf9a55124
y.create.l HWIO_PERIPH_SS_USB1_HS_USB_OTG_HS_USBCMD_ADDR A:0xf9a55140
y.create.l HWIO_PERIPH_SS_USB1_HS_USB_OTG_HS_USBSTS_ADDR A:0xf9a55144
y.create.l HWIO_PERIPH_SS_USB1_HS_USB_OTG_HS_USBINTR_ADDR A:0xf9a55148
y.create.l HWIO_PERIPH_SS_USB1_HS_USB_OTG_HS_FRINDEX_ADDR A:0xf9a5514c
y.create.l HWIO_PERIPH_SS_USB1_HS_USB_OTG_HS_PERIODICLISTBASE_ADDR A:0xf9a55154
y.create.l HWIO_PERIPH_SS_USB1_HS_USB_OTG_HS_DEVICEADDR_ADDR A:0xf9a55154
y.create.l HWIO_PERIPH_SS_USB1_HS_USB_OTG_HS_ASYNCLISTADDR_ADDR A:0xf9a55158
y.create.l HWIO_PERIPH_SS_USB1_HS_USB_OTG_HS_ENDPOINTLISTADDR_ADDR A:0xf9a55158
y.create.l HWIO_PERIPH_SS_USB1_HS_USB_OTG_HS_TTCTRL_ADDR A:0xf9a5515c
y.create.l HWIO_PERIPH_SS_USB1_HS_USB_OTG_HS_BURSTSIZE_ADDR A:0xf9a55160
y.create.l HWIO_PERIPH_SS_USB1_HS_USB_OTG_HS_TXFILLTUNING_ADDR A:0xf9a55164
y.create.l HWIO_PERIPH_SS_USB1_HS_USB_OTG_HS_ULPI_VIEWPORT_ADDR A:0xf9a55170
y.create.l HWIO_PERIPH_SS_USB1_HS_USB_OTG_HS_ENDPTNAK_ADDR A:0xf9a55178
y.create.l HWIO_PERIPH_SS_USB1_HS_USB_OTG_HS_ENDPTNAKEN_ADDR A:0xf9a5517c
y.create.l HWIO_PERIPH_SS_USB1_HS_USB_OTG_HS_PORTSC_ADDR A:0xf9a55184
y.create.l HWIO_PERIPH_SS_USB1_HS_USB_OTG_HS_OTGSC_ADDR A:0xf9a551a4
y.create.l HWIO_PERIPH_SS_USB1_HS_USB_OTG_HS_USBMODE_ADDR A:0xf9a551a8
y.create.l HWIO_PERIPH_SS_USB1_HS_USB_OTG_HS_ENDPTSETUPSTAT_ADDR A:0xf9a551ac
y.create.l HWIO_PERIPH_SS_USB1_HS_USB_OTG_HS_ENDPTPRIME_ADDR A:0xf9a551b0
y.create.l HWIO_PERIPH_SS_USB1_HS_USB_OTG_HS_ENDPTFLUSH_ADDR A:0xf9a551b4
y.create.l HWIO_PERIPH_SS_USB1_HS_USB_OTG_HS_ENDPTSTAT_ADDR A:0xf9a551b8
y.create.l HWIO_PERIPH_SS_USB1_HS_USB_OTG_HS_ENDPTCOMPLETE_ADDR A:0xf9a551bc
y.create.l HWIO_PERIPH_SS_USB1_HS_USB_OTG_HS_ENDPTCTRL0_ADDR A:0xf9a551c0
y.create.l HWIO_PERIPH_SS_USB1_HS_USB_OTG_HS_ENDPTCTRL1_ADDR A:0xf9a551c4
y.create.l HWIO_PERIPH_SS_USB1_HS_USB_OTG_HS_ENDPTCTRL2_ADDR A:0xf9a551c8
y.create.l HWIO_PERIPH_SS_USB1_HS_USB_OTG_HS_ENDPTCTRL3_ADDR A:0xf9a551cc
y.create.l HWIO_PERIPH_SS_USB1_HS_USB_OTG_HS_ENDPTCTRL4_ADDR A:0xf9a551d0
y.create.l HWIO_PERIPH_SS_USB1_HS_USB_OTG_HS_ENDPTCTRL5_ADDR A:0xf9a551d4
y.create.l HWIO_PERIPH_SS_USB1_HS_USB_OTG_HS_ENDPTCTRL6_ADDR A:0xf9a551d8
y.create.l HWIO_PERIPH_SS_USB1_HS_USB_OTG_HS_ENDPTCTRL7_ADDR A:0xf9a551dc
y.create.l HWIO_PERIPH_SS_USB1_HS_USB_OTG_HS_ENDPTCTRL8_ADDR A:0xf9a551e0
y.create.l HWIO_PERIPH_SS_USB1_HS_USB_OTG_HS_ENDPTCTRL9_ADDR A:0xf9a551e4
y.create.l HWIO_PERIPH_SS_USB1_HS_USB_OTG_HS_ENDPTCTRL10_ADDR A:0xf9a551e8
y.create.l HWIO_PERIPH_SS_USB1_HS_USB_OTG_HS_ENDPT_PIPE_ID1_ADDR A:0xf9a55200
y.create.l HWIO_PERIPH_SS_USB1_HS_USB_OTG_HS_ENDPT_PIPE_ID2_ADDR A:0xf9a55204
y.create.l HWIO_PERIPH_SS_USB1_HS_USB_OTG_HS_ENDPT_PIPE_ID3_ADDR A:0xf9a55208
y.create.l HWIO_PERIPH_SS_USB1_HS_USB_OTG_HS_ENDPT_PIPE_ID4_ADDR A:0xf9a5520c
y.create.l HWIO_PERIPH_SS_USB1_HS_USB_OTG_HS_ENDPT_PIPE_ID5_ADDR A:0xf9a55210
y.create.l HWIO_PERIPH_SS_USB1_HS_USB_OTG_HS_ENDPT_PIPE_ID6_ADDR A:0xf9a55214
y.create.l HWIO_PERIPH_SS_USB1_HS_USB_OTG_HS_ENDPT_PIPE_ID7_ADDR A:0xf9a55218
y.create.l HWIO_PERIPH_SS_USB1_HS_USB_OTG_HS_ENDPT_PIPE_ID8_ADDR A:0xf9a5521c
y.create.l HWIO_PERIPH_SS_USB1_HS_USB_OTG_HS_ENDPT_PIPE_ID9_ADDR A:0xf9a55220
y.create.l HWIO_PERIPH_SS_USB1_HS_USB_OTG_HS_ENDPT_PIPE_ID10_ADDR A:0xf9a55224
y.create.l HWIO_PERIPH_SS_USB1_HS_USB_OTG_HS_PHY_CTRL_ADDR A:0xf9a55240
y.create.l HWIO_PERIPH_SS_USB1_HS_USB_OTG_HS_GENERIC1_ADDR A:0xf9a55244
y.create.l HWIO_PERIPH_SS_USB1_HS_USB_OTG_HS_GENERIC2_ADDR A:0xf9a55248
y.create.l HWIO_PERIPH_SS_USB1_HS_USB_OTG_HS_HW_VER_ADDR A:0xf9a55270
y.create.l HWIO_PERIPH_SS_USB1_HS_USB_OTG_HS_TEST_BUS_ADDR A:0xf9a55274
y.create.l HWIO_PERIPH_SS_USB1_HS_USB_OTG_HS_PHY_SEC_CTRL_ADDR A:0xf9a55278
y.create.l HWIO_PERIPH_SS_USB1_HS_USB_OTG_HS_BTO_TIME_HS_ADDR A:0xf9a55340
y.create.l HWIO_PERIPH_SS_USB1_HS_USB_OTG_HS_BTO_TIME_FS_LS_ADDR A:0xf9a55344
y.create.l HWIO_PERIPH_SS_USB1_HS_USB_OTG_HS_QSB_VALUES_ADDR A:0xf9a55348
y.create.l HWIO_PERIPH_SS_USB1_HS_BAM_CTRL_ADDR A:0xf9a44000
y.create.l HWIO_PERIPH_SS_USB1_HS_BAM_REVISION_ADDR A:0xf9a44004
y.create.l HWIO_PERIPH_SS_USB1_HS_BAM_SW_VERSION_ADDR A:0xf9a44080
y.create.l HWIO_PERIPH_SS_USB1_HS_BAM_NUM_PIPES_ADDR A:0xf9a4403c
y.create.l HWIO_PERIPH_SS_USB1_HS_BAM_TIMER_ADDR A:0xf9a44040
y.create.l HWIO_PERIPH_SS_USB1_HS_BAM_TIMER_CTRL_ADDR A:0xf9a44044
y.create.l HWIO_PERIPH_SS_USB1_HS_BAM_DESC_CNT_TRSHLD_ADDR A:0xf9a44008
y.create.l HWIO_PERIPH_SS_USB1_HS_BAM_IRQ_SRCS_ADDR A:0xf9a4400c
y.create.l HWIO_PERIPH_SS_USB1_HS_BAM_IRQ_SRCS_MSK_ADDR A:0xf9a44010
y.create.l HWIO_PERIPH_SS_USB1_HS_BAM_IRQ_SRCS_UNMASKED_ADDR A:0xf9a44030
y.create.l HWIO_PERIPH_SS_USB1_HS_BAM_IRQ_STTS_ADDR A:0xf9a44014
y.create.l HWIO_PERIPH_SS_USB1_HS_BAM_IRQ_CLR_ADDR A:0xf9a44018
y.create.l HWIO_PERIPH_SS_USB1_HS_BAM_IRQ_EN_ADDR A:0xf9a4401c
y.create.l HWIO_PERIPH_SS_USB1_HS_BAM_AHB_MASTER_ERR_CTRLS_ADDR A:0xf9a44024
y.create.l HWIO_PERIPH_SS_USB1_HS_BAM_AHB_MASTER_ERR_ADDR_ADDR A:0xf9a44028
y.create.l HWIO_PERIPH_SS_USB1_HS_BAM_AHB_MASTER_ERR_DATA_ADDR A:0xf9a4402c
y.create.l HWIO_PERIPH_SS_USB1_HS_BAM_TRUST_REG_ADDR A:0xf9a44070
y.create.l HWIO_PERIPH_SS_USB1_HS_BAM_TEST_BUS_SEL_ADDR A:0xf9a44074
y.create.l HWIO_PERIPH_SS_USB1_HS_BAM_TEST_BUS_REG_ADDR A:0xf9a44078
y.create.l HWIO_PERIPH_SS_USB1_HS_BAM_CNFG_BITS_ADDR A:0xf9a4407c
y.create.l HWIO_PERIPH_SS_USB1_HS_BAM_IRQ_SRCS_EE0_ADDR A:0xf9a44800
y.create.l HWIO_PERIPH_SS_USB1_HS_BAM_IRQ_SRCS_EE1_ADDR A:0xf9a44880
y.create.l HWIO_PERIPH_SS_USB1_HS_BAM_IRQ_SRCS_EE2_ADDR A:0xf9a44900
y.create.l HWIO_PERIPH_SS_USB1_HS_BAM_IRQ_SRCS_EE3_ADDR A:0xf9a44980
y.create.l HWIO_PERIPH_SS_USB1_HS_BAM_IRQ_SRCS_EE4_ADDR A:0xf9a44a00
y.create.l HWIO_PERIPH_SS_USB1_HS_BAM_IRQ_SRCS_EE5_ADDR A:0xf9a44a80
y.create.l HWIO_PERIPH_SS_USB1_HS_BAM_IRQ_SRCS_EE6_ADDR A:0xf9a44b00
y.create.l HWIO_PERIPH_SS_USB1_HS_BAM_IRQ_SRCS_EE7_ADDR A:0xf9a44b80
y.create.l HWIO_PERIPH_SS_USB1_HS_BAM_IRQ_SRCS_MSK_EE0_ADDR A:0xf9a44804
y.create.l HWIO_PERIPH_SS_USB1_HS_BAM_IRQ_SRCS_MSK_EE1_ADDR A:0xf9a44884
y.create.l HWIO_PERIPH_SS_USB1_HS_BAM_IRQ_SRCS_MSK_EE2_ADDR A:0xf9a44904
y.create.l HWIO_PERIPH_SS_USB1_HS_BAM_IRQ_SRCS_MSK_EE3_ADDR A:0xf9a44984
y.create.l HWIO_PERIPH_SS_USB1_HS_BAM_IRQ_SRCS_MSK_EE4_ADDR A:0xf9a44a04
y.create.l HWIO_PERIPH_SS_USB1_HS_BAM_IRQ_SRCS_MSK_EE5_ADDR A:0xf9a44a84
y.create.l HWIO_PERIPH_SS_USB1_HS_BAM_IRQ_SRCS_MSK_EE6_ADDR A:0xf9a44b04
y.create.l HWIO_PERIPH_SS_USB1_HS_BAM_IRQ_SRCS_MSK_EE7_ADDR A:0xf9a44b84
y.create.l HWIO_PERIPH_SS_USB1_HS_BAM_IRQ_SRCS_UNMASKED_EE0_ADDR A:0xf9a44808
y.create.l HWIO_PERIPH_SS_USB1_HS_BAM_IRQ_SRCS_UNMASKED_EE1_ADDR A:0xf9a44888
y.create.l HWIO_PERIPH_SS_USB1_HS_BAM_IRQ_SRCS_UNMASKED_EE2_ADDR A:0xf9a44908
y.create.l HWIO_PERIPH_SS_USB1_HS_BAM_IRQ_SRCS_UNMASKED_EE3_ADDR A:0xf9a44988
y.create.l HWIO_PERIPH_SS_USB1_HS_BAM_IRQ_SRCS_UNMASKED_EE4_ADDR A:0xf9a44a08
y.create.l HWIO_PERIPH_SS_USB1_HS_BAM_IRQ_SRCS_UNMASKED_EE5_ADDR A:0xf9a44a88
y.create.l HWIO_PERIPH_SS_USB1_HS_BAM_IRQ_SRCS_UNMASKED_EE6_ADDR A:0xf9a44b08
y.create.l HWIO_PERIPH_SS_USB1_HS_BAM_IRQ_SRCS_UNMASKED_EE7_ADDR A:0xf9a44b88
y.create.l HWIO_PERIPH_SS_USB1_HS_BAM_P_CTRL0_ADDR A:0xf9a45000
y.create.l HWIO_PERIPH_SS_USB1_HS_BAM_P_CTRL1_ADDR A:0xf9a46000
y.create.l HWIO_PERIPH_SS_USB1_HS_BAM_P_CTRL2_ADDR A:0xf9a47000
y.create.l HWIO_PERIPH_SS_USB1_HS_BAM_P_CTRL3_ADDR A:0xf9a48000
y.create.l HWIO_PERIPH_SS_USB1_HS_BAM_P_CTRL4_ADDR A:0xf9a49000
y.create.l HWIO_PERIPH_SS_USB1_HS_BAM_P_CTRL5_ADDR A:0xf9a4a000
y.create.l HWIO_PERIPH_SS_USB1_HS_BAM_P_CTRL6_ADDR A:0xf9a4b000
y.create.l HWIO_PERIPH_SS_USB1_HS_BAM_P_CTRL7_ADDR A:0xf9a4c000
y.create.l HWIO_PERIPH_SS_USB1_HS_BAM_P_CTRL8_ADDR A:0xf9a4d000
y.create.l HWIO_PERIPH_SS_USB1_HS_BAM_P_CTRL9_ADDR A:0xf9a4e000
y.create.l HWIO_PERIPH_SS_USB1_HS_BAM_P_RST0_ADDR A:0xf9a45004
y.create.l HWIO_PERIPH_SS_USB1_HS_BAM_P_RST1_ADDR A:0xf9a46004
y.create.l HWIO_PERIPH_SS_USB1_HS_BAM_P_RST2_ADDR A:0xf9a47004
y.create.l HWIO_PERIPH_SS_USB1_HS_BAM_P_RST3_ADDR A:0xf9a48004
y.create.l HWIO_PERIPH_SS_USB1_HS_BAM_P_RST4_ADDR A:0xf9a49004
y.create.l HWIO_PERIPH_SS_USB1_HS_BAM_P_RST5_ADDR A:0xf9a4a004
y.create.l HWIO_PERIPH_SS_USB1_HS_BAM_P_RST6_ADDR A:0xf9a4b004
y.create.l HWIO_PERIPH_SS_USB1_HS_BAM_P_RST7_ADDR A:0xf9a4c004
y.create.l HWIO_PERIPH_SS_USB1_HS_BAM_P_RST8_ADDR A:0xf9a4d004
y.create.l HWIO_PERIPH_SS_USB1_HS_BAM_P_RST9_ADDR A:0xf9a4e004
y.create.l HWIO_PERIPH_SS_USB1_HS_BAM_P_HALT0_ADDR A:0xf9a45008
y.create.l HWIO_PERIPH_SS_USB1_HS_BAM_P_HALT1_ADDR A:0xf9a46008
y.create.l HWIO_PERIPH_SS_USB1_HS_BAM_P_HALT2_ADDR A:0xf9a47008
y.create.l HWIO_PERIPH_SS_USB1_HS_BAM_P_HALT3_ADDR A:0xf9a48008
y.create.l HWIO_PERIPH_SS_USB1_HS_BAM_P_HALT4_ADDR A:0xf9a49008
y.create.l HWIO_PERIPH_SS_USB1_HS_BAM_P_HALT5_ADDR A:0xf9a4a008
y.create.l HWIO_PERIPH_SS_USB1_HS_BAM_P_HALT6_ADDR A:0xf9a4b008
y.create.l HWIO_PERIPH_SS_USB1_HS_BAM_P_HALT7_ADDR A:0xf9a4c008
y.create.l HWIO_PERIPH_SS_USB1_HS_BAM_P_HALT8_ADDR A:0xf9a4d008
y.create.l HWIO_PERIPH_SS_USB1_HS_BAM_P_HALT9_ADDR A:0xf9a4e008
y.create.l HWIO_PERIPH_SS_USB1_HS_BAM_P_TRUST_REG0_ADDR A:0xf9a45030
y.create.l HWIO_PERIPH_SS_USB1_HS_BAM_P_TRUST_REG1_ADDR A:0xf9a46030
y.create.l HWIO_PERIPH_SS_USB1_HS_BAM_P_TRUST_REG2_ADDR A:0xf9a47030
y.create.l HWIO_PERIPH_SS_USB1_HS_BAM_P_TRUST_REG3_ADDR A:0xf9a48030
y.create.l HWIO_PERIPH_SS_USB1_HS_BAM_P_TRUST_REG4_ADDR A:0xf9a49030
y.create.l HWIO_PERIPH_SS_USB1_HS_BAM_P_TRUST_REG5_ADDR A:0xf9a4a030
y.create.l HWIO_PERIPH_SS_USB1_HS_BAM_P_TRUST_REG6_ADDR A:0xf9a4b030
y.create.l HWIO_PERIPH_SS_USB1_HS_BAM_P_TRUST_REG7_ADDR A:0xf9a4c030
y.create.l HWIO_PERIPH_SS_USB1_HS_BAM_P_TRUST_REG8_ADDR A:0xf9a4d030
y.create.l HWIO_PERIPH_SS_USB1_HS_BAM_P_TRUST_REG9_ADDR A:0xf9a4e030
y.create.l HWIO_PERIPH_SS_USB1_HS_BAM_P_IRQ_STTS0_ADDR A:0xf9a45010
y.create.l HWIO_PERIPH_SS_USB1_HS_BAM_P_IRQ_STTS1_ADDR A:0xf9a46010
y.create.l HWIO_PERIPH_SS_USB1_HS_BAM_P_IRQ_STTS2_ADDR A:0xf9a47010
y.create.l HWIO_PERIPH_SS_USB1_HS_BAM_P_IRQ_STTS3_ADDR A:0xf9a48010
y.create.l HWIO_PERIPH_SS_USB1_HS_BAM_P_IRQ_STTS4_ADDR A:0xf9a49010
y.create.l HWIO_PERIPH_SS_USB1_HS_BAM_P_IRQ_STTS5_ADDR A:0xf9a4a010
y.create.l HWIO_PERIPH_SS_USB1_HS_BAM_P_IRQ_STTS6_ADDR A:0xf9a4b010
y.create.l HWIO_PERIPH_SS_USB1_HS_BAM_P_IRQ_STTS7_ADDR A:0xf9a4c010
y.create.l HWIO_PERIPH_SS_USB1_HS_BAM_P_IRQ_STTS8_ADDR A:0xf9a4d010
y.create.l HWIO_PERIPH_SS_USB1_HS_BAM_P_IRQ_STTS9_ADDR A:0xf9a4e010
y.create.l HWIO_PERIPH_SS_USB1_HS_BAM_P_IRQ_CLR0_ADDR A:0xf9a45014
y.create.l HWIO_PERIPH_SS_USB1_HS_BAM_P_IRQ_CLR1_ADDR A:0xf9a46014
y.create.l HWIO_PERIPH_SS_USB1_HS_BAM_P_IRQ_CLR2_ADDR A:0xf9a47014
y.create.l HWIO_PERIPH_SS_USB1_HS_BAM_P_IRQ_CLR3_ADDR A:0xf9a48014
y.create.l HWIO_PERIPH_SS_USB1_HS_BAM_P_IRQ_CLR4_ADDR A:0xf9a49014
y.create.l HWIO_PERIPH_SS_USB1_HS_BAM_P_IRQ_CLR5_ADDR A:0xf9a4a014
y.create.l HWIO_PERIPH_SS_USB1_HS_BAM_P_IRQ_CLR6_ADDR A:0xf9a4b014
y.create.l HWIO_PERIPH_SS_USB1_HS_BAM_P_IRQ_CLR7_ADDR A:0xf9a4c014
y.create.l HWIO_PERIPH_SS_USB1_HS_BAM_P_IRQ_CLR8_ADDR A:0xf9a4d014
y.create.l HWIO_PERIPH_SS_USB1_HS_BAM_P_IRQ_CLR9_ADDR A:0xf9a4e014
y.create.l HWIO_PERIPH_SS_USB1_HS_BAM_P_IRQ_EN0_ADDR A:0xf9a45018
y.create.l HWIO_PERIPH_SS_USB1_HS_BAM_P_IRQ_EN1_ADDR A:0xf9a46018
y.create.l HWIO_PERIPH_SS_USB1_HS_BAM_P_IRQ_EN2_ADDR A:0xf9a47018
y.create.l HWIO_PERIPH_SS_USB1_HS_BAM_P_IRQ_EN3_ADDR A:0xf9a48018
y.create.l HWIO_PERIPH_SS_USB1_HS_BAM_P_IRQ_EN4_ADDR A:0xf9a49018
y.create.l HWIO_PERIPH_SS_USB1_HS_BAM_P_IRQ_EN5_ADDR A:0xf9a4a018
y.create.l HWIO_PERIPH_SS_USB1_HS_BAM_P_IRQ_EN6_ADDR A:0xf9a4b018
y.create.l HWIO_PERIPH_SS_USB1_HS_BAM_P_IRQ_EN7_ADDR A:0xf9a4c018
y.create.l HWIO_PERIPH_SS_USB1_HS_BAM_P_IRQ_EN8_ADDR A:0xf9a4d018
y.create.l HWIO_PERIPH_SS_USB1_HS_BAM_P_IRQ_EN9_ADDR A:0xf9a4e018
y.create.l HWIO_PERIPH_SS_USB1_HS_BAM_P_TIMER0_ADDR A:0xf9a4501c
y.create.l HWIO_PERIPH_SS_USB1_HS_BAM_P_TIMER1_ADDR A:0xf9a4601c
y.create.l HWIO_PERIPH_SS_USB1_HS_BAM_P_TIMER2_ADDR A:0xf9a4701c
y.create.l HWIO_PERIPH_SS_USB1_HS_BAM_P_TIMER3_ADDR A:0xf9a4801c
y.create.l HWIO_PERIPH_SS_USB1_HS_BAM_P_TIMER4_ADDR A:0xf9a4901c
y.create.l HWIO_PERIPH_SS_USB1_HS_BAM_P_TIMER5_ADDR A:0xf9a4a01c
y.create.l HWIO_PERIPH_SS_USB1_HS_BAM_P_TIMER6_ADDR A:0xf9a4b01c
y.create.l HWIO_PERIPH_SS_USB1_HS_BAM_P_TIMER7_ADDR A:0xf9a4c01c
y.create.l HWIO_PERIPH_SS_USB1_HS_BAM_P_TIMER8_ADDR A:0xf9a4d01c
y.create.l HWIO_PERIPH_SS_USB1_HS_BAM_P_TIMER9_ADDR A:0xf9a4e01c
y.create.l HWIO_PERIPH_SS_USB1_HS_BAM_P_TIMER_CTRL0_ADDR A:0xf9a45020
y.create.l HWIO_PERIPH_SS_USB1_HS_BAM_P_TIMER_CTRL1_ADDR A:0xf9a46020
y.create.l HWIO_PERIPH_SS_USB1_HS_BAM_P_TIMER_CTRL2_ADDR A:0xf9a47020
y.create.l HWIO_PERIPH_SS_USB1_HS_BAM_P_TIMER_CTRL3_ADDR A:0xf9a48020
y.create.l HWIO_PERIPH_SS_USB1_HS_BAM_P_TIMER_CTRL4_ADDR A:0xf9a49020
y.create.l HWIO_PERIPH_SS_USB1_HS_BAM_P_TIMER_CTRL5_ADDR A:0xf9a4a020
y.create.l HWIO_PERIPH_SS_USB1_HS_BAM_P_TIMER_CTRL6_ADDR A:0xf9a4b020
y.create.l HWIO_PERIPH_SS_USB1_HS_BAM_P_TIMER_CTRL7_ADDR A:0xf9a4c020
y.create.l HWIO_PERIPH_SS_USB1_HS_BAM_P_TIMER_CTRL8_ADDR A:0xf9a4d020
y.create.l HWIO_PERIPH_SS_USB1_HS_BAM_P_TIMER_CTRL9_ADDR A:0xf9a4e020
y.create.l HWIO_PERIPH_SS_USB1_HS_BAM_P_PRDCR_SDBND0_ADDR A:0xf9a45024
y.create.l HWIO_PERIPH_SS_USB1_HS_BAM_P_PRDCR_SDBND1_ADDR A:0xf9a46024
y.create.l HWIO_PERIPH_SS_USB1_HS_BAM_P_PRDCR_SDBND2_ADDR A:0xf9a47024
y.create.l HWIO_PERIPH_SS_USB1_HS_BAM_P_PRDCR_SDBND3_ADDR A:0xf9a48024
y.create.l HWIO_PERIPH_SS_USB1_HS_BAM_P_PRDCR_SDBND4_ADDR A:0xf9a49024
y.create.l HWIO_PERIPH_SS_USB1_HS_BAM_P_PRDCR_SDBND5_ADDR A:0xf9a4a024
y.create.l HWIO_PERIPH_SS_USB1_HS_BAM_P_PRDCR_SDBND6_ADDR A:0xf9a4b024
y.create.l HWIO_PERIPH_SS_USB1_HS_BAM_P_PRDCR_SDBND7_ADDR A:0xf9a4c024
y.create.l HWIO_PERIPH_SS_USB1_HS_BAM_P_PRDCR_SDBND8_ADDR A:0xf9a4d024
y.create.l HWIO_PERIPH_SS_USB1_HS_BAM_P_PRDCR_SDBND9_ADDR A:0xf9a4e024
y.create.l HWIO_PERIPH_SS_USB1_HS_BAM_P_CNSMR_SDBND0_ADDR A:0xf9a45028
y.create.l HWIO_PERIPH_SS_USB1_HS_BAM_P_CNSMR_SDBND1_ADDR A:0xf9a46028
y.create.l HWIO_PERIPH_SS_USB1_HS_BAM_P_CNSMR_SDBND2_ADDR A:0xf9a47028
y.create.l HWIO_PERIPH_SS_USB1_HS_BAM_P_CNSMR_SDBND3_ADDR A:0xf9a48028
y.create.l HWIO_PERIPH_SS_USB1_HS_BAM_P_CNSMR_SDBND4_ADDR A:0xf9a49028
y.create.l HWIO_PERIPH_SS_USB1_HS_BAM_P_CNSMR_SDBND5_ADDR A:0xf9a4a028
y.create.l HWIO_PERIPH_SS_USB1_HS_BAM_P_CNSMR_SDBND6_ADDR A:0xf9a4b028
y.create.l HWIO_PERIPH_SS_USB1_HS_BAM_P_CNSMR_SDBND7_ADDR A:0xf9a4c028
y.create.l HWIO_PERIPH_SS_USB1_HS_BAM_P_CNSMR_SDBND8_ADDR A:0xf9a4d028
y.create.l HWIO_PERIPH_SS_USB1_HS_BAM_P_CNSMR_SDBND9_ADDR A:0xf9a4e028
y.create.l HWIO_PERIPH_SS_USB1_HS_BAM_P_EVNT_DEST_ADDR0_ADDR A:0xf9a4582c
y.create.l HWIO_PERIPH_SS_USB1_HS_BAM_P_EVNT_DEST_ADDR1_ADDR A:0xf9a4682c
y.create.l HWIO_PERIPH_SS_USB1_HS_BAM_P_EVNT_DEST_ADDR2_ADDR A:0xf9a4782c
y.create.l HWIO_PERIPH_SS_USB1_HS_BAM_P_EVNT_DEST_ADDR3_ADDR A:0xf9a4882c
y.create.l HWIO_PERIPH_SS_USB1_HS_BAM_P_EVNT_DEST_ADDR4_ADDR A:0xf9a4982c
y.create.l HWIO_PERIPH_SS_USB1_HS_BAM_P_EVNT_DEST_ADDR5_ADDR A:0xf9a4a82c
y.create.l HWIO_PERIPH_SS_USB1_HS_BAM_P_EVNT_DEST_ADDR6_ADDR A:0xf9a4b82c
y.create.l HWIO_PERIPH_SS_USB1_HS_BAM_P_EVNT_DEST_ADDR7_ADDR A:0xf9a4c82c
y.create.l HWIO_PERIPH_SS_USB1_HS_BAM_P_EVNT_DEST_ADDR8_ADDR A:0xf9a4d82c
y.create.l HWIO_PERIPH_SS_USB1_HS_BAM_P_EVNT_DEST_ADDR9_ADDR A:0xf9a4e82c
y.create.l HWIO_PERIPH_SS_USB1_HS_BAM_P_EVNT_REG0_ADDR A:0xf9a45818
y.create.l HWIO_PERIPH_SS_USB1_HS_BAM_P_EVNT_REG1_ADDR A:0xf9a46818
y.create.l HWIO_PERIPH_SS_USB1_HS_BAM_P_EVNT_REG2_ADDR A:0xf9a47818
y.create.l HWIO_PERIPH_SS_USB1_HS_BAM_P_EVNT_REG3_ADDR A:0xf9a48818
y.create.l HWIO_PERIPH_SS_USB1_HS_BAM_P_EVNT_REG4_ADDR A:0xf9a49818
y.create.l HWIO_PERIPH_SS_USB1_HS_BAM_P_EVNT_REG5_ADDR A:0xf9a4a818
y.create.l HWIO_PERIPH_SS_USB1_HS_BAM_P_EVNT_REG6_ADDR A:0xf9a4b818
y.create.l HWIO_PERIPH_SS_USB1_HS_BAM_P_EVNT_REG7_ADDR A:0xf9a4c818
y.create.l HWIO_PERIPH_SS_USB1_HS_BAM_P_EVNT_REG8_ADDR A:0xf9a4d818
y.create.l HWIO_PERIPH_SS_USB1_HS_BAM_P_EVNT_REG9_ADDR A:0xf9a4e818
y.create.l HWIO_PERIPH_SS_USB1_HS_BAM_P_SW_OFSTS0_ADDR A:0xf9a45800
y.create.l HWIO_PERIPH_SS_USB1_HS_BAM_P_SW_OFSTS1_ADDR A:0xf9a46800
y.create.l HWIO_PERIPH_SS_USB1_HS_BAM_P_SW_OFSTS2_ADDR A:0xf9a47800
y.create.l HWIO_PERIPH_SS_USB1_HS_BAM_P_SW_OFSTS3_ADDR A:0xf9a48800
y.create.l HWIO_PERIPH_SS_USB1_HS_BAM_P_SW_OFSTS4_ADDR A:0xf9a49800
y.create.l HWIO_PERIPH_SS_USB1_HS_BAM_P_SW_OFSTS5_ADDR A:0xf9a4a800
y.create.l HWIO_PERIPH_SS_USB1_HS_BAM_P_SW_OFSTS6_ADDR A:0xf9a4b800
y.create.l HWIO_PERIPH_SS_USB1_HS_BAM_P_SW_OFSTS7_ADDR A:0xf9a4c800
y.create.l HWIO_PERIPH_SS_USB1_HS_BAM_P_SW_OFSTS8_ADDR A:0xf9a4d800
y.create.l HWIO_PERIPH_SS_USB1_HS_BAM_P_SW_OFSTS9_ADDR A:0xf9a4e800
y.create.l HWIO_PERIPH_SS_USB1_HS_BAM_P_DATA_FIFO_ADDR0_ADDR A:0xf9a45824
y.create.l HWIO_PERIPH_SS_USB1_HS_BAM_P_DATA_FIFO_ADDR1_ADDR A:0xf9a46824
y.create.l HWIO_PERIPH_SS_USB1_HS_BAM_P_DATA_FIFO_ADDR2_ADDR A:0xf9a47824
y.create.l HWIO_PERIPH_SS_USB1_HS_BAM_P_DATA_FIFO_ADDR3_ADDR A:0xf9a48824
y.create.l HWIO_PERIPH_SS_USB1_HS_BAM_P_DATA_FIFO_ADDR4_ADDR A:0xf9a49824
y.create.l HWIO_PERIPH_SS_USB1_HS_BAM_P_DATA_FIFO_ADDR5_ADDR A:0xf9a4a824
y.create.l HWIO_PERIPH_SS_USB1_HS_BAM_P_DATA_FIFO_ADDR6_ADDR A:0xf9a4b824
y.create.l HWIO_PERIPH_SS_USB1_HS_BAM_P_DATA_FIFO_ADDR7_ADDR A:0xf9a4c824
y.create.l HWIO_PERIPH_SS_USB1_HS_BAM_P_DATA_FIFO_ADDR8_ADDR A:0xf9a4d824
y.create.l HWIO_PERIPH_SS_USB1_HS_BAM_P_DATA_FIFO_ADDR9_ADDR A:0xf9a4e824
y.create.l HWIO_PERIPH_SS_USB1_HS_BAM_P_DESC_FIFO_ADDR0_ADDR A:0xf9a4581c
y.create.l HWIO_PERIPH_SS_USB1_HS_BAM_P_DESC_FIFO_ADDR1_ADDR A:0xf9a4681c
y.create.l HWIO_PERIPH_SS_USB1_HS_BAM_P_DESC_FIFO_ADDR2_ADDR A:0xf9a4781c
y.create.l HWIO_PERIPH_SS_USB1_HS_BAM_P_DESC_FIFO_ADDR3_ADDR A:0xf9a4881c
y.create.l HWIO_PERIPH_SS_USB1_HS_BAM_P_DESC_FIFO_ADDR4_ADDR A:0xf9a4981c
y.create.l HWIO_PERIPH_SS_USB1_HS_BAM_P_DESC_FIFO_ADDR5_ADDR A:0xf9a4a81c
y.create.l HWIO_PERIPH_SS_USB1_HS_BAM_P_DESC_FIFO_ADDR6_ADDR A:0xf9a4b81c
y.create.l HWIO_PERIPH_SS_USB1_HS_BAM_P_DESC_FIFO_ADDR7_ADDR A:0xf9a4c81c
y.create.l HWIO_PERIPH_SS_USB1_HS_BAM_P_DESC_FIFO_ADDR8_ADDR A:0xf9a4d81c
y.create.l HWIO_PERIPH_SS_USB1_HS_BAM_P_DESC_FIFO_ADDR9_ADDR A:0xf9a4e81c
y.create.l HWIO_PERIPH_SS_USB1_HS_BAM_P_EVNT_GEN_TRSHLD0_ADDR A:0xf9a45828
y.create.l HWIO_PERIPH_SS_USB1_HS_BAM_P_EVNT_GEN_TRSHLD1_ADDR A:0xf9a46828
y.create.l HWIO_PERIPH_SS_USB1_HS_BAM_P_EVNT_GEN_TRSHLD2_ADDR A:0xf9a47828
y.create.l HWIO_PERIPH_SS_USB1_HS_BAM_P_EVNT_GEN_TRSHLD3_ADDR A:0xf9a48828
y.create.l HWIO_PERIPH_SS_USB1_HS_BAM_P_EVNT_GEN_TRSHLD4_ADDR A:0xf9a49828
y.create.l HWIO_PERIPH_SS_USB1_HS_BAM_P_EVNT_GEN_TRSHLD5_ADDR A:0xf9a4a828
y.create.l HWIO_PERIPH_SS_USB1_HS_BAM_P_EVNT_GEN_TRSHLD6_ADDR A:0xf9a4b828
y.create.l HWIO_PERIPH_SS_USB1_HS_BAM_P_EVNT_GEN_TRSHLD7_ADDR A:0xf9a4c828
y.create.l HWIO_PERIPH_SS_USB1_HS_BAM_P_EVNT_GEN_TRSHLD8_ADDR A:0xf9a4d828
y.create.l HWIO_PERIPH_SS_USB1_HS_BAM_P_EVNT_GEN_TRSHLD9_ADDR A:0xf9a4e828
y.create.l HWIO_PERIPH_SS_USB1_HS_BAM_P_FIFO_SIZES0_ADDR A:0xf9a45820
y.create.l HWIO_PERIPH_SS_USB1_HS_BAM_P_FIFO_SIZES1_ADDR A:0xf9a46820
y.create.l HWIO_PERIPH_SS_USB1_HS_BAM_P_FIFO_SIZES2_ADDR A:0xf9a47820
y.create.l HWIO_PERIPH_SS_USB1_HS_BAM_P_FIFO_SIZES3_ADDR A:0xf9a48820
y.create.l HWIO_PERIPH_SS_USB1_HS_BAM_P_FIFO_SIZES4_ADDR A:0xf9a49820
y.create.l HWIO_PERIPH_SS_USB1_HS_BAM_P_FIFO_SIZES5_ADDR A:0xf9a4a820
y.create.l HWIO_PERIPH_SS_USB1_HS_BAM_P_FIFO_SIZES6_ADDR A:0xf9a4b820
y.create.l HWIO_PERIPH_SS_USB1_HS_BAM_P_FIFO_SIZES7_ADDR A:0xf9a4c820
y.create.l HWIO_PERIPH_SS_USB1_HS_BAM_P_FIFO_SIZES8_ADDR A:0xf9a4d820
y.create.l HWIO_PERIPH_SS_USB1_HS_BAM_P_FIFO_SIZES9_ADDR A:0xf9a4e820
y.create.l HWIO_PERIPH_SS_USB1_HS_BAM_P_RETR_CNTXT_0_ADDR A:0xf9a45834
y.create.l HWIO_PERIPH_SS_USB1_HS_BAM_P_RETR_CNTXT_1_ADDR A:0xf9a46834
y.create.l HWIO_PERIPH_SS_USB1_HS_BAM_P_RETR_CNTXT_2_ADDR A:0xf9a47834
y.create.l HWIO_PERIPH_SS_USB1_HS_BAM_P_RETR_CNTXT_3_ADDR A:0xf9a48834
y.create.l HWIO_PERIPH_SS_USB1_HS_BAM_P_RETR_CNTXT_4_ADDR A:0xf9a49834
y.create.l HWIO_PERIPH_SS_USB1_HS_BAM_P_RETR_CNTXT_5_ADDR A:0xf9a4a834
y.create.l HWIO_PERIPH_SS_USB1_HS_BAM_P_RETR_CNTXT_6_ADDR A:0xf9a4b834
y.create.l HWIO_PERIPH_SS_USB1_HS_BAM_P_RETR_CNTXT_7_ADDR A:0xf9a4c834
y.create.l HWIO_PERIPH_SS_USB1_HS_BAM_P_RETR_CNTXT_8_ADDR A:0xf9a4d834
y.create.l HWIO_PERIPH_SS_USB1_HS_BAM_P_RETR_CNTXT_9_ADDR A:0xf9a4e834
y.create.l HWIO_PERIPH_SS_USB1_HS_BAM_P_SI_CNTXT_0_ADDR A:0xf9a45838
y.create.l HWIO_PERIPH_SS_USB1_HS_BAM_P_SI_CNTXT_1_ADDR A:0xf9a46838
y.create.l HWIO_PERIPH_SS_USB1_HS_BAM_P_SI_CNTXT_2_ADDR A:0xf9a47838
y.create.l HWIO_PERIPH_SS_USB1_HS_BAM_P_SI_CNTXT_3_ADDR A:0xf9a48838
y.create.l HWIO_PERIPH_SS_USB1_HS_BAM_P_SI_CNTXT_4_ADDR A:0xf9a49838
y.create.l HWIO_PERIPH_SS_USB1_HS_BAM_P_SI_CNTXT_5_ADDR A:0xf9a4a838
y.create.l HWIO_PERIPH_SS_USB1_HS_BAM_P_SI_CNTXT_6_ADDR A:0xf9a4b838
y.create.l HWIO_PERIPH_SS_USB1_HS_BAM_P_SI_CNTXT_7_ADDR A:0xf9a4c838
y.create.l HWIO_PERIPH_SS_USB1_HS_BAM_P_SI_CNTXT_8_ADDR A:0xf9a4d838
y.create.l HWIO_PERIPH_SS_USB1_HS_BAM_P_SI_CNTXT_9_ADDR A:0xf9a4e838
y.create.l HWIO_PERIPH_SS_USB1_HS_BAM_P_DF_CNTXT_0_ADDR A:0xf9a45830
y.create.l HWIO_PERIPH_SS_USB1_HS_BAM_P_DF_CNTXT_1_ADDR A:0xf9a46830
y.create.l HWIO_PERIPH_SS_USB1_HS_BAM_P_DF_CNTXT_2_ADDR A:0xf9a47830
y.create.l HWIO_PERIPH_SS_USB1_HS_BAM_P_DF_CNTXT_3_ADDR A:0xf9a48830
y.create.l HWIO_PERIPH_SS_USB1_HS_BAM_P_DF_CNTXT_4_ADDR A:0xf9a49830
y.create.l HWIO_PERIPH_SS_USB1_HS_BAM_P_DF_CNTXT_5_ADDR A:0xf9a4a830
y.create.l HWIO_PERIPH_SS_USB1_HS_BAM_P_DF_CNTXT_6_ADDR A:0xf9a4b830
y.create.l HWIO_PERIPH_SS_USB1_HS_BAM_P_DF_CNTXT_7_ADDR A:0xf9a4c830
y.create.l HWIO_PERIPH_SS_USB1_HS_BAM_P_DF_CNTXT_8_ADDR A:0xf9a4d830
y.create.l HWIO_PERIPH_SS_USB1_HS_BAM_P_DF_CNTXT_9_ADDR A:0xf9a4e830
y.create.l HWIO_PERIPH_SS_USB1_HS_BAM_P_AU_PSM_CNTXT_1_0_ADDR A:0xf9a45804
y.create.l HWIO_PERIPH_SS_USB1_HS_BAM_P_AU_PSM_CNTXT_1_1_ADDR A:0xf9a46804
y.create.l HWIO_PERIPH_SS_USB1_HS_BAM_P_AU_PSM_CNTXT_1_2_ADDR A:0xf9a47804
y.create.l HWIO_PERIPH_SS_USB1_HS_BAM_P_AU_PSM_CNTXT_1_3_ADDR A:0xf9a48804
y.create.l HWIO_PERIPH_SS_USB1_HS_BAM_P_AU_PSM_CNTXT_1_4_ADDR A:0xf9a49804
y.create.l HWIO_PERIPH_SS_USB1_HS_BAM_P_AU_PSM_CNTXT_1_5_ADDR A:0xf9a4a804
y.create.l HWIO_PERIPH_SS_USB1_HS_BAM_P_AU_PSM_CNTXT_1_6_ADDR A:0xf9a4b804
y.create.l HWIO_PERIPH_SS_USB1_HS_BAM_P_AU_PSM_CNTXT_1_7_ADDR A:0xf9a4c804
y.create.l HWIO_PERIPH_SS_USB1_HS_BAM_P_AU_PSM_CNTXT_1_8_ADDR A:0xf9a4d804
y.create.l HWIO_PERIPH_SS_USB1_HS_BAM_P_AU_PSM_CNTXT_1_9_ADDR A:0xf9a4e804
y.create.l HWIO_PERIPH_SS_USB1_HS_BAM_P_PSM_CNTXT_2_0_ADDR A:0xf9a45808
y.create.l HWIO_PERIPH_SS_USB1_HS_BAM_P_PSM_CNTXT_2_1_ADDR A:0xf9a46808
y.create.l HWIO_PERIPH_SS_USB1_HS_BAM_P_PSM_CNTXT_2_2_ADDR A:0xf9a47808
y.create.l HWIO_PERIPH_SS_USB1_HS_BAM_P_PSM_CNTXT_2_3_ADDR A:0xf9a48808
y.create.l HWIO_PERIPH_SS_USB1_HS_BAM_P_PSM_CNTXT_2_4_ADDR A:0xf9a49808
y.create.l HWIO_PERIPH_SS_USB1_HS_BAM_P_PSM_CNTXT_2_5_ADDR A:0xf9a4a808
y.create.l HWIO_PERIPH_SS_USB1_HS_BAM_P_PSM_CNTXT_2_6_ADDR A:0xf9a4b808
y.create.l HWIO_PERIPH_SS_USB1_HS_BAM_P_PSM_CNTXT_2_7_ADDR A:0xf9a4c808
y.create.l HWIO_PERIPH_SS_USB1_HS_BAM_P_PSM_CNTXT_2_8_ADDR A:0xf9a4d808
y.create.l HWIO_PERIPH_SS_USB1_HS_BAM_P_PSM_CNTXT_2_9_ADDR A:0xf9a4e808
y.create.l HWIO_PERIPH_SS_USB1_HS_BAM_P_PSM_CNTXT_3_0_ADDR A:0xf9a4580c
y.create.l HWIO_PERIPH_SS_USB1_HS_BAM_P_PSM_CNTXT_3_1_ADDR A:0xf9a4680c
y.create.l HWIO_PERIPH_SS_USB1_HS_BAM_P_PSM_CNTXT_3_2_ADDR A:0xf9a4780c
y.create.l HWIO_PERIPH_SS_USB1_HS_BAM_P_PSM_CNTXT_3_3_ADDR A:0xf9a4880c
y.create.l HWIO_PERIPH_SS_USB1_HS_BAM_P_PSM_CNTXT_3_4_ADDR A:0xf9a4980c
y.create.l HWIO_PERIPH_SS_USB1_HS_BAM_P_PSM_CNTXT_3_5_ADDR A:0xf9a4a80c
y.create.l HWIO_PERIPH_SS_USB1_HS_BAM_P_PSM_CNTXT_3_6_ADDR A:0xf9a4b80c
y.create.l HWIO_PERIPH_SS_USB1_HS_BAM_P_PSM_CNTXT_3_7_ADDR A:0xf9a4c80c
y.create.l HWIO_PERIPH_SS_USB1_HS_BAM_P_PSM_CNTXT_3_8_ADDR A:0xf9a4d80c
y.create.l HWIO_PERIPH_SS_USB1_HS_BAM_P_PSM_CNTXT_3_9_ADDR A:0xf9a4e80c
y.create.l HWIO_PERIPH_SS_USB1_HS_BAM_P_PSM_CNTXT_4_0_ADDR A:0xf9a45810
y.create.l HWIO_PERIPH_SS_USB1_HS_BAM_P_PSM_CNTXT_4_1_ADDR A:0xf9a46810
y.create.l HWIO_PERIPH_SS_USB1_HS_BAM_P_PSM_CNTXT_4_2_ADDR A:0xf9a47810
y.create.l HWIO_PERIPH_SS_USB1_HS_BAM_P_PSM_CNTXT_4_3_ADDR A:0xf9a48810
y.create.l HWIO_PERIPH_SS_USB1_HS_BAM_P_PSM_CNTXT_4_4_ADDR A:0xf9a49810
y.create.l HWIO_PERIPH_SS_USB1_HS_BAM_P_PSM_CNTXT_4_5_ADDR A:0xf9a4a810
y.create.l HWIO_PERIPH_SS_USB1_HS_BAM_P_PSM_CNTXT_4_6_ADDR A:0xf9a4b810
y.create.l HWIO_PERIPH_SS_USB1_HS_BAM_P_PSM_CNTXT_4_7_ADDR A:0xf9a4c810
y.create.l HWIO_PERIPH_SS_USB1_HS_BAM_P_PSM_CNTXT_4_8_ADDR A:0xf9a4d810
y.create.l HWIO_PERIPH_SS_USB1_HS_BAM_P_PSM_CNTXT_4_9_ADDR A:0xf9a4e810
y.create.l HWIO_PERIPH_SS_USB1_HS_BAM_P_PSM_CNTXT_5_0_ADDR A:0xf9a45814
y.create.l HWIO_PERIPH_SS_USB1_HS_BAM_P_PSM_CNTXT_5_1_ADDR A:0xf9a46814
y.create.l HWIO_PERIPH_SS_USB1_HS_BAM_P_PSM_CNTXT_5_2_ADDR A:0xf9a47814
y.create.l HWIO_PERIPH_SS_USB1_HS_BAM_P_PSM_CNTXT_5_3_ADDR A:0xf9a48814
y.create.l HWIO_PERIPH_SS_USB1_HS_BAM_P_PSM_CNTXT_5_4_ADDR A:0xf9a49814
y.create.l HWIO_PERIPH_SS_USB1_HS_BAM_P_PSM_CNTXT_5_5_ADDR A:0xf9a4a814
y.create.l HWIO_PERIPH_SS_USB1_HS_BAM_P_PSM_CNTXT_5_6_ADDR A:0xf9a4b814
y.create.l HWIO_PERIPH_SS_USB1_HS_BAM_P_PSM_CNTXT_5_7_ADDR A:0xf9a4c814
y.create.l HWIO_PERIPH_SS_USB1_HS_BAM_P_PSM_CNTXT_5_8_ADDR A:0xf9a4d814
y.create.l HWIO_PERIPH_SS_USB1_HS_BAM_P_PSM_CNTXT_5_9_ADDR A:0xf9a4e814
y.create.l HWIO_PERIPH_SS_USB1_HS_XPU_SCR_ADDR A:0xf9a42000
y.create.l HWIO_PERIPH_SS_USB1_HS_XPU_SWDR_ADDR A:0xf9a42004
y.create.l HWIO_PERIPH_SS_USB1_HS_XPU_SEAR0_ADDR A:0xf9a42040
y.create.l HWIO_PERIPH_SS_USB1_HS_XPU_SESR_ADDR A:0xf9a42048
y.create.l HWIO_PERIPH_SS_USB1_HS_XPU_SESRRESTORE_ADDR A:0xf9a4204c
y.create.l HWIO_PERIPH_SS_USB1_HS_XPU_SESYNR0_ADDR A:0xf9a42050
y.create.l HWIO_PERIPH_SS_USB1_HS_XPU_SESYNR1_ADDR A:0xf9a42054
y.create.l HWIO_PERIPH_SS_USB1_HS_XPU_SESYNR2_ADDR A:0xf9a42058
y.create.l HWIO_PERIPH_SS_USB1_HS_XPU_MCR_ADDR A:0xf9a42100
y.create.l HWIO_PERIPH_SS_USB1_HS_XPU_MEAR0_ADDR A:0xf9a42140
y.create.l HWIO_PERIPH_SS_USB1_HS_XPU_MESR_ADDR A:0xf9a42148
y.create.l HWIO_PERIPH_SS_USB1_HS_XPU_MESRRESTORE_ADDR A:0xf9a4214c
y.create.l HWIO_PERIPH_SS_USB1_HS_XPU_MESYNR0_ADDR A:0xf9a42150
y.create.l HWIO_PERIPH_SS_USB1_HS_XPU_MESYNR1_ADDR A:0xf9a42154
y.create.l HWIO_PERIPH_SS_USB1_HS_XPU_MESYNR2_ADDR A:0xf9a42158
y.create.l HWIO_PERIPH_SS_USB1_HS_XPU_CR_ADDR A:0xf9a42080
y.create.l HWIO_PERIPH_SS_USB1_HS_XPU_RPU_ACR0_ADDR A:0xf9a420a0
y.create.l HWIO_PERIPH_SS_USB1_HS_XPU_EAR0_ADDR A:0xf9a420c0
y.create.l HWIO_PERIPH_SS_USB1_HS_XPU_ESR_ADDR A:0xf9a420c8
y.create.l HWIO_PERIPH_SS_USB1_HS_XPU_ESRRESTORE_ADDR A:0xf9a420cc
y.create.l HWIO_PERIPH_SS_USB1_HS_XPU_ESYNR0_ADDR A:0xf9a420d0
y.create.l HWIO_PERIPH_SS_USB1_HS_XPU_ESYNR1_ADDR A:0xf9a420d4
y.create.l HWIO_PERIPH_SS_USB1_HS_XPU_ESYNR2_ADDR A:0xf9a420d8
y.create.l HWIO_PERIPH_SS_USB1_HS_XPU_IDR0_ADDR A:0xf9a42074
y.create.l HWIO_PERIPH_SS_USB1_HS_XPU_IDR1_ADDR A:0xf9a42078
y.create.l HWIO_PERIPH_SS_USB1_HS_XPU_REV_ADDR A:0xf9a4207c
y.create.l HWIO_PERIPH_SS_USB1_HS_XPU_RG0_RACR0_ADDR A:0xf9a42200
y.create.l HWIO_PERIPH_SS_USB1_HS_XPU_RG1_RACR0_ADDR A:0xf9a42280
y.create.l HWIO_PERIPH_SS_USB1_HS_XPU_RG2_RACR0_ADDR A:0xf9a42300
y.create.l HWIO_PERIPH_SS_USB1_HS_XPU_RG3_RACR0_ADDR A:0xf9a42380
y.create.l HWIO_PERIPH_SS_USB1_HS_XPU_RG4_RACR0_ADDR A:0xf9a42400
y.create.l HWIO_PERIPH_SS_USB1_HS_XPU_RG5_RACR0_ADDR A:0xf9a42480
y.create.l HWIO_PERIPH_SS_USB1_HS_XPU_RG6_RACR0_ADDR A:0xf9a42500
y.create.l HWIO_PERIPH_SS_USB1_HS_XPU_RG7_RACR0_ADDR A:0xf9a42580
y.create.l HWIO_PERIPH_SS_USB1_HS_XPU_RG8_RACR0_ADDR A:0xf9a42600
y.create.l HWIO_PERIPH_SS_USB1_HS_XPU_RG9_RACR0_ADDR A:0xf9a42680
y.create.l HWIO_PERIPH_SS_USB1_HS_XPU_RG0_SCR_ADDR A:0xf9a42250
y.create.l HWIO_PERIPH_SS_USB1_HS_XPU_RG1_SCR_ADDR A:0xf9a422d0
y.create.l HWIO_PERIPH_SS_USB1_HS_XPU_RG2_SCR_ADDR A:0xf9a42350
y.create.l HWIO_PERIPH_SS_USB1_HS_XPU_RG3_SCR_ADDR A:0xf9a423d0
y.create.l HWIO_PERIPH_SS_USB1_HS_XPU_RG4_SCR_ADDR A:0xf9a42450
y.create.l HWIO_PERIPH_SS_USB1_HS_XPU_RG5_SCR_ADDR A:0xf9a424d0
y.create.l HWIO_PERIPH_SS_USB1_HS_XPU_RG6_SCR_ADDR A:0xf9a42550
y.create.l HWIO_PERIPH_SS_USB1_HS_XPU_RG7_SCR_ADDR A:0xf9a425d0
y.create.l HWIO_PERIPH_SS_USB1_HS_XPU_RG8_SCR_ADDR A:0xf9a42650
y.create.l HWIO_PERIPH_SS_USB1_HS_XPU_RG9_SCR_ADDR A:0xf9a426d0
y.create.l HWIO_PERIPH_SS_USB1_HS_XPU_RG0_MCR_ADDR A:0xf9a42254
y.create.l HWIO_PERIPH_SS_USB1_HS_XPU_RG1_MCR_ADDR A:0xf9a422d4
y.create.l HWIO_PERIPH_SS_USB1_HS_XPU_RG2_MCR_ADDR A:0xf9a42354
y.create.l HWIO_PERIPH_SS_USB1_HS_XPU_RG3_MCR_ADDR A:0xf9a423d4
y.create.l HWIO_PERIPH_SS_USB1_HS_XPU_RG4_MCR_ADDR A:0xf9a42454
y.create.l HWIO_PERIPH_SS_USB1_HS_XPU_RG5_MCR_ADDR A:0xf9a424d4
y.create.l HWIO_PERIPH_SS_USB1_HS_XPU_RG6_MCR_ADDR A:0xf9a42554
y.create.l HWIO_PERIPH_SS_USB1_HS_XPU_RG7_MCR_ADDR A:0xf9a425d4
y.create.l HWIO_PERIPH_SS_USB1_HS_XPU_RG8_MCR_ADDR A:0xf9a42654
y.create.l HWIO_PERIPH_SS_USB1_HS_XPU_RG9_MCR_ADDR A:0xf9a426d4
y.create.l HWIO_PERIPH_SS_USB1_HS_VMIDMT_SCR0_ADDR A:0xf9a40000
y.create.l HWIO_PERIPH_SS_USB1_HS_VMIDMT_SCR1_ADDR A:0xf9a40004
y.create.l HWIO_PERIPH_SS_USB1_HS_VMIDMT_SCR2_ADDR A:0xf9a40008
y.create.l HWIO_PERIPH_SS_USB1_HS_VMIDMT_SACR_ADDR A:0xf9a40010
y.create.l HWIO_PERIPH_SS_USB1_HS_VMIDMT_SIDR0_ADDR A:0xf9a40020
y.create.l HWIO_PERIPH_SS_USB1_HS_VMIDMT_SIDR1_ADDR A:0xf9a40024
y.create.l HWIO_PERIPH_SS_USB1_HS_VMIDMT_SIDR2_ADDR A:0xf9a40028
y.create.l HWIO_PERIPH_SS_USB1_HS_VMIDMT_SIDR4_ADDR A:0xf9a40030
y.create.l HWIO_PERIPH_SS_USB1_HS_VMIDMT_SIDR5_ADDR A:0xf9a40034
y.create.l HWIO_PERIPH_SS_USB1_HS_VMIDMT_SIDR7_ADDR A:0xf9a4003c
y.create.l HWIO_PERIPH_SS_USB1_HS_VMIDMT_SGFAR0_ADDR A:0xf9a40040
y.create.l HWIO_PERIPH_SS_USB1_HS_VMIDMT_SGFSR_ADDR A:0xf9a40048
y.create.l HWIO_PERIPH_SS_USB1_HS_VMIDMT_SGFSRRESTORE_ADDR A:0xf9a4004c
y.create.l HWIO_PERIPH_SS_USB1_HS_VMIDMT_SGFSYNDR0_ADDR A:0xf9a40050
y.create.l HWIO_PERIPH_SS_USB1_HS_VMIDMT_SGFSYNDR1_ADDR A:0xf9a40054
y.create.l HWIO_PERIPH_SS_USB1_HS_VMIDMT_SGFSYNDR2_ADDR A:0xf9a40058
y.create.l HWIO_PERIPH_SS_USB1_HS_VMIDMT_VMIDMTSCR0_ADDR A:0xf9a40090
y.create.l HWIO_PERIPH_SS_USB1_HS_VMIDMT_CR0_ADDR A:0xf9a40000
y.create.l HWIO_PERIPH_SS_USB1_HS_VMIDMT_CR2_ADDR A:0xf9a40008
y.create.l HWIO_PERIPH_SS_USB1_HS_VMIDMT_ACR_ADDR A:0xf9a40010
y.create.l HWIO_PERIPH_SS_USB1_HS_VMIDMT_IDR0_ADDR A:0xf9a40020
y.create.l HWIO_PERIPH_SS_USB1_HS_VMIDMT_IDR1_ADDR A:0xf9a40024
y.create.l HWIO_PERIPH_SS_USB1_HS_VMIDMT_IDR2_ADDR A:0xf9a40028
y.create.l HWIO_PERIPH_SS_USB1_HS_VMIDMT_IDR4_ADDR A:0xf9a40030
y.create.l HWIO_PERIPH_SS_USB1_HS_VMIDMT_IDR5_ADDR A:0xf9a40034
y.create.l HWIO_PERIPH_SS_USB1_HS_VMIDMT_IDR7_ADDR A:0xf9a4003c
y.create.l HWIO_PERIPH_SS_USB1_HS_VMIDMT_GFAR0_ADDR A:0xf9a40040
y.create.l HWIO_PERIPH_SS_USB1_HS_VMIDMT_GFSR_ADDR A:0xf9a40048
y.create.l HWIO_PERIPH_SS_USB1_HS_VMIDMT_GFSRRESTORE_ADDR A:0xf9a4004c
y.create.l HWIO_PERIPH_SS_USB1_HS_VMIDMT_GFSYNDR0_ADDR A:0xf9a40050
y.create.l HWIO_PERIPH_SS_USB1_HS_VMIDMT_GFSYNDR1_ADDR A:0xf9a40054
y.create.l HWIO_PERIPH_SS_USB1_HS_VMIDMT_GFSYNDR2_ADDR A:0xf9a40058
y.create.l HWIO_PERIPH_SS_USB1_HS_VMIDMT_VMIDMTCR0_ADDR A:0xf9a40090
y.create.l HWIO_PERIPH_SS_USB1_HS_VMIDMT_VMIDMTACR_ADDR A:0xf9a4009c
y.create.l HWIO_PERIPH_SS_USB1_HS_VMIDMT_NSCR0_ADDR A:0xf9a40400
y.create.l HWIO_PERIPH_SS_USB1_HS_VMIDMT_NSCR2_ADDR A:0xf9a40408
y.create.l HWIO_PERIPH_SS_USB1_HS_VMIDMT_NSACR_ADDR A:0xf9a40410
y.create.l HWIO_PERIPH_SS_USB1_HS_VMIDMT_NSGFAR0_ADDR A:0xf9a40440
y.create.l HWIO_PERIPH_SS_USB1_HS_VMIDMT_NSGFSR_ADDR A:0xf9a40448
y.create.l HWIO_PERIPH_SS_USB1_HS_VMIDMT_NSGFSRRESTORE_ADDR A:0xf9a4044c
y.create.l HWIO_PERIPH_SS_USB1_HS_VMIDMT_NSGFSYNDR0_ADDR A:0xf9a40450
y.create.l HWIO_PERIPH_SS_USB1_HS_VMIDMT_NSGFSYNDR1_ADDR A:0xf9a40454
y.create.l HWIO_PERIPH_SS_USB1_HS_VMIDMT_NSGFSYNDR2_ADDR A:0xf9a40458
y.create.l HWIO_PERIPH_SS_USB1_HS_VMIDMT_NSVMIDMTCR0_ADDR A:0xf9a40490
y.create.l HWIO_PERIPH_SS_USB1_HS_VMIDMT_SSDR0_ADDR A:0xf9a40080
y.create.l HWIO_PERIPH_SS_USB1_HS_VMIDMT_MSDR0_ADDR A:0xf9a40480
y.create.l HWIO_PERIPH_SS_USB1_HS_VMIDMT_MCR_ADDR A:0xf9a40494
y.create.l HWIO_PERIPH_SS_USB1_HS_VMIDMT_S2VR0_ADDR A:0xf9a40c00
y.create.l HWIO_PERIPH_SS_USB1_HS_VMIDMT_S2VR1_ADDR A:0xf9a40c04
y.create.l HWIO_PERIPH_SS_USB1_HS_VMIDMT_S2VR2_ADDR A:0xf9a40c08
y.create.l HWIO_PERIPH_SS_USB1_HS_VMIDMT_S2VR3_ADDR A:0xf9a40c0c
y.create.l HWIO_PERIPH_SS_USB1_HS_VMIDMT_S2VR4_ADDR A:0xf9a40c10
y.create.l HWIO_PERIPH_SS_USB1_HS_VMIDMT_S2VR5_ADDR A:0xf9a40c14
y.create.l HWIO_PERIPH_SS_USB1_HS_VMIDMT_S2VR6_ADDR A:0xf9a40c18
y.create.l HWIO_PERIPH_SS_USB1_HS_VMIDMT_S2VR7_ADDR A:0xf9a40c1c
y.create.l HWIO_PERIPH_SS_USB1_HS_VMIDMT_S2VR8_ADDR A:0xf9a40c20
y.create.l HWIO_PERIPH_SS_USB1_HS_VMIDMT_S2VR9_ADDR A:0xf9a40c24
y.create.l HWIO_PERIPH_SS_USB1_HS_VMIDMT_AS2VR0_ADDR A:0xf9a40e00
y.create.l HWIO_PERIPH_SS_USB1_HS_VMIDMT_AS2VR1_ADDR A:0xf9a40e04
y.create.l HWIO_PERIPH_SS_USB1_HS_VMIDMT_AS2VR2_ADDR A:0xf9a40e08
y.create.l HWIO_PERIPH_SS_USB1_HS_VMIDMT_AS2VR3_ADDR A:0xf9a40e0c
y.create.l HWIO_PERIPH_SS_USB1_HS_VMIDMT_AS2VR4_ADDR A:0xf9a40e10
y.create.l HWIO_PERIPH_SS_USB1_HS_VMIDMT_AS2VR5_ADDR A:0xf9a40e14
y.create.l HWIO_PERIPH_SS_USB1_HS_VMIDMT_AS2VR6_ADDR A:0xf9a40e18
y.create.l HWIO_PERIPH_SS_USB1_HS_VMIDMT_AS2VR7_ADDR A:0xf9a40e1c
y.create.l HWIO_PERIPH_SS_USB1_HS_VMIDMT_AS2VR8_ADDR A:0xf9a40e20
y.create.l HWIO_PERIPH_SS_USB1_HS_VMIDMT_AS2VR9_ADDR A:0xf9a40e24
y.create.l HWIO_PERIPH_SS_USB1_HS_VMIDMT_SMR0_ADDR A:0xf9a40800
y.create.l HWIO_PERIPH_SS_USB1_HS_VMIDMT_SMR1_ADDR A:0xf9a40804
y.create.l HWIO_PERIPH_SS_USB1_HS_VMIDMT_SMR2_ADDR A:0xf9a40808
y.create.l HWIO_PERIPH_SS_USB1_HS_VMIDMT_SMR3_ADDR A:0xf9a4080c
y.create.l HWIO_PERIPH_SS_USB1_HS_VMIDMT_SMR4_ADDR A:0xf9a40810
y.create.l HWIO_PERIPH_SS_USB1_HS_VMIDMT_SMR5_ADDR A:0xf9a40814
y.create.l HWIO_PERIPH_SS_USB1_HS_VMIDMT_SMR6_ADDR A:0xf9a40818
y.create.l HWIO_PERIPH_SS_USB1_HS_VMIDMT_SMR7_ADDR A:0xf9a4081c
y.create.l HWIO_PERIPH_SS_USB1_HS_VMIDMT_SMR8_ADDR A:0xf9a40820
y.create.l HWIO_PERIPH_SS_USB1_HS_VMIDMT_SMR9_ADDR A:0xf9a40824
y.create.l HWIO_PERIPH_SS_BUS_TIMEOUT_0_ABT_HW_VERSION_ADDR A:0xf9bf7000
y.create.l HWIO_PERIPH_SS_BUS_TIMEOUT_0_ABT_INST_ID_ADDR A:0xf9bf7004
y.create.l HWIO_PERIPH_SS_BUS_TIMEOUT_0_ABT_NUM_SLAVES_ADDR A:0xf9bf7008
y.create.l HWIO_PERIPH_SS_BUS_TIMEOUT_0_ABT_TIMER_LOADVAL_ADDR A:0xf9bf700c
y.create.l HWIO_PERIPH_SS_BUS_TIMEOUT_0_ABT_TIMER_MODE_ADDR A:0xf9bf7010
y.create.l HWIO_PERIPH_SS_BUS_TIMEOUT_0_ABT_INTR_STATUS_ADDR A:0xf9bf7014
y.create.l HWIO_PERIPH_SS_BUS_TIMEOUT_0_ABT_INTR_CLEAR_ADDR A:0xf9bf7018
y.create.l HWIO_PERIPH_SS_BUS_TIMEOUT_0_ABT_INTR_ENABLE_ADDR A:0xf9bf701c
y.create.l HWIO_PERIPH_SS_BUS_TIMEOUT_0_ABT_SYND_VALID_ADDR A:0xf9bf7020
y.create.l HWIO_PERIPH_SS_BUS_TIMEOUT_0_ABT_SYND_CLEAR_ADDR A:0xf9bf7024
y.create.l HWIO_PERIPH_SS_BUS_TIMEOUT_0_ABT_SYND_ID_ADDR A:0xf9bf7028
y.create.l HWIO_PERIPH_SS_BUS_TIMEOUT_0_ABT_SYND_ADDR0_ADDR A:0xf9bf702c
y.create.l HWIO_PERIPH_SS_BUS_TIMEOUT_0_ABT_SYND_ADDR1_ADDR A:0xf9bf7030
y.create.l HWIO_PERIPH_SS_BUS_TIMEOUT_0_ABT_SYND_HREADY_ADDR A:0xf9bf7034
y.create.l HWIO_PERIPH_SS_BUS_TIMEOUT_1_ABT_HW_VERSION_ADDR A:0xf9bf8000
y.create.l HWIO_PERIPH_SS_BUS_TIMEOUT_1_ABT_INST_ID_ADDR A:0xf9bf8004
y.create.l HWIO_PERIPH_SS_BUS_TIMEOUT_1_ABT_NUM_SLAVES_ADDR A:0xf9bf8008
y.create.l HWIO_PERIPH_SS_BUS_TIMEOUT_1_ABT_TIMER_LOADVAL_ADDR A:0xf9bf800c
y.create.l HWIO_PERIPH_SS_BUS_TIMEOUT_1_ABT_TIMER_MODE_ADDR A:0xf9bf8010
y.create.l HWIO_PERIPH_SS_BUS_TIMEOUT_1_ABT_INTR_STATUS_ADDR A:0xf9bf8014
y.create.l HWIO_PERIPH_SS_BUS_TIMEOUT_1_ABT_INTR_CLEAR_ADDR A:0xf9bf8018
y.create.l HWIO_PERIPH_SS_BUS_TIMEOUT_1_ABT_INTR_ENABLE_ADDR A:0xf9bf801c
y.create.l HWIO_PERIPH_SS_BUS_TIMEOUT_1_ABT_SYND_VALID_ADDR A:0xf9bf8020
y.create.l HWIO_PERIPH_SS_BUS_TIMEOUT_1_ABT_SYND_CLEAR_ADDR A:0xf9bf8024
y.create.l HWIO_PERIPH_SS_BUS_TIMEOUT_1_ABT_SYND_ID_ADDR A:0xf9bf8028
y.create.l HWIO_PERIPH_SS_BUS_TIMEOUT_1_ABT_SYND_ADDR0_ADDR A:0xf9bf802c
y.create.l HWIO_PERIPH_SS_BUS_TIMEOUT_1_ABT_SYND_ADDR1_ADDR A:0xf9bf8030
y.create.l HWIO_PERIPH_SS_BUS_TIMEOUT_1_ABT_SYND_HREADY_ADDR A:0xf9bf8034
y.create.l HWIO_PERIPH_SS_BUS_TIMEOUT_2_ABT_HW_VERSION_ADDR A:0xf9bf9000
y.create.l HWIO_PERIPH_SS_BUS_TIMEOUT_2_ABT_INST_ID_ADDR A:0xf9bf9004
y.create.l HWIO_PERIPH_SS_BUS_TIMEOUT_2_ABT_NUM_SLAVES_ADDR A:0xf9bf9008
y.create.l HWIO_PERIPH_SS_BUS_TIMEOUT_2_ABT_TIMER_LOADVAL_ADDR A:0xf9bf900c
y.create.l HWIO_PERIPH_SS_BUS_TIMEOUT_2_ABT_TIMER_MODE_ADDR A:0xf9bf9010
y.create.l HWIO_PERIPH_SS_BUS_TIMEOUT_2_ABT_INTR_STATUS_ADDR A:0xf9bf9014
y.create.l HWIO_PERIPH_SS_BUS_TIMEOUT_2_ABT_INTR_CLEAR_ADDR A:0xf9bf9018
y.create.l HWIO_PERIPH_SS_BUS_TIMEOUT_2_ABT_INTR_ENABLE_ADDR A:0xf9bf901c
y.create.l HWIO_PERIPH_SS_BUS_TIMEOUT_2_ABT_SYND_VALID_ADDR A:0xf9bf9020
y.create.l HWIO_PERIPH_SS_BUS_TIMEOUT_2_ABT_SYND_CLEAR_ADDR A:0xf9bf9024
y.create.l HWIO_PERIPH_SS_BUS_TIMEOUT_2_ABT_SYND_ID_ADDR A:0xf9bf9028
y.create.l HWIO_PERIPH_SS_BUS_TIMEOUT_2_ABT_SYND_ADDR0_ADDR A:0xf9bf902c
y.create.l HWIO_PERIPH_SS_BUS_TIMEOUT_2_ABT_SYND_ADDR1_ADDR A:0xf9bf9030
y.create.l HWIO_PERIPH_SS_BUS_TIMEOUT_2_ABT_SYND_HREADY_ADDR A:0xf9bf9034
y.create.l HWIO_PERIPH_SS_BUS_TIMEOUT_3_ABT_HW_VERSION_ADDR A:0xf9bfa000
y.create.l HWIO_PERIPH_SS_BUS_TIMEOUT_3_ABT_INST_ID_ADDR A:0xf9bfa004
y.create.l HWIO_PERIPH_SS_BUS_TIMEOUT_3_ABT_NUM_SLAVES_ADDR A:0xf9bfa008
y.create.l HWIO_PERIPH_SS_BUS_TIMEOUT_3_ABT_TIMER_LOADVAL_ADDR A:0xf9bfa00c
y.create.l HWIO_PERIPH_SS_BUS_TIMEOUT_3_ABT_TIMER_MODE_ADDR A:0xf9bfa010
y.create.l HWIO_PERIPH_SS_BUS_TIMEOUT_3_ABT_INTR_STATUS_ADDR A:0xf9bfa014
y.create.l HWIO_PERIPH_SS_BUS_TIMEOUT_3_ABT_INTR_CLEAR_ADDR A:0xf9bfa018
y.create.l HWIO_PERIPH_SS_BUS_TIMEOUT_3_ABT_INTR_ENABLE_ADDR A:0xf9bfa01c
y.create.l HWIO_PERIPH_SS_BUS_TIMEOUT_3_ABT_SYND_VALID_ADDR A:0xf9bfa020
y.create.l HWIO_PERIPH_SS_BUS_TIMEOUT_3_ABT_SYND_CLEAR_ADDR A:0xf9bfa024
y.create.l HWIO_PERIPH_SS_BUS_TIMEOUT_3_ABT_SYND_ID_ADDR A:0xf9bfa028
y.create.l HWIO_PERIPH_SS_BUS_TIMEOUT_3_ABT_SYND_ADDR0_ADDR A:0xf9bfa02c
y.create.l HWIO_PERIPH_SS_BUS_TIMEOUT_3_ABT_SYND_ADDR1_ADDR A:0xf9bfa030
y.create.l HWIO_PERIPH_SS_BUS_TIMEOUT_3_ABT_SYND_HREADY_ADDR A:0xf9bfa034
y.create.l HWIO_PERIPH_SS_BUS_TIMEOUT_4_ABT_HW_VERSION_ADDR A:0xf9bfb000
y.create.l HWIO_PERIPH_SS_BUS_TIMEOUT_4_ABT_INST_ID_ADDR A:0xf9bfb004
y.create.l HWIO_PERIPH_SS_BUS_TIMEOUT_4_ABT_NUM_SLAVES_ADDR A:0xf9bfb008
y.create.l HWIO_PERIPH_SS_BUS_TIMEOUT_4_ABT_TIMER_LOADVAL_ADDR A:0xf9bfb00c
y.create.l HWIO_PERIPH_SS_BUS_TIMEOUT_4_ABT_TIMER_MODE_ADDR A:0xf9bfb010
y.create.l HWIO_PERIPH_SS_BUS_TIMEOUT_4_ABT_INTR_STATUS_ADDR A:0xf9bfb014
y.create.l HWIO_PERIPH_SS_BUS_TIMEOUT_4_ABT_INTR_CLEAR_ADDR A:0xf9bfb018
y.create.l HWIO_PERIPH_SS_BUS_TIMEOUT_4_ABT_INTR_ENABLE_ADDR A:0xf9bfb01c
y.create.l HWIO_PERIPH_SS_BUS_TIMEOUT_4_ABT_SYND_VALID_ADDR A:0xf9bfb020
y.create.l HWIO_PERIPH_SS_BUS_TIMEOUT_4_ABT_SYND_CLEAR_ADDR A:0xf9bfb024
y.create.l HWIO_PERIPH_SS_BUS_TIMEOUT_4_ABT_SYND_ID_ADDR A:0xf9bfb028
y.create.l HWIO_PERIPH_SS_BUS_TIMEOUT_4_ABT_SYND_ADDR0_ADDR A:0xf9bfb02c
y.create.l HWIO_PERIPH_SS_BUS_TIMEOUT_4_ABT_SYND_ADDR1_ADDR A:0xf9bfb030
y.create.l HWIO_PERIPH_SS_BUS_TIMEOUT_4_ABT_SYND_HREADY_ADDR A:0xf9bfb034
y.create.l HWIO_PERIPH_SS_MPU_XPU_SCR_ADDR A:0xf9bfc000
y.create.l HWIO_PERIPH_SS_MPU_XPU_SWDR_ADDR A:0xf9bfc004
y.create.l HWIO_PERIPH_SS_MPU_XPU_PRTN_RACR_SSHADOW_ADDR A:0xf9bfc008
y.create.l HWIO_PERIPH_SS_MPU_XPU_PRTN_WACR_SSHADOW_ADDR A:0xf9bfc00c
y.create.l HWIO_PERIPH_SS_MPU_XPU_PRTN_START_SSHADOW0_ADDR A:0xf9bfc010
y.create.l HWIO_PERIPH_SS_MPU_XPU_PRTN_END_SSHADOW0_ADDR A:0xf9bfc018
y.create.l HWIO_PERIPH_SS_MPU_XPU_SEAR0_ADDR A:0xf9bfc040
y.create.l HWIO_PERIPH_SS_MPU_XPU_SESR_ADDR A:0xf9bfc048
y.create.l HWIO_PERIPH_SS_MPU_XPU_SESRRESTORE_ADDR A:0xf9bfc04c
y.create.l HWIO_PERIPH_SS_MPU_XPU_SESYNR0_ADDR A:0xf9bfc050
y.create.l HWIO_PERIPH_SS_MPU_XPU_SESYNR1_ADDR A:0xf9bfc054
y.create.l HWIO_PERIPH_SS_MPU_XPU_SESYNR2_ADDR A:0xf9bfc058
y.create.l HWIO_PERIPH_SS_MPU_XPU_MCR_ADDR A:0xf9bfc100
y.create.l HWIO_PERIPH_SS_MPU_XPU_MEAR0_ADDR A:0xf9bfc140
y.create.l HWIO_PERIPH_SS_MPU_XPU_MESR_ADDR A:0xf9bfc148
y.create.l HWIO_PERIPH_SS_MPU_XPU_MESRRESTORE_ADDR A:0xf9bfc14c
y.create.l HWIO_PERIPH_SS_MPU_XPU_MESYNR0_ADDR A:0xf9bfc150
y.create.l HWIO_PERIPH_SS_MPU_XPU_MESYNR1_ADDR A:0xf9bfc154
y.create.l HWIO_PERIPH_SS_MPU_XPU_MESYNR2_ADDR A:0xf9bfc158
y.create.l HWIO_PERIPH_SS_MPU_XPU_CR_ADDR A:0xf9bfc080
y.create.l HWIO_PERIPH_SS_MPU_XPU_PRTN_RACR_SHADOW_ADDR A:0xf9bfc088
y.create.l HWIO_PERIPH_SS_MPU_XPU_PRTN_WACR_SHADOW_ADDR A:0xf9bfc08c
y.create.l HWIO_PERIPH_SS_MPU_XPU_PRTN_START_SHADOW0_ADDR A:0xf9bfc090
y.create.l HWIO_PERIPH_SS_MPU_XPU_PRTN_END_SHADOW0_ADDR A:0xf9bfc098
y.create.l HWIO_PERIPH_SS_MPU_XPU_RPU_ACR0_ADDR A:0xf9bfc0a0
y.create.l HWIO_PERIPH_SS_MPU_XPU_EAR0_ADDR A:0xf9bfc0c0
y.create.l HWIO_PERIPH_SS_MPU_XPU_ESR_ADDR A:0xf9bfc0c8
y.create.l HWIO_PERIPH_SS_MPU_XPU_ESRRESTORE_ADDR A:0xf9bfc0cc
y.create.l HWIO_PERIPH_SS_MPU_XPU_ESYNR0_ADDR A:0xf9bfc0d0
y.create.l HWIO_PERIPH_SS_MPU_XPU_ESYNR1_ADDR A:0xf9bfc0d4
y.create.l HWIO_PERIPH_SS_MPU_XPU_ESYNR2_ADDR A:0xf9bfc0d8
y.create.l HWIO_PERIPH_SS_MPU_XPU_UMR_RACR_ADDR A:0xf9bfc0e0
y.create.l HWIO_PERIPH_SS_MPU_XPU_UMR_WACR_ADDR A:0xf9bfc0e4
y.create.l HWIO_PERIPH_SS_MPU_XPU_IDR0_ADDR A:0xf9bfc074
y.create.l HWIO_PERIPH_SS_MPU_XPU_IDR1_ADDR A:0xf9bfc078
y.create.l HWIO_PERIPH_SS_MPU_XPU_REV_ADDR A:0xf9bfc07c
y.create.l HWIO_PERIPH_SS_MPU_XPU_PRT0_RACR0_ADDR A:0xf9bfc200
y.create.l HWIO_PERIPH_SS_MPU_XPU_PRT1_RACR0_ADDR A:0xf9bfc280
y.create.l HWIO_PERIPH_SS_MPU_XPU_PRT2_RACR0_ADDR A:0xf9bfc300
y.create.l HWIO_PERIPH_SS_MPU_XPU_PRT3_RACR0_ADDR A:0xf9bfc380
y.create.l HWIO_PERIPH_SS_MPU_XPU_PRT0_WACR0_ADDR A:0xf9bfc220
y.create.l HWIO_PERIPH_SS_MPU_XPU_PRT1_WACR0_ADDR A:0xf9bfc2a0
y.create.l HWIO_PERIPH_SS_MPU_XPU_PRT2_WACR0_ADDR A:0xf9bfc320
y.create.l HWIO_PERIPH_SS_MPU_XPU_PRT3_WACR0_ADDR A:0xf9bfc3a0
y.create.l HWIO_PERIPH_SS_MPU_XPU_PRT0_START0_ADDR A:0xf9bfc240
y.create.l HWIO_PERIPH_SS_MPU_XPU_PRT1_START0_ADDR A:0xf9bfc2c0
y.create.l HWIO_PERIPH_SS_MPU_XPU_PRT2_START0_ADDR A:0xf9bfc340
y.create.l HWIO_PERIPH_SS_MPU_XPU_PRT3_START0_ADDR A:0xf9bfc3c0
y.create.l HWIO_PERIPH_SS_MPU_XPU_PRT0_END0_ADDR A:0xf9bfc248
y.create.l HWIO_PERIPH_SS_MPU_XPU_PRT1_END0_ADDR A:0xf9bfc2c8
y.create.l HWIO_PERIPH_SS_MPU_XPU_PRT2_END0_ADDR A:0xf9bfc348
y.create.l HWIO_PERIPH_SS_MPU_XPU_PRT3_END0_ADDR A:0xf9bfc3c8
y.create.l HWIO_PERIPH_SS_MPU_XPU_PRT0_SCR_ADDR A:0xf9bfc250
y.create.l HWIO_PERIPH_SS_MPU_XPU_PRT1_SCR_ADDR A:0xf9bfc2d0
y.create.l HWIO_PERIPH_SS_MPU_XPU_PRT2_SCR_ADDR A:0xf9bfc350
y.create.l HWIO_PERIPH_SS_MPU_XPU_PRT3_SCR_ADDR A:0xf9bfc3d0
y.create.l HWIO_PERIPH_SS_MPU_XPU_PRT0_MCR_ADDR A:0xf9bfc254
y.create.l HWIO_PERIPH_SS_MPU_XPU_PRT1_MCR_ADDR A:0xf9bfc2d4
y.create.l HWIO_PERIPH_SS_MPU_XPU_PRT2_MCR_ADDR A:0xf9bfc354
y.create.l HWIO_PERIPH_SS_MPU_XPU_PRT3_MCR_ADDR A:0xf9bfc3d4
y.create.l HWIO_PERIPH_SS_MPU_XPU_PRT0_CNTL0_ADDR A:0xf9bfc258
y.create.l HWIO_PERIPH_SS_MPU_XPU_PRT1_CNTL0_ADDR A:0xf9bfc2d8
y.create.l HWIO_PERIPH_SS_MPU_XPU_PRT2_CNTL0_ADDR A:0xf9bfc358
y.create.l HWIO_PERIPH_SS_MPU_XPU_PRT3_CNTL0_ADDR A:0xf9bfc3d8
y.create.l HWIO_PERIPH_SS_MPU_XPU_PRT0_CNTL1_ADDR A:0xf9bfc25c
y.create.l HWIO_PERIPH_SS_MPU_XPU_PRT1_CNTL1_ADDR A:0xf9bfc2dc
y.create.l HWIO_PERIPH_SS_MPU_XPU_PRT2_CNTL1_ADDR A:0xf9bfc35c
y.create.l HWIO_PERIPH_SS_MPU_XPU_PRT3_CNTL1_ADDR A:0xf9bfc3dc
y.create.l HWIO_PERIPH_SS_APU_XPU_SCR_ADDR A:0xf9bfd000
y.create.l HWIO_PERIPH_SS_APU_XPU_SWDR_ADDR A:0xf9bfd004
y.create.l HWIO_PERIPH_SS_APU_XPU_SEAR0_ADDR A:0xf9bfd040
y.create.l HWIO_PERIPH_SS_APU_XPU_SESR_ADDR A:0xf9bfd048
y.create.l HWIO_PERIPH_SS_APU_XPU_SESRRESTORE_ADDR A:0xf9bfd04c
y.create.l HWIO_PERIPH_SS_APU_XPU_SESYNR0_ADDR A:0xf9bfd050
y.create.l HWIO_PERIPH_SS_APU_XPU_SESYNR1_ADDR A:0xf9bfd054
y.create.l HWIO_PERIPH_SS_APU_XPU_SESYNR2_ADDR A:0xf9bfd058
y.create.l HWIO_PERIPH_SS_APU_XPU_MCR_ADDR A:0xf9bfd100
y.create.l HWIO_PERIPH_SS_APU_XPU_MEAR0_ADDR A:0xf9bfd140
y.create.l HWIO_PERIPH_SS_APU_XPU_MESR_ADDR A:0xf9bfd148
y.create.l HWIO_PERIPH_SS_APU_XPU_MESRRESTORE_ADDR A:0xf9bfd14c
y.create.l HWIO_PERIPH_SS_APU_XPU_MESYNR0_ADDR A:0xf9bfd150
y.create.l HWIO_PERIPH_SS_APU_XPU_MESYNR1_ADDR A:0xf9bfd154
y.create.l HWIO_PERIPH_SS_APU_XPU_MESYNR2_ADDR A:0xf9bfd158
y.create.l HWIO_PERIPH_SS_APU_XPU_CR_ADDR A:0xf9bfd080
y.create.l HWIO_PERIPH_SS_APU_XPU_RPU_ACR0_ADDR A:0xf9bfd0a0
y.create.l HWIO_PERIPH_SS_APU_XPU_EAR0_ADDR A:0xf9bfd0c0
y.create.l HWIO_PERIPH_SS_APU_XPU_ESR_ADDR A:0xf9bfd0c8
y.create.l HWIO_PERIPH_SS_APU_XPU_ESRRESTORE_ADDR A:0xf9bfd0cc
y.create.l HWIO_PERIPH_SS_APU_XPU_ESYNR0_ADDR A:0xf9bfd0d0
y.create.l HWIO_PERIPH_SS_APU_XPU_ESYNR1_ADDR A:0xf9bfd0d4
y.create.l HWIO_PERIPH_SS_APU_XPU_ESYNR2_ADDR A:0xf9bfd0d8
y.create.l HWIO_PERIPH_SS_APU_XPU_IDR0_ADDR A:0xf9bfd074
y.create.l HWIO_PERIPH_SS_APU_XPU_IDR1_ADDR A:0xf9bfd078
y.create.l HWIO_PERIPH_SS_APU_XPU_REV_ADDR A:0xf9bfd07c
y.create.l HWIO_PERIPH_SS_APU_XPU_RG0_RACR0_ADDR A:0xf9bfd200
y.create.l HWIO_PERIPH_SS_APU_XPU_RG1_RACR0_ADDR A:0xf9bfd280
y.create.l HWIO_PERIPH_SS_APU_XPU_RG0_SCR_ADDR A:0xf9bfd250
y.create.l HWIO_PERIPH_SS_APU_XPU_RG1_SCR_ADDR A:0xf9bfd2d0
y.create.l HWIO_PERIPH_SS_APU_XPU_RG0_MCR_ADDR A:0xf9bfd254
y.create.l HWIO_PERIPH_SS_APU_XPU_RG1_MCR_ADDR A:0xf9bfd2d4
y.create.l HWIO_PERIPH_SS_PDM_TCXO_PDM_CTL_ADDR A:0xf9bfe040
y.create.l HWIO_PERIPH_SS_PDM_PDM0_CTL_ADDR A:0xf9bfe044
y.create.l HWIO_PERIPH_SS_PDM_PDM1_CTL_ADDR A:0xf9bfe048
y.create.l HWIO_PERIPH_SS_PDM_GP_MN_CLK_MDIV_ADDR A:0xf9bfe04c
y.create.l HWIO_PERIPH_SS_PDM_GP_MN_CLK_NDIV_ADDR A:0xf9bfe050
y.create.l HWIO_PERIPH_SS_PDM_GP_MN_CLK_DUTY_ADDR A:0xf9bfe054
y.create.l HWIO_PERIPH_SS_PDM_WEB_TCXO4_TEST_ADDR A:0xf9bfe058
y.create.l HWIO_PERIPH_SS_PDM_PDM2_CTL_ADDR A:0xf9bfe05c
y.create.l HWIO_PERIPH_SS_PRNG_PRNG_DATA_OUT_ADDR A:0xf9bff000
y.create.l HWIO_PERIPH_SS_PRNG_PRNG_STATUS_ADDR A:0xf9bff004
y.create.l HWIO_PERIPH_SS_PRNG_PRNG_HW_VERSION_ADDR A:0xf9bff008
y.create.l HWIO_PERIPH_SS_PRNG_PRNG_ENTROPY_CNTR_ADDR A:0xf9bff010
y.create.l HWIO_PERIPH_SS_PRNG_PRNG_SAMPLE_CNTR_ADDR A:0xf9bff014
y.create.l HWIO_PERIPH_SS_PRNG_PRNG_GEN_CNTR_ADDR A:0xf9bff018
y.create.l HWIO_PERIPH_SS_PRNG_PRNG_RESEED_CNTR_ADDR A:0xf9bff01c
y.create.l HWIO_PERIPH_SS_PRNG_PRNG_INSTANTIATE_CNTR_ADDR A:0xf9bff020
y.create.l HWIO_PERIPH_SS_PRNG_PRNG_DEBUG_ADDR A:0xf9bff024
y.create.l HWIO_PERIPH_SS_PRNG_PRNG_LFSR_CFG_ADDR A:0xf9bff100
y.create.l HWIO_PERIPH_SS_PRNG_PRNG_CONFIG_ADDR A:0xf9bff104
y.create.l HWIO_PERIPH_SS_PRNG_PRNG_PERSONALIZATION_STRING_ADDR A:0xf9bff108
y.create.l HWIO_PERIPH_SS_PRNG_PRNG_NUM_ENTROPY_ADDR A:0xf9bff110
y.create.l HWIO_PERIPH_SS_PRNG_PRNG_SAMPLE_FREQ_ADDR A:0xf9bff114
y.create.l HWIO_PERIPH_SS_PRNG_PRNG_GEN_WORDS_ADDR A:0xf9bff118
y.create.l HWIO_PERIPH_SS_PRNG_PRNG_RESEED_FREQ_ADDR A:0xf9bff11c
y.create.l HWIO_PERIPH_SS_PRNG_PRNG_INSTANTIATE_FREQ_ADDR A:0xf9bff120
y.create.l HWIO_PMIC_ARB_SPMI_GENI_CLK_CTRL_ADDR A:0xfc4ca000
y.create.l HWIO_PMIC_ARB_SPMI_GENI_HW_VERSION_ADDR A:0xfc4ca004
y.create.l HWIO_PMIC_ARB_SPMI_GENI_FW_REVISION_ADDR A:0xfc4ca008
y.create.l HWIO_PMIC_ARB_SPMI_GENI_FORCE_DEFAULT_REG_ADDR A:0xfc4ca00c
y.create.l HWIO_PMIC_ARB_SPMI_GENI_OUTPUT_CTRL_ADDR A:0xfc4ca010
y.create.l HWIO_PMIC_ARB_SPMI_GENI_CGC_CTRL_ADDR A:0xfc4ca014
y.create.l HWIO_PMIC_ARB_SPMI_GENI_CHAR_CFG_ADDR A:0xfc4ca018
y.create.l HWIO_PMIC_ARB_SPMI_GENI_CHAR_DATA_0_ADDR A:0xfc4ca01c
y.create.l HWIO_PMIC_ARB_SPMI_GENI_CHAR_DATA_1_ADDR A:0xfc4ca020
y.create.l HWIO_PMIC_ARB_SPMI_GENI_CTRL_ADDR A:0xfc4ca024
y.create.l HWIO_PMIC_ARB_SPMI_GENI_STATUS_ADDR A:0xfc4ca028
y.create.l HWIO_PMIC_ARB_SPMI_GENI_TEST_BUS_CTRL_ADDR A:0xfc4ca02c
y.create.l HWIO_PMIC_ARB_SPMI_GENI_CFG_REG0_ADDR A:0xfc4ca100
y.create.l HWIO_PMIC_ARB_SPMI_GENI_CFG_REG1_ADDR A:0xfc4ca104
y.create.l HWIO_PMIC_ARB_SPMI_GENI_CFG_REG2_ADDR A:0xfc4ca108
y.create.l HWIO_PMIC_ARB_SPMI_GENI_CFG_REG3_ADDR A:0xfc4ca10c
y.create.l HWIO_PMIC_ARB_SPMI_GENI_CFG_REG4_ADDR A:0xfc4ca110
y.create.l HWIO_PMIC_ARB_SPMI_GENI_CFG_REG5_ADDR A:0xfc4ca114
y.create.l HWIO_PMIC_ARB_SPMI_GENI_CFG_REG6_ADDR A:0xfc4ca118
y.create.l HWIO_PMIC_ARB_SPMI_GENI_CFG_REG7_ADDR A:0xfc4ca11c
y.create.l HWIO_PMIC_ARB_SPMI_GENI_CFG_REG8_ADDR A:0xfc4ca120
y.create.l HWIO_PMIC_ARB_SPMI_GENI_CFG_REG9_ADDR A:0xfc4ca124
y.create.l HWIO_PMIC_ARB_SPMI_GENI_CFG_REG10_ADDR A:0xfc4ca128
y.create.l HWIO_PMIC_ARB_SPMI_GENI_CFG_REG11_ADDR A:0xfc4ca12c
y.create.l HWIO_PMIC_ARB_SPMI_GENI_CFG_REG12_ADDR A:0xfc4ca130
y.create.l HWIO_PMIC_ARB_SPMI_GENI_CFG_REG13_ADDR A:0xfc4ca134
y.create.l HWIO_PMIC_ARB_SPMI_GENI_CFG_REG14_ADDR A:0xfc4ca138
y.create.l HWIO_PMIC_ARB_SPMI_GENI_CFG_REG15_ADDR A:0xfc4ca13c
y.create.l HWIO_PMIC_ARB_SPMI_GENI_CFG_REG16_ADDR A:0xfc4ca140
y.create.l HWIO_PMIC_ARB_SPMI_GENI_CFG_REG17_ADDR A:0xfc4ca144
y.create.l HWIO_PMIC_ARB_SPMI_GENI_CFG_REG18_ADDR A:0xfc4ca148
y.create.l HWIO_PMIC_ARB_SPMI_GENI_CFG_RAM0_ADDR A:0xfc4ca200
y.create.l HWIO_PMIC_ARB_SPMI_GENI_CFG_RAM1_ADDR A:0xfc4ca204
y.create.l HWIO_PMIC_ARB_SPMI_GENI_CFG_RAM2_ADDR A:0xfc4ca208
y.create.l HWIO_PMIC_ARB_SPMI_GENI_CFG_RAM3_ADDR A:0xfc4ca20c
y.create.l HWIO_PMIC_ARB_SPMI_GENI_CFG_RAM4_ADDR A:0xfc4ca210
y.create.l HWIO_PMIC_ARB_SPMI_GENI_CFG_RAM5_ADDR A:0xfc4ca214
y.create.l HWIO_PMIC_ARB_SPMI_GENI_CFG_RAM6_ADDR A:0xfc4ca218
y.create.l HWIO_PMIC_ARB_SPMI_GENI_CFG_RAM7_ADDR A:0xfc4ca21c
y.create.l HWIO_PMIC_ARB_SPMI_GENI_CFG_RAM8_ADDR A:0xfc4ca220
y.create.l HWIO_PMIC_ARB_SPMI_GENI_CFG_RAM9_ADDR A:0xfc4ca224
y.create.l HWIO_PMIC_ARB_SPMI_PERIPH0_2OWNER_TABLE_REG_ADDR A:0xfc4ca700
y.create.l HWIO_PMIC_ARB_SPMI_PERIPH1_2OWNER_TABLE_REG_ADDR A:0xfc4ca704
y.create.l HWIO_PMIC_ARB_SPMI_PERIPH2_2OWNER_TABLE_REG_ADDR A:0xfc4ca708
y.create.l HWIO_PMIC_ARB_SPMI_PERIPH3_2OWNER_TABLE_REG_ADDR A:0xfc4ca70c
y.create.l HWIO_PMIC_ARB_SPMI_PERIPH4_2OWNER_TABLE_REG_ADDR A:0xfc4ca710
y.create.l HWIO_PMIC_ARB_SPMI_PERIPH5_2OWNER_TABLE_REG_ADDR A:0xfc4ca714
y.create.l HWIO_PMIC_ARB_SPMI_PERIPH6_2OWNER_TABLE_REG_ADDR A:0xfc4ca718
y.create.l HWIO_PMIC_ARB_SPMI_PERIPH7_2OWNER_TABLE_REG_ADDR A:0xfc4ca71c
y.create.l HWIO_PMIC_ARB_SPMI_PERIPH8_2OWNER_TABLE_REG_ADDR A:0xfc4ca720
y.create.l HWIO_PMIC_ARB_SPMI_PERIPH9_2OWNER_TABLE_REG_ADDR A:0xfc4ca724
y.create.l HWIO_PMIC_ARB_SPMI_MAPPING_TABLE_REG0_ADDR A:0xfc4cab00
y.create.l HWIO_PMIC_ARB_SPMI_MAPPING_TABLE_REG1_ADDR A:0xfc4cab04
y.create.l HWIO_PMIC_ARB_SPMI_MAPPING_TABLE_REG2_ADDR A:0xfc4cab08
y.create.l HWIO_PMIC_ARB_SPMI_MAPPING_TABLE_REG3_ADDR A:0xfc4cab0c
y.create.l HWIO_PMIC_ARB_SPMI_MAPPING_TABLE_REG4_ADDR A:0xfc4cab10
y.create.l HWIO_PMIC_ARB_SPMI_MAPPING_TABLE_REG5_ADDR A:0xfc4cab14
y.create.l HWIO_PMIC_ARB_SPMI_MAPPING_TABLE_REG6_ADDR A:0xfc4cab18
y.create.l HWIO_PMIC_ARB_SPMI_MAPPING_TABLE_REG7_ADDR A:0xfc4cab1c
y.create.l HWIO_PMIC_ARB_SPMI_MAPPING_TABLE_REG8_ADDR A:0xfc4cab20
y.create.l HWIO_PMIC_ARB_SPMI_MAPPING_TABLE_REG9_ADDR A:0xfc4cab24
y.create.l HWIO_PMIC_ARB_SPMI_MID_REG_ADDR A:0xfc4caf00
y.create.l HWIO_PMIC_ARB_SPMI_CFG_REG_ADDR A:0xfc4caf04
y.create.l HWIO_PMIC_ARB_SPMI_SEC_DISABLE_REG_ADDR A:0xfc4caf08
y.create.l HWIO_PMIC_ARB_SPMI_HW_VERSION_ADDR A:0xfc4caf0c
y.create.l HWIO_PMIC_ARB_SPMI_CGC_CTRL_ADDR A:0xfc4caf10
y.create.l HWIO_PMIC_ARB_SPMI_MWB_ENABLE_REG_ADDR A:0xfc4caf14
y.create.l HWIO_PMIC_ARB_SPMI_PROTOCOL_IRQ_STATUS_ADDR A:0xfc4caf20
y.create.l HWIO_PMIC_ARB_SPMI_PROTOCOL_IRQ_ENABLE_ADDR A:0xfc4caf24
y.create.l HWIO_PMIC_ARB_SPMI_PROTOCOL_IRQ_CLEAR_ADDR A:0xfc4caf28
y.create.l HWIO_PMIC_ARB_SPMI_PROTOCOL_IRQ_EN_SET_ADDR A:0xfc4caf2c
y.create.l HWIO_PMIC_ARB_SPMI_PROTOCOL_IRQ_EN_CLEAR_ADDR A:0xfc4caf30
y.create.l HWIO_PMIC_ARB_SPMI_CHAR_CFG_ADDR A:0xfc4caf40
y.create.l HWIO_PMIC_ARB_SPMI_CHAR_DATA_0_ADDR A:0xfc4caf44
y.create.l HWIO_PMIC_ARB_SPMI_CHAR_DATA_1_ADDR A:0xfc4caf48
y.create.l HWIO_PMIC_ARB_SPMI_TEST_BUS_CTRL_ADDR A:0xfc4caf4c
y.create.l HWIO_PMIC_ARB_SPMI_HW_SW_EVENTS_CTRL_ADDR A:0xfc4caf50
y.create.l HWIO_PMIC_ARB_SPMI_XPU_SCR_ADDR A:0xfc4c0000
y.create.l HWIO_PMIC_ARB_SPMI_XPU_SWDR_ADDR A:0xfc4c0004
y.create.l HWIO_PMIC_ARB_SPMI_XPU_SEAR0_ADDR A:0xfc4c0040
y.create.l HWIO_PMIC_ARB_SPMI_XPU_SESR_ADDR A:0xfc4c0048
y.create.l HWIO_PMIC_ARB_SPMI_XPU_SESRRESTORE_ADDR A:0xfc4c004c
y.create.l HWIO_PMIC_ARB_SPMI_XPU_SESYNR0_ADDR A:0xfc4c0050
y.create.l HWIO_PMIC_ARB_SPMI_XPU_SESYNR1_ADDR A:0xfc4c0054
y.create.l HWIO_PMIC_ARB_SPMI_XPU_SESYNR2_ADDR A:0xfc4c0058
y.create.l HWIO_PMIC_ARB_SPMI_XPU_MCR_ADDR A:0xfc4c0100
y.create.l HWIO_PMIC_ARB_SPMI_XPU_MEAR0_ADDR A:0xfc4c0140
y.create.l HWIO_PMIC_ARB_SPMI_XPU_MESR_ADDR A:0xfc4c0148
y.create.l HWIO_PMIC_ARB_SPMI_XPU_MESRRESTORE_ADDR A:0xfc4c014c
y.create.l HWIO_PMIC_ARB_SPMI_XPU_MESYNR0_ADDR A:0xfc4c0150
y.create.l HWIO_PMIC_ARB_SPMI_XPU_MESYNR1_ADDR A:0xfc4c0154
y.create.l HWIO_PMIC_ARB_SPMI_XPU_MESYNR2_ADDR A:0xfc4c0158
y.create.l HWIO_PMIC_ARB_SPMI_XPU_CR_ADDR A:0xfc4c0080
y.create.l HWIO_PMIC_ARB_SPMI_XPU_RPU_ACR0_ADDR A:0xfc4c00a0
y.create.l HWIO_PMIC_ARB_SPMI_XPU_EAR0_ADDR A:0xfc4c00c0
y.create.l HWIO_PMIC_ARB_SPMI_XPU_ESR_ADDR A:0xfc4c00c8
y.create.l HWIO_PMIC_ARB_SPMI_XPU_ESRRESTORE_ADDR A:0xfc4c00cc
y.create.l HWIO_PMIC_ARB_SPMI_XPU_ESYNR0_ADDR A:0xfc4c00d0
y.create.l HWIO_PMIC_ARB_SPMI_XPU_ESYNR1_ADDR A:0xfc4c00d4
y.create.l HWIO_PMIC_ARB_SPMI_XPU_ESYNR2_ADDR A:0xfc4c00d8
y.create.l HWIO_PMIC_ARB_SPMI_XPU_IDR0_ADDR A:0xfc4c0074
y.create.l HWIO_PMIC_ARB_SPMI_XPU_IDR1_ADDR A:0xfc4c0078
y.create.l HWIO_PMIC_ARB_SPMI_XPU_REV_ADDR A:0xfc4c007c
y.create.l HWIO_PMIC_ARB_SPMI_XPU_RG0_RACR0_ADDR A:0xfc4c0200
y.create.l HWIO_PMIC_ARB_SPMI_XPU_RG1_RACR0_ADDR A:0xfc4c0280
y.create.l HWIO_PMIC_ARB_SPMI_XPU_RG2_RACR0_ADDR A:0xfc4c0300
y.create.l HWIO_PMIC_ARB_SPMI_XPU_RG3_RACR0_ADDR A:0xfc4c0380
y.create.l HWIO_PMIC_ARB_SPMI_XPU_RG4_RACR0_ADDR A:0xfc4c0400
y.create.l HWIO_PMIC_ARB_SPMI_XPU_RG5_RACR0_ADDR A:0xfc4c0480
y.create.l HWIO_PMIC_ARB_SPMI_XPU_RG6_RACR0_ADDR A:0xfc4c0500
y.create.l HWIO_PMIC_ARB_SPMI_XPU_RG7_RACR0_ADDR A:0xfc4c0580
y.create.l HWIO_PMIC_ARB_SPMI_XPU_RG8_RACR0_ADDR A:0xfc4c0600
y.create.l HWIO_PMIC_ARB_SPMI_XPU_RG9_RACR0_ADDR A:0xfc4c0680
y.create.l HWIO_PMIC_ARB_SPMI_XPU_RG0_SCR_ADDR A:0xfc4c0250
y.create.l HWIO_PMIC_ARB_SPMI_XPU_RG1_SCR_ADDR A:0xfc4c02d0
y.create.l HWIO_PMIC_ARB_SPMI_XPU_RG2_SCR_ADDR A:0xfc4c0350
y.create.l HWIO_PMIC_ARB_SPMI_XPU_RG3_SCR_ADDR A:0xfc4c03d0
y.create.l HWIO_PMIC_ARB_SPMI_XPU_RG4_SCR_ADDR A:0xfc4c0450
y.create.l HWIO_PMIC_ARB_SPMI_XPU_RG5_SCR_ADDR A:0xfc4c04d0
y.create.l HWIO_PMIC_ARB_SPMI_XPU_RG6_SCR_ADDR A:0xfc4c0550
y.create.l HWIO_PMIC_ARB_SPMI_XPU_RG7_SCR_ADDR A:0xfc4c05d0
y.create.l HWIO_PMIC_ARB_SPMI_XPU_RG8_SCR_ADDR A:0xfc4c0650
y.create.l HWIO_PMIC_ARB_SPMI_XPU_RG9_SCR_ADDR A:0xfc4c06d0
y.create.l HWIO_PMIC_ARB_SPMI_XPU_RG0_MCR_ADDR A:0xfc4c0254
y.create.l HWIO_PMIC_ARB_SPMI_XPU_RG1_MCR_ADDR A:0xfc4c02d4
y.create.l HWIO_PMIC_ARB_SPMI_XPU_RG2_MCR_ADDR A:0xfc4c0354
y.create.l HWIO_PMIC_ARB_SPMI_XPU_RG3_MCR_ADDR A:0xfc4c03d4
y.create.l HWIO_PMIC_ARB_SPMI_XPU_RG4_MCR_ADDR A:0xfc4c0454
y.create.l HWIO_PMIC_ARB_SPMI_XPU_RG5_MCR_ADDR A:0xfc4c04d4
y.create.l HWIO_PMIC_ARB_SPMI_XPU_RG6_MCR_ADDR A:0xfc4c0554
y.create.l HWIO_PMIC_ARB_SPMI_XPU_RG7_MCR_ADDR A:0xfc4c05d4
y.create.l HWIO_PMIC_ARB_SPMI_XPU_RG8_MCR_ADDR A:0xfc4c0654
y.create.l HWIO_PMIC_ARB_SPMI_XPU_RG9_MCR_ADDR A:0xfc4c06d4
y.create.l HWIO_PMIC_ARB_SPMI_PIC_OWNER0_ACC_STATUS0_ADDR A:0xfc4cb000
y.create.l HWIO_PMIC_ARB_SPMI_PIC_OWNER0_ACC_STATUS1_ADDR A:0xfc4cb004
y.create.l HWIO_PMIC_ARB_SPMI_PIC_OWNER0_ACC_STATUS2_ADDR A:0xfc4cb008
y.create.l HWIO_PMIC_ARB_SPMI_PIC_OWNER0_ACC_STATUS3_ADDR A:0xfc4cb00c
y.create.l HWIO_PMIC_ARB_SPMI_PIC_OWNER1_ACC_STATUS0_ADDR A:0xfc4cb020
y.create.l HWIO_PMIC_ARB_SPMI_PIC_OWNER1_ACC_STATUS1_ADDR A:0xfc4cb024
y.create.l HWIO_PMIC_ARB_SPMI_PIC_OWNER1_ACC_STATUS2_ADDR A:0xfc4cb028
y.create.l HWIO_PMIC_ARB_SPMI_PIC_OWNER1_ACC_STATUS3_ADDR A:0xfc4cb02c
y.create.l HWIO_PMIC_ARB_SPMI_PIC_OWNER2_ACC_STATUS0_ADDR A:0xfc4cb040
y.create.l HWIO_PMIC_ARB_SPMI_PIC_OWNER2_ACC_STATUS1_ADDR A:0xfc4cb044
y.create.l HWIO_PMIC_ARB_SPMI_PIC_OWNER2_ACC_STATUS2_ADDR A:0xfc4cb048
y.create.l HWIO_PMIC_ARB_SPMI_PIC_OWNER2_ACC_STATUS3_ADDR A:0xfc4cb04c
y.create.l HWIO_PMIC_ARB_SPMI_PIC_OWNER3_ACC_STATUS0_ADDR A:0xfc4cb060
y.create.l HWIO_PMIC_ARB_SPMI_PIC_OWNER3_ACC_STATUS1_ADDR A:0xfc4cb064
y.create.l HWIO_PMIC_ARB_SPMI_PIC_OWNER3_ACC_STATUS2_ADDR A:0xfc4cb068
y.create.l HWIO_PMIC_ARB_SPMI_PIC_OWNER3_ACC_STATUS3_ADDR A:0xfc4cb06c
y.create.l HWIO_PMIC_ARB_SPMI_PIC_OWNER4_ACC_STATUS0_ADDR A:0xfc4cb080
y.create.l HWIO_PMIC_ARB_SPMI_PIC_OWNER4_ACC_STATUS1_ADDR A:0xfc4cb084
y.create.l HWIO_PMIC_ARB_SPMI_PIC_OWNER4_ACC_STATUS2_ADDR A:0xfc4cb088
y.create.l HWIO_PMIC_ARB_SPMI_PIC_OWNER4_ACC_STATUS3_ADDR A:0xfc4cb08c
y.create.l HWIO_PMIC_ARB_SPMI_PIC_OWNER5_ACC_STATUS0_ADDR A:0xfc4cb0a0
y.create.l HWIO_PMIC_ARB_SPMI_PIC_OWNER5_ACC_STATUS1_ADDR A:0xfc4cb0a4
y.create.l HWIO_PMIC_ARB_SPMI_PIC_OWNER5_ACC_STATUS2_ADDR A:0xfc4cb0a8
y.create.l HWIO_PMIC_ARB_SPMI_PIC_OWNER5_ACC_STATUS3_ADDR A:0xfc4cb0ac
y.create.l HWIO_PMIC_ARB_SPMI_PIC_ACC_ENABLE0_ADDR A:0xfc4cb200
y.create.l HWIO_PMIC_ARB_SPMI_PIC_ACC_ENABLE1_ADDR A:0xfc4cb204
y.create.l HWIO_PMIC_ARB_SPMI_PIC_ACC_ENABLE2_ADDR A:0xfc4cb208
y.create.l HWIO_PMIC_ARB_SPMI_PIC_ACC_ENABLE3_ADDR A:0xfc4cb20c
y.create.l HWIO_PMIC_ARB_SPMI_PIC_ACC_ENABLE4_ADDR A:0xfc4cb210
y.create.l HWIO_PMIC_ARB_SPMI_PIC_ACC_ENABLE5_ADDR A:0xfc4cb214
y.create.l HWIO_PMIC_ARB_SPMI_PIC_ACC_ENABLE6_ADDR A:0xfc4cb218
y.create.l HWIO_PMIC_ARB_SPMI_PIC_ACC_ENABLE7_ADDR A:0xfc4cb21c
y.create.l HWIO_PMIC_ARB_SPMI_PIC_ACC_ENABLE8_ADDR A:0xfc4cb220
y.create.l HWIO_PMIC_ARB_SPMI_PIC_ACC_ENABLE9_ADDR A:0xfc4cb224
y.create.l HWIO_PMIC_ARB_SPMI_PIC_IRQ_STATUS0_ADDR A:0xfc4cb600
y.create.l HWIO_PMIC_ARB_SPMI_PIC_IRQ_STATUS1_ADDR A:0xfc4cb604
y.create.l HWIO_PMIC_ARB_SPMI_PIC_IRQ_STATUS2_ADDR A:0xfc4cb608
y.create.l HWIO_PMIC_ARB_SPMI_PIC_IRQ_STATUS3_ADDR A:0xfc4cb60c
y.create.l HWIO_PMIC_ARB_SPMI_PIC_IRQ_STATUS4_ADDR A:0xfc4cb610
y.create.l HWIO_PMIC_ARB_SPMI_PIC_IRQ_STATUS5_ADDR A:0xfc4cb614
y.create.l HWIO_PMIC_ARB_SPMI_PIC_IRQ_STATUS6_ADDR A:0xfc4cb618
y.create.l HWIO_PMIC_ARB_SPMI_PIC_IRQ_STATUS7_ADDR A:0xfc4cb61c
y.create.l HWIO_PMIC_ARB_SPMI_PIC_IRQ_STATUS8_ADDR A:0xfc4cb620
y.create.l HWIO_PMIC_ARB_SPMI_PIC_IRQ_STATUS9_ADDR A:0xfc4cb624
y.create.l HWIO_PMIC_ARB_SPMI_PIC_IRQ_CLEAR0_ADDR A:0xfc4cba00
y.create.l HWIO_PMIC_ARB_SPMI_PIC_IRQ_CLEAR1_ADDR A:0xfc4cba04
y.create.l HWIO_PMIC_ARB_SPMI_PIC_IRQ_CLEAR2_ADDR A:0xfc4cba08
y.create.l HWIO_PMIC_ARB_SPMI_PIC_IRQ_CLEAR3_ADDR A:0xfc4cba0c
y.create.l HWIO_PMIC_ARB_SPMI_PIC_IRQ_CLEAR4_ADDR A:0xfc4cba10
y.create.l HWIO_PMIC_ARB_SPMI_PIC_IRQ_CLEAR5_ADDR A:0xfc4cba14
y.create.l HWIO_PMIC_ARB_SPMI_PIC_IRQ_CLEAR6_ADDR A:0xfc4cba18
y.create.l HWIO_PMIC_ARB_SPMI_PIC_IRQ_CLEAR7_ADDR A:0xfc4cba1c
y.create.l HWIO_PMIC_ARB_SPMI_PIC_IRQ_CLEAR8_ADDR A:0xfc4cba20
y.create.l HWIO_PMIC_ARB_SPMI_PIC_IRQ_CLEAR9_ADDR A:0xfc4cba24
y.create.l HWIO_PMIC_ARB_XPU_SCR_ADDR A:0xfc4ce000
y.create.l HWIO_PMIC_ARB_XPU_SWDR_ADDR A:0xfc4ce004
y.create.l HWIO_PMIC_ARB_XPU_SEAR0_ADDR A:0xfc4ce040
y.create.l HWIO_PMIC_ARB_XPU_SESR_ADDR A:0xfc4ce048
y.create.l HWIO_PMIC_ARB_XPU_SESRRESTORE_ADDR A:0xfc4ce04c
y.create.l HWIO_PMIC_ARB_XPU_SESYNR0_ADDR A:0xfc4ce050
y.create.l HWIO_PMIC_ARB_XPU_SESYNR1_ADDR A:0xfc4ce054
y.create.l HWIO_PMIC_ARB_XPU_SESYNR2_ADDR A:0xfc4ce058
y.create.l HWIO_PMIC_ARB_XPU_MCR_ADDR A:0xfc4ce100
y.create.l HWIO_PMIC_ARB_XPU_MEAR0_ADDR A:0xfc4ce140
y.create.l HWIO_PMIC_ARB_XPU_MESR_ADDR A:0xfc4ce148
y.create.l HWIO_PMIC_ARB_XPU_MESRRESTORE_ADDR A:0xfc4ce14c
y.create.l HWIO_PMIC_ARB_XPU_MESYNR0_ADDR A:0xfc4ce150
y.create.l HWIO_PMIC_ARB_XPU_MESYNR1_ADDR A:0xfc4ce154
y.create.l HWIO_PMIC_ARB_XPU_MESYNR2_ADDR A:0xfc4ce158
y.create.l HWIO_PMIC_ARB_XPU_CR_ADDR A:0xfc4ce080
y.create.l HWIO_PMIC_ARB_XPU_RPU_ACR0_ADDR A:0xfc4ce0a0
y.create.l HWIO_PMIC_ARB_XPU_EAR0_ADDR A:0xfc4ce0c0
y.create.l HWIO_PMIC_ARB_XPU_ESR_ADDR A:0xfc4ce0c8
y.create.l HWIO_PMIC_ARB_XPU_ESRRESTORE_ADDR A:0xfc4ce0cc
y.create.l HWIO_PMIC_ARB_XPU_ESYNR0_ADDR A:0xfc4ce0d0
y.create.l HWIO_PMIC_ARB_XPU_ESYNR1_ADDR A:0xfc4ce0d4
y.create.l HWIO_PMIC_ARB_XPU_ESYNR2_ADDR A:0xfc4ce0d8
y.create.l HWIO_PMIC_ARB_XPU_IDR0_ADDR A:0xfc4ce074
y.create.l HWIO_PMIC_ARB_XPU_IDR1_ADDR A:0xfc4ce078
y.create.l HWIO_PMIC_ARB_XPU_REV_ADDR A:0xfc4ce07c
y.create.l HWIO_PMIC_ARB_XPU_RG0_RACR0_ADDR A:0xfc4ce200
y.create.l HWIO_PMIC_ARB_XPU_RG1_RACR0_ADDR A:0xfc4ce280
y.create.l HWIO_PMIC_ARB_XPU_RG2_RACR0_ADDR A:0xfc4ce300
y.create.l HWIO_PMIC_ARB_XPU_RG3_RACR0_ADDR A:0xfc4ce380
y.create.l HWIO_PMIC_ARB_XPU_RG4_RACR0_ADDR A:0xfc4ce400
y.create.l HWIO_PMIC_ARB_XPU_RG5_RACR0_ADDR A:0xfc4ce480
y.create.l HWIO_PMIC_ARB_XPU_RG6_RACR0_ADDR A:0xfc4ce500
y.create.l HWIO_PMIC_ARB_XPU_RG7_RACR0_ADDR A:0xfc4ce580
y.create.l HWIO_PMIC_ARB_XPU_RG0_SCR_ADDR A:0xfc4ce250
y.create.l HWIO_PMIC_ARB_XPU_RG1_SCR_ADDR A:0xfc4ce2d0
y.create.l HWIO_PMIC_ARB_XPU_RG2_SCR_ADDR A:0xfc4ce350
y.create.l HWIO_PMIC_ARB_XPU_RG3_SCR_ADDR A:0xfc4ce3d0
y.create.l HWIO_PMIC_ARB_XPU_RG4_SCR_ADDR A:0xfc4ce450
y.create.l HWIO_PMIC_ARB_XPU_RG5_SCR_ADDR A:0xfc4ce4d0
y.create.l HWIO_PMIC_ARB_XPU_RG6_SCR_ADDR A:0xfc4ce550
y.create.l HWIO_PMIC_ARB_XPU_RG7_SCR_ADDR A:0xfc4ce5d0
y.create.l HWIO_PMIC_ARB_XPU_RG0_MCR_ADDR A:0xfc4ce254
y.create.l HWIO_PMIC_ARB_XPU_RG1_MCR_ADDR A:0xfc4ce2d4
y.create.l HWIO_PMIC_ARB_XPU_RG2_MCR_ADDR A:0xfc4ce354
y.create.l HWIO_PMIC_ARB_XPU_RG3_MCR_ADDR A:0xfc4ce3d4
y.create.l HWIO_PMIC_ARB_XPU_RG4_MCR_ADDR A:0xfc4ce454
y.create.l HWIO_PMIC_ARB_XPU_RG5_MCR_ADDR A:0xfc4ce4d4
y.create.l HWIO_PMIC_ARB_XPU_RG6_MCR_ADDR A:0xfc4ce554
y.create.l HWIO_PMIC_ARB_XPU_RG7_MCR_ADDR A:0xfc4ce5d4
y.create.l HWIO_PMIC_ARB_HW_VERSION_ADDR A:0xfc4cf000
y.create.l HWIO_PMIC_ARB_MISC_CONFIG_ADDR A:0xfc4cf004
y.create.l HWIO_PMIC_ARB_PVC_INTF_CTL_ADDR A:0xfc4cf008
y.create.l HWIO_PMIC_ARB_PVC_INTF_STATUS_ADDR A:0xfc4cf00c
y.create.l HWIO_PMIC_ARB_PRIORITIES0_ADDR A:0xfc4cf100
y.create.l HWIO_PMIC_ARB_PRIORITIES1_ADDR A:0xfc4cf104
y.create.l HWIO_PMIC_ARB_PRIORITIES2_ADDR A:0xfc4cf108
y.create.l HWIO_PMIC_ARB_PRIORITIES3_ADDR A:0xfc4cf10c
y.create.l HWIO_PMIC_ARB_PRIORITIES4_ADDR A:0xfc4cf110
y.create.l HWIO_PMIC_ARB_PRIORITIES5_ADDR A:0xfc4cf114
y.create.l HWIO_PMIC_ARB_PRIORITIES6_ADDR A:0xfc4cf118
y.create.l HWIO_PMIC_ARB_PRIORITIES7_ADDR A:0xfc4cf11c
y.create.l HWIO_PMIC_ARB_PRIORITIES8_ADDR A:0xfc4cf120
y.create.l HWIO_PMIC_ARB_PRIORITIES9_ADDR A:0xfc4cf124
y.create.l HWIO_PMIC_ARB_PVC_PORT0_CTL_ADDR A:0xfc4cf200
y.create.l HWIO_PMIC_ARB_PVC_PORT1_CTL_ADDR A:0xfc4cf204
y.create.l HWIO_PMIC_ARB_PVC_PORT2_CTL_ADDR A:0xfc4cf208
y.create.l HWIO_PMIC_ARB_PVC_PORT3_CTL_ADDR A:0xfc4cf20c
y.create.l HWIO_PMIC_ARB_PVC_PORT4_CTL_ADDR A:0xfc4cf210
y.create.l HWIO_PMIC_ARB_PVC_PORT5_CTL_ADDR A:0xfc4cf214
y.create.l HWIO_PMIC_ARB_PVC_PORT6_CTL_ADDR A:0xfc4cf218
y.create.l HWIO_PMIC_ARB_PVC_PORT7_CTL_ADDR A:0xfc4cf21c
y.create.l HWIO_PMIC_ARB_PVC_PORT8_CTL_ADDR A:0xfc4cf220
y.create.l HWIO_PMIC_ARB_PVC_PORT0_STATUS_ADDR A:0xfc4cf280
y.create.l HWIO_PMIC_ARB_PVC_PORT1_STATUS_ADDR A:0xfc4cf284
y.create.l HWIO_PMIC_ARB_PVC_PORT2_STATUS_ADDR A:0xfc4cf288
y.create.l HWIO_PMIC_ARB_PVC_PORT3_STATUS_ADDR A:0xfc4cf28c
y.create.l HWIO_PMIC_ARB_PVC_PORT4_STATUS_ADDR A:0xfc4cf290
y.create.l HWIO_PMIC_ARB_PVC_PORT5_STATUS_ADDR A:0xfc4cf294
y.create.l HWIO_PMIC_ARB_PVC_PORT6_STATUS_ADDR A:0xfc4cf298
y.create.l HWIO_PMIC_ARB_PVC_PORT7_STATUS_ADDR A:0xfc4cf29c
y.create.l HWIO_PMIC_ARB_PVC_PORT8_STATUS_ADDR A:0xfc4cf2a0
y.create.l HWIO_PMIC_ARB_PVC0_ADDR0_ADDR A:0xfc4cf400
y.create.l HWIO_PMIC_ARB_PVC0_ADDR1_ADDR A:0xfc4cf404
y.create.l HWIO_PMIC_ARB_PVC0_ADDR2_ADDR A:0xfc4cf408
y.create.l HWIO_PMIC_ARB_PVC0_ADDR3_ADDR A:0xfc4cf40c
y.create.l HWIO_PMIC_ARB_PVC1_ADDR0_ADDR A:0xfc4cf420
y.create.l HWIO_PMIC_ARB_PVC1_ADDR1_ADDR A:0xfc4cf424
y.create.l HWIO_PMIC_ARB_PVC1_ADDR2_ADDR A:0xfc4cf428
y.create.l HWIO_PMIC_ARB_PVC1_ADDR3_ADDR A:0xfc4cf42c
y.create.l HWIO_PMIC_ARB_PVC2_ADDR0_ADDR A:0xfc4cf440
y.create.l HWIO_PMIC_ARB_PVC2_ADDR1_ADDR A:0xfc4cf444
y.create.l HWIO_PMIC_ARB_PVC2_ADDR2_ADDR A:0xfc4cf448
y.create.l HWIO_PMIC_ARB_PVC2_ADDR3_ADDR A:0xfc4cf44c
y.create.l HWIO_PMIC_ARB_PVC3_ADDR0_ADDR A:0xfc4cf460
y.create.l HWIO_PMIC_ARB_PVC3_ADDR1_ADDR A:0xfc4cf464
y.create.l HWIO_PMIC_ARB_PVC3_ADDR2_ADDR A:0xfc4cf468
y.create.l HWIO_PMIC_ARB_PVC3_ADDR3_ADDR A:0xfc4cf46c
y.create.l HWIO_PMIC_ARB_PVC4_ADDR0_ADDR A:0xfc4cf480
y.create.l HWIO_PMIC_ARB_PVC4_ADDR1_ADDR A:0xfc4cf484
y.create.l HWIO_PMIC_ARB_PVC4_ADDR2_ADDR A:0xfc4cf488
y.create.l HWIO_PMIC_ARB_PVC4_ADDR3_ADDR A:0xfc4cf48c
y.create.l HWIO_PMIC_ARB_PVC5_ADDR0_ADDR A:0xfc4cf4a0
y.create.l HWIO_PMIC_ARB_PVC5_ADDR1_ADDR A:0xfc4cf4a4
y.create.l HWIO_PMIC_ARB_PVC5_ADDR2_ADDR A:0xfc4cf4a8
y.create.l HWIO_PMIC_ARB_PVC5_ADDR3_ADDR A:0xfc4cf4ac
y.create.l HWIO_PMIC_ARB_PVC6_ADDR0_ADDR A:0xfc4cf4c0
y.create.l HWIO_PMIC_ARB_PVC6_ADDR1_ADDR A:0xfc4cf4c4
y.create.l HWIO_PMIC_ARB_PVC6_ADDR2_ADDR A:0xfc4cf4c8
y.create.l HWIO_PMIC_ARB_PVC6_ADDR3_ADDR A:0xfc4cf4cc
y.create.l HWIO_PMIC_ARB_PVC7_ADDR0_ADDR A:0xfc4cf4e0
y.create.l HWIO_PMIC_ARB_PVC7_ADDR1_ADDR A:0xfc4cf4e4
y.create.l HWIO_PMIC_ARB_PVC7_ADDR2_ADDR A:0xfc4cf4e8
y.create.l HWIO_PMIC_ARB_PVC7_ADDR3_ADDR A:0xfc4cf4ec
y.create.l HWIO_PMIC_ARB_PVC8_ADDR0_ADDR A:0xfc4cf500
y.create.l HWIO_PMIC_ARB_PVC8_ADDR1_ADDR A:0xfc4cf504
y.create.l HWIO_PMIC_ARB_PVC8_ADDR2_ADDR A:0xfc4cf508
y.create.l HWIO_PMIC_ARB_PVC8_ADDR3_ADDR A:0xfc4cf50c
y.create.l HWIO_PMIC_ARB_CHNL0_CMD_ADDR A:0xfc4cf800
y.create.l HWIO_PMIC_ARB_CHNL1_CMD_ADDR A:0xfc4cf880
y.create.l HWIO_PMIC_ARB_CHNL2_CMD_ADDR A:0xfc4cf900
y.create.l HWIO_PMIC_ARB_CHNL3_CMD_ADDR A:0xfc4cf980
y.create.l HWIO_PMIC_ARB_CHNL4_CMD_ADDR A:0xfc4cfa00
y.create.l HWIO_PMIC_ARB_CHNL5_CMD_ADDR A:0xfc4cfa80
y.create.l HWIO_PMIC_ARB_CHNL0_CONFIG_ADDR A:0xfc4cf804
y.create.l HWIO_PMIC_ARB_CHNL1_CONFIG_ADDR A:0xfc4cf884
y.create.l HWIO_PMIC_ARB_CHNL2_CONFIG_ADDR A:0xfc4cf904
y.create.l HWIO_PMIC_ARB_CHNL3_CONFIG_ADDR A:0xfc4cf984
y.create.l HWIO_PMIC_ARB_CHNL4_CONFIG_ADDR A:0xfc4cfa04
y.create.l HWIO_PMIC_ARB_CHNL5_CONFIG_ADDR A:0xfc4cfa84
y.create.l HWIO_PMIC_ARB_CHNL0_STATUS_ADDR A:0xfc4cf808
y.create.l HWIO_PMIC_ARB_CHNL1_STATUS_ADDR A:0xfc4cf888
y.create.l HWIO_PMIC_ARB_CHNL2_STATUS_ADDR A:0xfc4cf908
y.create.l HWIO_PMIC_ARB_CHNL3_STATUS_ADDR A:0xfc4cf988
y.create.l HWIO_PMIC_ARB_CHNL4_STATUS_ADDR A:0xfc4cfa08
y.create.l HWIO_PMIC_ARB_CHNL5_STATUS_ADDR A:0xfc4cfa88
y.create.l HWIO_PMIC_ARB_CHNL0_WDATA0_ADDR A:0xfc4cf810
y.create.l HWIO_PMIC_ARB_CHNL1_WDATA0_ADDR A:0xfc4cf890
y.create.l HWIO_PMIC_ARB_CHNL2_WDATA0_ADDR A:0xfc4cf910
y.create.l HWIO_PMIC_ARB_CHNL3_WDATA0_ADDR A:0xfc4cf990
y.create.l HWIO_PMIC_ARB_CHNL4_WDATA0_ADDR A:0xfc4cfa10
y.create.l HWIO_PMIC_ARB_CHNL5_WDATA0_ADDR A:0xfc4cfa90
y.create.l HWIO_PMIC_ARB_CHNL0_WDATA1_ADDR A:0xfc4cf814
y.create.l HWIO_PMIC_ARB_CHNL1_WDATA1_ADDR A:0xfc4cf894
y.create.l HWIO_PMIC_ARB_CHNL2_WDATA1_ADDR A:0xfc4cf914
y.create.l HWIO_PMIC_ARB_CHNL3_WDATA1_ADDR A:0xfc4cf994
y.create.l HWIO_PMIC_ARB_CHNL4_WDATA1_ADDR A:0xfc4cfa14
y.create.l HWIO_PMIC_ARB_CHNL5_WDATA1_ADDR A:0xfc4cfa94
y.create.l HWIO_PMIC_ARB_CHNL0_RDATA0_ADDR A:0xfc4cf818
y.create.l HWIO_PMIC_ARB_CHNL1_RDATA0_ADDR A:0xfc4cf898
y.create.l HWIO_PMIC_ARB_CHNL2_RDATA0_ADDR A:0xfc4cf918
y.create.l HWIO_PMIC_ARB_CHNL3_RDATA0_ADDR A:0xfc4cf998
y.create.l HWIO_PMIC_ARB_CHNL4_RDATA0_ADDR A:0xfc4cfa18
y.create.l HWIO_PMIC_ARB_CHNL5_RDATA0_ADDR A:0xfc4cfa98
y.create.l HWIO_PMIC_ARB_CHNL0_RDATA1_ADDR A:0xfc4cf81c
y.create.l HWIO_PMIC_ARB_CHNL1_RDATA1_ADDR A:0xfc4cf89c
y.create.l HWIO_PMIC_ARB_CHNL2_RDATA1_ADDR A:0xfc4cf91c
y.create.l HWIO_PMIC_ARB_CHNL3_RDATA1_ADDR A:0xfc4cf99c
y.create.l HWIO_PMIC_ARB_CHNL4_RDATA1_ADDR A:0xfc4cfa1c
y.create.l HWIO_PMIC_ARB_CHNL5_RDATA1_ADDR A:0xfc4cfa9c
y.create.l HWIO_PMIC_ARB_CHNL0_RDATA2_ADDR A:0xfc4cf820
y.create.l HWIO_PMIC_ARB_CHNL1_RDATA2_ADDR A:0xfc4cf8a0
y.create.l HWIO_PMIC_ARB_CHNL2_RDATA2_ADDR A:0xfc4cf920
y.create.l HWIO_PMIC_ARB_CHNL3_RDATA2_ADDR A:0xfc4cf9a0
y.create.l HWIO_PMIC_ARB_CHNL4_RDATA2_ADDR A:0xfc4cfa20
y.create.l HWIO_PMIC_ARB_CHNL5_RDATA2_ADDR A:0xfc4cfaa0
y.create.l HWIO_QDSS_CORESIGHT_CSR_ROM_WORD_ADDR A:0xfc300000
y.create.l HWIO_QDSS_STM_ROM_WORD_ADDR A:0xfc300004
y.create.l HWIO_QDSS_CTI0_ROM_WORD_ADDR A:0xfc300008
y.create.l HWIO_QDSS_CTI1_ROM_WORD_ADDR A:0xfc30000c
y.create.l HWIO_QDSS_CTI2_ROM_WORD_ADDR A:0xfc300010
y.create.l HWIO_QDSS_CTI3_ROM_WORD_ADDR A:0xfc300014
y.create.l HWIO_QDSS_CTI4_ROM_WORD_ADDR A:0xfc300018
y.create.l HWIO_QDSS_CTI5_ROM_WORD_ADDR A:0xfc30001c
y.create.l HWIO_QDSS_CTI6_ROM_WORD_ADDR A:0xfc300020
y.create.l HWIO_QDSS_CTI7_ROM_WORD_ADDR A:0xfc300024
y.create.l HWIO_QDSS_CTI8_ROM_WORD_ADDR A:0xfc300028
y.create.l HWIO_QDSS_TPIU_ROM_WORD_ADDR A:0xfc30002c
y.create.l HWIO_QDSS_TFUN0_ROM_WORD_ADDR A:0xfc300030
y.create.l HWIO_QDSS_TFUN1_ROM_WORD_ADDR A:0xfc300034
y.create.l HWIO_QDSS_TFUN2_ROM_WORD_ADDR A:0xfc300038
y.create.l HWIO_QDSS_TREPL_ROM_WORD_ADDR A:0xfc30003c
y.create.l HWIO_QDSS_ETBETF_ROM_WORD_ADDR A:0xfc300040
y.create.l HWIO_QDSS_ETR_ROM_WORD_ADDR A:0xfc300044
y.create.l HWIO_QDSS_PRONTO_ETM9_ROM_WORD_ADDR A:0xfc300048
y.create.l HWIO_QDSS_PRONTO_CTI_ROM_WORD_ADDR A:0xfc30004c
y.create.l HWIO_QDSS_MODEM_Q6_CTI_ROM_WORD_ADDR A:0xfc300050
y.create.l HWIO_QDSS_LPA_Q6_CTI_ROM_WORD_ADDR A:0xfc300054
y.create.l HWIO_QDSS_APPS0_DBG_ROM_WORD_ADDR A:0xfc300058
y.create.l HWIO_QDSS_APPS0_PM_ROM_WORD_ADDR A:0xfc30005c
y.create.l HWIO_QDSS_APPS1_DBG_ROM_WORD_ADDR A:0xfc300060
y.create.l HWIO_QDSS_APPS1_PM_ROM_WORD_ADDR A:0xfc300064
y.create.l HWIO_QDSS_APPS0_ETM_ROM_WORD_ADDR A:0xfc300068
y.create.l HWIO_QDSS_APPS1_ETM_ROM_WORD_ADDR A:0xfc30006c
y.create.l HWIO_QDSS_APPS0_CTI_ROM_WORD_ADDR A:0xfc300070
y.create.l HWIO_QDSS_APPS1_CTI_ROM_WORD_ADDR A:0xfc300074
y.create.l HWIO_QDSS_APPS_TFUN_ROM_WORD_ADDR A:0xfc300078
y.create.l HWIO_QDSS_RPM_CTI_ROM_WORD_ADDR A:0xfc30007c
y.create.l HWIO_QDSS_DAPROM_PERIPHERAL_ID4_ADDR A:0xfc300fd0
y.create.l HWIO_QDSS_DAPROM_PERIPHERAL_ID5_ADDR A:0xfc300fd4
y.create.l HWIO_QDSS_DAPROM_PERIPHERAL_ID6_ADDR A:0xfc300fd8
y.create.l HWIO_QDSS_DAPROM_PERIPHERAL_ID7_ADDR A:0xfc300fdc
y.create.l HWIO_QDSS_DAPROM_PERIPHERAL_ID0_ADDR A:0xfc300fe0
y.create.l HWIO_QDSS_DAPROM_PERIPHERAL_ID1_ADDR A:0xfc300fe4
y.create.l HWIO_QDSS_DAPROM_PERIPHERAL_ID2_ADDR A:0xfc300fe8
y.create.l HWIO_QDSS_DAPROM_PERIPHERAL_ID3_ADDR A:0xfc300fec
y.create.l HWIO_QDSS_DAPROM_COMPONENT_ID0_ADDR A:0xfc300ff0
y.create.l HWIO_QDSS_DAPROM_COMPONENT_ID1_ADDR A:0xfc300ff4
y.create.l HWIO_QDSS_DAPROM_COMPONENT_ID2_ADDR A:0xfc300ff8
y.create.l HWIO_QDSS_DAPROM_COMPONENT_ID3_ADDR A:0xfc300ffc
y.create.l HWIO_QDSS_CS_QDSSCSR_SWDBGPWRCTRL_ADDR A:0xfc301000
y.create.l HWIO_QDSS_CS_QDSSCSR_SWDBGPWRACK_ADDR A:0xfc301004
y.create.l HWIO_QDSS_CS_QDSSCSR_SWSPADREG0_ADDR A:0xfc301008
y.create.l HWIO_QDSS_CS_QDSSCSR_SWSPADREG1_ADDR A:0xfc30100c
y.create.l HWIO_QDSS_CS_QDSSCSR_STMTRANSCTRL_ADDR A:0xfc301010
y.create.l HWIO_QDSS_CS_QDSSCSR_STMAWIDCTRL_ADDR A:0xfc301014
y.create.l HWIO_QDSS_CS_QDSSCSR_STMCHNOFST0_ADDR A:0xfc301018
y.create.l HWIO_QDSS_CS_QDSSCSR_STMCHNOFST1_ADDR A:0xfc30101c
y.create.l HWIO_QDSS_CS_QDSSCSR_STMEXTHWCTRL0_ADDR A:0xfc301020
y.create.l HWIO_QDSS_CS_QDSSCSR_STMEXTHWCTRL1_ADDR A:0xfc301024
y.create.l HWIO_QDSS_CS_QDSSCSR_STMEXTHWCTRL2_ADDR A:0xfc301028
y.create.l HWIO_QDSS_CS_QDSSCSR_STMEXTHWCTRL3_ADDR A:0xfc30102c
y.create.l HWIO_QDSS_CS_QDSSCSR_USBBAMCTRL_ADDR A:0xfc301030
y.create.l HWIO_QDSS_CS_QDSSCSR_USBFLSHCTRL_ADDR A:0xfc301034
y.create.l HWIO_QDSS_CS_QDSSCSR_TIMESTAMPCTRL_ADDR A:0xfc301038
y.create.l HWIO_QDSS_CS_QDSSCSR_AOTIMEVAL0_ADDR A:0xfc30103c
y.create.l HWIO_QDSS_CS_QDSSCSR_AOTIMEVAL1_ADDR A:0xfc301040
y.create.l HWIO_QDSS_CS_QDSSCSR_QDSSTIMEVAL0_ADDR A:0xfc301044
y.create.l HWIO_QDSS_CS_QDSSCSR_QDSSTIMEVAL1_ADDR A:0xfc301048
y.create.l HWIO_QDSS_CS_QDSSCSR_QDSSTIMELOAD0_ADDR A:0xfc30104c
y.create.l HWIO_QDSS_CS_QDSSCSR_QDSSTIMELOAD1_ADDR A:0xfc301050
y.create.l HWIO_QDSS_CS_QDSSCSR_DAPMSAVAL_ADDR A:0xfc301054
y.create.l HWIO_QDSS_CS_QDSSCSR_QDSSCLKVOTE_ADDR A:0xfc301058
y.create.l HWIO_QDSS_CS_QDSSCSR_QDSSCLKIPI_ADDR A:0xfc30105c
y.create.l HWIO_QDSS_CS_QDSSCSR_QDSSPWRREQIGNORE_ADDR A:0xfc301060
y.create.l HWIO_QDSS_CS_QDSSCSR_QDSSSPARE_ADDR A:0xfc301064
y.create.l HWIO_QDSS_CS_QDSSCSR_IPCAT_ADDR A:0xfc301068
y.create.l HWIO_QDSS_CS_QDSSCSR_ETRIRQCTRL_ADDR A:0xfc30106c
y.create.l HWIO_QDSS_CS_QDSSCSR_ITCTL_ADDR A:0xfc301f00
y.create.l HWIO_QDSS_CS_QDSSCSR_CLAIMSET_ADDR A:0xfc301fa0
y.create.l HWIO_QDSS_CS_QDSSCSR_CLAIMCLR_ADDR A:0xfc301fa4
y.create.l HWIO_QDSS_CS_QDSSCSR_LOCKACCESS_ADDR A:0xfc301fb0
y.create.l HWIO_QDSS_CS_QDSSCSR_LOCKSTATUS_ADDR A:0xfc301fb4
y.create.l HWIO_QDSS_CS_QDSSCSR_AUTHSTATUS_ADDR A:0xfc301fb8
y.create.l HWIO_QDSS_CS_QDSSCSR_DEVICEID_ADDR A:0xfc301fc8
y.create.l HWIO_QDSS_CS_QDSSCSR_DEVICETYPE_ADDR A:0xfc301fcc
y.create.l HWIO_QDSS_CS_QDSSCSR_PERIPHID4_ADDR A:0xfc301fd0
y.create.l HWIO_QDSS_CS_QDSSCSR_PERIPHID5_ADDR A:0xfc301fd4
y.create.l HWIO_QDSS_CS_QDSSCSR_PERIPHID6_ADDR A:0xfc301fd8
y.create.l HWIO_QDSS_CS_QDSSCSR_PERIPHID7_ADDR A:0xfc301fdc
y.create.l HWIO_QDSS_CS_QDSSCSR_PERIPHID0_ADDR A:0xfc301fe0
y.create.l HWIO_QDSS_CS_QDSSCSR_PERIPHID1_ADDR A:0xfc301fe4
y.create.l HWIO_QDSS_CS_QDSSCSR_PERIPHID2_ADDR A:0xfc301fe8
y.create.l HWIO_QDSS_CS_QDSSCSR_PERIPHID3_ADDR A:0xfc301fec
y.create.l HWIO_QDSS_CS_QDSSCSR_COMPID0_ADDR A:0xfc301ff0
y.create.l HWIO_QDSS_CS_QDSSCSR_COMPID1_ADDR A:0xfc301ff4
y.create.l HWIO_QDSS_CS_QDSSCSR_COMPID2_ADDR A:0xfc301ff8
y.create.l HWIO_QDSS_CS_QDSSCSR_COMPID3_ADDR A:0xfc301ffc
y.create.l HWIO_QDSS_STMDMASTARTR_ADDR A:0xfc302c04
y.create.l HWIO_QDSS_STMDMASTOPR_ADDR A:0xfc302c08
y.create.l HWIO_QDSS_STMDMASTATR_ADDR A:0xfc302c0c
y.create.l HWIO_QDSS_STMDMACTLR_ADDR A:0xfc302c10
y.create.l HWIO_QDSS_STMDMAIDR_ADDR A:0xfc302cfc
y.create.l HWIO_QDSS_STMHEER_ADDR A:0xfc302d00
y.create.l HWIO_QDSS_STMHETER_ADDR A:0xfc302d20
y.create.l HWIO_QDSS_STMHEMCR_ADDR A:0xfc302d64
y.create.l HWIO_QDSS_STMHEMASTR_ADDR A:0xfc302df4
y.create.l HWIO_QDSS_STMHEFEAT1R_ADDR A:0xfc302df8
y.create.l HWIO_QDSS_STMHEIDR_ADDR A:0xfc302dfc
y.create.l HWIO_QDSS_STMSPER_ADDR A:0xfc302e00
y.create.l HWIO_QDSS_STMSPTER_ADDR A:0xfc302e20
y.create.l HWIO_QDSS_STMSPSCR_ADDR A:0xfc302e60
y.create.l HWIO_QDSS_STMSPMSCR_ADDR A:0xfc302e64
y.create.l HWIO_QDSS_STMSPOVERRIDER_ADDR A:0xfc302e68
y.create.l HWIO_QDSS_STMSPMOVERRIDER_ADDR A:0xfc302e6c
y.create.l HWIO_QDSS_STMSPTRIGCSR_ADDR A:0xfc302e70
y.create.l HWIO_QDSS_STMTCSR_ADDR A:0xfc302e80
y.create.l HWIO_QDSS_STMTSSTIMR_ADDR A:0xfc302e84
y.create.l HWIO_QDSS_STMTSFREQR_ADDR A:0xfc302e8c
y.create.l HWIO_QDSS_STMSYNCR_ADDR A:0xfc302e90
y.create.l HWIO_QDSS_STMAUXCR_ADDR A:0xfc302e94
y.create.l HWIO_QDSS_STMSPFEAT1R_ADDR A:0xfc302ea0
y.create.l HWIO_QDSS_STMSPFEAT2R_ADDR A:0xfc302ea4
y.create.l HWIO_QDSS_STMSPFEAT3R_ADDR A:0xfc302ea8
y.create.l HWIO_QDSS_STMITTRIGGER_ADDR A:0xfc302ee8
y.create.l HWIO_QDSS_STMITATBDATA0_ADDR A:0xfc302eec
y.create.l HWIO_QDSS_STMITATBCTR2_ADDR A:0xfc302ef0
y.create.l HWIO_QDSS_STMITATBID_ADDR A:0xfc302ef4
y.create.l HWIO_QDSS_STMITATBCTR0_ADDR A:0xfc302ef8
y.create.l HWIO_QDSS_STMITCTRL_ADDR A:0xfc302f00
y.create.l HWIO_QDSS_STMCLAIMSET_ADDR A:0xfc302fa0
y.create.l HWIO_QDSS_STMCLAIMCLR_ADDR A:0xfc302fa4
y.create.l HWIO_QDSS_STMLAR_ADDR A:0xfc302fb0
y.create.l HWIO_QDSS_STMLSR_ADDR A:0xfc302fb4
y.create.l HWIO_QDSS_STMAUTHSTATUS_ADDR A:0xfc302fb8
y.create.l HWIO_QDSS_STMDEVID_ADDR A:0xfc302fc8
y.create.l HWIO_QDSS_STMDEVTYPE_ADDR A:0xfc302fcc
y.create.l HWIO_QDSS_STMPIDR0_ADDR A:0xfc302fe0
y.create.l HWIO_QDSS_STMPIDR1_ADDR A:0xfc302fe4
y.create.l HWIO_QDSS_STMPIDR2_ADDR A:0xfc302fe8
y.create.l HWIO_QDSS_STMPIDR3_ADDR A:0xfc302fec
y.create.l HWIO_QDSS_STMPIDR4_ADDR A:0xfc302fd0
y.create.l HWIO_QDSS_STMPIDR5_ADDR A:0xfc302fd4
y.create.l HWIO_QDSS_STMPIDR6_ADDR A:0xfc302fd8
y.create.l HWIO_QDSS_STMPIDR7_ADDR A:0xfc302fdc
y.create.l HWIO_QDSS_STMCIDR0_ADDR A:0xfc302ff0
y.create.l HWIO_QDSS_STMCIDR1_ADDR A:0xfc302ff4
y.create.l HWIO_QDSS_STMCIDR2_ADDR A:0xfc302ff8
y.create.l HWIO_QDSS_STMCIDR3_ADDR A:0xfc302ffc
y.create.l HWIO_QDSS_CTI0_CTICONTROL_ADDR A:0xfc310000
y.create.l HWIO_QDSS_CTI0_CTIINTACK_ADDR A:0xfc310010
y.create.l HWIO_QDSS_CTI0_CTIAPPSET_ADDR A:0xfc310014
y.create.l HWIO_QDSS_CTI0_CTIAPPCLEAR_ADDR A:0xfc310018
y.create.l HWIO_QDSS_CTI0_CTIAPPPULSE_ADDR A:0xfc31001c
y.create.l HWIO_QDSS_CTI0_CTIINEN0_ADDR A:0xfc310020
y.create.l HWIO_QDSS_CTI0_CTIINEN1_ADDR A:0xfc310024
y.create.l HWIO_QDSS_CTI0_CTIINEN2_ADDR A:0xfc310028
y.create.l HWIO_QDSS_CTI0_CTIINEN3_ADDR A:0xfc31002c
y.create.l HWIO_QDSS_CTI0_CTIINEN4_ADDR A:0xfc310030
y.create.l HWIO_QDSS_CTI0_CTIINEN5_ADDR A:0xfc310034
y.create.l HWIO_QDSS_CTI0_CTIINEN6_ADDR A:0xfc310038
y.create.l HWIO_QDSS_CTI0_CTIINEN7_ADDR A:0xfc31003c
y.create.l HWIO_QDSS_CTI0_CTIOUTEN0_ADDR A:0xfc3100a0
y.create.l HWIO_QDSS_CTI0_CTIOUTEN1_ADDR A:0xfc3100a4
y.create.l HWIO_QDSS_CTI0_CTIOUTEN2_ADDR A:0xfc3100a8
y.create.l HWIO_QDSS_CTI0_CTIOUTEN3_ADDR A:0xfc3100ac
y.create.l HWIO_QDSS_CTI0_CTIOUTEN4_ADDR A:0xfc3100b0
y.create.l HWIO_QDSS_CTI0_CTIOUTEN5_ADDR A:0xfc3100b4
y.create.l HWIO_QDSS_CTI0_CTIOUTEN6_ADDR A:0xfc3100b8
y.create.l HWIO_QDSS_CTI0_CTIOUTEN7_ADDR A:0xfc3100bc
y.create.l HWIO_QDSS_CTI0_CTITRIGINSTATUS_ADDR A:0xfc310130
y.create.l HWIO_QDSS_CTI0_CTITRIGOUTSTATUS_ADDR A:0xfc310134
y.create.l HWIO_QDSS_CTI0_CTICHINSTATUS_ADDR A:0xfc310138
y.create.l HWIO_QDSS_CTI0_CTICHOUTSTATUS_ADDR A:0xfc31013c
y.create.l HWIO_QDSS_CTI0_CTIGATE_ADDR A:0xfc310140
y.create.l HWIO_QDSS_CTI0_ASICCTL_ADDR A:0xfc310144
y.create.l HWIO_QDSS_CTI0_ITCHINACK_ADDR A:0xfc310edc
y.create.l HWIO_QDSS_CTI0_ITTRIGINACK_ADDR A:0xfc310ee0
y.create.l HWIO_QDSS_CTI0_ITCHOUT_ADDR A:0xfc310ee4
y.create.l HWIO_QDSS_CTI0_ITTRIGOUT_ADDR A:0xfc310ee8
y.create.l HWIO_QDSS_CTI0_ITCHOUTACK_ADDR A:0xfc310eec
y.create.l HWIO_QDSS_CTI0_ITTRIGOUTACK_ADDR A:0xfc310ef0
y.create.l HWIO_QDSS_CTI0_ITCHIN_ADDR A:0xfc310ef4
y.create.l HWIO_QDSS_CTI0_ITTRIGIN_ADDR A:0xfc310ef8
y.create.l HWIO_QDSS_CTI0_ITCTRL_ADDR A:0xfc310f00
y.create.l HWIO_QDSS_CTI0_CLAIMSET_ADDR A:0xfc310fa0
y.create.l HWIO_QDSS_CTI0_CLAIMCLR_ADDR A:0xfc310fa4
y.create.l HWIO_QDSS_CTI0_LAR_ADDR A:0xfc310fb0
y.create.l HWIO_QDSS_CTI0_LSR_ADDR A:0xfc310fb4
y.create.l HWIO_QDSS_CTI0_AUTHSTATUS_ADDR A:0xfc310fb8
y.create.l HWIO_QDSS_CTI0_DEVID_ADDR A:0xfc310fc8
y.create.l HWIO_QDSS_CTI0_DEVTYPE_ADDR A:0xfc310fcc
y.create.l HWIO_QDSS_CTI0_PERIPHID0_ADDR A:0xfc310fe0
y.create.l HWIO_QDSS_CTI0_PERIPHID1_ADDR A:0xfc310fe4
y.create.l HWIO_QDSS_CTI0_PERIPHID2_ADDR A:0xfc310fe8
y.create.l HWIO_QDSS_CTI0_PERIPHID3_ADDR A:0xfc310fec
y.create.l HWIO_QDSS_CTI0_PERIPHID4_ADDR A:0xfc310fd0
y.create.l HWIO_QDSS_CTI0_PERIPHID5_ADDR A:0xfc310fd4
y.create.l HWIO_QDSS_CTI0_PERIPHID6_ADDR A:0xfc310fd8
y.create.l HWIO_QDSS_CTI0_PERIPHID7_ADDR A:0xfc310fdc
y.create.l HWIO_QDSS_CTI0_COMPID0_ADDR A:0xfc310ff0
y.create.l HWIO_QDSS_CTI0_COMPID1_ADDR A:0xfc310ff4
y.create.l HWIO_QDSS_CTI0_COMPID2_ADDR A:0xfc310ff8
y.create.l HWIO_QDSS_CTI0_COMPID3_ADDR A:0xfc310ffc
y.create.l HWIO_QDSS_CTI1_CTICONTROL_ADDR A:0xfc311000
y.create.l HWIO_QDSS_CTI1_CTIINTACK_ADDR A:0xfc311010
y.create.l HWIO_QDSS_CTI1_CTIAPPSET_ADDR A:0xfc311014
y.create.l HWIO_QDSS_CTI1_CTIAPPCLEAR_ADDR A:0xfc311018
y.create.l HWIO_QDSS_CTI1_CTIAPPPULSE_ADDR A:0xfc31101c
y.create.l HWIO_QDSS_CTI1_CTIINEN0_ADDR A:0xfc311020
y.create.l HWIO_QDSS_CTI1_CTIINEN1_ADDR A:0xfc311024
y.create.l HWIO_QDSS_CTI1_CTIINEN2_ADDR A:0xfc311028
y.create.l HWIO_QDSS_CTI1_CTIINEN3_ADDR A:0xfc31102c
y.create.l HWIO_QDSS_CTI1_CTIINEN4_ADDR A:0xfc311030
y.create.l HWIO_QDSS_CTI1_CTIINEN5_ADDR A:0xfc311034
y.create.l HWIO_QDSS_CTI1_CTIINEN6_ADDR A:0xfc311038
y.create.l HWIO_QDSS_CTI1_CTIINEN7_ADDR A:0xfc31103c
y.create.l HWIO_QDSS_CTI1_CTIOUTEN0_ADDR A:0xfc3110a0
y.create.l HWIO_QDSS_CTI1_CTIOUTEN1_ADDR A:0xfc3110a4
y.create.l HWIO_QDSS_CTI1_CTIOUTEN2_ADDR A:0xfc3110a8
y.create.l HWIO_QDSS_CTI1_CTIOUTEN3_ADDR A:0xfc3110ac
y.create.l HWIO_QDSS_CTI1_CTIOUTEN4_ADDR A:0xfc3110b0
y.create.l HWIO_QDSS_CTI1_CTIOUTEN5_ADDR A:0xfc3110b4
y.create.l HWIO_QDSS_CTI1_CTIOUTEN6_ADDR A:0xfc3110b8
y.create.l HWIO_QDSS_CTI1_CTIOUTEN7_ADDR A:0xfc3110bc
y.create.l HWIO_QDSS_CTI1_CTITRIGINSTATUS_ADDR A:0xfc311130
y.create.l HWIO_QDSS_CTI1_CTITRIGOUTSTATUS_ADDR A:0xfc311134
y.create.l HWIO_QDSS_CTI1_CTICHINSTATUS_ADDR A:0xfc311138
y.create.l HWIO_QDSS_CTI1_CTICHOUTSTATUS_ADDR A:0xfc31113c
y.create.l HWIO_QDSS_CTI1_CTIGATE_ADDR A:0xfc311140
y.create.l HWIO_QDSS_CTI1_ASICCTL_ADDR A:0xfc311144
y.create.l HWIO_QDSS_CTI1_ITCHINACK_ADDR A:0xfc311edc
y.create.l HWIO_QDSS_CTI1_ITTRIGINACK_ADDR A:0xfc311ee0
y.create.l HWIO_QDSS_CTI1_ITCHOUT_ADDR A:0xfc311ee4
y.create.l HWIO_QDSS_CTI1_ITTRIGOUT_ADDR A:0xfc311ee8
y.create.l HWIO_QDSS_CTI1_ITCHOUTACK_ADDR A:0xfc311eec
y.create.l HWIO_QDSS_CTI1_ITTRIGOUTACK_ADDR A:0xfc311ef0
y.create.l HWIO_QDSS_CTI1_ITCHIN_ADDR A:0xfc311ef4
y.create.l HWIO_QDSS_CTI1_ITTRIGIN_ADDR A:0xfc311ef8
y.create.l HWIO_QDSS_CTI1_ITCTRL_ADDR A:0xfc311f00
y.create.l HWIO_QDSS_CTI1_CLAIMSET_ADDR A:0xfc311fa0
y.create.l HWIO_QDSS_CTI1_CLAIMCLR_ADDR A:0xfc311fa4
y.create.l HWIO_QDSS_CTI1_LAR_ADDR A:0xfc311fb0
y.create.l HWIO_QDSS_CTI1_LSR_ADDR A:0xfc311fb4
y.create.l HWIO_QDSS_CTI1_AUTHSTATUS_ADDR A:0xfc311fb8
y.create.l HWIO_QDSS_CTI1_DEVID_ADDR A:0xfc311fc8
y.create.l HWIO_QDSS_CTI1_DEVTYPE_ADDR A:0xfc311fcc
y.create.l HWIO_QDSS_CTI1_PERIPHID0_ADDR A:0xfc311fe0
y.create.l HWIO_QDSS_CTI1_PERIPHID1_ADDR A:0xfc311fe4
y.create.l HWIO_QDSS_CTI1_PERIPHID2_ADDR A:0xfc311fe8
y.create.l HWIO_QDSS_CTI1_PERIPHID3_ADDR A:0xfc311fec
y.create.l HWIO_QDSS_CTI1_PERIPHID4_ADDR A:0xfc311fd0
y.create.l HWIO_QDSS_CTI1_PERIPHID5_ADDR A:0xfc311fd4
y.create.l HWIO_QDSS_CTI1_PERIPHID6_ADDR A:0xfc311fd8
y.create.l HWIO_QDSS_CTI1_PERIPHID7_ADDR A:0xfc311fdc
y.create.l HWIO_QDSS_CTI1_COMPID0_ADDR A:0xfc311ff0
y.create.l HWIO_QDSS_CTI1_COMPID1_ADDR A:0xfc311ff4
y.create.l HWIO_QDSS_CTI1_COMPID2_ADDR A:0xfc311ff8
y.create.l HWIO_QDSS_CTI1_COMPID3_ADDR A:0xfc311ffc
y.create.l HWIO_QDSS_CTI2_CTICONTROL_ADDR A:0xfc312000
y.create.l HWIO_QDSS_CTI2_CTIINTACK_ADDR A:0xfc312010
y.create.l HWIO_QDSS_CTI2_CTIAPPSET_ADDR A:0xfc312014
y.create.l HWIO_QDSS_CTI2_CTIAPPCLEAR_ADDR A:0xfc312018
y.create.l HWIO_QDSS_CTI2_CTIAPPPULSE_ADDR A:0xfc31201c
y.create.l HWIO_QDSS_CTI2_CTIINEN0_ADDR A:0xfc312020
y.create.l HWIO_QDSS_CTI2_CTIINEN1_ADDR A:0xfc312024
y.create.l HWIO_QDSS_CTI2_CTIINEN2_ADDR A:0xfc312028
y.create.l HWIO_QDSS_CTI2_CTIINEN3_ADDR A:0xfc31202c
y.create.l HWIO_QDSS_CTI2_CTIINEN4_ADDR A:0xfc312030
y.create.l HWIO_QDSS_CTI2_CTIINEN5_ADDR A:0xfc312034
y.create.l HWIO_QDSS_CTI2_CTIINEN6_ADDR A:0xfc312038
y.create.l HWIO_QDSS_CTI2_CTIINEN7_ADDR A:0xfc31203c
y.create.l HWIO_QDSS_CTI2_CTIOUTEN0_ADDR A:0xfc3120a0
y.create.l HWIO_QDSS_CTI2_CTIOUTEN1_ADDR A:0xfc3120a4
y.create.l HWIO_QDSS_CTI2_CTIOUTEN2_ADDR A:0xfc3120a8
y.create.l HWIO_QDSS_CTI2_CTIOUTEN3_ADDR A:0xfc3120ac
y.create.l HWIO_QDSS_CTI2_CTIOUTEN4_ADDR A:0xfc3120b0
y.create.l HWIO_QDSS_CTI2_CTIOUTEN5_ADDR A:0xfc3120b4
y.create.l HWIO_QDSS_CTI2_CTIOUTEN6_ADDR A:0xfc3120b8
y.create.l HWIO_QDSS_CTI2_CTIOUTEN7_ADDR A:0xfc3120bc
y.create.l HWIO_QDSS_CTI2_CTITRIGINSTATUS_ADDR A:0xfc312130
y.create.l HWIO_QDSS_CTI2_CTITRIGOUTSTATUS_ADDR A:0xfc312134
y.create.l HWIO_QDSS_CTI2_CTICHINSTATUS_ADDR A:0xfc312138
y.create.l HWIO_QDSS_CTI2_CTICHOUTSTATUS_ADDR A:0xfc31213c
y.create.l HWIO_QDSS_CTI2_CTIGATE_ADDR A:0xfc312140
y.create.l HWIO_QDSS_CTI2_ASICCTL_ADDR A:0xfc312144
y.create.l HWIO_QDSS_CTI2_ITCHINACK_ADDR A:0xfc312edc
y.create.l HWIO_QDSS_CTI2_ITTRIGINACK_ADDR A:0xfc312ee0
y.create.l HWIO_QDSS_CTI2_ITCHOUT_ADDR A:0xfc312ee4
y.create.l HWIO_QDSS_CTI2_ITTRIGOUT_ADDR A:0xfc312ee8
y.create.l HWIO_QDSS_CTI2_ITCHOUTACK_ADDR A:0xfc312eec
y.create.l HWIO_QDSS_CTI2_ITTRIGOUTACK_ADDR A:0xfc312ef0
y.create.l HWIO_QDSS_CTI2_ITCHIN_ADDR A:0xfc312ef4
y.create.l HWIO_QDSS_CTI2_ITTRIGIN_ADDR A:0xfc312ef8
y.create.l HWIO_QDSS_CTI2_ITCTRL_ADDR A:0xfc312f00
y.create.l HWIO_QDSS_CTI2_CLAIMSET_ADDR A:0xfc312fa0
y.create.l HWIO_QDSS_CTI2_CLAIMCLR_ADDR A:0xfc312fa4
y.create.l HWIO_QDSS_CTI2_LAR_ADDR A:0xfc312fb0
y.create.l HWIO_QDSS_CTI2_LSR_ADDR A:0xfc312fb4
y.create.l HWIO_QDSS_CTI2_AUTHSTATUS_ADDR A:0xfc312fb8
y.create.l HWIO_QDSS_CTI2_DEVID_ADDR A:0xfc312fc8
y.create.l HWIO_QDSS_CTI2_DEVTYPE_ADDR A:0xfc312fcc
y.create.l HWIO_QDSS_CTI2_PERIPHID0_ADDR A:0xfc312fe0
y.create.l HWIO_QDSS_CTI2_PERIPHID1_ADDR A:0xfc312fe4
y.create.l HWIO_QDSS_CTI2_PERIPHID2_ADDR A:0xfc312fe8
y.create.l HWIO_QDSS_CTI2_PERIPHID3_ADDR A:0xfc312fec
y.create.l HWIO_QDSS_CTI2_PERIPHID4_ADDR A:0xfc312fd0
y.create.l HWIO_QDSS_CTI2_PERIPHID5_ADDR A:0xfc312fd4
y.create.l HWIO_QDSS_CTI2_PERIPHID6_ADDR A:0xfc312fd8
y.create.l HWIO_QDSS_CTI2_PERIPHID7_ADDR A:0xfc312fdc
y.create.l HWIO_QDSS_CTI2_COMPID0_ADDR A:0xfc312ff0
y.create.l HWIO_QDSS_CTI2_COMPID1_ADDR A:0xfc312ff4
y.create.l HWIO_QDSS_CTI2_COMPID2_ADDR A:0xfc312ff8
y.create.l HWIO_QDSS_CTI2_COMPID3_ADDR A:0xfc312ffc
y.create.l HWIO_QDSS_CTI3_CTICONTROL_ADDR A:0xfc313000
y.create.l HWIO_QDSS_CTI3_CTIINTACK_ADDR A:0xfc313010
y.create.l HWIO_QDSS_CTI3_CTIAPPSET_ADDR A:0xfc313014
y.create.l HWIO_QDSS_CTI3_CTIAPPCLEAR_ADDR A:0xfc313018
y.create.l HWIO_QDSS_CTI3_CTIAPPPULSE_ADDR A:0xfc31301c
y.create.l HWIO_QDSS_CTI3_CTIINEN0_ADDR A:0xfc313020
y.create.l HWIO_QDSS_CTI3_CTIINEN1_ADDR A:0xfc313024
y.create.l HWIO_QDSS_CTI3_CTIINEN2_ADDR A:0xfc313028
y.create.l HWIO_QDSS_CTI3_CTIINEN3_ADDR A:0xfc31302c
y.create.l HWIO_QDSS_CTI3_CTIINEN4_ADDR A:0xfc313030
y.create.l HWIO_QDSS_CTI3_CTIINEN5_ADDR A:0xfc313034
y.create.l HWIO_QDSS_CTI3_CTIINEN6_ADDR A:0xfc313038
y.create.l HWIO_QDSS_CTI3_CTIINEN7_ADDR A:0xfc31303c
y.create.l HWIO_QDSS_CTI3_CTIOUTEN0_ADDR A:0xfc3130a0
y.create.l HWIO_QDSS_CTI3_CTIOUTEN1_ADDR A:0xfc3130a4
y.create.l HWIO_QDSS_CTI3_CTIOUTEN2_ADDR A:0xfc3130a8
y.create.l HWIO_QDSS_CTI3_CTIOUTEN3_ADDR A:0xfc3130ac
y.create.l HWIO_QDSS_CTI3_CTIOUTEN4_ADDR A:0xfc3130b0
y.create.l HWIO_QDSS_CTI3_CTIOUTEN5_ADDR A:0xfc3130b4
y.create.l HWIO_QDSS_CTI3_CTIOUTEN6_ADDR A:0xfc3130b8
y.create.l HWIO_QDSS_CTI3_CTIOUTEN7_ADDR A:0xfc3130bc
y.create.l HWIO_QDSS_CTI3_CTITRIGINSTATUS_ADDR A:0xfc313130
y.create.l HWIO_QDSS_CTI3_CTITRIGOUTSTATUS_ADDR A:0xfc313134
y.create.l HWIO_QDSS_CTI3_CTICHINSTATUS_ADDR A:0xfc313138
y.create.l HWIO_QDSS_CTI3_CTICHOUTSTATUS_ADDR A:0xfc31313c
y.create.l HWIO_QDSS_CTI3_CTIGATE_ADDR A:0xfc313140
y.create.l HWIO_QDSS_CTI3_ASICCTL_ADDR A:0xfc313144
y.create.l HWIO_QDSS_CTI3_ITCHINACK_ADDR A:0xfc313edc
y.create.l HWIO_QDSS_CTI3_ITTRIGINACK_ADDR A:0xfc313ee0
y.create.l HWIO_QDSS_CTI3_ITCHOUT_ADDR A:0xfc313ee4
y.create.l HWIO_QDSS_CTI3_ITTRIGOUT_ADDR A:0xfc313ee8
y.create.l HWIO_QDSS_CTI3_ITCHOUTACK_ADDR A:0xfc313eec
y.create.l HWIO_QDSS_CTI3_ITTRIGOUTACK_ADDR A:0xfc313ef0
y.create.l HWIO_QDSS_CTI3_ITCHIN_ADDR A:0xfc313ef4
y.create.l HWIO_QDSS_CTI3_ITTRIGIN_ADDR A:0xfc313ef8
y.create.l HWIO_QDSS_CTI3_ITCTRL_ADDR A:0xfc313f00
y.create.l HWIO_QDSS_CTI3_CLAIMSET_ADDR A:0xfc313fa0
y.create.l HWIO_QDSS_CTI3_CLAIMCLR_ADDR A:0xfc313fa4
y.create.l HWIO_QDSS_CTI3_LAR_ADDR A:0xfc313fb0
y.create.l HWIO_QDSS_CTI3_LSR_ADDR A:0xfc313fb4
y.create.l HWIO_QDSS_CTI3_AUTHSTATUS_ADDR A:0xfc313fb8
y.create.l HWIO_QDSS_CTI3_DEVID_ADDR A:0xfc313fc8
y.create.l HWIO_QDSS_CTI3_DEVTYPE_ADDR A:0xfc313fcc
y.create.l HWIO_QDSS_CTI3_PERIPHID0_ADDR A:0xfc313fe0
y.create.l HWIO_QDSS_CTI3_PERIPHID1_ADDR A:0xfc313fe4
y.create.l HWIO_QDSS_CTI3_PERIPHID2_ADDR A:0xfc313fe8
y.create.l HWIO_QDSS_CTI3_PERIPHID3_ADDR A:0xfc313fec
y.create.l HWIO_QDSS_CTI3_PERIPHID4_ADDR A:0xfc313fd0
y.create.l HWIO_QDSS_CTI3_PERIPHID5_ADDR A:0xfc313fd4
y.create.l HWIO_QDSS_CTI3_PERIPHID6_ADDR A:0xfc313fd8
y.create.l HWIO_QDSS_CTI3_PERIPHID7_ADDR A:0xfc313fdc
y.create.l HWIO_QDSS_CTI3_COMPID0_ADDR A:0xfc313ff0
y.create.l HWIO_QDSS_CTI3_COMPID1_ADDR A:0xfc313ff4
y.create.l HWIO_QDSS_CTI3_COMPID2_ADDR A:0xfc313ff8
y.create.l HWIO_QDSS_CTI3_COMPID3_ADDR A:0xfc313ffc
y.create.l HWIO_QDSS_CTI4_CTICONTROL_ADDR A:0xfc314000
y.create.l HWIO_QDSS_CTI4_CTIINTACK_ADDR A:0xfc314010
y.create.l HWIO_QDSS_CTI4_CTIAPPSET_ADDR A:0xfc314014
y.create.l HWIO_QDSS_CTI4_CTIAPPCLEAR_ADDR A:0xfc314018
y.create.l HWIO_QDSS_CTI4_CTIAPPPULSE_ADDR A:0xfc31401c
y.create.l HWIO_QDSS_CTI4_CTIINEN0_ADDR A:0xfc314020
y.create.l HWIO_QDSS_CTI4_CTIINEN1_ADDR A:0xfc314024
y.create.l HWIO_QDSS_CTI4_CTIINEN2_ADDR A:0xfc314028
y.create.l HWIO_QDSS_CTI4_CTIINEN3_ADDR A:0xfc31402c
y.create.l HWIO_QDSS_CTI4_CTIINEN4_ADDR A:0xfc314030
y.create.l HWIO_QDSS_CTI4_CTIINEN5_ADDR A:0xfc314034
y.create.l HWIO_QDSS_CTI4_CTIINEN6_ADDR A:0xfc314038
y.create.l HWIO_QDSS_CTI4_CTIINEN7_ADDR A:0xfc31403c
y.create.l HWIO_QDSS_CTI4_CTIOUTEN0_ADDR A:0xfc3140a0
y.create.l HWIO_QDSS_CTI4_CTIOUTEN1_ADDR A:0xfc3140a4
y.create.l HWIO_QDSS_CTI4_CTIOUTEN2_ADDR A:0xfc3140a8
y.create.l HWIO_QDSS_CTI4_CTIOUTEN3_ADDR A:0xfc3140ac
y.create.l HWIO_QDSS_CTI4_CTIOUTEN4_ADDR A:0xfc3140b0
y.create.l HWIO_QDSS_CTI4_CTIOUTEN5_ADDR A:0xfc3140b4
y.create.l HWIO_QDSS_CTI4_CTIOUTEN6_ADDR A:0xfc3140b8
y.create.l HWIO_QDSS_CTI4_CTIOUTEN7_ADDR A:0xfc3140bc
y.create.l HWIO_QDSS_CTI4_CTITRIGINSTATUS_ADDR A:0xfc314130
y.create.l HWIO_QDSS_CTI4_CTITRIGOUTSTATUS_ADDR A:0xfc314134
y.create.l HWIO_QDSS_CTI4_CTICHINSTATUS_ADDR A:0xfc314138
y.create.l HWIO_QDSS_CTI4_CTICHOUTSTATUS_ADDR A:0xfc31413c
y.create.l HWIO_QDSS_CTI4_CTIGATE_ADDR A:0xfc314140
y.create.l HWIO_QDSS_CTI4_ASICCTL_ADDR A:0xfc314144
y.create.l HWIO_QDSS_CTI4_ITCHINACK_ADDR A:0xfc314edc
y.create.l HWIO_QDSS_CTI4_ITTRIGINACK_ADDR A:0xfc314ee0
y.create.l HWIO_QDSS_CTI4_ITCHOUT_ADDR A:0xfc314ee4
y.create.l HWIO_QDSS_CTI4_ITTRIGOUT_ADDR A:0xfc314ee8
y.create.l HWIO_QDSS_CTI4_ITCHOUTACK_ADDR A:0xfc314eec
y.create.l HWIO_QDSS_CTI4_ITTRIGOUTACK_ADDR A:0xfc314ef0
y.create.l HWIO_QDSS_CTI4_ITCHIN_ADDR A:0xfc314ef4
y.create.l HWIO_QDSS_CTI4_ITTRIGIN_ADDR A:0xfc314ef8
y.create.l HWIO_QDSS_CTI4_ITCTRL_ADDR A:0xfc314f00
y.create.l HWIO_QDSS_CTI4_CLAIMSET_ADDR A:0xfc314fa0
y.create.l HWIO_QDSS_CTI4_CLAIMCLR_ADDR A:0xfc314fa4
y.create.l HWIO_QDSS_CTI4_LAR_ADDR A:0xfc314fb0
y.create.l HWIO_QDSS_CTI4_LSR_ADDR A:0xfc314fb4
y.create.l HWIO_QDSS_CTI4_AUTHSTATUS_ADDR A:0xfc314fb8
y.create.l HWIO_QDSS_CTI4_DEVID_ADDR A:0xfc314fc8
y.create.l HWIO_QDSS_CTI4_DEVTYPE_ADDR A:0xfc314fcc
y.create.l HWIO_QDSS_CTI4_PERIPHID0_ADDR A:0xfc314fe0
y.create.l HWIO_QDSS_CTI4_PERIPHID1_ADDR A:0xfc314fe4
y.create.l HWIO_QDSS_CTI4_PERIPHID2_ADDR A:0xfc314fe8
y.create.l HWIO_QDSS_CTI4_PERIPHID3_ADDR A:0xfc314fec
y.create.l HWIO_QDSS_CTI4_PERIPHID4_ADDR A:0xfc314fd0
y.create.l HWIO_QDSS_CTI4_PERIPHID5_ADDR A:0xfc314fd4
y.create.l HWIO_QDSS_CTI4_PERIPHID6_ADDR A:0xfc314fd8
y.create.l HWIO_QDSS_CTI4_PERIPHID7_ADDR A:0xfc314fdc
y.create.l HWIO_QDSS_CTI4_COMPID0_ADDR A:0xfc314ff0
y.create.l HWIO_QDSS_CTI4_COMPID1_ADDR A:0xfc314ff4
y.create.l HWIO_QDSS_CTI4_COMPID2_ADDR A:0xfc314ff8
y.create.l HWIO_QDSS_CTI4_COMPID3_ADDR A:0xfc314ffc
y.create.l HWIO_QDSS_CTI5_CTICONTROL_ADDR A:0xfc315000
y.create.l HWIO_QDSS_CTI5_CTIINTACK_ADDR A:0xfc315010
y.create.l HWIO_QDSS_CTI5_CTIAPPSET_ADDR A:0xfc315014
y.create.l HWIO_QDSS_CTI5_CTIAPPCLEAR_ADDR A:0xfc315018
y.create.l HWIO_QDSS_CTI5_CTIAPPPULSE_ADDR A:0xfc31501c
y.create.l HWIO_QDSS_CTI5_CTIINEN0_ADDR A:0xfc315020
y.create.l HWIO_QDSS_CTI5_CTIINEN1_ADDR A:0xfc315024
y.create.l HWIO_QDSS_CTI5_CTIINEN2_ADDR A:0xfc315028
y.create.l HWIO_QDSS_CTI5_CTIINEN3_ADDR A:0xfc31502c
y.create.l HWIO_QDSS_CTI5_CTIINEN4_ADDR A:0xfc315030
y.create.l HWIO_QDSS_CTI5_CTIINEN5_ADDR A:0xfc315034
y.create.l HWIO_QDSS_CTI5_CTIINEN6_ADDR A:0xfc315038
y.create.l HWIO_QDSS_CTI5_CTIINEN7_ADDR A:0xfc31503c
y.create.l HWIO_QDSS_CTI5_CTIOUTEN0_ADDR A:0xfc3150a0
y.create.l HWIO_QDSS_CTI5_CTIOUTEN1_ADDR A:0xfc3150a4
y.create.l HWIO_QDSS_CTI5_CTIOUTEN2_ADDR A:0xfc3150a8
y.create.l HWIO_QDSS_CTI5_CTIOUTEN3_ADDR A:0xfc3150ac
y.create.l HWIO_QDSS_CTI5_CTIOUTEN4_ADDR A:0xfc3150b0
y.create.l HWIO_QDSS_CTI5_CTIOUTEN5_ADDR A:0xfc3150b4
y.create.l HWIO_QDSS_CTI5_CTIOUTEN6_ADDR A:0xfc3150b8
y.create.l HWIO_QDSS_CTI5_CTIOUTEN7_ADDR A:0xfc3150bc
y.create.l HWIO_QDSS_CTI5_CTITRIGINSTATUS_ADDR A:0xfc315130
y.create.l HWIO_QDSS_CTI5_CTITRIGOUTSTATUS_ADDR A:0xfc315134
y.create.l HWIO_QDSS_CTI5_CTICHINSTATUS_ADDR A:0xfc315138
y.create.l HWIO_QDSS_CTI5_CTICHOUTSTATUS_ADDR A:0xfc31513c
y.create.l HWIO_QDSS_CTI5_CTIGATE_ADDR A:0xfc315140
y.create.l HWIO_QDSS_CTI5_ASICCTL_ADDR A:0xfc315144
y.create.l HWIO_QDSS_CTI5_ITCHINACK_ADDR A:0xfc315edc
y.create.l HWIO_QDSS_CTI5_ITTRIGINACK_ADDR A:0xfc315ee0
y.create.l HWIO_QDSS_CTI5_ITCHOUT_ADDR A:0xfc315ee4
y.create.l HWIO_QDSS_CTI5_ITTRIGOUT_ADDR A:0xfc315ee8
y.create.l HWIO_QDSS_CTI5_ITCHOUTACK_ADDR A:0xfc315eec
y.create.l HWIO_QDSS_CTI5_ITTRIGOUTACK_ADDR A:0xfc315ef0
y.create.l HWIO_QDSS_CTI5_ITCHIN_ADDR A:0xfc315ef4
y.create.l HWIO_QDSS_CTI5_ITTRIGIN_ADDR A:0xfc315ef8
y.create.l HWIO_QDSS_CTI5_ITCTRL_ADDR A:0xfc315f00
y.create.l HWIO_QDSS_CTI5_CLAIMSET_ADDR A:0xfc315fa0
y.create.l HWIO_QDSS_CTI5_CLAIMCLR_ADDR A:0xfc315fa4
y.create.l HWIO_QDSS_CTI5_LAR_ADDR A:0xfc315fb0
y.create.l HWIO_QDSS_CTI5_LSR_ADDR A:0xfc315fb4
y.create.l HWIO_QDSS_CTI5_AUTHSTATUS_ADDR A:0xfc315fb8
y.create.l HWIO_QDSS_CTI5_DEVID_ADDR A:0xfc315fc8
y.create.l HWIO_QDSS_CTI5_DEVTYPE_ADDR A:0xfc315fcc
y.create.l HWIO_QDSS_CTI5_PERIPHID0_ADDR A:0xfc315fe0
y.create.l HWIO_QDSS_CTI5_PERIPHID1_ADDR A:0xfc315fe4
y.create.l HWIO_QDSS_CTI5_PERIPHID2_ADDR A:0xfc315fe8
y.create.l HWIO_QDSS_CTI5_PERIPHID3_ADDR A:0xfc315fec
y.create.l HWIO_QDSS_CTI5_PERIPHID4_ADDR A:0xfc315fd0
y.create.l HWIO_QDSS_CTI5_PERIPHID5_ADDR A:0xfc315fd4
y.create.l HWIO_QDSS_CTI5_PERIPHID6_ADDR A:0xfc315fd8
y.create.l HWIO_QDSS_CTI5_PERIPHID7_ADDR A:0xfc315fdc
y.create.l HWIO_QDSS_CTI5_COMPID0_ADDR A:0xfc315ff0
y.create.l HWIO_QDSS_CTI5_COMPID1_ADDR A:0xfc315ff4
y.create.l HWIO_QDSS_CTI5_COMPID2_ADDR A:0xfc315ff8
y.create.l HWIO_QDSS_CTI5_COMPID3_ADDR A:0xfc315ffc
y.create.l HWIO_QDSS_CTI6_CTICONTROL_ADDR A:0xfc316000
y.create.l HWIO_QDSS_CTI6_CTIINTACK_ADDR A:0xfc316010
y.create.l HWIO_QDSS_CTI6_CTIAPPSET_ADDR A:0xfc316014
y.create.l HWIO_QDSS_CTI6_CTIAPPCLEAR_ADDR A:0xfc316018
y.create.l HWIO_QDSS_CTI6_CTIAPPPULSE_ADDR A:0xfc31601c
y.create.l HWIO_QDSS_CTI6_CTIINEN0_ADDR A:0xfc316020
y.create.l HWIO_QDSS_CTI6_CTIINEN1_ADDR A:0xfc316024
y.create.l HWIO_QDSS_CTI6_CTIINEN2_ADDR A:0xfc316028
y.create.l HWIO_QDSS_CTI6_CTIINEN3_ADDR A:0xfc31602c
y.create.l HWIO_QDSS_CTI6_CTIINEN4_ADDR A:0xfc316030
y.create.l HWIO_QDSS_CTI6_CTIINEN5_ADDR A:0xfc316034
y.create.l HWIO_QDSS_CTI6_CTIINEN6_ADDR A:0xfc316038
y.create.l HWIO_QDSS_CTI6_CTIINEN7_ADDR A:0xfc31603c
y.create.l HWIO_QDSS_CTI6_CTIOUTEN0_ADDR A:0xfc3160a0
y.create.l HWIO_QDSS_CTI6_CTIOUTEN1_ADDR A:0xfc3160a4
y.create.l HWIO_QDSS_CTI6_CTIOUTEN2_ADDR A:0xfc3160a8
y.create.l HWIO_QDSS_CTI6_CTIOUTEN3_ADDR A:0xfc3160ac
y.create.l HWIO_QDSS_CTI6_CTIOUTEN4_ADDR A:0xfc3160b0
y.create.l HWIO_QDSS_CTI6_CTIOUTEN5_ADDR A:0xfc3160b4
y.create.l HWIO_QDSS_CTI6_CTIOUTEN6_ADDR A:0xfc3160b8
y.create.l HWIO_QDSS_CTI6_CTIOUTEN7_ADDR A:0xfc3160bc
y.create.l HWIO_QDSS_CTI6_CTITRIGINSTATUS_ADDR A:0xfc316130
y.create.l HWIO_QDSS_CTI6_CTITRIGOUTSTATUS_ADDR A:0xfc316134
y.create.l HWIO_QDSS_CTI6_CTICHINSTATUS_ADDR A:0xfc316138
y.create.l HWIO_QDSS_CTI6_CTICHOUTSTATUS_ADDR A:0xfc31613c
y.create.l HWIO_QDSS_CTI6_CTIGATE_ADDR A:0xfc316140
y.create.l HWIO_QDSS_CTI6_ASICCTL_ADDR A:0xfc316144
y.create.l HWIO_QDSS_CTI6_ITCHINACK_ADDR A:0xfc316edc
y.create.l HWIO_QDSS_CTI6_ITTRIGINACK_ADDR A:0xfc316ee0
y.create.l HWIO_QDSS_CTI6_ITCHOUT_ADDR A:0xfc316ee4
y.create.l HWIO_QDSS_CTI6_ITTRIGOUT_ADDR A:0xfc316ee8
y.create.l HWIO_QDSS_CTI6_ITCHOUTACK_ADDR A:0xfc316eec
y.create.l HWIO_QDSS_CTI6_ITTRIGOUTACK_ADDR A:0xfc316ef0
y.create.l HWIO_QDSS_CTI6_ITCHIN_ADDR A:0xfc316ef4
y.create.l HWIO_QDSS_CTI6_ITTRIGIN_ADDR A:0xfc316ef8
y.create.l HWIO_QDSS_CTI6_ITCTRL_ADDR A:0xfc316f00
y.create.l HWIO_QDSS_CTI6_CLAIMSET_ADDR A:0xfc316fa0
y.create.l HWIO_QDSS_CTI6_CLAIMCLR_ADDR A:0xfc316fa4
y.create.l HWIO_QDSS_CTI6_LAR_ADDR A:0xfc316fb0
y.create.l HWIO_QDSS_CTI6_LSR_ADDR A:0xfc316fb4
y.create.l HWIO_QDSS_CTI6_AUTHSTATUS_ADDR A:0xfc316fb8
y.create.l HWIO_QDSS_CTI6_DEVID_ADDR A:0xfc316fc8
y.create.l HWIO_QDSS_CTI6_DEVTYPE_ADDR A:0xfc316fcc
y.create.l HWIO_QDSS_CTI6_PERIPHID0_ADDR A:0xfc316fe0
y.create.l HWIO_QDSS_CTI6_PERIPHID1_ADDR A:0xfc316fe4
y.create.l HWIO_QDSS_CTI6_PERIPHID2_ADDR A:0xfc316fe8
y.create.l HWIO_QDSS_CTI6_PERIPHID3_ADDR A:0xfc316fec
y.create.l HWIO_QDSS_CTI6_PERIPHID4_ADDR A:0xfc316fd0
y.create.l HWIO_QDSS_CTI6_PERIPHID5_ADDR A:0xfc316fd4
y.create.l HWIO_QDSS_CTI6_PERIPHID6_ADDR A:0xfc316fd8
y.create.l HWIO_QDSS_CTI6_PERIPHID7_ADDR A:0xfc316fdc
y.create.l HWIO_QDSS_CTI6_COMPID0_ADDR A:0xfc316ff0
y.create.l HWIO_QDSS_CTI6_COMPID1_ADDR A:0xfc316ff4
y.create.l HWIO_QDSS_CTI6_COMPID2_ADDR A:0xfc316ff8
y.create.l HWIO_QDSS_CTI6_COMPID3_ADDR A:0xfc316ffc
y.create.l HWIO_QDSS_CTI7_CTICONTROL_ADDR A:0xfc317000
y.create.l HWIO_QDSS_CTI7_CTIINTACK_ADDR A:0xfc317010
y.create.l HWIO_QDSS_CTI7_CTIAPPSET_ADDR A:0xfc317014
y.create.l HWIO_QDSS_CTI7_CTIAPPCLEAR_ADDR A:0xfc317018
y.create.l HWIO_QDSS_CTI7_CTIAPPPULSE_ADDR A:0xfc31701c
y.create.l HWIO_QDSS_CTI7_CTIINEN0_ADDR A:0xfc317020
y.create.l HWIO_QDSS_CTI7_CTIINEN1_ADDR A:0xfc317024
y.create.l HWIO_QDSS_CTI7_CTIINEN2_ADDR A:0xfc317028
y.create.l HWIO_QDSS_CTI7_CTIINEN3_ADDR A:0xfc31702c
y.create.l HWIO_QDSS_CTI7_CTIINEN4_ADDR A:0xfc317030
y.create.l HWIO_QDSS_CTI7_CTIINEN5_ADDR A:0xfc317034
y.create.l HWIO_QDSS_CTI7_CTIINEN6_ADDR A:0xfc317038
y.create.l HWIO_QDSS_CTI7_CTIINEN7_ADDR A:0xfc31703c
y.create.l HWIO_QDSS_CTI7_CTIOUTEN0_ADDR A:0xfc3170a0
y.create.l HWIO_QDSS_CTI7_CTIOUTEN1_ADDR A:0xfc3170a4
y.create.l HWIO_QDSS_CTI7_CTIOUTEN2_ADDR A:0xfc3170a8
y.create.l HWIO_QDSS_CTI7_CTIOUTEN3_ADDR A:0xfc3170ac
y.create.l HWIO_QDSS_CTI7_CTIOUTEN4_ADDR A:0xfc3170b0
y.create.l HWIO_QDSS_CTI7_CTIOUTEN5_ADDR A:0xfc3170b4
y.create.l HWIO_QDSS_CTI7_CTIOUTEN6_ADDR A:0xfc3170b8
y.create.l HWIO_QDSS_CTI7_CTIOUTEN7_ADDR A:0xfc3170bc
y.create.l HWIO_QDSS_CTI7_CTITRIGINSTATUS_ADDR A:0xfc317130
y.create.l HWIO_QDSS_CTI7_CTITRIGOUTSTATUS_ADDR A:0xfc317134
y.create.l HWIO_QDSS_CTI7_CTICHINSTATUS_ADDR A:0xfc317138
y.create.l HWIO_QDSS_CTI7_CTICHOUTSTATUS_ADDR A:0xfc31713c
y.create.l HWIO_QDSS_CTI7_CTIGATE_ADDR A:0xfc317140
y.create.l HWIO_QDSS_CTI7_ASICCTL_ADDR A:0xfc317144
y.create.l HWIO_QDSS_CTI7_ITCHINACK_ADDR A:0xfc317edc
y.create.l HWIO_QDSS_CTI7_ITTRIGINACK_ADDR A:0xfc317ee0
y.create.l HWIO_QDSS_CTI7_ITCHOUT_ADDR A:0xfc317ee4
y.create.l HWIO_QDSS_CTI7_ITTRIGOUT_ADDR A:0xfc317ee8
y.create.l HWIO_QDSS_CTI7_ITCHOUTACK_ADDR A:0xfc317eec
y.create.l HWIO_QDSS_CTI7_ITTRIGOUTACK_ADDR A:0xfc317ef0
y.create.l HWIO_QDSS_CTI7_ITCHIN_ADDR A:0xfc317ef4
y.create.l HWIO_QDSS_CTI7_ITTRIGIN_ADDR A:0xfc317ef8
y.create.l HWIO_QDSS_CTI7_ITCTRL_ADDR A:0xfc317f00
y.create.l HWIO_QDSS_CTI7_CLAIMSET_ADDR A:0xfc317fa0
y.create.l HWIO_QDSS_CTI7_CLAIMCLR_ADDR A:0xfc317fa4
y.create.l HWIO_QDSS_CTI7_LAR_ADDR A:0xfc317fb0
y.create.l HWIO_QDSS_CTI7_LSR_ADDR A:0xfc317fb4
y.create.l HWIO_QDSS_CTI7_AUTHSTATUS_ADDR A:0xfc317fb8
y.create.l HWIO_QDSS_CTI7_DEVID_ADDR A:0xfc317fc8
y.create.l HWIO_QDSS_CTI7_DEVTYPE_ADDR A:0xfc317fcc
y.create.l HWIO_QDSS_CTI7_PERIPHID0_ADDR A:0xfc317fe0
y.create.l HWIO_QDSS_CTI7_PERIPHID1_ADDR A:0xfc317fe4
y.create.l HWIO_QDSS_CTI7_PERIPHID2_ADDR A:0xfc317fe8
y.create.l HWIO_QDSS_CTI7_PERIPHID3_ADDR A:0xfc317fec
y.create.l HWIO_QDSS_CTI7_PERIPHID4_ADDR A:0xfc317fd0
y.create.l HWIO_QDSS_CTI7_PERIPHID5_ADDR A:0xfc317fd4
y.create.l HWIO_QDSS_CTI7_PERIPHID6_ADDR A:0xfc317fd8
y.create.l HWIO_QDSS_CTI7_PERIPHID7_ADDR A:0xfc317fdc
y.create.l HWIO_QDSS_CTI7_COMPID0_ADDR A:0xfc317ff0
y.create.l HWIO_QDSS_CTI7_COMPID1_ADDR A:0xfc317ff4
y.create.l HWIO_QDSS_CTI7_COMPID2_ADDR A:0xfc317ff8
y.create.l HWIO_QDSS_CTI7_COMPID3_ADDR A:0xfc317ffc
y.create.l HWIO_QDSS_CTI8_CTICONTROL_ADDR A:0xfc318000
y.create.l HWIO_QDSS_CTI8_CTIINTACK_ADDR A:0xfc318010
y.create.l HWIO_QDSS_CTI8_CTIAPPSET_ADDR A:0xfc318014
y.create.l HWIO_QDSS_CTI8_CTIAPPCLEAR_ADDR A:0xfc318018
y.create.l HWIO_QDSS_CTI8_CTIAPPPULSE_ADDR A:0xfc31801c
y.create.l HWIO_QDSS_CTI8_CTIINEN0_ADDR A:0xfc318020
y.create.l HWIO_QDSS_CTI8_CTIINEN1_ADDR A:0xfc318024
y.create.l HWIO_QDSS_CTI8_CTIINEN2_ADDR A:0xfc318028
y.create.l HWIO_QDSS_CTI8_CTIINEN3_ADDR A:0xfc31802c
y.create.l HWIO_QDSS_CTI8_CTIINEN4_ADDR A:0xfc318030
y.create.l HWIO_QDSS_CTI8_CTIINEN5_ADDR A:0xfc318034
y.create.l HWIO_QDSS_CTI8_CTIINEN6_ADDR A:0xfc318038
y.create.l HWIO_QDSS_CTI8_CTIINEN7_ADDR A:0xfc31803c
y.create.l HWIO_QDSS_CTI8_CTIOUTEN0_ADDR A:0xfc3180a0
y.create.l HWIO_QDSS_CTI8_CTIOUTEN1_ADDR A:0xfc3180a4
y.create.l HWIO_QDSS_CTI8_CTIOUTEN2_ADDR A:0xfc3180a8
y.create.l HWIO_QDSS_CTI8_CTIOUTEN3_ADDR A:0xfc3180ac
y.create.l HWIO_QDSS_CTI8_CTIOUTEN4_ADDR A:0xfc3180b0
y.create.l HWIO_QDSS_CTI8_CTIOUTEN5_ADDR A:0xfc3180b4
y.create.l HWIO_QDSS_CTI8_CTIOUTEN6_ADDR A:0xfc3180b8
y.create.l HWIO_QDSS_CTI8_CTIOUTEN7_ADDR A:0xfc3180bc
y.create.l HWIO_QDSS_CTI8_CTITRIGINSTATUS_ADDR A:0xfc318130
y.create.l HWIO_QDSS_CTI8_CTITRIGOUTSTATUS_ADDR A:0xfc318134
y.create.l HWIO_QDSS_CTI8_CTICHINSTATUS_ADDR A:0xfc318138
y.create.l HWIO_QDSS_CTI8_CTICHOUTSTATUS_ADDR A:0xfc31813c
y.create.l HWIO_QDSS_CTI8_CTIGATE_ADDR A:0xfc318140
y.create.l HWIO_QDSS_CTI8_ASICCTL_ADDR A:0xfc318144
y.create.l HWIO_QDSS_CTI8_ITCHINACK_ADDR A:0xfc318edc
y.create.l HWIO_QDSS_CTI8_ITTRIGINACK_ADDR A:0xfc318ee0
y.create.l HWIO_QDSS_CTI8_ITCHOUT_ADDR A:0xfc318ee4
y.create.l HWIO_QDSS_CTI8_ITTRIGOUT_ADDR A:0xfc318ee8
y.create.l HWIO_QDSS_CTI8_ITCHOUTACK_ADDR A:0xfc318eec
y.create.l HWIO_QDSS_CTI8_ITTRIGOUTACK_ADDR A:0xfc318ef0
y.create.l HWIO_QDSS_CTI8_ITCHIN_ADDR A:0xfc318ef4
y.create.l HWIO_QDSS_CTI8_ITTRIGIN_ADDR A:0xfc318ef8
y.create.l HWIO_QDSS_CTI8_ITCTRL_ADDR A:0xfc318f00
y.create.l HWIO_QDSS_CTI8_CLAIMSET_ADDR A:0xfc318fa0
y.create.l HWIO_QDSS_CTI8_CLAIMCLR_ADDR A:0xfc318fa4
y.create.l HWIO_QDSS_CTI8_LAR_ADDR A:0xfc318fb0
y.create.l HWIO_QDSS_CTI8_LSR_ADDR A:0xfc318fb4
y.create.l HWIO_QDSS_CTI8_AUTHSTATUS_ADDR A:0xfc318fb8
y.create.l HWIO_QDSS_CTI8_DEVID_ADDR A:0xfc318fc8
y.create.l HWIO_QDSS_CTI8_DEVTYPE_ADDR A:0xfc318fcc
y.create.l HWIO_QDSS_CTI8_PERIPHID0_ADDR A:0xfc318fe0
y.create.l HWIO_QDSS_CTI8_PERIPHID1_ADDR A:0xfc318fe4
y.create.l HWIO_QDSS_CTI8_PERIPHID2_ADDR A:0xfc318fe8
y.create.l HWIO_QDSS_CTI8_PERIPHID3_ADDR A:0xfc318fec
y.create.l HWIO_QDSS_CTI8_PERIPHID4_ADDR A:0xfc318fd0
y.create.l HWIO_QDSS_CTI8_PERIPHID5_ADDR A:0xfc318fd4
y.create.l HWIO_QDSS_CTI8_PERIPHID6_ADDR A:0xfc318fd8
y.create.l HWIO_QDSS_CTI8_PERIPHID7_ADDR A:0xfc318fdc
y.create.l HWIO_QDSS_CTI8_COMPID0_ADDR A:0xfc318ff0
y.create.l HWIO_QDSS_CTI8_COMPID1_ADDR A:0xfc318ff4
y.create.l HWIO_QDSS_CTI8_COMPID2_ADDR A:0xfc318ff8
y.create.l HWIO_QDSS_CTI8_COMPID3_ADDR A:0xfc318ffc
y.create.l HWIO_QDSS_CSTPIU_SUPPORTED_PORT_SIZES_ADDR A:0xfc320000
y.create.l HWIO_QDSS_CSTPIU_CURRENT_PORT_SIZE_ADDR A:0xfc320004
y.create.l HWIO_QDSS_CSTPIU_SUPPORTED_TRIGGER_MODES_ADDR A:0xfc320100
y.create.l HWIO_QDSS_CSTPIU_TRIGGER_COUNTER_VALUE_ADDR A:0xfc320104
y.create.l HWIO_QDSS_CSTPIU_TRIGGER_MULTIPLIER_ADDR A:0xfc320108
y.create.l HWIO_QDSS_CSTPIU_SUPPORTED_TEST_PATTERN_MODES_ADDR A:0xfc320200
y.create.l HWIO_QDSS_CSTPIU_CURRENT_TEST_PATTERN_MODE_ADDR A:0xfc320204
y.create.l HWIO_QDSS_CSTPIU_TPRCR_ADDR A:0xfc320208
y.create.l HWIO_QDSS_CSTPIU_FFSR_ADDR A:0xfc320300
y.create.l HWIO_QDSS_CSTPIU_FFCR_ADDR A:0xfc320304
y.create.l HWIO_QDSS_CSTPIU_FSCR_ADDR A:0xfc320308
y.create.l HWIO_QDSS_CSTPIU_EXTCTL_IN_PORT_ADDR A:0xfc320400
y.create.l HWIO_QDSS_CSTPIU_EXTCTL_OUT_PORT_ADDR A:0xfc320404
y.create.l HWIO_QDSS_CSTPIU_ITTRFLINACK_ADDR A:0xfc320ee4
y.create.l HWIO_QDSS_CSTPIU_ITTRFLIN_ADDR A:0xfc320ee8
y.create.l HWIO_QDSS_CSTPIU_ITATBDATA0_ADDR A:0xfc320eec
y.create.l HWIO_QDSS_CSTPIU_ITATBCTR2_ADDR A:0xfc320ef0
y.create.l HWIO_QDSS_CSTPIU_ITATBCTR1_ADDR A:0xfc320ef4
y.create.l HWIO_QDSS_CSTPIU_ITATBCTR0_ADDR A:0xfc320ef8
y.create.l HWIO_QDSS_CSTPIU_ITCTRL_ADDR A:0xfc320f00
y.create.l HWIO_QDSS_CSTPIU_CLAIMSET_ADDR A:0xfc320fa0
y.create.l HWIO_QDSS_CSTPIU_CLAIMCLR_ADDR A:0xfc320fa4
y.create.l HWIO_QDSS_CSTPIU_LAR_ADDR A:0xfc320fb0
y.create.l HWIO_QDSS_CSTPIU_LSR_ADDR A:0xfc320fb4
y.create.l HWIO_QDSS_CSTPIU_AUTHSTATUS_ADDR A:0xfc320fb8
y.create.l HWIO_QDSS_CSTPIU_DEVID_ADDR A:0xfc320fc8
y.create.l HWIO_QDSS_CSTPIU_DEVTYPE_ADDR A:0xfc320fcc
y.create.l HWIO_QDSS_CSTPIU_PERIPHID0_ADDR A:0xfc320fe0
y.create.l HWIO_QDSS_CSTPIU_PERIPHID1_ADDR A:0xfc320fe4
y.create.l HWIO_QDSS_CSTPIU_PERIPHID2_ADDR A:0xfc320fe8
y.create.l HWIO_QDSS_CSTPIU_PERIPHID3_ADDR A:0xfc320fec
y.create.l HWIO_QDSS_CSTPIU_PERIPHID4_ADDR A:0xfc320fd0
y.create.l HWIO_QDSS_CSTPIU_PERIPHID5_ADDR A:0xfc320fd4
y.create.l HWIO_QDSS_CSTPIU_PERIPHID6_ADDR A:0xfc320fd8
y.create.l HWIO_QDSS_CSTPIU_PERIPHID7_ADDR A:0xfc320fdc
y.create.l HWIO_QDSS_CSTPIU_COMPID0_ADDR A:0xfc320ff0
y.create.l HWIO_QDSS_CSTPIU_COMPID1_ADDR A:0xfc320ff4
y.create.l HWIO_QDSS_CSTPIU_COMPID2_ADDR A:0xfc320ff8
y.create.l HWIO_QDSS_CSTPIU_COMPID3_ADDR A:0xfc320ffc
y.create.l HWIO_QDSS_IN_FUN0_CTRL_REG_ADDR A:0xfc321000
y.create.l HWIO_QDSS_IN_FUN0_PRIORITY_CTRL_REG_ADDR A:0xfc321004
y.create.l HWIO_QDSS_IN_FUN0_ITATBDATA0_ADDR A:0xfc321eec
y.create.l HWIO_QDSS_IN_FUN0_ITATBCTR2_ADDR A:0xfc321ef0
y.create.l HWIO_QDSS_IN_FUN0_ITATBCTR1_ADDR A:0xfc321ef4
y.create.l HWIO_QDSS_IN_FUN0_ITATBCTR0_ADDR A:0xfc321ef8
y.create.l HWIO_QDSS_IN_FUN0_ITCTRL_ADDR A:0xfc321f00
y.create.l HWIO_QDSS_IN_FUN0_CLAIMSET_ADDR A:0xfc321fa0
y.create.l HWIO_QDSS_IN_FUN0_CLAIMCLR_ADDR A:0xfc321fa4
y.create.l HWIO_QDSS_IN_FUN0_LOCKACCESS_ADDR A:0xfc321fb0
y.create.l HWIO_QDSS_IN_FUN0_LOCKSTATUS_ADDR A:0xfc321fb4
y.create.l HWIO_QDSS_IN_FUN0_AUTHSTATUS_ADDR A:0xfc321fb8
y.create.l HWIO_QDSS_IN_FUN0_DEVID_ADDR A:0xfc321fc8
y.create.l HWIO_QDSS_IN_FUN0_DEVTYPE_ADDR A:0xfc321fcc
y.create.l HWIO_QDSS_IN_FUN0_PERIPHID0_ADDR A:0xfc321fe0
y.create.l HWIO_QDSS_IN_FUN0_PERIPHID1_ADDR A:0xfc321fe4
y.create.l HWIO_QDSS_IN_FUN0_PERIPHID2_ADDR A:0xfc321fe8
y.create.l HWIO_QDSS_IN_FUN0_PERIPHID3_ADDR A:0xfc321fec
y.create.l HWIO_QDSS_IN_FUN0_PERIPHID4_ADDR A:0xfc321fd0
y.create.l HWIO_QDSS_IN_FUN0_PERIPHID5_ADDR A:0xfc321fd4
y.create.l HWIO_QDSS_IN_FUN0_PERIPHID6_ADDR A:0xfc321fd8
y.create.l HWIO_QDSS_IN_FUN0_PERIPHID7_ADDR A:0xfc321fdc
y.create.l HWIO_QDSS_IN_FUN0_COMPID0_ADDR A:0xfc321ff0
y.create.l HWIO_QDSS_IN_FUN0_COMPID1_ADDR A:0xfc321ff4
y.create.l HWIO_QDSS_IN_FUN0_COMPID2_ADDR A:0xfc321ff8
y.create.l HWIO_QDSS_IN_FUN0_COMPID3_ADDR A:0xfc321ffc
y.create.l HWIO_QDSS_IN_FUN1_CTRL_REG_ADDR A:0xfc322000
y.create.l HWIO_QDSS_IN_FUN1_PRIORITY_CTRL_REG_ADDR A:0xfc322004
y.create.l HWIO_QDSS_IN_FUN1_ITATBDATA0_ADDR A:0xfc322eec
y.create.l HWIO_QDSS_IN_FUN1_ITATBCTR2_ADDR A:0xfc322ef0
y.create.l HWIO_QDSS_IN_FUN1_ITATBCTR1_ADDR A:0xfc322ef4
y.create.l HWIO_QDSS_IN_FUN1_ITATBCTR0_ADDR A:0xfc322ef8
y.create.l HWIO_QDSS_IN_FUN1_ITCTRL_ADDR A:0xfc322f00
y.create.l HWIO_QDSS_IN_FUN1_CLAIMSET_ADDR A:0xfc322fa0
y.create.l HWIO_QDSS_IN_FUN1_CLAIMCLR_ADDR A:0xfc322fa4
y.create.l HWIO_QDSS_IN_FUN1_LOCKACCESS_ADDR A:0xfc322fb0
y.create.l HWIO_QDSS_IN_FUN1_LOCKSTATUS_ADDR A:0xfc322fb4
y.create.l HWIO_QDSS_IN_FUN1_AUTHSTATUS_ADDR A:0xfc322fb8
y.create.l HWIO_QDSS_IN_FUN1_DEVID_ADDR A:0xfc322fc8
y.create.l HWIO_QDSS_IN_FUN1_DEVTYPE_ADDR A:0xfc322fcc
y.create.l HWIO_QDSS_IN_FUN1_PERIPHID0_ADDR A:0xfc322fe0
y.create.l HWIO_QDSS_IN_FUN1_PERIPHID1_ADDR A:0xfc322fe4
y.create.l HWIO_QDSS_IN_FUN1_PERIPHID2_ADDR A:0xfc322fe8
y.create.l HWIO_QDSS_IN_FUN1_PERIPHID3_ADDR A:0xfc322fec
y.create.l HWIO_QDSS_IN_FUN1_PERIPHID4_ADDR A:0xfc322fd0
y.create.l HWIO_QDSS_IN_FUN1_PERIPHID5_ADDR A:0xfc322fd4
y.create.l HWIO_QDSS_IN_FUN1_PERIPHID6_ADDR A:0xfc322fd8
y.create.l HWIO_QDSS_IN_FUN1_PERIPHID7_ADDR A:0xfc322fdc
y.create.l HWIO_QDSS_IN_FUN1_COMPID0_ADDR A:0xfc322ff0
y.create.l HWIO_QDSS_IN_FUN1_COMPID1_ADDR A:0xfc322ff4
y.create.l HWIO_QDSS_IN_FUN1_COMPID2_ADDR A:0xfc322ff8
y.create.l HWIO_QDSS_IN_FUN1_COMPID3_ADDR A:0xfc322ffc
y.create.l HWIO_QDSS_MERG_FUN_CTRL_REG_ADDR A:0xfc323000
y.create.l HWIO_QDSS_MERG_FUN_PRIORITY_CTRL_REG_ADDR A:0xfc323004
y.create.l HWIO_QDSS_MERG_FUN_ITATBDATA0_ADDR A:0xfc323eec
y.create.l HWIO_QDSS_MERG_FUN_ITATBCTR2_ADDR A:0xfc323ef0
y.create.l HWIO_QDSS_MERG_FUN_ITATBCTR1_ADDR A:0xfc323ef4
y.create.l HWIO_QDSS_MERG_FUN_ITATBCTR0_ADDR A:0xfc323ef8
y.create.l HWIO_QDSS_MERG_FUN_ITCTRL_ADDR A:0xfc323f00
y.create.l HWIO_QDSS_MERG_FUN_CLAIMSET_ADDR A:0xfc323fa0
y.create.l HWIO_QDSS_MERG_FUN_CLAIMCLR_ADDR A:0xfc323fa4
y.create.l HWIO_QDSS_MERG_FUN_LOCKACCESS_ADDR A:0xfc323fb0
y.create.l HWIO_QDSS_MERG_FUN_LOCKSTATUS_ADDR A:0xfc323fb4
y.create.l HWIO_QDSS_MERG_FUN_AUTHSTATUS_ADDR A:0xfc323fb8
y.create.l HWIO_QDSS_MERG_FUN_DEVID_ADDR A:0xfc323fc8
y.create.l HWIO_QDSS_MERG_FUN_DEVTYPE_ADDR A:0xfc323fcc
y.create.l HWIO_QDSS_MERG_FUN_PERIPHID0_ADDR A:0xfc323fe0
y.create.l HWIO_QDSS_MERG_FUN_PERIPHID1_ADDR A:0xfc323fe4
y.create.l HWIO_QDSS_MERG_FUN_PERIPHID2_ADDR A:0xfc323fe8
y.create.l HWIO_QDSS_MERG_FUN_PERIPHID3_ADDR A:0xfc323fec
y.create.l HWIO_QDSS_MERG_FUN_PERIPHID4_ADDR A:0xfc323fd0
y.create.l HWIO_QDSS_MERG_FUN_PERIPHID5_ADDR A:0xfc323fd4
y.create.l HWIO_QDSS_MERG_FUN_PERIPHID6_ADDR A:0xfc323fd8
y.create.l HWIO_QDSS_MERG_FUN_PERIPHID7_ADDR A:0xfc323fdc
y.create.l HWIO_QDSS_MERG_FUN_COMPID0_ADDR A:0xfc323ff0
y.create.l HWIO_QDSS_MERG_FUN_COMPID1_ADDR A:0xfc323ff4
y.create.l HWIO_QDSS_MERG_FUN_COMPID2_ADDR A:0xfc323ff8
y.create.l HWIO_QDSS_MERG_FUN_COMPID3_ADDR A:0xfc323ffc
y.create.l HWIO_QDSS_REPL64_IDFILTER0_ADDR A:0xfc324000
y.create.l HWIO_QDSS_REPL64_IDFILTER1_ADDR A:0xfc324004
y.create.l HWIO_QDSS_REPL64_ITATBCTR0_ADDR A:0xfc324efc
y.create.l HWIO_QDSS_REPL64_ITATBCTR1_ADDR A:0xfc324ef8
y.create.l HWIO_QDSS_REPL64_ITCTRL_ADDR A:0xfc324f00
y.create.l HWIO_QDSS_REPL64_CLAIMSET_ADDR A:0xfc324fa0
y.create.l HWIO_QDSS_REPL64_CLAIMCLR_ADDR A:0xfc324fa4
y.create.l HWIO_QDSS_REPL64_LAR_ADDR A:0xfc324fb0
y.create.l HWIO_QDSS_REPL64_LSR_ADDR A:0xfc324fb4
y.create.l HWIO_QDSS_REPL64_AUTHSTATUS_ADDR A:0xfc324fb8
y.create.l HWIO_QDSS_REPL64_DEVID_ADDR A:0xfc324fc8
y.create.l HWIO_QDSS_REPL64_DEVTYPE_ADDR A:0xfc324fcc
y.create.l HWIO_QDSS_REPL64_PIDR0_ADDR A:0xfc324fe0
y.create.l HWIO_QDSS_REPL64_PIDR1_ADDR A:0xfc324fe4
y.create.l HWIO_QDSS_REPL64_PIDR2_ADDR A:0xfc324fe8
y.create.l HWIO_QDSS_REPL64_PIDR3_ADDR A:0xfc324fec
y.create.l HWIO_QDSS_REPL64_PIDR4_ADDR A:0xfc324fd0
y.create.l HWIO_QDSS_REPL64_PIDR5_ADDR A:0xfc324fd4
y.create.l HWIO_QDSS_REPL64_PIDR6_ADDR A:0xfc324fd8
y.create.l HWIO_QDSS_REPL64_PIDR7_ADDR A:0xfc324fdc
y.create.l HWIO_QDSS_REPL64_CIDR0_ADDR A:0xfc324ff0
y.create.l HWIO_QDSS_REPL64_CIDR1_ADDR A:0xfc324ff4
y.create.l HWIO_QDSS_REPL64_CIDR2_ADDR A:0xfc324ff8
y.create.l HWIO_QDSS_REPL64_CIDR3_ADDR A:0xfc324ffc
y.create.l HWIO_QDSS_ETFETB_RSZ_ADDR A:0xfc325004
y.create.l HWIO_QDSS_ETFETB_STS_ADDR A:0xfc32500c
y.create.l HWIO_QDSS_ETFETB_RRD_ADDR A:0xfc325010
y.create.l HWIO_QDSS_ETFETB_RRP_ADDR A:0xfc325014
y.create.l HWIO_QDSS_ETFETB_RWP_ADDR A:0xfc325018
y.create.l HWIO_QDSS_ETFETB_TRG_ADDR A:0xfc32501c
y.create.l HWIO_QDSS_ETFETB_CTL_ADDR A:0xfc325020
y.create.l HWIO_QDSS_ETFETB_RWD_ADDR A:0xfc325024
y.create.l HWIO_QDSS_ETFETB_MODE_ADDR A:0xfc325028
y.create.l HWIO_QDSS_ETFETB_LBUFLEVEL_ADDR A:0xfc32502c
y.create.l HWIO_QDSS_ETFETB_CBUFLEVEL_ADDR A:0xfc325030
y.create.l HWIO_QDSS_ETFETB_BUFWM_ADDR A:0xfc325034
y.create.l HWIO_QDSS_ETFETB_FFSR_ADDR A:0xfc325300
y.create.l HWIO_QDSS_ETFETB_FFCR_ADDR A:0xfc325304
y.create.l HWIO_QDSS_ETFETB_PSCR_ADDR A:0xfc325308
y.create.l HWIO_QDSS_ETFETB_ITATBMDATA0_ADDR A:0xfc325ed0
y.create.l HWIO_QDSS_ETFETB_ITATBMCTR2_ADDR A:0xfc325ed4
y.create.l HWIO_QDSS_ETFETB_ITATBMCTR1_ADDR A:0xfc325ed8
y.create.l HWIO_QDSS_ETFETB_ITATBMCTR0_ADDR A:0xfc325edc
y.create.l HWIO_QDSS_ETFETB_ITMISCOP0_ADDR A:0xfc325ee0
y.create.l HWIO_QDSS_ETFETB_ITTRFLIN_ADDR A:0xfc325ee8
y.create.l HWIO_QDSS_ETFETB_ITATBDATA0_ADDR A:0xfc325eec
y.create.l HWIO_QDSS_ETFETB_ITATBCTR2_ADDR A:0xfc325ef0
y.create.l HWIO_QDSS_ETFETB_ITATBCTR1_ADDR A:0xfc325ef4
y.create.l HWIO_QDSS_ETFETB_ITATBCTR0_ADDR A:0xfc325ef8
y.create.l HWIO_QDSS_ETFETB_ITCTRL_ADDR A:0xfc325f00
y.create.l HWIO_QDSS_ETFETB_CLAIMSET_ADDR A:0xfc325fa0
y.create.l HWIO_QDSS_ETFETB_CLAIMCLR_ADDR A:0xfc325fa4
y.create.l HWIO_QDSS_ETFETB_LAR_ADDR A:0xfc325fb0
y.create.l HWIO_QDSS_ETFETB_LSR_ADDR A:0xfc325fb4
y.create.l HWIO_QDSS_ETFETB_AUTHSTATUS_ADDR A:0xfc325fb8
y.create.l HWIO_QDSS_ETFETB_DEVID_ADDR A:0xfc325fc8
y.create.l HWIO_QDSS_ETFETB_DEVTYPE_ADDR A:0xfc325fcc
y.create.l HWIO_QDSS_ETFETB_PERIPHID0_ADDR A:0xfc325fe0
y.create.l HWIO_QDSS_ETFETB_PERIPHID1_ADDR A:0xfc325fe4
y.create.l HWIO_QDSS_ETFETB_PERIPHID2_ADDR A:0xfc325fe8
y.create.l HWIO_QDSS_ETFETB_PERIPHID3_ADDR A:0xfc325fec
y.create.l HWIO_QDSS_ETFETB_PERIPHID4_ADDR A:0xfc325fd0
y.create.l HWIO_QDSS_ETFETB_PERIPHID5_ADDR A:0xfc325fd4
y.create.l HWIO_QDSS_ETFETB_PERIPHID6_ADDR A:0xfc325fd8
y.create.l HWIO_QDSS_ETFETB_PERIPHID7_ADDR A:0xfc325fdc
y.create.l HWIO_QDSS_ETFETB_COMPID0_ADDR A:0xfc325ff0
y.create.l HWIO_QDSS_ETFETB_COMPID1_ADDR A:0xfc325ff4
y.create.l HWIO_QDSS_ETFETB_COMPID2_ADDR A:0xfc325ff8
y.create.l HWIO_QDSS_ETFETB_COMPID3_ADDR A:0xfc325ffc
y.create.l HWIO_QDSS_ETR_RSZ_ADDR A:0xfc326004
y.create.l HWIO_QDSS_ETR_STS_ADDR A:0xfc32600c
y.create.l HWIO_QDSS_ETR_RRD_ADDR A:0xfc326010
y.create.l HWIO_QDSS_ETR_RRP_ADDR A:0xfc326014
y.create.l HWIO_QDSS_ETR_RWP_ADDR A:0xfc326018
y.create.l HWIO_QDSS_ETR_TRG_ADDR A:0xfc32601c
y.create.l HWIO_QDSS_ETR_CTL_ADDR A:0xfc326020
y.create.l HWIO_QDSS_ETR_RWD_ADDR A:0xfc326024
y.create.l HWIO_QDSS_ETR_MODE_ADDR A:0xfc326028
y.create.l HWIO_QDSS_ETR_LBUFLEVEL_ADDR A:0xfc32602c
y.create.l HWIO_QDSS_ETR_CBUFLEVEL_ADDR A:0xfc326030
y.create.l HWIO_QDSS_ETR_BUFWM_ADDR A:0xfc326034
y.create.l HWIO_QDSS_ETR_RRPHI_ADDR A:0xfc326038
y.create.l HWIO_QDSS_ETR_RWPHI_ADDR A:0xfc32603c
y.create.l HWIO_QDSS_ETR_AXICTL_ADDR A:0xfc326110
y.create.l HWIO_QDSS_ETR_DBALO_ADDR A:0xfc326118
y.create.l HWIO_QDSS_ETR_DBAHI_ADDR A:0xfc32611c
y.create.l HWIO_QDSS_ETR_FFSR_ADDR A:0xfc326300
y.create.l HWIO_QDSS_ETR_FFCR_ADDR A:0xfc326304
y.create.l HWIO_QDSS_ETR_PSCR_ADDR A:0xfc326308
y.create.l HWIO_QDSS_ETR_ITMISCOP0_ADDR A:0xfc326ee0
y.create.l HWIO_QDSS_ETR_ITTRFLIN_ADDR A:0xfc326ee8
y.create.l HWIO_QDSS_ETR_ITATBDATA0_ADDR A:0xfc326eec
y.create.l HWIO_QDSS_ETR_ITATBCTR2_ADDR A:0xfc326ef0
y.create.l HWIO_QDSS_ETR_ITATBCTR1_ADDR A:0xfc326ef4
y.create.l HWIO_QDSS_ETR_ITATBCTR0_ADDR A:0xfc326ef8
y.create.l HWIO_QDSS_ETR_ITCTRL_ADDR A:0xfc326f00
y.create.l HWIO_QDSS_ETR_CLAIMSET_ADDR A:0xfc326fa0
y.create.l HWIO_QDSS_ETR_CLAIMCLR_ADDR A:0xfc326fa4
y.create.l HWIO_QDSS_ETR_LAR_ADDR A:0xfc326fb0
y.create.l HWIO_QDSS_ETR_LSR_ADDR A:0xfc326fb4
y.create.l HWIO_QDSS_ETR_AUTHSTATUS_ADDR A:0xfc326fb8
y.create.l HWIO_QDSS_ETR_DEVID_ADDR A:0xfc326fc8
y.create.l HWIO_QDSS_ETR_DEVTYPE_ADDR A:0xfc326fcc
y.create.l HWIO_QDSS_ETR_PERIPHID0_ADDR A:0xfc326fe0
y.create.l HWIO_QDSS_ETR_PERIPHID1_ADDR A:0xfc326fe4
y.create.l HWIO_QDSS_ETR_PERIPHID2_ADDR A:0xfc326fe8
y.create.l HWIO_QDSS_ETR_PERIPHID3_ADDR A:0xfc326fec
y.create.l HWIO_QDSS_ETR_PERIPHID4_ADDR A:0xfc326fd0
y.create.l HWIO_QDSS_ETR_PERIPHID5_ADDR A:0xfc326fd4
y.create.l HWIO_QDSS_ETR_PERIPHID6_ADDR A:0xfc326fd8
y.create.l HWIO_QDSS_ETR_PERIPHID7_ADDR A:0xfc326fdc
y.create.l HWIO_QDSS_ETR_COMPID0_ADDR A:0xfc326ff0
y.create.l HWIO_QDSS_ETR_COMPID1_ADDR A:0xfc326ff4
y.create.l HWIO_QDSS_ETR_COMPID2_ADDR A:0xfc326ff8
y.create.l HWIO_QDSS_ETR_COMPID3_ADDR A:0xfc326ffc
y.create.l HWIO_QDSS_VMIDDAP_VMIDMT_SCR0_ADDR A:0xfc376000
y.create.l HWIO_QDSS_VMIDDAP_VMIDMT_SCR1_ADDR A:0xfc376004
y.create.l HWIO_QDSS_VMIDDAP_VMIDMT_SCR2_ADDR A:0xfc376008
y.create.l HWIO_QDSS_VMIDDAP_VMIDMT_SACR_ADDR A:0xfc376010
y.create.l HWIO_QDSS_VMIDDAP_VMIDMT_SIDR0_ADDR A:0xfc376020
y.create.l HWIO_QDSS_VMIDDAP_VMIDMT_SIDR1_ADDR A:0xfc376024
y.create.l HWIO_QDSS_VMIDDAP_VMIDMT_SIDR2_ADDR A:0xfc376028
y.create.l HWIO_QDSS_VMIDDAP_VMIDMT_SIDR4_ADDR A:0xfc376030
y.create.l HWIO_QDSS_VMIDDAP_VMIDMT_SIDR5_ADDR A:0xfc376034
y.create.l HWIO_QDSS_VMIDDAP_VMIDMT_SIDR7_ADDR A:0xfc37603c
y.create.l HWIO_QDSS_VMIDDAP_VMIDMT_SGFAR0_ADDR A:0xfc376040
y.create.l HWIO_QDSS_VMIDDAP_VMIDMT_SGFSR_ADDR A:0xfc376048
y.create.l HWIO_QDSS_VMIDDAP_VMIDMT_SGFSRRESTORE_ADDR A:0xfc37604c
y.create.l HWIO_QDSS_VMIDDAP_VMIDMT_SGFSYNDR0_ADDR A:0xfc376050
y.create.l HWIO_QDSS_VMIDDAP_VMIDMT_SGFSYNDR1_ADDR A:0xfc376054
y.create.l HWIO_QDSS_VMIDDAP_VMIDMT_SGFSYNDR2_ADDR A:0xfc376058
y.create.l HWIO_QDSS_VMIDDAP_VMIDMT_VMIDMTSCR0_ADDR A:0xfc376090
y.create.l HWIO_QDSS_VMIDDAP_VMIDMT_CR0_ADDR A:0xfc376000
y.create.l HWIO_QDSS_VMIDDAP_VMIDMT_CR2_ADDR A:0xfc376008
y.create.l HWIO_QDSS_VMIDDAP_VMIDMT_ACR_ADDR A:0xfc376010
y.create.l HWIO_QDSS_VMIDDAP_VMIDMT_IDR0_ADDR A:0xfc376020
y.create.l HWIO_QDSS_VMIDDAP_VMIDMT_IDR1_ADDR A:0xfc376024
y.create.l HWIO_QDSS_VMIDDAP_VMIDMT_IDR2_ADDR A:0xfc376028
y.create.l HWIO_QDSS_VMIDDAP_VMIDMT_IDR4_ADDR A:0xfc376030
y.create.l HWIO_QDSS_VMIDDAP_VMIDMT_IDR5_ADDR A:0xfc376034
y.create.l HWIO_QDSS_VMIDDAP_VMIDMT_IDR7_ADDR A:0xfc37603c
y.create.l HWIO_QDSS_VMIDDAP_VMIDMT_GFAR0_ADDR A:0xfc376040
y.create.l HWIO_QDSS_VMIDDAP_VMIDMT_GFSR_ADDR A:0xfc376048
y.create.l HWIO_QDSS_VMIDDAP_VMIDMT_GFSRRESTORE_ADDR A:0xfc37604c
y.create.l HWIO_QDSS_VMIDDAP_VMIDMT_GFSYNDR0_ADDR A:0xfc376050
y.create.l HWIO_QDSS_VMIDDAP_VMIDMT_GFSYNDR1_ADDR A:0xfc376054
y.create.l HWIO_QDSS_VMIDDAP_VMIDMT_GFSYNDR2_ADDR A:0xfc376058
y.create.l HWIO_QDSS_VMIDDAP_VMIDMT_VMIDMTCR0_ADDR A:0xfc376090
y.create.l HWIO_QDSS_VMIDDAP_VMIDMT_VMIDMTACR_ADDR A:0xfc37609c
y.create.l HWIO_QDSS_VMIDDAP_VMIDMT_NSCR0_ADDR A:0xfc376400
y.create.l HWIO_QDSS_VMIDDAP_VMIDMT_NSCR2_ADDR A:0xfc376408
y.create.l HWIO_QDSS_VMIDDAP_VMIDMT_NSACR_ADDR A:0xfc376410
y.create.l HWIO_QDSS_VMIDDAP_VMIDMT_NSGFAR0_ADDR A:0xfc376440
y.create.l HWIO_QDSS_VMIDDAP_VMIDMT_NSGFSR_ADDR A:0xfc376448
y.create.l HWIO_QDSS_VMIDDAP_VMIDMT_NSGFSRRESTORE_ADDR A:0xfc37644c
y.create.l HWIO_QDSS_VMIDDAP_VMIDMT_NSGFSYNDR0_ADDR A:0xfc376450
y.create.l HWIO_QDSS_VMIDDAP_VMIDMT_NSGFSYNDR1_ADDR A:0xfc376454
y.create.l HWIO_QDSS_VMIDDAP_VMIDMT_NSGFSYNDR2_ADDR A:0xfc376458
y.create.l HWIO_QDSS_VMIDDAP_VMIDMT_NSVMIDMTCR0_ADDR A:0xfc376490
y.create.l HWIO_QDSS_VMIDDAP_VMIDMT_SSDR0_ADDR A:0xfc376080
y.create.l HWIO_QDSS_VMIDDAP_VMIDMT_S2VR0_ADDR A:0xfc376c00
y.create.l HWIO_QDSS_VMIDDAP_VMIDMT_S2VR1_ADDR A:0xfc376c04
y.create.l HWIO_QDSS_VMIDDAP_VMIDMT_AS2VR0_ADDR A:0xfc376e00
y.create.l HWIO_QDSS_VMIDDAP_VMIDMT_AS2VR1_ADDR A:0xfc376e04
y.create.l HWIO_QDSS_VMIDETR_VMIDMT_SCR0_ADDR A:0xfc377000
y.create.l HWIO_QDSS_VMIDETR_VMIDMT_SCR1_ADDR A:0xfc377004
y.create.l HWIO_QDSS_VMIDETR_VMIDMT_SCR2_ADDR A:0xfc377008
y.create.l HWIO_QDSS_VMIDETR_VMIDMT_SACR_ADDR A:0xfc377010
y.create.l HWIO_QDSS_VMIDETR_VMIDMT_SIDR0_ADDR A:0xfc377020
y.create.l HWIO_QDSS_VMIDETR_VMIDMT_SIDR1_ADDR A:0xfc377024
y.create.l HWIO_QDSS_VMIDETR_VMIDMT_SIDR2_ADDR A:0xfc377028
y.create.l HWIO_QDSS_VMIDETR_VMIDMT_SIDR4_ADDR A:0xfc377030
y.create.l HWIO_QDSS_VMIDETR_VMIDMT_SIDR5_ADDR A:0xfc377034
y.create.l HWIO_QDSS_VMIDETR_VMIDMT_SIDR7_ADDR A:0xfc37703c
y.create.l HWIO_QDSS_VMIDETR_VMIDMT_SGFAR0_ADDR A:0xfc377040
y.create.l HWIO_QDSS_VMIDETR_VMIDMT_SGFSR_ADDR A:0xfc377048
y.create.l HWIO_QDSS_VMIDETR_VMIDMT_SGFSRRESTORE_ADDR A:0xfc37704c
y.create.l HWIO_QDSS_VMIDETR_VMIDMT_SGFSYNDR0_ADDR A:0xfc377050
y.create.l HWIO_QDSS_VMIDETR_VMIDMT_SGFSYNDR1_ADDR A:0xfc377054
y.create.l HWIO_QDSS_VMIDETR_VMIDMT_SGFSYNDR2_ADDR A:0xfc377058
y.create.l HWIO_QDSS_VMIDETR_VMIDMT_VMIDMTSCR0_ADDR A:0xfc377090
y.create.l HWIO_QDSS_VMIDETR_VMIDMT_CR0_ADDR A:0xfc377000
y.create.l HWIO_QDSS_VMIDETR_VMIDMT_CR2_ADDR A:0xfc377008
y.create.l HWIO_QDSS_VMIDETR_VMIDMT_ACR_ADDR A:0xfc377010
y.create.l HWIO_QDSS_VMIDETR_VMIDMT_IDR0_ADDR A:0xfc377020
y.create.l HWIO_QDSS_VMIDETR_VMIDMT_IDR1_ADDR A:0xfc377024
y.create.l HWIO_QDSS_VMIDETR_VMIDMT_IDR2_ADDR A:0xfc377028
y.create.l HWIO_QDSS_VMIDETR_VMIDMT_IDR4_ADDR A:0xfc377030
y.create.l HWIO_QDSS_VMIDETR_VMIDMT_IDR5_ADDR A:0xfc377034
y.create.l HWIO_QDSS_VMIDETR_VMIDMT_IDR7_ADDR A:0xfc37703c
y.create.l HWIO_QDSS_VMIDETR_VMIDMT_GFAR0_ADDR A:0xfc377040
y.create.l HWIO_QDSS_VMIDETR_VMIDMT_GFSR_ADDR A:0xfc377048
y.create.l HWIO_QDSS_VMIDETR_VMIDMT_GFSRRESTORE_ADDR A:0xfc37704c
y.create.l HWIO_QDSS_VMIDETR_VMIDMT_GFSYNDR0_ADDR A:0xfc377050
y.create.l HWIO_QDSS_VMIDETR_VMIDMT_GFSYNDR1_ADDR A:0xfc377054
y.create.l HWIO_QDSS_VMIDETR_VMIDMT_GFSYNDR2_ADDR A:0xfc377058
y.create.l HWIO_QDSS_VMIDETR_VMIDMT_VMIDMTCR0_ADDR A:0xfc377090
y.create.l HWIO_QDSS_VMIDETR_VMIDMT_VMIDMTACR_ADDR A:0xfc37709c
y.create.l HWIO_QDSS_VMIDETR_VMIDMT_NSCR0_ADDR A:0xfc377400
y.create.l HWIO_QDSS_VMIDETR_VMIDMT_NSCR2_ADDR A:0xfc377408
y.create.l HWIO_QDSS_VMIDETR_VMIDMT_NSACR_ADDR A:0xfc377410
y.create.l HWIO_QDSS_VMIDETR_VMIDMT_NSGFAR0_ADDR A:0xfc377440
y.create.l HWIO_QDSS_VMIDETR_VMIDMT_NSGFSR_ADDR A:0xfc377448
y.create.l HWIO_QDSS_VMIDETR_VMIDMT_NSGFSRRESTORE_ADDR A:0xfc37744c
y.create.l HWIO_QDSS_VMIDETR_VMIDMT_NSGFSYNDR0_ADDR A:0xfc377450
y.create.l HWIO_QDSS_VMIDETR_VMIDMT_NSGFSYNDR1_ADDR A:0xfc377454
y.create.l HWIO_QDSS_VMIDETR_VMIDMT_NSGFSYNDR2_ADDR A:0xfc377458
y.create.l HWIO_QDSS_VMIDETR_VMIDMT_NSVMIDMTCR0_ADDR A:0xfc377490
y.create.l HWIO_QDSS_VMIDETR_VMIDMT_SSDR0_ADDR A:0xfc377080
y.create.l HWIO_QDSS_VMIDETR_VMIDMT_S2VR0_ADDR A:0xfc377c00
y.create.l HWIO_QDSS_VMIDETR_VMIDMT_S2VR1_ADDR A:0xfc377c04
y.create.l HWIO_QDSS_VMIDETR_VMIDMT_AS2VR0_ADDR A:0xfc377e00
y.create.l HWIO_QDSS_VMIDETR_VMIDMT_AS2VR1_ADDR A:0xfc377e04
y.create.l HWIO_QDSS_NDPBAM_BAM_CTRL_ADDR A:0xfc37c000
y.create.l HWIO_QDSS_NDPBAM_BAM_REVISION_ADDR A:0xfc37c004
y.create.l HWIO_QDSS_NDPBAM_BAM_SW_VERSION_ADDR A:0xfc37c080
y.create.l HWIO_QDSS_NDPBAM_BAM_NUM_PIPES_ADDR A:0xfc37c03c
y.create.l HWIO_QDSS_NDPBAM_BAM_TIMER_ADDR A:0xfc37c040
y.create.l HWIO_QDSS_NDPBAM_BAM_TIMER_CTRL_ADDR A:0xfc37c044
y.create.l HWIO_QDSS_NDPBAM_BAM_DESC_CNT_TRSHLD_ADDR A:0xfc37c008
y.create.l HWIO_QDSS_NDPBAM_BAM_IRQ_SRCS_ADDR A:0xfc37c00c
y.create.l HWIO_QDSS_NDPBAM_BAM_IRQ_SRCS_MSK_ADDR A:0xfc37c010
y.create.l HWIO_QDSS_NDPBAM_BAM_IRQ_SRCS_UNMASKED_ADDR A:0xfc37c030
y.create.l HWIO_QDSS_NDPBAM_BAM_IRQ_STTS_ADDR A:0xfc37c014
y.create.l HWIO_QDSS_NDPBAM_BAM_IRQ_CLR_ADDR A:0xfc37c018
y.create.l HWIO_QDSS_NDPBAM_BAM_IRQ_EN_ADDR A:0xfc37c01c
y.create.l HWIO_QDSS_NDPBAM_BAM_AHB_MASTER_ERR_CTRLS_ADDR A:0xfc37c024
y.create.l HWIO_QDSS_NDPBAM_BAM_AHB_MASTER_ERR_ADDR_ADDR A:0xfc37c028
y.create.l HWIO_QDSS_NDPBAM_BAM_AHB_MASTER_ERR_DATA_ADDR A:0xfc37c02c
y.create.l HWIO_QDSS_NDPBAM_BAM_TRUST_REG_ADDR A:0xfc37c070
y.create.l HWIO_QDSS_NDPBAM_BAM_TEST_BUS_SEL_ADDR A:0xfc37c074
y.create.l HWIO_QDSS_NDPBAM_BAM_TEST_BUS_REG_ADDR A:0xfc37c078
y.create.l HWIO_QDSS_NDPBAM_BAM_CNFG_BITS_ADDR A:0xfc37c07c
y.create.l HWIO_QDSS_NDPBAM_BAM_IRQ_SRCS_EE0_ADDR A:0xfc37c800
y.create.l HWIO_QDSS_NDPBAM_BAM_IRQ_SRCS_EE1_ADDR A:0xfc37c880
y.create.l HWIO_QDSS_NDPBAM_BAM_IRQ_SRCS_EE2_ADDR A:0xfc37c900
y.create.l HWIO_QDSS_NDPBAM_BAM_IRQ_SRCS_EE3_ADDR A:0xfc37c980
y.create.l HWIO_QDSS_NDPBAM_BAM_IRQ_SRCS_EE4_ADDR A:0xfc37ca00
y.create.l HWIO_QDSS_NDPBAM_BAM_IRQ_SRCS_EE5_ADDR A:0xfc37ca80
y.create.l HWIO_QDSS_NDPBAM_BAM_IRQ_SRCS_EE6_ADDR A:0xfc37cb00
y.create.l HWIO_QDSS_NDPBAM_BAM_IRQ_SRCS_EE7_ADDR A:0xfc37cb80
y.create.l HWIO_QDSS_NDPBAM_BAM_IRQ_SRCS_MSK_EE0_ADDR A:0xfc37c804
y.create.l HWIO_QDSS_NDPBAM_BAM_IRQ_SRCS_MSK_EE1_ADDR A:0xfc37c884
y.create.l HWIO_QDSS_NDPBAM_BAM_IRQ_SRCS_MSK_EE2_ADDR A:0xfc37c904
y.create.l HWIO_QDSS_NDPBAM_BAM_IRQ_SRCS_MSK_EE3_ADDR A:0xfc37c984
y.create.l HWIO_QDSS_NDPBAM_BAM_IRQ_SRCS_MSK_EE4_ADDR A:0xfc37ca04
y.create.l HWIO_QDSS_NDPBAM_BAM_IRQ_SRCS_MSK_EE5_ADDR A:0xfc37ca84
y.create.l HWIO_QDSS_NDPBAM_BAM_IRQ_SRCS_MSK_EE6_ADDR A:0xfc37cb04
y.create.l HWIO_QDSS_NDPBAM_BAM_IRQ_SRCS_MSK_EE7_ADDR A:0xfc37cb84
y.create.l HWIO_QDSS_NDPBAM_BAM_IRQ_SRCS_UNMASKED_EE0_ADDR A:0xfc37c808
y.create.l HWIO_QDSS_NDPBAM_BAM_IRQ_SRCS_UNMASKED_EE1_ADDR A:0xfc37c888
y.create.l HWIO_QDSS_NDPBAM_BAM_IRQ_SRCS_UNMASKED_EE2_ADDR A:0xfc37c908
y.create.l HWIO_QDSS_NDPBAM_BAM_IRQ_SRCS_UNMASKED_EE3_ADDR A:0xfc37c988
y.create.l HWIO_QDSS_NDPBAM_BAM_IRQ_SRCS_UNMASKED_EE4_ADDR A:0xfc37ca08
y.create.l HWIO_QDSS_NDPBAM_BAM_IRQ_SRCS_UNMASKED_EE5_ADDR A:0xfc37ca88
y.create.l HWIO_QDSS_NDPBAM_BAM_IRQ_SRCS_UNMASKED_EE6_ADDR A:0xfc37cb08
y.create.l HWIO_QDSS_NDPBAM_BAM_IRQ_SRCS_UNMASKED_EE7_ADDR A:0xfc37cb88
y.create.l HWIO_QDSS_NDPBAM_BAM_P_CTRL0_ADDR A:0xfc37d000
y.create.l HWIO_QDSS_NDPBAM_BAM_P_CTRL1_ADDR A:0xfc37e000
y.create.l HWIO_QDSS_NDPBAM_BAM_P_RST0_ADDR A:0xfc37d004
y.create.l HWIO_QDSS_NDPBAM_BAM_P_RST1_ADDR A:0xfc37e004
y.create.l HWIO_QDSS_NDPBAM_BAM_P_HALT0_ADDR A:0xfc37d008
y.create.l HWIO_QDSS_NDPBAM_BAM_P_HALT1_ADDR A:0xfc37e008
y.create.l HWIO_QDSS_NDPBAM_BAM_P_TRUST_REG0_ADDR A:0xfc37d030
y.create.l HWIO_QDSS_NDPBAM_BAM_P_TRUST_REG1_ADDR A:0xfc37e030
y.create.l HWIO_QDSS_NDPBAM_BAM_P_IRQ_STTS0_ADDR A:0xfc37d010
y.create.l HWIO_QDSS_NDPBAM_BAM_P_IRQ_STTS1_ADDR A:0xfc37e010
y.create.l HWIO_QDSS_NDPBAM_BAM_P_IRQ_CLR0_ADDR A:0xfc37d014
y.create.l HWIO_QDSS_NDPBAM_BAM_P_IRQ_CLR1_ADDR A:0xfc37e014
y.create.l HWIO_QDSS_NDPBAM_BAM_P_IRQ_EN0_ADDR A:0xfc37d018
y.create.l HWIO_QDSS_NDPBAM_BAM_P_IRQ_EN1_ADDR A:0xfc37e018
y.create.l HWIO_QDSS_NDPBAM_BAM_P_TIMER0_ADDR A:0xfc37d01c
y.create.l HWIO_QDSS_NDPBAM_BAM_P_TIMER1_ADDR A:0xfc37e01c
y.create.l HWIO_QDSS_NDPBAM_BAM_P_TIMER_CTRL0_ADDR A:0xfc37d020
y.create.l HWIO_QDSS_NDPBAM_BAM_P_TIMER_CTRL1_ADDR A:0xfc37e020
y.create.l HWIO_QDSS_NDPBAM_BAM_P_PRDCR_SDBND0_ADDR A:0xfc37d024
y.create.l HWIO_QDSS_NDPBAM_BAM_P_PRDCR_SDBND1_ADDR A:0xfc37e024
y.create.l HWIO_QDSS_NDPBAM_BAM_P_CNSMR_SDBND0_ADDR A:0xfc37d028
y.create.l HWIO_QDSS_NDPBAM_BAM_P_CNSMR_SDBND1_ADDR A:0xfc37e028
y.create.l HWIO_QDSS_NDPBAM_BAM_P_EVNT_DEST_ADDR0_ADDR A:0xfc37d82c
y.create.l HWIO_QDSS_NDPBAM_BAM_P_EVNT_DEST_ADDR1_ADDR A:0xfc37e82c
y.create.l HWIO_QDSS_NDPBAM_BAM_P_EVNT_REG0_ADDR A:0xfc37d818
y.create.l HWIO_QDSS_NDPBAM_BAM_P_EVNT_REG1_ADDR A:0xfc37e818
y.create.l HWIO_QDSS_NDPBAM_BAM_P_SW_OFSTS0_ADDR A:0xfc37d800
y.create.l HWIO_QDSS_NDPBAM_BAM_P_SW_OFSTS1_ADDR A:0xfc37e800
y.create.l HWIO_QDSS_NDPBAM_BAM_P_DATA_FIFO_ADDR0_ADDR A:0xfc37d824
y.create.l HWIO_QDSS_NDPBAM_BAM_P_DATA_FIFO_ADDR1_ADDR A:0xfc37e824
y.create.l HWIO_QDSS_NDPBAM_BAM_P_DESC_FIFO_ADDR0_ADDR A:0xfc37d81c
y.create.l HWIO_QDSS_NDPBAM_BAM_P_DESC_FIFO_ADDR1_ADDR A:0xfc37e81c
y.create.l HWIO_QDSS_NDPBAM_BAM_P_EVNT_GEN_TRSHLD0_ADDR A:0xfc37d828
y.create.l HWIO_QDSS_NDPBAM_BAM_P_EVNT_GEN_TRSHLD1_ADDR A:0xfc37e828
y.create.l HWIO_QDSS_NDPBAM_BAM_P_FIFO_SIZES0_ADDR A:0xfc37d820
y.create.l HWIO_QDSS_NDPBAM_BAM_P_FIFO_SIZES1_ADDR A:0xfc37e820
y.create.l HWIO_QDSS_NDPBAM_BAM_P_RETR_CNTXT_0_ADDR A:0xfc37d834
y.create.l HWIO_QDSS_NDPBAM_BAM_P_RETR_CNTXT_1_ADDR A:0xfc37e834
y.create.l HWIO_QDSS_NDPBAM_BAM_P_SI_CNTXT_0_ADDR A:0xfc37d838
y.create.l HWIO_QDSS_NDPBAM_BAM_P_SI_CNTXT_1_ADDR A:0xfc37e838
y.create.l HWIO_QDSS_NDPBAM_BAM_P_DF_CNTXT_0_ADDR A:0xfc37d830
y.create.l HWIO_QDSS_NDPBAM_BAM_P_DF_CNTXT_1_ADDR A:0xfc37e830
y.create.l HWIO_QDSS_NDPBAM_BAM_P_AU_PSM_CNTXT_1_0_ADDR A:0xfc37d804
y.create.l HWIO_QDSS_NDPBAM_BAM_P_AU_PSM_CNTXT_1_1_ADDR A:0xfc37e804
y.create.l HWIO_QDSS_NDPBAM_BAM_P_PSM_CNTXT_2_0_ADDR A:0xfc37d808
y.create.l HWIO_QDSS_NDPBAM_BAM_P_PSM_CNTXT_2_1_ADDR A:0xfc37e808
y.create.l HWIO_QDSS_NDPBAM_BAM_P_PSM_CNTXT_3_0_ADDR A:0xfc37d80c
y.create.l HWIO_QDSS_NDPBAM_BAM_P_PSM_CNTXT_3_1_ADDR A:0xfc37e80c
y.create.l HWIO_QDSS_NDPBAM_BAM_P_PSM_CNTXT_4_0_ADDR A:0xfc37d810
y.create.l HWIO_QDSS_NDPBAM_BAM_P_PSM_CNTXT_4_1_ADDR A:0xfc37e810
y.create.l HWIO_QDSS_NDPBAM_BAM_P_PSM_CNTXT_5_0_ADDR A:0xfc37d814
y.create.l HWIO_QDSS_NDPBAM_BAM_P_PSM_CNTXT_5_1_ADDR A:0xfc37e814
y.create.l HWIO_RBCPR_VERSION_ADDR A:0xfc44f000
y.create.l HWIO_RBCPR_SENSOR_MASK0_ADDR A:0xfc44f020
y.create.l HWIO_RBCPR_SENSOR_MASK1_ADDR A:0xfc44f024
y.create.l HWIO_RBCPR_SENSOR_MASK2_ADDR A:0xfc44f028
y.create.l HWIO_RBCPR_SENSOR_MASK3_ADDR A:0xfc44f02c
y.create.l HWIO_RBCPR_SENSOR_BYPASS0_ADDR A:0xfc44f030
y.create.l HWIO_RBCPR_SENSOR_BYPASS1_ADDR A:0xfc44f034
y.create.l HWIO_RBCPR_SENSOR_BYPASS2_ADDR A:0xfc44f038
y.create.l HWIO_RBCPR_SENSOR_BYPASS3_ADDR A:0xfc44f03c
y.create.l HWIO_RBIF_PMIC_ADDR_ADDR A:0xfc44f040
y.create.l HWIO_RBCPR_TIMER_INTERVAL_ADDR A:0xfc44f044
y.create.l HWIO_RBIF_LIMIT_ADDR A:0xfc44f048
y.create.l HWIO_RBIF_TIMER_ADJUST_ADDR A:0xfc44f04c
y.create.l HWIO_RBCPR_GCNT_TARGET0_ADDR A:0xfc44f060
y.create.l HWIO_RBCPR_GCNT_TARGET1_ADDR A:0xfc44f064
y.create.l HWIO_RBCPR_GCNT_TARGET2_ADDR A:0xfc44f068
y.create.l HWIO_RBCPR_GCNT_TARGET3_ADDR A:0xfc44f06c
y.create.l HWIO_RBCPR_GCNT_TARGET4_ADDR A:0xfc44f070
y.create.l HWIO_RBCPR_GCNT_TARGET5_ADDR A:0xfc44f074
y.create.l HWIO_RBCPR_GCNT_TARGET6_ADDR A:0xfc44f078
y.create.l HWIO_RBCPR_GCNT_TARGET7_ADDR A:0xfc44f07c
y.create.l HWIO_RBCPR_STEP_QUOT_ADDR A:0xfc44f080
y.create.l HWIO_RBCPR_CTL_ADDR A:0xfc44f090
y.create.l HWIO_RBIF_SW_VLEVEL_ADDR A:0xfc44f094
y.create.l HWIO_RBIF_CONT_ACK_CMD_ADDR A:0xfc44f098
y.create.l HWIO_RBIF_CONT_NACK_CMD_ADDR A:0xfc44f09c
y.create.l HWIO_RBCPR_RESULT_0_ADDR A:0xfc44f0a0
y.create.l HWIO_RBCPR_RESULT_1_ADDR A:0xfc44f0a4
y.create.l HWIO_RBIF_IRQ_EN_0_ADDR A:0xfc44f100
y.create.l HWIO_RBIF_IRQ_EN_1_ADDR A:0xfc44f104
y.create.l HWIO_RBIF_IRQ_EN_2_ADDR A:0xfc44f108
y.create.l HWIO_RBIF_IRQ_CLEAR_ADDR A:0xfc44f110
y.create.l HWIO_RBIF_IRQ_STATUS_ADDR A:0xfc44f114
y.create.l HWIO_RBCPR_QUOT_AVG_ADDR A:0xfc44f118
y.create.l HWIO_RBCPR_DEBUG0_ADDR A:0xfc44f11c
y.create.l HWIO_RBCPR_DEBUG1_ADDR A:0xfc44f120
y.create.l HWIO_RBCPR_DEBUG2_ADDR A:0xfc44f124
y.create.l HWIO_RBCPR_BIST_MINMAX_ADDR A:0xfc44f128
y.create.l HWIO_RBCPR_BIST_RESULT_ADDR A:0xfc44f12c
y.create.l HWIO_RBCPR_BIST_FAIL_MAP0_ADDR A:0xfc44f130
y.create.l HWIO_RBCPR_BIST_FAIL_MAP1_ADDR A:0xfc44f134
y.create.l HWIO_RBCPR_BIST_FAIL_MAP2_ADDR A:0xfc44f138
y.create.l HWIO_RBCPR_BIST_FAIL_MAP3_ADDR A:0xfc44f13c
y.create.l HWIO_RBCPR_LOG_0_ADDR A:0xfc44f140
y.create.l HWIO_RBCPR_LOG_1_ADDR A:0xfc44f144
y.create.l HWIO_RBCPR_LOG_2_ADDR A:0xfc44f148
y.create.l HWIO_RBCPR_LOG_3_ADDR A:0xfc44f14c
y.create.l HWIO_RBCPR_LOG_4_ADDR A:0xfc44f150
y.create.l HWIO_RBCPR_LOG_5_ADDR A:0xfc44f154
y.create.l HWIO_RBCPR_LOG_6_ADDR A:0xfc44f158
y.create.l HWIO_RBCPR_LOG_7_ADDR A:0xfc44f15c
y.create.l HWIO_RBCPR_HTOL_AGE_ADDR A:0xfc44f160
y.create.l HWIO_RPM_HW_VERSION_ADDR A:0xfc180000
y.create.l HWIO_RPM_WFI_CONFIG_ADDR A:0xfc180004
y.create.l HWIO_RPM_TIMERS_CLK_OFF_CTL_ADDR A:0xfc180008
y.create.l HWIO_RPM_IPC_ADDR A:0xfc18000c
y.create.l HWIO_RPM_GPO_WDATA_ADDR A:0xfc180010
y.create.l HWIO_RPM_GPO_WDSET_ADDR A:0xfc180014
y.create.l HWIO_RPM_GPO_WDCLR_ADDR A:0xfc180018
y.create.l HWIO_RPM_SLAVES_CLK_GATING_ADDR A:0xfc18001c
y.create.l HWIO_RPM_BOOTROM_REMAP_ADDR_ADDR A:0xfc180020
y.create.l HWIO_RPM_SYSIF_REMAP_ADDR0_ADDR A:0xfc180024
y.create.l HWIO_RPM_SYSIF_REMAP_ADDR1_ADDR A:0xfc180028
y.create.l HWIO_RPM_SYSIF_REMAP_ADDR2_ADDR A:0xfc18002c
y.create.l HWIO_RPM_INTR_POLARITY_0_ADDR A:0xfc180030
y.create.l HWIO_RPM_INTR_POLARITY_1_ADDR A:0xfc180034
y.create.l HWIO_RPM_INTR_EDG_LVL_0_ADDR A:0xfc180038
y.create.l HWIO_RPM_INTR_EDG_LVL_1_ADDR A:0xfc18003c
y.create.l HWIO_RPM_WDOG_RESET_ADDR A:0xfc180040
y.create.l HWIO_RPM_WDOG_CTRL_ADDR A:0xfc180044
y.create.l HWIO_RPM_WDOG_STATUS_ADDR A:0xfc180048
y.create.l HWIO_RPM_WDOG_BARK_TIME_ADDR A:0xfc18004c
y.create.l HWIO_RPM_WDOG_BITE_TIME_ADDR A:0xfc180050
y.create.l HWIO_RPM_WDOG_TEST_LOAD_ADDR A:0xfc180054
y.create.l HWIO_RPM_WDOG_TEST_ADDR A:0xfc180058
y.create.l HWIO_RPM_TEST_BUS_SEL_ADDR A:0xfc18005c
y.create.l HWIO_RPM_SPARE_REG0_ADDR A:0xfc180060
y.create.l HWIO_RPM_SPARE_REG1_ADDR A:0xfc180064
y.create.l HWIO_RPM_SPARE_REG2_ADDR A:0xfc180068
y.create.l HWIO_RPM_SPARE_REG3_ADDR A:0xfc18006c
y.create.l HWIO_RPM_QTMR_AC_CNTFRQ_ADDR A:0xfc182000
y.create.l HWIO_RPM_QTMR_AC_CNTSR_ADDR A:0xfc182004
y.create.l HWIO_RPM_QTMR_AC_CNTTID_ADDR A:0xfc182008
y.create.l HWIO_RPM_QTMR_AC_CNTACR_0_ADDR A:0xfc182040
y.create.l HWIO_RPM_QTMR_AC_CNTACR_1_ADDR A:0xfc182044
y.create.l HWIO_RPM_QTMR_AC_CNTVOFF_LO_0_ADDR A:0xfc182080
y.create.l HWIO_RPM_QTMR_AC_CNTVOFF_LO_1_ADDR A:0xfc182088
y.create.l HWIO_RPM_QTMR_AC_CNTVOFF_HI_0_ADDR A:0xfc182084
y.create.l HWIO_RPM_QTMR_AC_CNTVOFF_HI_1_ADDR A:0xfc18208c
y.create.l HWIO_RPM_QTMR_AC_CFG_ADDR A:0xfc182fc0
y.create.l HWIO_RPM_QTMR_AC_VERSION_ADDR A:0xfc182fd0
y.create.l HWIO_RPM_F0_QTMR_V1_CNTPCT_LO_ADDR A:0xfc183000
y.create.l HWIO_RPM_F0_QTMR_V1_CNTPCT_HI_ADDR A:0xfc183004
y.create.l HWIO_RPM_F0_QTMR_V1_CNTVCT_LO_ADDR A:0xfc183008
y.create.l HWIO_RPM_F0_QTMR_V1_CNTVCT_HI_ADDR A:0xfc18300c
y.create.l HWIO_RPM_F0_QTMR_V1_CNTFRQ_ADDR A:0xfc183010
y.create.l HWIO_RPM_F0_QTMR_V1_CNTPL0ACR_ADDR A:0xfc183014
y.create.l HWIO_RPM_F0_QTMR_V1_CNTVOFF_LO_ADDR A:0xfc183018
y.create.l HWIO_RPM_F0_QTMR_V1_CNTVOFF_HI_ADDR A:0xfc18301c
y.create.l HWIO_RPM_F0_QTMR_V1_CNTP_CVAL_LO_ADDR A:0xfc183020
y.create.l HWIO_RPM_F0_QTMR_V1_CNTP_CVAL_HI_ADDR A:0xfc183024
y.create.l HWIO_RPM_F0_QTMR_V1_CNTP_TVAL_ADDR A:0xfc183028
y.create.l HWIO_RPM_F0_QTMR_V1_CNTP_CTL_ADDR A:0xfc18302c
y.create.l HWIO_RPM_F0_QTMR_V1_CNTV_CVAL_LO_ADDR A:0xfc183030
y.create.l HWIO_RPM_F0_QTMR_V1_CNTV_CVAL_HI_ADDR A:0xfc183034
y.create.l HWIO_RPM_F0_QTMR_V1_CNTV_TVAL_ADDR A:0xfc183038
y.create.l HWIO_RPM_F0_QTMR_V1_CNTV_CTL_ADDR A:0xfc18303c
y.create.l HWIO_RPM_F0_QTMR_V1_VERSION_ADDR A:0xfc183fd0
y.create.l HWIO_RPM_F1_QTMR_V1_CNTPCT_LO_ADDR A:0xfc184000
y.create.l HWIO_RPM_F1_QTMR_V1_CNTPCT_HI_ADDR A:0xfc184004
y.create.l HWIO_RPM_F1_QTMR_V1_CNTVCT_LO_ADDR A:0xfc184008
y.create.l HWIO_RPM_F1_QTMR_V1_CNTVCT_HI_ADDR A:0xfc18400c
y.create.l HWIO_RPM_F1_QTMR_V1_CNTFRQ_ADDR A:0xfc184010
y.create.l HWIO_RPM_F1_QTMR_V1_CNTPL0ACR_ADDR A:0xfc184014
y.create.l HWIO_RPM_F1_QTMR_V1_CNTVOFF_LO_ADDR A:0xfc184018
y.create.l HWIO_RPM_F1_QTMR_V1_CNTVOFF_HI_ADDR A:0xfc18401c
y.create.l HWIO_RPM_F1_QTMR_V1_CNTP_CVAL_LO_ADDR A:0xfc184020
y.create.l HWIO_RPM_F1_QTMR_V1_CNTP_CVAL_HI_ADDR A:0xfc184024
y.create.l HWIO_RPM_F1_QTMR_V1_CNTP_TVAL_ADDR A:0xfc184028
y.create.l HWIO_RPM_F1_QTMR_V1_CNTP_CTL_ADDR A:0xfc18402c
y.create.l HWIO_RPM_F1_QTMR_V1_CNTV_CVAL_LO_ADDR A:0xfc184030
y.create.l HWIO_RPM_F1_QTMR_V1_CNTV_CVAL_HI_ADDR A:0xfc184034
y.create.l HWIO_RPM_F1_QTMR_V1_CNTV_TVAL_ADDR A:0xfc184038
y.create.l HWIO_RPM_F1_QTMR_V1_CNTV_CTL_ADDR A:0xfc18403c
y.create.l HWIO_RPM_F1_QTMR_V1_VERSION_ADDR A:0xfc184fd0
y.create.l HWIO_RPM_MPU_XPU_SCR_ADDR A:0xfc186000
y.create.l HWIO_RPM_MPU_XPU_SWDR_ADDR A:0xfc186004
y.create.l HWIO_RPM_MPU_XPU_PRTN_RACR_SSHADOW_ADDR A:0xfc186008
y.create.l HWIO_RPM_MPU_XPU_PRTN_START_SSHADOW0_ADDR A:0xfc186010
y.create.l HWIO_RPM_MPU_XPU_PRTN_END_SSHADOW0_ADDR A:0xfc186018
y.create.l HWIO_RPM_MPU_XPU_SEAR0_ADDR A:0xfc186040
y.create.l HWIO_RPM_MPU_XPU_SESR_ADDR A:0xfc186048
y.create.l HWIO_RPM_MPU_XPU_SESRRESTORE_ADDR A:0xfc18604c
y.create.l HWIO_RPM_MPU_XPU_SESYNR0_ADDR A:0xfc186050
y.create.l HWIO_RPM_MPU_XPU_SESYNR1_ADDR A:0xfc186054
y.create.l HWIO_RPM_MPU_XPU_SESYNR2_ADDR A:0xfc186058
y.create.l HWIO_RPM_MPU_XPU_MCR_ADDR A:0xfc186100
y.create.l HWIO_RPM_MPU_XPU_MEAR0_ADDR A:0xfc186140
y.create.l HWIO_RPM_MPU_XPU_MESR_ADDR A:0xfc186148
y.create.l HWIO_RPM_MPU_XPU_MESRRESTORE_ADDR A:0xfc18614c
y.create.l HWIO_RPM_MPU_XPU_MESYNR0_ADDR A:0xfc186150
y.create.l HWIO_RPM_MPU_XPU_MESYNR1_ADDR A:0xfc186154
y.create.l HWIO_RPM_MPU_XPU_MESYNR2_ADDR A:0xfc186158
y.create.l HWIO_RPM_MPU_XPU_CR_ADDR A:0xfc186080
y.create.l HWIO_RPM_MPU_XPU_PRTN_RACR_SHADOW_ADDR A:0xfc186088
y.create.l HWIO_RPM_MPU_XPU_PRTN_START_SHADOW0_ADDR A:0xfc186090
y.create.l HWIO_RPM_MPU_XPU_PRTN_END_SHADOW0_ADDR A:0xfc186098
y.create.l HWIO_RPM_MPU_XPU_RPU_ACR0_ADDR A:0xfc1860a0
y.create.l HWIO_RPM_MPU_XPU_EAR0_ADDR A:0xfc1860c0
y.create.l HWIO_RPM_MPU_XPU_ESR_ADDR A:0xfc1860c8
y.create.l HWIO_RPM_MPU_XPU_ESRRESTORE_ADDR A:0xfc1860cc
y.create.l HWIO_RPM_MPU_XPU_ESYNR0_ADDR A:0xfc1860d0
y.create.l HWIO_RPM_MPU_XPU_ESYNR1_ADDR A:0xfc1860d4
y.create.l HWIO_RPM_MPU_XPU_ESYNR2_ADDR A:0xfc1860d8
y.create.l HWIO_RPM_MPU_XPU_UMR_RACR_ADDR A:0xfc1860e0
y.create.l HWIO_RPM_MPU_XPU_UMR_WACR_ADDR A:0xfc1860e4
y.create.l HWIO_RPM_MPU_XPU_IDR0_ADDR A:0xfc186074
y.create.l HWIO_RPM_MPU_XPU_IDR1_ADDR A:0xfc186078
y.create.l HWIO_RPM_MPU_XPU_REV_ADDR A:0xfc18607c
y.create.l HWIO_RPM_MPU_XPU_PRT0_RACR0_ADDR A:0xfc186200
y.create.l HWIO_RPM_MPU_XPU_PRT1_RACR0_ADDR A:0xfc186280
y.create.l HWIO_RPM_MPU_XPU_PRT2_RACR0_ADDR A:0xfc186300
y.create.l HWIO_RPM_MPU_XPU_PRT3_RACR0_ADDR A:0xfc186380
y.create.l HWIO_RPM_MPU_XPU_PRT4_RACR0_ADDR A:0xfc186400
y.create.l HWIO_RPM_MPU_XPU_PRT5_RACR0_ADDR A:0xfc186480
y.create.l HWIO_RPM_MPU_XPU_PRT0_START0_ADDR A:0xfc186240
y.create.l HWIO_RPM_MPU_XPU_PRT1_START0_ADDR A:0xfc1862c0
y.create.l HWIO_RPM_MPU_XPU_PRT2_START0_ADDR A:0xfc186340
y.create.l HWIO_RPM_MPU_XPU_PRT3_START0_ADDR A:0xfc1863c0
y.create.l HWIO_RPM_MPU_XPU_PRT4_START0_ADDR A:0xfc186440
y.create.l HWIO_RPM_MPU_XPU_PRT5_START0_ADDR A:0xfc1864c0
y.create.l HWIO_RPM_MPU_XPU_PRT0_END0_ADDR A:0xfc186248
y.create.l HWIO_RPM_MPU_XPU_PRT1_END0_ADDR A:0xfc1862c8
y.create.l HWIO_RPM_MPU_XPU_PRT2_END0_ADDR A:0xfc186348
y.create.l HWIO_RPM_MPU_XPU_PRT3_END0_ADDR A:0xfc1863c8
y.create.l HWIO_RPM_MPU_XPU_PRT4_END0_ADDR A:0xfc186448
y.create.l HWIO_RPM_MPU_XPU_PRT5_END0_ADDR A:0xfc1864c8
y.create.l HWIO_RPM_MPU_XPU_PRT0_SCR_ADDR A:0xfc186250
y.create.l HWIO_RPM_MPU_XPU_PRT1_SCR_ADDR A:0xfc1862d0
y.create.l HWIO_RPM_MPU_XPU_PRT2_SCR_ADDR A:0xfc186350
y.create.l HWIO_RPM_MPU_XPU_PRT3_SCR_ADDR A:0xfc1863d0
y.create.l HWIO_RPM_MPU_XPU_PRT4_SCR_ADDR A:0xfc186450
y.create.l HWIO_RPM_MPU_XPU_PRT5_SCR_ADDR A:0xfc1864d0
y.create.l HWIO_RPM_MPU_XPU_PRT0_MCR_ADDR A:0xfc186254
y.create.l HWIO_RPM_MPU_XPU_PRT1_MCR_ADDR A:0xfc1862d4
y.create.l HWIO_RPM_MPU_XPU_PRT2_MCR_ADDR A:0xfc186354
y.create.l HWIO_RPM_MPU_XPU_PRT3_MCR_ADDR A:0xfc1863d4
y.create.l HWIO_RPM_MPU_XPU_PRT4_MCR_ADDR A:0xfc186454
y.create.l HWIO_RPM_MPU_XPU_PRT5_MCR_ADDR A:0xfc1864d4
y.create.l HWIO_RPM_MPU_XPU_PRT0_CNTL0_ADDR A:0xfc186258
y.create.l HWIO_RPM_MPU_XPU_PRT1_CNTL0_ADDR A:0xfc1862d8
y.create.l HWIO_RPM_MPU_XPU_PRT2_CNTL0_ADDR A:0xfc186358
y.create.l HWIO_RPM_MPU_XPU_PRT3_CNTL0_ADDR A:0xfc1863d8
y.create.l HWIO_RPM_MPU_XPU_PRT4_CNTL0_ADDR A:0xfc186458
y.create.l HWIO_RPM_MPU_XPU_PRT5_CNTL0_ADDR A:0xfc1864d8
y.create.l HWIO_RPM_MPU_XPU_PRT0_CNTL1_ADDR A:0xfc18625c
y.create.l HWIO_RPM_MPU_XPU_PRT1_CNTL1_ADDR A:0xfc1862dc
y.create.l HWIO_RPM_MPU_XPU_PRT2_CNTL1_ADDR A:0xfc18635c
y.create.l HWIO_RPM_MPU_XPU_PRT3_CNTL1_ADDR A:0xfc1863dc
y.create.l HWIO_RPM_MPU_XPU_PRT4_CNTL1_ADDR A:0xfc18645c
y.create.l HWIO_RPM_MPU_XPU_PRT5_CNTL1_ADDR A:0xfc1864dc
y.create.l HWIO_RPM_APU_XPU_SCR_ADDR A:0xfc187000
y.create.l HWIO_RPM_APU_XPU_SWDR_ADDR A:0xfc187004
y.create.l HWIO_RPM_APU_XPU_SEAR0_ADDR A:0xfc187040
y.create.l HWIO_RPM_APU_XPU_SESR_ADDR A:0xfc187048
y.create.l HWIO_RPM_APU_XPU_SESRRESTORE_ADDR A:0xfc18704c
y.create.l HWIO_RPM_APU_XPU_SESYNR0_ADDR A:0xfc187050
y.create.l HWIO_RPM_APU_XPU_SESYNR1_ADDR A:0xfc187054
y.create.l HWIO_RPM_APU_XPU_SESYNR2_ADDR A:0xfc187058
y.create.l HWIO_RPM_APU_XPU_MCR_ADDR A:0xfc187100
y.create.l HWIO_RPM_APU_XPU_MEAR0_ADDR A:0xfc187140
y.create.l HWIO_RPM_APU_XPU_MESR_ADDR A:0xfc187148
y.create.l HWIO_RPM_APU_XPU_MESRRESTORE_ADDR A:0xfc18714c
y.create.l HWIO_RPM_APU_XPU_MESYNR0_ADDR A:0xfc187150
y.create.l HWIO_RPM_APU_XPU_MESYNR1_ADDR A:0xfc187154
y.create.l HWIO_RPM_APU_XPU_MESYNR2_ADDR A:0xfc187158
y.create.l HWIO_RPM_APU_XPU_CR_ADDR A:0xfc187080
y.create.l HWIO_RPM_APU_XPU_RPU_ACR0_ADDR A:0xfc1870a0
y.create.l HWIO_RPM_APU_XPU_EAR0_ADDR A:0xfc1870c0
y.create.l HWIO_RPM_APU_XPU_ESR_ADDR A:0xfc1870c8
y.create.l HWIO_RPM_APU_XPU_ESRRESTORE_ADDR A:0xfc1870cc
y.create.l HWIO_RPM_APU_XPU_ESYNR0_ADDR A:0xfc1870d0
y.create.l HWIO_RPM_APU_XPU_ESYNR1_ADDR A:0xfc1870d4
y.create.l HWIO_RPM_APU_XPU_ESYNR2_ADDR A:0xfc1870d8
y.create.l HWIO_RPM_APU_XPU_IDR0_ADDR A:0xfc187074
y.create.l HWIO_RPM_APU_XPU_IDR1_ADDR A:0xfc187078
y.create.l HWIO_RPM_APU_XPU_REV_ADDR A:0xfc18707c
y.create.l HWIO_RPM_APU_XPU_RG0_RACR0_ADDR A:0xfc187200
y.create.l HWIO_RPM_APU_XPU_RG0_WACR0_ADDR A:0xfc187220
y.create.l HWIO_RPM_APU_XPU_RG0_SCR_ADDR A:0xfc187250
y.create.l HWIO_RPM_APU_XPU_RG0_MCR_ADDR A:0xfc187254
y.create.l HWIO_RPM_VMIDMT_SCR0_ADDR A:0xfc188000
y.create.l HWIO_RPM_VMIDMT_SCR1_ADDR A:0xfc188004
y.create.l HWIO_RPM_VMIDMT_SCR2_ADDR A:0xfc188008
y.create.l HWIO_RPM_VMIDMT_SACR_ADDR A:0xfc188010
y.create.l HWIO_RPM_VMIDMT_SIDR0_ADDR A:0xfc188020
y.create.l HWIO_RPM_VMIDMT_SIDR1_ADDR A:0xfc188024
y.create.l HWIO_RPM_VMIDMT_SIDR2_ADDR A:0xfc188028
y.create.l HWIO_RPM_VMIDMT_SIDR4_ADDR A:0xfc188030
y.create.l HWIO_RPM_VMIDMT_SIDR5_ADDR A:0xfc188034
y.create.l HWIO_RPM_VMIDMT_SIDR7_ADDR A:0xfc18803c
y.create.l HWIO_RPM_VMIDMT_SGFAR0_ADDR A:0xfc188040
y.create.l HWIO_RPM_VMIDMT_SGFSR_ADDR A:0xfc188048
y.create.l HWIO_RPM_VMIDMT_SGFSRRESTORE_ADDR A:0xfc18804c
y.create.l HWIO_RPM_VMIDMT_SGFSYNDR0_ADDR A:0xfc188050
y.create.l HWIO_RPM_VMIDMT_SGFSYNDR1_ADDR A:0xfc188054
y.create.l HWIO_RPM_VMIDMT_SGFSYNDR2_ADDR A:0xfc188058
y.create.l HWIO_RPM_VMIDMT_VMIDMTSCR0_ADDR A:0xfc188090
y.create.l HWIO_RPM_VMIDMT_CR0_ADDR A:0xfc188000
y.create.l HWIO_RPM_VMIDMT_CR2_ADDR A:0xfc188008
y.create.l HWIO_RPM_VMIDMT_ACR_ADDR A:0xfc188010
y.create.l HWIO_RPM_VMIDMT_IDR0_ADDR A:0xfc188020
y.create.l HWIO_RPM_VMIDMT_IDR1_ADDR A:0xfc188024
y.create.l HWIO_RPM_VMIDMT_IDR2_ADDR A:0xfc188028
y.create.l HWIO_RPM_VMIDMT_IDR4_ADDR A:0xfc188030
y.create.l HWIO_RPM_VMIDMT_IDR5_ADDR A:0xfc188034
y.create.l HWIO_RPM_VMIDMT_IDR7_ADDR A:0xfc18803c
y.create.l HWIO_RPM_VMIDMT_GFAR0_ADDR A:0xfc188040
y.create.l HWIO_RPM_VMIDMT_GFSR_ADDR A:0xfc188048
y.create.l HWIO_RPM_VMIDMT_GFSRRESTORE_ADDR A:0xfc18804c
y.create.l HWIO_RPM_VMIDMT_GFSYNDR0_ADDR A:0xfc188050
y.create.l HWIO_RPM_VMIDMT_GFSYNDR1_ADDR A:0xfc188054
y.create.l HWIO_RPM_VMIDMT_GFSYNDR2_ADDR A:0xfc188058
y.create.l HWIO_RPM_VMIDMT_VMIDMTCR0_ADDR A:0xfc188090
y.create.l HWIO_RPM_VMIDMT_VMIDMTACR_ADDR A:0xfc18809c
y.create.l HWIO_RPM_VMIDMT_NSCR0_ADDR A:0xfc188400
y.create.l HWIO_RPM_VMIDMT_NSCR2_ADDR A:0xfc188408
y.create.l HWIO_RPM_VMIDMT_NSACR_ADDR A:0xfc188410
y.create.l HWIO_RPM_VMIDMT_NSGFAR0_ADDR A:0xfc188440
y.create.l HWIO_RPM_VMIDMT_NSGFSR_ADDR A:0xfc188448
y.create.l HWIO_RPM_VMIDMT_NSGFSRRESTORE_ADDR A:0xfc18844c
y.create.l HWIO_RPM_VMIDMT_NSGFSYNDR0_ADDR A:0xfc188450
y.create.l HWIO_RPM_VMIDMT_NSGFSYNDR1_ADDR A:0xfc188454
y.create.l HWIO_RPM_VMIDMT_NSGFSYNDR2_ADDR A:0xfc188458
y.create.l HWIO_RPM_VMIDMT_NSVMIDMTCR0_ADDR A:0xfc188490
y.create.l HWIO_RPM_VMIDMT_SSDR0_ADDR A:0xfc188080
y.create.l HWIO_RPM_VMIDMT_MSDR0_ADDR A:0xfc188480
y.create.l HWIO_RPM_VMIDMT_MCR_ADDR A:0xfc188494
y.create.l HWIO_RPM_VMIDMT_S2VR0_ADDR A:0xfc188c00
y.create.l HWIO_RPM_VMIDMT_AS2VR0_ADDR A:0xfc188e00
y.create.l HWIO_RPM_MSG_RAM_XPU_SCR_ADDR A:0xfc420000
y.create.l HWIO_RPM_MSG_RAM_XPU_SWDR_ADDR A:0xfc420004
y.create.l HWIO_RPM_MSG_RAM_XPU_SEAR0_ADDR A:0xfc420040
y.create.l HWIO_RPM_MSG_RAM_XPU_SESR_ADDR A:0xfc420048
y.create.l HWIO_RPM_MSG_RAM_XPU_SESRRESTORE_ADDR A:0xfc42004c
y.create.l HWIO_RPM_MSG_RAM_XPU_SESYNR0_ADDR A:0xfc420050
y.create.l HWIO_RPM_MSG_RAM_XPU_SESYNR1_ADDR A:0xfc420054
y.create.l HWIO_RPM_MSG_RAM_XPU_SESYNR2_ADDR A:0xfc420058
y.create.l HWIO_RPM_MSG_RAM_XPU_MCR_ADDR A:0xfc420100
y.create.l HWIO_RPM_MSG_RAM_XPU_MEAR0_ADDR A:0xfc420140
y.create.l HWIO_RPM_MSG_RAM_XPU_MESR_ADDR A:0xfc420148
y.create.l HWIO_RPM_MSG_RAM_XPU_MESRRESTORE_ADDR A:0xfc42014c
y.create.l HWIO_RPM_MSG_RAM_XPU_MESYNR0_ADDR A:0xfc420150
y.create.l HWIO_RPM_MSG_RAM_XPU_MESYNR1_ADDR A:0xfc420154
y.create.l HWIO_RPM_MSG_RAM_XPU_MESYNR2_ADDR A:0xfc420158
y.create.l HWIO_RPM_MSG_RAM_XPU_CR_ADDR A:0xfc420080
y.create.l HWIO_RPM_MSG_RAM_XPU_RPU_ACR0_ADDR A:0xfc4200a0
y.create.l HWIO_RPM_MSG_RAM_XPU_EAR0_ADDR A:0xfc4200c0
y.create.l HWIO_RPM_MSG_RAM_XPU_ESR_ADDR A:0xfc4200c8
y.create.l HWIO_RPM_MSG_RAM_XPU_ESRRESTORE_ADDR A:0xfc4200cc
y.create.l HWIO_RPM_MSG_RAM_XPU_ESYNR0_ADDR A:0xfc4200d0
y.create.l HWIO_RPM_MSG_RAM_XPU_ESYNR1_ADDR A:0xfc4200d4
y.create.l HWIO_RPM_MSG_RAM_XPU_ESYNR2_ADDR A:0xfc4200d8
y.create.l HWIO_RPM_MSG_RAM_XPU_IDR0_ADDR A:0xfc420074
y.create.l HWIO_RPM_MSG_RAM_XPU_IDR1_ADDR A:0xfc420078
y.create.l HWIO_RPM_MSG_RAM_XPU_REV_ADDR A:0xfc42007c
y.create.l HWIO_RPM_MSG_RAM_XPU_RG0_RACR0_ADDR A:0xfc420200
y.create.l HWIO_RPM_MSG_RAM_XPU_RG1_RACR0_ADDR A:0xfc420280
y.create.l HWIO_RPM_MSG_RAM_XPU_RG2_RACR0_ADDR A:0xfc420300
y.create.l HWIO_RPM_MSG_RAM_XPU_RG3_RACR0_ADDR A:0xfc420380
y.create.l HWIO_RPM_MSG_RAM_XPU_RG4_RACR0_ADDR A:0xfc420400
y.create.l HWIO_RPM_MSG_RAM_XPU_RG5_RACR0_ADDR A:0xfc420480
y.create.l HWIO_RPM_MSG_RAM_XPU_RG6_RACR0_ADDR A:0xfc420500
y.create.l HWIO_RPM_MSG_RAM_XPU_RG7_RACR0_ADDR A:0xfc420580
y.create.l HWIO_RPM_MSG_RAM_XPU_RG8_RACR0_ADDR A:0xfc420600
y.create.l HWIO_RPM_MSG_RAM_XPU_RG9_RACR0_ADDR A:0xfc420680
y.create.l HWIO_RPM_MSG_RAM_XPU_RG0_SCR_ADDR A:0xfc420250
y.create.l HWIO_RPM_MSG_RAM_XPU_RG1_SCR_ADDR A:0xfc4202d0
y.create.l HWIO_RPM_MSG_RAM_XPU_RG2_SCR_ADDR A:0xfc420350
y.create.l HWIO_RPM_MSG_RAM_XPU_RG3_SCR_ADDR A:0xfc4203d0
y.create.l HWIO_RPM_MSG_RAM_XPU_RG4_SCR_ADDR A:0xfc420450
y.create.l HWIO_RPM_MSG_RAM_XPU_RG5_SCR_ADDR A:0xfc4204d0
y.create.l HWIO_RPM_MSG_RAM_XPU_RG6_SCR_ADDR A:0xfc420550
y.create.l HWIO_RPM_MSG_RAM_XPU_RG7_SCR_ADDR A:0xfc4205d0
y.create.l HWIO_RPM_MSG_RAM_XPU_RG8_SCR_ADDR A:0xfc420650
y.create.l HWIO_RPM_MSG_RAM_XPU_RG9_SCR_ADDR A:0xfc4206d0
y.create.l HWIO_RPM_MSG_RAM_XPU_RG0_MCR_ADDR A:0xfc420254
y.create.l HWIO_RPM_MSG_RAM_XPU_RG1_MCR_ADDR A:0xfc4202d4
y.create.l HWIO_RPM_MSG_RAM_XPU_RG2_MCR_ADDR A:0xfc420354
y.create.l HWIO_RPM_MSG_RAM_XPU_RG3_MCR_ADDR A:0xfc4203d4
y.create.l HWIO_RPM_MSG_RAM_XPU_RG4_MCR_ADDR A:0xfc420454
y.create.l HWIO_RPM_MSG_RAM_XPU_RG5_MCR_ADDR A:0xfc4204d4
y.create.l HWIO_RPM_MSG_RAM_XPU_RG6_MCR_ADDR A:0xfc420554
y.create.l HWIO_RPM_MSG_RAM_XPU_RG7_MCR_ADDR A:0xfc4205d4
y.create.l HWIO_RPM_MSG_RAM_XPU_RG8_MCR_ADDR A:0xfc420654
y.create.l HWIO_RPM_MSG_RAM_XPU_RG9_MCR_ADDR A:0xfc4206d4
y.create.l HWIO_QFPROM_RAW_ACC_PRIVATE0_ADDR A:0xfc4b8000
y.create.l HWIO_QFPROM_RAW_ACC_PRIVATE1_ADDR A:0xfc4b8004
y.create.l HWIO_QFPROM_RAW_ACC_PRIVATE2_ADDR A:0xfc4b8008
y.create.l HWIO_QFPROM_RAW_ACC_PRIVATE3_ADDR A:0xfc4b800c
y.create.l HWIO_QFPROM_RAW_ACC_PRIVATE4_ADDR A:0xfc4b8010
y.create.l HWIO_QFPROM_RAW_ACC_PRIVATE5_ADDR A:0xfc4b8014
y.create.l HWIO_QFPROM_RAW_ACC_PRIVATE6_ADDR A:0xfc4b8018
y.create.l HWIO_QFPROM_RAW_ACC_PRIVATE7_ADDR A:0xfc4b801c
y.create.l HWIO_QFPROM_RAW_ACC_PRIVATE8_ADDR A:0xfc4b8020
y.create.l HWIO_QFPROM_RAW_ACC_PRIVATE9_ADDR A:0xfc4b8024
y.create.l HWIO_QFPROM_RAW_JTAG_ID_LSB_ADDR A:0xfc4b80a0
y.create.l HWIO_QFPROM_RAW_JTAG_ID_MSB_ADDR A:0xfc4b80a4
y.create.l HWIO_QFPROM_RAW_RD_PERM_LSB_ADDR A:0xfc4b80a8
y.create.l HWIO_QFPROM_RAW_RD_PERM_MSB_ADDR A:0xfc4b80ac
y.create.l HWIO_QFPROM_RAW_WR_PERM_LSB_ADDR A:0xfc4b80b0
y.create.l HWIO_QFPROM_RAW_WR_PERM_MSB_ADDR A:0xfc4b80b4
y.create.l HWIO_QFPROM_RAW_PTE_LSB_ADDR A:0xfc4b80b8
y.create.l HWIO_QFPROM_RAW_PTE_MSB_ADDR A:0xfc4b80bc
y.create.l HWIO_QFPROM_RAW_AP_ANTI_ROLLBACK_ROW0_LSB_ADDR A:0xfc4b80c0
y.create.l HWIO_QFPROM_RAW_AP_ANTI_ROLLBACK_ROW0_MSB_ADDR A:0xfc4b80c4
y.create.l HWIO_QFPROM_RAW_AP_ANTI_ROLLBACK_ROW1_LSB_ADDR A:0xfc4b80c8
y.create.l HWIO_QFPROM_RAW_AP_ANTI_ROLLBACK_ROW1_MSB_ADDR A:0xfc4b80cc
y.create.l HWIO_QFPROM_RAW_MSA_ANTI_ROLLBACK_LSB_ADDR A:0xfc4b80d0
y.create.l HWIO_QFPROM_RAW_MSA_ANTI_ROLLBACK_MSB_ADDR A:0xfc4b80d4
y.create.l HWIO_QFPROM_RAW_SPARE_REG7_LSB_ADDR A:0xfc4b80d8
y.create.l HWIO_QFPROM_RAW_SPARE_REG7_MSB_ADDR A:0xfc4b80dc
y.create.l HWIO_QFPROM_RAW_SPARE_REG8_LSB_ADDR A:0xfc4b80e0
y.create.l HWIO_QFPROM_RAW_SPARE_REG8_MSB_ADDR A:0xfc4b80e4
y.create.l HWIO_QFPROM_RAW_SPARE_REG9_LSB_ADDR A:0xfc4b80e8
y.create.l HWIO_QFPROM_RAW_SPARE_REG9_MSB_ADDR A:0xfc4b80ec
y.create.l HWIO_QFPROM_RAW_OEM_CONFIG_ROW0_LSB_ADDR A:0xfc4b80f0
y.create.l HWIO_QFPROM_RAW_OEM_CONFIG_ROW0_MSB_ADDR A:0xfc4b80f4
y.create.l HWIO_QFPROM_RAW_OEM_CONFIG_ROW1_LSB_ADDR A:0xfc4b80f8
y.create.l HWIO_QFPROM_RAW_OEM_CONFIG_ROW1_MSB_ADDR A:0xfc4b80fc
y.create.l HWIO_QFPROM_RAW_FEAT_CONFIG_ROW0_LSB_ADDR A:0xfc4b8100
y.create.l HWIO_QFPROM_RAW_FEAT_CONFIG_ROW0_MSB_ADDR A:0xfc4b8104
y.create.l HWIO_QFPROM_RAW_FEAT_CONFIG_ROW1_LSB_ADDR A:0xfc4b8108
y.create.l HWIO_QFPROM_RAW_FEAT_CONFIG_ROW1_MSB_ADDR A:0xfc4b810c
y.create.l HWIO_QFPROM_RAW_FEAT_CONFIG_ROW2_LSB_ADDR A:0xfc4b8110
y.create.l HWIO_QFPROM_RAW_FEAT_CONFIG_ROW2_MSB_ADDR A:0xfc4b8114
y.create.l HWIO_QFPROM_RAW_FEAT_CONFIG_ROW3_LSB_ADDR A:0xfc4b8118
y.create.l HWIO_QFPROM_RAW_FEAT_CONFIG_ROW3_MSB_ADDR A:0xfc4b811c
y.create.l HWIO_QFPROM_RAW_MEM_REDUN0_ADDR A:0xfc4b8120
y.create.l HWIO_QFPROM_RAW_MEM_REDUN1_ADDR A:0xfc4b8124
y.create.l HWIO_QFPROM_RAW_MEM_REDUN2_ADDR A:0xfc4b8128
y.create.l HWIO_QFPROM_RAW_MEM_REDUN3_ADDR A:0xfc4b812c
y.create.l HWIO_QFPROM_RAW_MEM_REDUN4_ADDR A:0xfc4b8130
y.create.l HWIO_QFPROM_RAW_MEM_REDUN5_ADDR A:0xfc4b8134
y.create.l HWIO_QFPROM_RAW_MEM_REDUN6_ADDR A:0xfc4b8138
y.create.l HWIO_QFPROM_RAW_MEM_REDUN7_ADDR A:0xfc4b813c
y.create.l HWIO_QFPROM_RAW_MEM_REDUN8_ADDR A:0xfc4b8140
y.create.l HWIO_QFPROM_RAW_MEM_REDUN9_ADDR A:0xfc4b8144
y.create.l HWIO_QFPROM_RAW_DEBUG_KEY_LSB_ADDR A:0xfc4b8188
y.create.l HWIO_QFPROM_RAW_DEBUG_KEY_MSB_ADDR A:0xfc4b818c
y.create.l HWIO_QFPROM_RAW_MEM_ACCEL_ROW0_LSB_ADDR A:0xfc4b8190
y.create.l HWIO_QFPROM_RAW_MEM_ACCEL_ROW0_MSB_ADDR A:0xfc4b8194
y.create.l HWIO_QFPROM_RAW_MEM_ACCEL_ROW1_LSB_ADDR A:0xfc4b8198
y.create.l HWIO_QFPROM_RAW_MEM_ACCEL_ROW1_MSB_ADDR A:0xfc4b819c
y.create.l HWIO_QFPROM_RAW_CALIB_ROW0_LSB_ADDR A:0xfc4b81a0
y.create.l HWIO_QFPROM_RAW_CALIB_ROW0_MSB_ADDR A:0xfc4b81a4
y.create.l HWIO_QFPROM_RAW_CALIB_ROW1_LSB_ADDR A:0xfc4b81a8
y.create.l HWIO_QFPROM_RAW_CALIB_ROW1_MSB_ADDR A:0xfc4b81ac
y.create.l HWIO_QFPROM_RAW_FEC_EN_LSB_ADDR A:0xfc4b81b0
y.create.l HWIO_QFPROM_RAW_FEC_EN_MSB_ADDR A:0xfc4b81b4
y.create.l HWIO_QFPROM_RAW_INTAGLIO_GLUEBIT_LSB_ADDR A:0xfc4b81b8
y.create.l HWIO_QFPROM_RAW_INTAGLIO_GLUEBIT_MSB_ADDR A:0xfc4b81bc
y.create.l HWIO_QFPROM_RAW_CUST_KEY_ROW0_LSB_ADDR A:0xfc4b81c0
y.create.l HWIO_QFPROM_RAW_CUST_KEY_ROW1_LSB_ADDR A:0xfc4b81c8
y.create.l HWIO_QFPROM_RAW_CUST_KEY_ROW2_LSB_ADDR A:0xfc4b81d0
y.create.l HWIO_QFPROM_RAW_CUST_KEY_ROW0_MSB_ADDR A:0xfc4b81c4
y.create.l HWIO_QFPROM_RAW_CUST_KEY_ROW1_MSB_ADDR A:0xfc4b81cc
y.create.l HWIO_QFPROM_RAW_CUST_KEY_ROW2_MSB_ADDR A:0xfc4b81d4
y.create.l HWIO_QFPROM_RAW_SERIAL_NUM_LSB_ADDR A:0xfc4b81d8
y.create.l HWIO_QFPROM_RAW_SERIAL_NUM_MSB_ADDR A:0xfc4b81dc
y.create.l HWIO_QFPROM_RAW_SPARE_REG20_ROW0_LSB_ADDR A:0xfc4b81e0
y.create.l HWIO_QFPROM_RAW_SPARE_REG20_ROW0_MSB_ADDR A:0xfc4b81e4
y.create.l HWIO_QFPROM_RAW_SPARE_REG20_ROW1_LSB_ADDR A:0xfc4b81e8
y.create.l HWIO_QFPROM_RAW_SPARE_REG20_ROW1_MSB_ADDR A:0xfc4b81ec
y.create.l HWIO_QFPROM_RAW_ROM_PATCH_ROW0_LSB_ADDR A:0xfc4b81f0
y.create.l HWIO_QFPROM_RAW_ROM_PATCH_ROW1_LSB_ADDR A:0xfc4b81f8
y.create.l HWIO_QFPROM_RAW_ROM_PATCH_ROW2_LSB_ADDR A:0xfc4b8200
y.create.l HWIO_QFPROM_RAW_ROM_PATCH_ROW3_LSB_ADDR A:0xfc4b8208
y.create.l HWIO_QFPROM_RAW_ROM_PATCH_ROW4_LSB_ADDR A:0xfc4b8210
y.create.l HWIO_QFPROM_RAW_ROM_PATCH_ROW5_LSB_ADDR A:0xfc4b8218
y.create.l HWIO_QFPROM_RAW_ROM_PATCH_ROW6_LSB_ADDR A:0xfc4b8220
y.create.l HWIO_QFPROM_RAW_ROM_PATCH_ROW7_LSB_ADDR A:0xfc4b8228
y.create.l HWIO_QFPROM_RAW_ROM_PATCH_ROW8_LSB_ADDR A:0xfc4b8230
y.create.l HWIO_QFPROM_RAW_ROM_PATCH_ROW9_LSB_ADDR A:0xfc4b8238
y.create.l HWIO_QFPROM_RAW_ROM_PATCH_ROW0_MSB_ADDR A:0xfc4b81f4
y.create.l HWIO_QFPROM_RAW_ROM_PATCH_ROW1_MSB_ADDR A:0xfc4b81fc
y.create.l HWIO_QFPROM_RAW_ROM_PATCH_ROW2_MSB_ADDR A:0xfc4b8204
y.create.l HWIO_QFPROM_RAW_ROM_PATCH_ROW3_MSB_ADDR A:0xfc4b820c
y.create.l HWIO_QFPROM_RAW_ROM_PATCH_ROW4_MSB_ADDR A:0xfc4b8214
y.create.l HWIO_QFPROM_RAW_ROM_PATCH_ROW5_MSB_ADDR A:0xfc4b821c
y.create.l HWIO_QFPROM_RAW_ROM_PATCH_ROW6_MSB_ADDR A:0xfc4b8224
y.create.l HWIO_QFPROM_RAW_ROM_PATCH_ROW7_MSB_ADDR A:0xfc4b822c
y.create.l HWIO_QFPROM_RAW_ROM_PATCH_ROW8_MSB_ADDR A:0xfc4b8234
y.create.l HWIO_QFPROM_RAW_ROM_PATCH_ROW9_MSB_ADDR A:0xfc4b823c
y.create.l HWIO_QFPROM_RAW_PRI_KEY_DERIVATION_KEY_ROW0_LSB_ADDR A:0xfc4b8370
y.create.l HWIO_QFPROM_RAW_PRI_KEY_DERIVATION_KEY_ROW1_LSB_ADDR A:0xfc4b8378
y.create.l HWIO_QFPROM_RAW_PRI_KEY_DERIVATION_KEY_ROW2_LSB_ADDR A:0xfc4b8380
y.create.l HWIO_QFPROM_RAW_PRI_KEY_DERIVATION_KEY_ROW3_LSB_ADDR A:0xfc4b8388
y.create.l HWIO_QFPROM_RAW_PRI_KEY_DERIVATION_KEY_ROW0_MSB_ADDR A:0xfc4b8374
y.create.l HWIO_QFPROM_RAW_PRI_KEY_DERIVATION_KEY_ROW1_MSB_ADDR A:0xfc4b837c
y.create.l HWIO_QFPROM_RAW_PRI_KEY_DERIVATION_KEY_ROW2_MSB_ADDR A:0xfc4b8384
y.create.l HWIO_QFPROM_RAW_PRI_KEY_DERIVATION_KEY_ROW3_MSB_ADDR A:0xfc4b838c
y.create.l HWIO_QFPROM_RAW_PRI_KEY_DERIVATION_KEY_ROW4_LSB_ADDR A:0xfc4b8390
y.create.l HWIO_QFPROM_RAW_PRI_KEY_DERIVATION_KEY_ROW4_MSB_ADDR A:0xfc4b8394
y.create.l HWIO_QFPROM_RAW_SEC_KEY_DERIVATION_KEY_ROW0_LSB_ADDR A:0xfc4b8398
y.create.l HWIO_QFPROM_RAW_SEC_KEY_DERIVATION_KEY_ROW1_LSB_ADDR A:0xfc4b83a0
y.create.l HWIO_QFPROM_RAW_SEC_KEY_DERIVATION_KEY_ROW2_LSB_ADDR A:0xfc4b83a8
y.create.l HWIO_QFPROM_RAW_SEC_KEY_DERIVATION_KEY_ROW3_LSB_ADDR A:0xfc4b83b0
y.create.l HWIO_QFPROM_RAW_SEC_KEY_DERIVATION_KEY_ROW0_MSB_ADDR A:0xfc4b839c
y.create.l HWIO_QFPROM_RAW_SEC_KEY_DERIVATION_KEY_ROW1_MSB_ADDR A:0xfc4b83a4
y.create.l HWIO_QFPROM_RAW_SEC_KEY_DERIVATION_KEY_ROW2_MSB_ADDR A:0xfc4b83ac
y.create.l HWIO_QFPROM_RAW_SEC_KEY_DERIVATION_KEY_ROW3_MSB_ADDR A:0xfc4b83b4
y.create.l HWIO_QFPROM_RAW_SEC_KEY_DERIVATION_KEY_ROW4_LSB_ADDR A:0xfc4b83b8
y.create.l HWIO_QFPROM_RAW_SEC_KEY_DERIVATION_KEY_ROW4_MSB_ADDR A:0xfc4b83bc
y.create.l HWIO_QFPROM_RAW_OEM_PK_HASH_ROW0_LSB_ADDR A:0xfc4b83c0
y.create.l HWIO_QFPROM_RAW_OEM_PK_HASH_ROW1_LSB_ADDR A:0xfc4b83c8
y.create.l HWIO_QFPROM_RAW_OEM_PK_HASH_ROW2_LSB_ADDR A:0xfc4b83d0
y.create.l HWIO_QFPROM_RAW_OEM_PK_HASH_ROW3_LSB_ADDR A:0xfc4b83d8
y.create.l HWIO_QFPROM_RAW_OEM_PK_HASH_ROW0_MSB_ADDR A:0xfc4b83c4
y.create.l HWIO_QFPROM_RAW_OEM_PK_HASH_ROW1_MSB_ADDR A:0xfc4b83cc
y.create.l HWIO_QFPROM_RAW_OEM_PK_HASH_ROW2_MSB_ADDR A:0xfc4b83d4
y.create.l HWIO_QFPROM_RAW_OEM_PK_HASH_ROW3_MSB_ADDR A:0xfc4b83dc
y.create.l HWIO_QFPROM_RAW_OEM_PK_HASH_ROW4_LSB_ADDR A:0xfc4b83e0
y.create.l HWIO_QFPROM_RAW_OEM_PK_HASH_ROW4_MSB_ADDR A:0xfc4b83e4
y.create.l HWIO_QFPROM_RAW_OEM_SEC_BOOT_ROW0_LSB_ADDR A:0xfc4b83e8
y.create.l HWIO_QFPROM_RAW_OEM_SEC_BOOT_ROW0_MSB_ADDR A:0xfc4b83ec
y.create.l HWIO_QFPROM_RAW_QC_SEC_BOOT_ROW0_LSB_ADDR A:0xfc4b83f0
y.create.l HWIO_QFPROM_RAW_QC_SEC_BOOT_ROW0_MSB_ADDR A:0xfc4b83f4
y.create.l HWIO_QFPROM_RAW_USB_VID_PID_LSB_ADDR A:0xfc4b83f8
y.create.l HWIO_QFPROM_RAW_USB_VID_PID_MSB_ADDR A:0xfc4b83fc
y.create.l HWIO_ACC_IR_ADDR A:0xfc4ba000
y.create.l HWIO_ACC_DR_ADDR A:0xfc4ba004
y.create.l HWIO_ACC_VERID_ADDR A:0xfc4ba008
y.create.l HWIO_ACC_FEATSET0_ADDR A:0xfc4ba010
y.create.l HWIO_ACC_FEATSET1_ADDR A:0xfc4ba014
y.create.l HWIO_ACC_FEATSET2_ADDR A:0xfc4ba018
y.create.l HWIO_ACC_FEATSET3_ADDR A:0xfc4ba01c
y.create.l HWIO_ACC_FEATSET4_ADDR A:0xfc4ba020
y.create.l HWIO_ACC_FEATSET5_ADDR A:0xfc4ba024
y.create.l HWIO_ACC_FEATSET6_ADDR A:0xfc4ba028
y.create.l HWIO_ACC_FEATSET7_ADDR A:0xfc4ba02c
y.create.l HWIO_QFPROM_BLOW_TIMER_ADDR A:0xfc4ba038
y.create.l HWIO_QFPROM_TEST_CTRL_ADDR A:0xfc4ba03c
y.create.l HWIO_QFPROM_ACCEL_ADDR A:0xfc4ba040
y.create.l HWIO_ACC_STATE_ADDR A:0xfc4ba044
y.create.l HWIO_QFPROM_BLOW_STATUS_ADDR A:0xfc4ba048
y.create.l HWIO_HW_KEY_STATUS_ADDR A:0xfc4ba04c
y.create.l HWIO_QFPROM_BIST_CTRL_ADDR A:0xfc4ba050
y.create.l HWIO_QFPROM_BIST_ERROR_ADDR A:0xfc4ba054
y.create.l HWIO_QFPROM_HASH_SIGNATURE0_ADDR A:0xfc4ba060
y.create.l HWIO_QFPROM_HASH_SIGNATURE1_ADDR A:0xfc4ba064
y.create.l HWIO_QFPROM_HASH_SIGNATURE2_ADDR A:0xfc4ba068
y.create.l HWIO_QFPROM_HASH_SIGNATURE3_ADDR A:0xfc4ba06c
y.create.l HWIO_QFPROM_HASH_SIGNATURE4_ADDR A:0xfc4ba070
y.create.l HWIO_QFPROM_HASH_SIGNATURE5_ADDR A:0xfc4ba074
y.create.l HWIO_QFPROM_HASH_SIGNATURE6_ADDR A:0xfc4ba078
y.create.l HWIO_QFPROM_HASH_SIGNATURE7_ADDR A:0xfc4ba07c
y.create.l HWIO_FEC_ESR_ADDR A:0xfc4ba080
y.create.l HWIO_FEC_EAR_ADDR A:0xfc4ba084
y.create.l HWIO_RESET_JDR_STATUS_ADDR A:0xfc4ba088
y.create.l HWIO_QFPROM_ROM_ERROR_ADDR A:0xfc4ba090
y.create.l HWIO_QFPROM0_MATCH_STATUS_ADDR A:0xfc4ba094
y.create.l HWIO_QFPROM1_MATCH_STATUS_ADDR A:0xfc4ba098
y.create.l HWIO_QFPROM_CORR_ACC_PRIVATE0_ADDR A:0xfc4bc000
y.create.l HWIO_QFPROM_CORR_ACC_PRIVATE1_ADDR A:0xfc4bc004
y.create.l HWIO_QFPROM_CORR_ACC_PRIVATE2_ADDR A:0xfc4bc008
y.create.l HWIO_QFPROM_CORR_ACC_PRIVATE3_ADDR A:0xfc4bc00c
y.create.l HWIO_QFPROM_CORR_ACC_PRIVATE4_ADDR A:0xfc4bc010
y.create.l HWIO_QFPROM_CORR_ACC_PRIVATE5_ADDR A:0xfc4bc014
y.create.l HWIO_QFPROM_CORR_ACC_PRIVATE6_ADDR A:0xfc4bc018
y.create.l HWIO_QFPROM_CORR_ACC_PRIVATE7_ADDR A:0xfc4bc01c
y.create.l HWIO_QFPROM_CORR_ACC_PRIVATE8_ADDR A:0xfc4bc020
y.create.l HWIO_QFPROM_CORR_ACC_PRIVATE9_ADDR A:0xfc4bc024
y.create.l HWIO_QFPROM_CORR_JTAG_ID_LSB_ADDR A:0xfc4bc0a0
y.create.l HWIO_QFPROM_CORR_JTAG_ID_MSB_ADDR A:0xfc4bc0a4
y.create.l HWIO_QFPROM_CORR_RD_PERM_LSB_ADDR A:0xfc4bc0a8
y.create.l HWIO_QFPROM_CORR_RD_PERM_MSB_ADDR A:0xfc4bc0ac
y.create.l HWIO_QFPROM_CORR_WR_PERM_LSB_ADDR A:0xfc4bc0b0
y.create.l HWIO_QFPROM_CORR_WR_PERM_MSB_ADDR A:0xfc4bc0b4
y.create.l HWIO_QFPROM_CORR_PTE_LSB_ADDR A:0xfc4bc0b8
y.create.l HWIO_QFPROM_CORR_PTE_MSB_ADDR A:0xfc4bc0bc
y.create.l HWIO_QFPROM_CORR_AP_ANTI_ROLLBACK_ROW0_LSB_ADDR A:0xfc4bc0c0
y.create.l HWIO_QFPROM_CORR_AP_ANTI_ROLLBACK_ROW0_MSB_ADDR A:0xfc4bc0c4
y.create.l HWIO_QFPROM_CORR_AP_ANTI_ROLLBACK_ROW1_LSB_ADDR A:0xfc4bc0c8
y.create.l HWIO_QFPROM_CORR_AP_ANTI_ROLLBACK_ROW1_MSB_ADDR A:0xfc4bc0cc
y.create.l HWIO_QFPROM_CORR_MSA_ANTI_ROLLBACK_LSB_ADDR A:0xfc4bc0d0
y.create.l HWIO_QFPROM_CORR_MSA_ANTI_ROLLBACK_MSB_ADDR A:0xfc4bc0d4
y.create.l HWIO_QFPROM_CORR_SPARE_REG7_LSB_ADDR A:0xfc4bc0d8
y.create.l HWIO_QFPROM_CORR_SPARE_REG7_MSB_ADDR A:0xfc4bc0dc
y.create.l HWIO_QFPROM_CORR_SPARE_REG8_LSB_ADDR A:0xfc4bc0e0
y.create.l HWIO_QFPROM_CORR_SPARE_REG8_MSB_ADDR A:0xfc4bc0e4
y.create.l HWIO_QFPROM_CORR_SPARE_REG9_LSB_ADDR A:0xfc4bc0e8
y.create.l HWIO_QFPROM_CORR_SPARE_REG9_MSB_ADDR A:0xfc4bc0ec
y.create.l HWIO_QFPROM_CORR_OEM_CONFIG_ROW0_LSB_ADDR A:0xfc4bc0f0
y.create.l HWIO_QFPROM_CORR_OEM_CONFIG_ROW0_MSB_ADDR A:0xfc4bc0f4
y.create.l HWIO_QFPROM_CORR_OEM_CONFIG_ROW1_LSB_ADDR A:0xfc4bc0f8
y.create.l HWIO_QFPROM_CORR_OEM_CONFIG_ROW1_MSB_ADDR A:0xfc4bc0fc
y.create.l HWIO_QFPROM_CORR_FEAT_CONFIG_ROW0_LSB_ADDR A:0xfc4bc100
y.create.l HWIO_QFPROM_CORR_FEAT_CONFIG_ROW0_MSB_ADDR A:0xfc4bc104
y.create.l HWIO_QFPROM_CORR_FEAT_CONFIG_ROW1_LSB_ADDR A:0xfc4bc108
y.create.l HWIO_QFPROM_CORR_FEAT_CONFIG_ROW1_MSB_ADDR A:0xfc4bc10c
y.create.l HWIO_QFPROM_CORR_FEAT_CONFIG_ROW2_LSB_ADDR A:0xfc4bc110
y.create.l HWIO_QFPROM_CORR_FEAT_CONFIG_ROW2_MSB_ADDR A:0xfc4bc114
y.create.l HWIO_QFPROM_CORR_FEAT_CONFIG_ROW3_LSB_ADDR A:0xfc4bc118
y.create.l HWIO_QFPROM_CORR_FEAT_CONFIG_ROW3_MSB_ADDR A:0xfc4bc11c
y.create.l HWIO_QFPROM_CORR_MEM_REDUN0_ADDR A:0xfc4bc120
y.create.l HWIO_QFPROM_CORR_MEM_REDUN1_ADDR A:0xfc4bc124
y.create.l HWIO_QFPROM_CORR_MEM_REDUN2_ADDR A:0xfc4bc128
y.create.l HWIO_QFPROM_CORR_MEM_REDUN3_ADDR A:0xfc4bc12c
y.create.l HWIO_QFPROM_CORR_MEM_REDUN4_ADDR A:0xfc4bc130
y.create.l HWIO_QFPROM_CORR_MEM_REDUN5_ADDR A:0xfc4bc134
y.create.l HWIO_QFPROM_CORR_MEM_REDUN6_ADDR A:0xfc4bc138
y.create.l HWIO_QFPROM_CORR_MEM_REDUN7_ADDR A:0xfc4bc13c
y.create.l HWIO_QFPROM_CORR_MEM_REDUN8_ADDR A:0xfc4bc140
y.create.l HWIO_QFPROM_CORR_MEM_REDUN9_ADDR A:0xfc4bc144
y.create.l HWIO_QFPROM_CORR_DEBUG_KEY_LSB_ADDR A:0xfc4bc188
y.create.l HWIO_QFPROM_CORR_DEBUG_KEY_MSB_ADDR A:0xfc4bc18c
y.create.l HWIO_QFPROM_CORR_MEM_ACCEL_ROW0_LSB_ADDR A:0xfc4bc190
y.create.l HWIO_QFPROM_CORR_MEM_ACCEL_ROW0_MSB_ADDR A:0xfc4bc194
y.create.l HWIO_QFPROM_CORR_MEM_ACCEL_ROW1_LSB_ADDR A:0xfc4bc198
y.create.l HWIO_QFPROM_CORR_MEM_ACCEL_ROW1_MSB_ADDR A:0xfc4bc19c
y.create.l HWIO_QFPROM_CORR_CALIB_ROW0_LSB_ADDR A:0xfc4bc1a0
y.create.l HWIO_QFPROM_CORR_CALIB_ROW0_MSB_ADDR A:0xfc4bc1a4
y.create.l HWIO_QFPROM_CORR_CALIB_ROW1_LSB_ADDR A:0xfc4bc1a8
y.create.l HWIO_QFPROM_CORR_CALIB_ROW1_MSB_ADDR A:0xfc4bc1ac
y.create.l HWIO_QFPROM_CORR_FEC_EN_LSB_ADDR A:0xfc4bc1b0
y.create.l HWIO_QFPROM_CORR_FEC_EN_MSB_ADDR A:0xfc4bc1b4
y.create.l HWIO_QFPROM_CORR_INTAGLIO_GLUEBIT_LSB_ADDR A:0xfc4bc1b8
y.create.l HWIO_QFPROM_CORR_INTAGLIO_GLUEBIT_MSB_ADDR A:0xfc4bc1bc
y.create.l HWIO_QFPROM_CORR_CUST_KEY_ROW0_LSB_ADDR A:0xfc4bc1c0
y.create.l HWIO_QFPROM_CORR_CUST_KEY_ROW1_LSB_ADDR A:0xfc4bc1c8
y.create.l HWIO_QFPROM_CORR_CUST_KEY_ROW2_LSB_ADDR A:0xfc4bc1d0
y.create.l HWIO_QFPROM_CORR_CUST_KEY_ROW0_MSB_ADDR A:0xfc4bc1c4
y.create.l HWIO_QFPROM_CORR_CUST_KEY_ROW1_MSB_ADDR A:0xfc4bc1cc
y.create.l HWIO_QFPROM_CORR_CUST_KEY_ROW2_MSB_ADDR A:0xfc4bc1d4
y.create.l HWIO_QFPROM_CORR_SERIAL_NUM_LSB_ADDR A:0xfc4bc1d8
y.create.l HWIO_QFPROM_CORR_SERIAL_NUM_MSB_ADDR A:0xfc4bc1dc
y.create.l HWIO_QFPROM_CORR_SPARE_REG20_ROW0_LSB_ADDR A:0xfc4bc1e0
y.create.l HWIO_QFPROM_CORR_SPARE_REG20_ROW0_MSB_ADDR A:0xfc4bc1e4
y.create.l HWIO_QFPROM_CORR_SPARE_REG20_ROW1_LSB_ADDR A:0xfc4bc1e8
y.create.l HWIO_QFPROM_CORR_SPARE_REG20_ROW1_MSB_ADDR A:0xfc4bc1ec
y.create.l HWIO_QFPROM_CORR_ROM_PATCH_ROW0_LSB_ADDR A:0xfc4bc1f0
y.create.l HWIO_QFPROM_CORR_ROM_PATCH_ROW1_LSB_ADDR A:0xfc4bc1f8
y.create.l HWIO_QFPROM_CORR_ROM_PATCH_ROW2_LSB_ADDR A:0xfc4bc200
y.create.l HWIO_QFPROM_CORR_ROM_PATCH_ROW3_LSB_ADDR A:0xfc4bc208
y.create.l HWIO_QFPROM_CORR_ROM_PATCH_ROW4_LSB_ADDR A:0xfc4bc210
y.create.l HWIO_QFPROM_CORR_ROM_PATCH_ROW5_LSB_ADDR A:0xfc4bc218
y.create.l HWIO_QFPROM_CORR_ROM_PATCH_ROW6_LSB_ADDR A:0xfc4bc220
y.create.l HWIO_QFPROM_CORR_ROM_PATCH_ROW7_LSB_ADDR A:0xfc4bc228
y.create.l HWIO_QFPROM_CORR_ROM_PATCH_ROW8_LSB_ADDR A:0xfc4bc230
y.create.l HWIO_QFPROM_CORR_ROM_PATCH_ROW9_LSB_ADDR A:0xfc4bc238
y.create.l HWIO_QFPROM_CORR_ROM_PATCH_ROW0_MSB_ADDR A:0xfc4bc1f4
y.create.l HWIO_QFPROM_CORR_ROM_PATCH_ROW1_MSB_ADDR A:0xfc4bc1fc
y.create.l HWIO_QFPROM_CORR_ROM_PATCH_ROW2_MSB_ADDR A:0xfc4bc204
y.create.l HWIO_QFPROM_CORR_ROM_PATCH_ROW3_MSB_ADDR A:0xfc4bc20c
y.create.l HWIO_QFPROM_CORR_ROM_PATCH_ROW4_MSB_ADDR A:0xfc4bc214
y.create.l HWIO_QFPROM_CORR_ROM_PATCH_ROW5_MSB_ADDR A:0xfc4bc21c
y.create.l HWIO_QFPROM_CORR_ROM_PATCH_ROW6_MSB_ADDR A:0xfc4bc224
y.create.l HWIO_QFPROM_CORR_ROM_PATCH_ROW7_MSB_ADDR A:0xfc4bc22c
y.create.l HWIO_QFPROM_CORR_ROM_PATCH_ROW8_MSB_ADDR A:0xfc4bc234
y.create.l HWIO_QFPROM_CORR_ROM_PATCH_ROW9_MSB_ADDR A:0xfc4bc23c
y.create.l HWIO_QFPROM_CORR_PRI_KEY_DERIVATION_KEY_ROW0_LSB_ADDR A:0xfc4bc370
y.create.l HWIO_QFPROM_CORR_PRI_KEY_DERIVATION_KEY_ROW1_LSB_ADDR A:0xfc4bc378
y.create.l HWIO_QFPROM_CORR_PRI_KEY_DERIVATION_KEY_ROW2_LSB_ADDR A:0xfc4bc380
y.create.l HWIO_QFPROM_CORR_PRI_KEY_DERIVATION_KEY_ROW3_LSB_ADDR A:0xfc4bc388
y.create.l HWIO_QFPROM_CORR_PRI_KEY_DERIVATION_KEY_ROW0_MSB_ADDR A:0xfc4bc374
y.create.l HWIO_QFPROM_CORR_PRI_KEY_DERIVATION_KEY_ROW1_MSB_ADDR A:0xfc4bc37c
y.create.l HWIO_QFPROM_CORR_PRI_KEY_DERIVATION_KEY_ROW2_MSB_ADDR A:0xfc4bc384
y.create.l HWIO_QFPROM_CORR_PRI_KEY_DERIVATION_KEY_ROW3_MSB_ADDR A:0xfc4bc38c
y.create.l HWIO_QFPROM_CORR_PRI_KEY_DERIVATION_KEY_ROW4_LSB_ADDR A:0xfc4bc390
y.create.l HWIO_QFPROM_CORR_PRI_KEY_DERIVATION_KEY_ROW4_MSB_ADDR A:0xfc4bc394
y.create.l HWIO_QFPROM_CORR_SEC_KEY_DERIVATION_KEY_ROW0_LSB_ADDR A:0xfc4bc398
y.create.l HWIO_QFPROM_CORR_SEC_KEY_DERIVATION_KEY_ROW1_LSB_ADDR A:0xfc4bc3a0
y.create.l HWIO_QFPROM_CORR_SEC_KEY_DERIVATION_KEY_ROW2_LSB_ADDR A:0xfc4bc3a8
y.create.l HWIO_QFPROM_CORR_SEC_KEY_DERIVATION_KEY_ROW3_LSB_ADDR A:0xfc4bc3b0
y.create.l HWIO_QFPROM_CORR_SEC_KEY_DERIVATION_KEY_ROW0_MSB_ADDR A:0xfc4bc39c
y.create.l HWIO_QFPROM_CORR_SEC_KEY_DERIVATION_KEY_ROW1_MSB_ADDR A:0xfc4bc3a4
y.create.l HWIO_QFPROM_CORR_SEC_KEY_DERIVATION_KEY_ROW2_MSB_ADDR A:0xfc4bc3ac
y.create.l HWIO_QFPROM_CORR_SEC_KEY_DERIVATION_KEY_ROW3_MSB_ADDR A:0xfc4bc3b4
y.create.l HWIO_QFPROM_CORR_SEC_KEY_DERIVATION_KEY_ROW4_LSB_ADDR A:0xfc4bc3b8
y.create.l HWIO_QFPROM_CORR_SEC_KEY_DERIVATION_KEY_ROW4_MSB_ADDR A:0xfc4bc3bc
y.create.l HWIO_QFPROM_CORR_OEM_PK_HASH_ROW0_LSB_ADDR A:0xfc4bc3c0
y.create.l HWIO_QFPROM_CORR_OEM_PK_HASH_ROW1_LSB_ADDR A:0xfc4bc3c8
y.create.l HWIO_QFPROM_CORR_OEM_PK_HASH_ROW2_LSB_ADDR A:0xfc4bc3d0
y.create.l HWIO_QFPROM_CORR_OEM_PK_HASH_ROW3_LSB_ADDR A:0xfc4bc3d8
y.create.l HWIO_QFPROM_CORR_OEM_PK_HASH_ROW0_MSB_ADDR A:0xfc4bc3c4
y.create.l HWIO_QFPROM_CORR_OEM_PK_HASH_ROW1_MSB_ADDR A:0xfc4bc3cc
y.create.l HWIO_QFPROM_CORR_OEM_PK_HASH_ROW2_MSB_ADDR A:0xfc4bc3d4
y.create.l HWIO_QFPROM_CORR_OEM_PK_HASH_ROW3_MSB_ADDR A:0xfc4bc3dc
y.create.l HWIO_QFPROM_CORR_OEM_PK_HASH_ROW4_LSB_ADDR A:0xfc4bc3e0
y.create.l HWIO_QFPROM_CORR_OEM_PK_HASH_ROW4_MSB_ADDR A:0xfc4bc3e4
y.create.l HWIO_QFPROM_CORR_OEM_SEC_BOOT_ROW0_LSB_ADDR A:0xfc4bc3e8
y.create.l HWIO_QFPROM_CORR_OEM_SEC_BOOT_ROW0_MSB_ADDR A:0xfc4bc3ec
y.create.l HWIO_QFPROM_CORR_QC_SEC_BOOT_ROW0_LSB_ADDR A:0xfc4bc3f0
y.create.l HWIO_QFPROM_CORR_QC_SEC_BOOT_ROW0_MSB_ADDR A:0xfc4bc3f4
y.create.l HWIO_QFPROM_CORR_USB_VID_PID_LSB_ADDR A:0xfc4bc3f8
y.create.l HWIO_QFPROM_CORR_USB_VID_PID_MSB_ADDR A:0xfc4bc3fc
y.create.l HWIO_SEC_CTRL_HW_VERSION_ADDR A:0xfc4be000
y.create.l HWIO_FEATURE_CONFIG0_ADDR A:0xfc4be004
y.create.l HWIO_FEATURE_CONFIG1_ADDR A:0xfc4be008
y.create.l HWIO_FEATURE_CONFIG2_ADDR A:0xfc4be00c
y.create.l HWIO_FEATURE_CONFIG3_ADDR A:0xfc4be010
y.create.l HWIO_FEATURE_CONFIG4_ADDR A:0xfc4be014
y.create.l HWIO_FEATURE_CONFIG5_ADDR A:0xfc4be018
y.create.l HWIO_FEATURE_CONFIG6_ADDR A:0xfc4be01c
y.create.l HWIO_FEATURE_CONFIG7_ADDR A:0xfc4be020
y.create.l HWIO_OEM_CONFIG0_ADDR A:0xfc4be024
y.create.l HWIO_OEM_CONFIG1_ADDR A:0xfc4be028
y.create.l HWIO_OEM_CONFIG2_ADDR A:0xfc4be02c
y.create.l HWIO_OEM_CONFIG3_ADDR A:0xfc4be030
y.create.l HWIO_BOOT_CONFIG_ADDR A:0xfc4be034
y.create.l HWIO_SECURE_BOOT1_ADDR A:0xfc4be03c
y.create.l HWIO_SECURE_BOOT2_ADDR A:0xfc4be040
y.create.l HWIO_SECURE_BOOT3_ADDR A:0xfc4be044
y.create.l HWIO_SECURE_BOOT4_ADDR A:0xfc4be048
y.create.l HWIO_SECURE_BOOT5_ADDR A:0xfc4be04c
y.create.l HWIO_SECURE_BOOT6_ADDR A:0xfc4be050
y.create.l HWIO_SECURE_BOOT7_ADDR A:0xfc4be054
y.create.l HWIO_SECURE_BOOT8_ADDR A:0xfc4be058
y.create.l HWIO_SECURE_BOOT9_ADDR A:0xfc4be05c
y.create.l HWIO_SECURE_BOOT10_ADDR A:0xfc4be060
y.create.l HWIO_OVERRIDE_0_ADDR A:0xfc4be0b0
y.create.l HWIO_OVERRIDE_1_ADDR A:0xfc4be0b4
y.create.l HWIO_OVERRIDE_2_ADDR A:0xfc4be0b8
y.create.l HWIO_OVERRIDE_3_ADDR A:0xfc4be0bc
y.create.l HWIO_OVERRIDE_4_ADDR A:0xfc4be0c0
y.create.l HWIO_CAPT_SEC_GPIO_ADDR A:0xfc4be0c4
y.create.l HWIO_APP_PROC_CFG_ADDR A:0xfc4be0c8
y.create.l HWIO_MSS_PROC_CFG_ADDR A:0xfc4be0cc
y.create.l HWIO_KDF_CFG_ADDR A:0xfc4be0d0
y.create.l HWIO_QFPROM_CLK_CTL_ADDR A:0xfc4be0d4
y.create.l HWIO_HDCP_KSV_LSB_ADDR A:0xfc4be0d8
y.create.l HWIO_HDCP_KSV_MSB_ADDR A:0xfc4be0dc
y.create.l HWIO_JTAG_ID_ADDR A:0xfc4be0e0
y.create.l HWIO_OEM_ID_ADDR A:0xfc4be0e4
y.create.l HWIO_TEST_BUS_SEL_ADDR A:0xfc4be0e8
y.create.l HWIO_SPDM_DYN_SECURE_MODE_ADDR A:0xfc4be0ec
y.create.l HWIO_BOOT_PARTITION_SELECT_ADDR A:0xfc4be0f0
y.create.l HWIO_SEC_CTRL_APU_XPU_SCR_ADDR A:0xfc4bf000
y.create.l HWIO_SEC_CTRL_APU_XPU_SWDR_ADDR A:0xfc4bf004
y.create.l HWIO_SEC_CTRL_APU_XPU_SEAR0_ADDR A:0xfc4bf040
y.create.l HWIO_SEC_CTRL_APU_XPU_SESR_ADDR A:0xfc4bf048
y.create.l HWIO_SEC_CTRL_APU_XPU_SESRRESTORE_ADDR A:0xfc4bf04c
y.create.l HWIO_SEC_CTRL_APU_XPU_SESYNR0_ADDR A:0xfc4bf050
y.create.l HWIO_SEC_CTRL_APU_XPU_SESYNR1_ADDR A:0xfc4bf054
y.create.l HWIO_SEC_CTRL_APU_XPU_SESYNR2_ADDR A:0xfc4bf058
y.create.l HWIO_SEC_CTRL_APU_XPU_MCR_ADDR A:0xfc4bf100
y.create.l HWIO_SEC_CTRL_APU_XPU_MEAR0_ADDR A:0xfc4bf140
y.create.l HWIO_SEC_CTRL_APU_XPU_MESR_ADDR A:0xfc4bf148
y.create.l HWIO_SEC_CTRL_APU_XPU_MESRRESTORE_ADDR A:0xfc4bf14c
y.create.l HWIO_SEC_CTRL_APU_XPU_MESYNR0_ADDR A:0xfc4bf150
y.create.l HWIO_SEC_CTRL_APU_XPU_MESYNR1_ADDR A:0xfc4bf154
y.create.l HWIO_SEC_CTRL_APU_XPU_MESYNR2_ADDR A:0xfc4bf158
y.create.l HWIO_SEC_CTRL_APU_XPU_CR_ADDR A:0xfc4bf080
y.create.l HWIO_SEC_CTRL_APU_XPU_RPU_ACR0_ADDR A:0xfc4bf0a0
y.create.l HWIO_SEC_CTRL_APU_XPU_EAR0_ADDR A:0xfc4bf0c0
y.create.l HWIO_SEC_CTRL_APU_XPU_ESR_ADDR A:0xfc4bf0c8
y.create.l HWIO_SEC_CTRL_APU_XPU_ESRRESTORE_ADDR A:0xfc4bf0cc
y.create.l HWIO_SEC_CTRL_APU_XPU_ESYNR0_ADDR A:0xfc4bf0d0
y.create.l HWIO_SEC_CTRL_APU_XPU_ESYNR1_ADDR A:0xfc4bf0d4
y.create.l HWIO_SEC_CTRL_APU_XPU_ESYNR2_ADDR A:0xfc4bf0d8
y.create.l HWIO_SEC_CTRL_APU_XPU_IDR0_ADDR A:0xfc4bf074
y.create.l HWIO_SEC_CTRL_APU_XPU_IDR1_ADDR A:0xfc4bf078
y.create.l HWIO_SEC_CTRL_APU_XPU_REV_ADDR A:0xfc4bf07c
y.create.l HWIO_SEC_CTRL_APU_XPU_RG0_RACR0_ADDR A:0xfc4bf200
y.create.l HWIO_SEC_CTRL_APU_XPU_RG1_RACR0_ADDR A:0xfc4bf280
y.create.l HWIO_SEC_CTRL_APU_XPU_RG2_RACR0_ADDR A:0xfc4bf300
y.create.l HWIO_SEC_CTRL_APU_XPU_RG0_WACR0_ADDR A:0xfc4bf220
y.create.l HWIO_SEC_CTRL_APU_XPU_RG1_WACR0_ADDR A:0xfc4bf2a0
y.create.l HWIO_SEC_CTRL_APU_XPU_RG2_WACR0_ADDR A:0xfc4bf320
y.create.l HWIO_SEC_CTRL_APU_XPU_RG0_SCR_ADDR A:0xfc4bf250
y.create.l HWIO_SEC_CTRL_APU_XPU_RG1_SCR_ADDR A:0xfc4bf2d0
y.create.l HWIO_SEC_CTRL_APU_XPU_RG2_SCR_ADDR A:0xfc4bf350
y.create.l HWIO_SEC_CTRL_APU_XPU_RG0_MCR_ADDR A:0xfc4bf254
y.create.l HWIO_SEC_CTRL_APU_XPU_RG1_MCR_ADDR A:0xfc4bf2d4
y.create.l HWIO_SEC_CTRL_APU_XPU_RG2_MCR_ADDR A:0xfc4bf354
y.create.l HWIO_SMMU_LPASS_CFG_SMMUX_CB0_SCTLR_ADDR A:0xfd000000
y.create.l HWIO_SMMU_LPASS_CFG_SMMUX_CB1_SCTLR_ADDR A:0xfd001000
y.create.l HWIO_SMMU_LPASS_CFG_SMMUX_CB2_SCTLR_ADDR A:0xfd002000
y.create.l HWIO_SMMU_LPASS_CFG_SMMUX_CB3_SCTLR_ADDR A:0xfd003000
y.create.l HWIO_SMMU_LPASS_CFG_SMMUX_CB0_ACTLR_ADDR A:0xfd000004
y.create.l HWIO_SMMU_LPASS_CFG_SMMUX_CB1_ACTLR_ADDR A:0xfd001004
y.create.l HWIO_SMMU_LPASS_CFG_SMMUX_CB2_ACTLR_ADDR A:0xfd002004
y.create.l HWIO_SMMU_LPASS_CFG_SMMUX_CB3_ACTLR_ADDR A:0xfd003004
y.create.l HWIO_SMMU_LPASS_CFG_SMMUX_CB0_CONTEXTIDR_ADDR A:0xfd000008
y.create.l HWIO_SMMU_LPASS_CFG_SMMUX_CB1_CONTEXTIDR_ADDR A:0xfd001008
y.create.l HWIO_SMMU_LPASS_CFG_SMMUX_CB2_CONTEXTIDR_ADDR A:0xfd002008
y.create.l HWIO_SMMU_LPASS_CFG_SMMUX_CB3_CONTEXTIDR_ADDR A:0xfd003008
y.create.l HWIO_SMMU_LPASS_CFG_SMMUX_CB0_TTBR0_ADDR A:0xfd000010
y.create.l HWIO_SMMU_LPASS_CFG_SMMUX_CB1_TTBR0_ADDR A:0xfd001010
y.create.l HWIO_SMMU_LPASS_CFG_SMMUX_CB2_TTBR0_ADDR A:0xfd002010
y.create.l HWIO_SMMU_LPASS_CFG_SMMUX_CB3_TTBR0_ADDR A:0xfd003010
y.create.l HWIO_SMMU_LPASS_CFG_SMMUX_CB0_TTBR1_ADDR A:0xfd000014
y.create.l HWIO_SMMU_LPASS_CFG_SMMUX_CB1_TTBR1_ADDR A:0xfd001014
y.create.l HWIO_SMMU_LPASS_CFG_SMMUX_CB2_TTBR1_ADDR A:0xfd002014
y.create.l HWIO_SMMU_LPASS_CFG_SMMUX_CB3_TTBR1_ADDR A:0xfd003014
y.create.l HWIO_SMMU_LPASS_CFG_SMMUX_CB0_TTBCR_ADDR A:0xfd000018
y.create.l HWIO_SMMU_LPASS_CFG_SMMUX_CB1_TTBCR_ADDR A:0xfd001018
y.create.l HWIO_SMMU_LPASS_CFG_SMMUX_CB2_TTBCR_ADDR A:0xfd002018
y.create.l HWIO_SMMU_LPASS_CFG_SMMUX_CB3_TTBCR_ADDR A:0xfd003018
y.create.l HWIO_SMMU_LPASS_CFG_SMMUX_CB0_PAR_ADDR A:0xfd00001c
y.create.l HWIO_SMMU_LPASS_CFG_SMMUX_CB1_PAR_ADDR A:0xfd00101c
y.create.l HWIO_SMMU_LPASS_CFG_SMMUX_CB2_PAR_ADDR A:0xfd00201c
y.create.l HWIO_SMMU_LPASS_CFG_SMMUX_CB3_PAR_ADDR A:0xfd00301c
y.create.l HWIO_SMMU_LPASS_CFG_SMMUX_CB0_FSR_ADDR A:0xfd000020
y.create.l HWIO_SMMU_LPASS_CFG_SMMUX_CB1_FSR_ADDR A:0xfd001020
y.create.l HWIO_SMMU_LPASS_CFG_SMMUX_CB2_FSR_ADDR A:0xfd002020
y.create.l HWIO_SMMU_LPASS_CFG_SMMUX_CB3_FSR_ADDR A:0xfd003020
y.create.l HWIO_SMMU_LPASS_CFG_SMMUX_CB0_FSRRESTORE_ADDR A:0xfd000024
y.create.l HWIO_SMMU_LPASS_CFG_SMMUX_CB1_FSRRESTORE_ADDR A:0xfd001024
y.create.l HWIO_SMMU_LPASS_CFG_SMMUX_CB2_FSRRESTORE_ADDR A:0xfd002024
y.create.l HWIO_SMMU_LPASS_CFG_SMMUX_CB3_FSRRESTORE_ADDR A:0xfd003024
y.create.l HWIO_SMMU_LPASS_CFG_SMMUX_CB0_FAR_ADDR A:0xfd000028
y.create.l HWIO_SMMU_LPASS_CFG_SMMUX_CB1_FAR_ADDR A:0xfd001028
y.create.l HWIO_SMMU_LPASS_CFG_SMMUX_CB2_FAR_ADDR A:0xfd002028
y.create.l HWIO_SMMU_LPASS_CFG_SMMUX_CB3_FAR_ADDR A:0xfd003028
y.create.l HWIO_SMMU_LPASS_CFG_SMMUX_CB0_FSYNR0_ADDR A:0xfd00002c
y.create.l HWIO_SMMU_LPASS_CFG_SMMUX_CB1_FSYNR0_ADDR A:0xfd00102c
y.create.l HWIO_SMMU_LPASS_CFG_SMMUX_CB2_FSYNR0_ADDR A:0xfd00202c
y.create.l HWIO_SMMU_LPASS_CFG_SMMUX_CB3_FSYNR0_ADDR A:0xfd00302c
y.create.l HWIO_SMMU_LPASS_CFG_SMMUX_CB0_FSYNR1_ADDR A:0xfd000030
y.create.l HWIO_SMMU_LPASS_CFG_SMMUX_CB1_FSYNR1_ADDR A:0xfd001030
y.create.l HWIO_SMMU_LPASS_CFG_SMMUX_CB2_FSYNR1_ADDR A:0xfd002030
y.create.l HWIO_SMMU_LPASS_CFG_SMMUX_CB3_FSYNR1_ADDR A:0xfd003030
y.create.l HWIO_SMMU_LPASS_CFG_SMMUX_CB0_PRRR_ADDR A:0xfd000034
y.create.l HWIO_SMMU_LPASS_CFG_SMMUX_CB1_PRRR_ADDR A:0xfd001034
y.create.l HWIO_SMMU_LPASS_CFG_SMMUX_CB2_PRRR_ADDR A:0xfd002034
y.create.l HWIO_SMMU_LPASS_CFG_SMMUX_CB3_PRRR_ADDR A:0xfd003034
y.create.l HWIO_SMMU_LPASS_CFG_SMMUX_CB0_NMRR_ADDR A:0xfd000038
y.create.l HWIO_SMMU_LPASS_CFG_SMMUX_CB1_NMRR_ADDR A:0xfd001038
y.create.l HWIO_SMMU_LPASS_CFG_SMMUX_CB2_NMRR_ADDR A:0xfd002038
y.create.l HWIO_SMMU_LPASS_CFG_SMMUX_CB3_NMRR_ADDR A:0xfd003038
y.create.l HWIO_SMMU_LPASS_CFG_SMMUX_CB0_TLBLKCR_ADDR A:0xfd00003c
y.create.l HWIO_SMMU_LPASS_CFG_SMMUX_CB1_TLBLKCR_ADDR A:0xfd00103c
y.create.l HWIO_SMMU_LPASS_CFG_SMMUX_CB2_TLBLKCR_ADDR A:0xfd00203c
y.create.l HWIO_SMMU_LPASS_CFG_SMMUX_CB3_TLBLKCR_ADDR A:0xfd00303c
y.create.l HWIO_SMMU_LPASS_CFG_SMMUX_CB0_V2PSR_ADDR A:0xfd000040
y.create.l HWIO_SMMU_LPASS_CFG_SMMUX_CB1_V2PSR_ADDR A:0xfd001040
y.create.l HWIO_SMMU_LPASS_CFG_SMMUX_CB2_V2PSR_ADDR A:0xfd002040
y.create.l HWIO_SMMU_LPASS_CFG_SMMUX_CB3_V2PSR_ADDR A:0xfd003040
y.create.l HWIO_SMMU_LPASS_CFG_SMMUX_CB0_TLBFLPTER_ADDR A:0xfd000044
y.create.l HWIO_SMMU_LPASS_CFG_SMMUX_CB1_TLBFLPTER_ADDR A:0xfd001044
y.create.l HWIO_SMMU_LPASS_CFG_SMMUX_CB2_TLBFLPTER_ADDR A:0xfd002044
y.create.l HWIO_SMMU_LPASS_CFG_SMMUX_CB3_TLBFLPTER_ADDR A:0xfd003044
y.create.l HWIO_SMMU_LPASS_CFG_SMMUX_CB0_TLBSLPTER_ADDR A:0xfd000048
y.create.l HWIO_SMMU_LPASS_CFG_SMMUX_CB1_TLBSLPTER_ADDR A:0xfd001048
y.create.l HWIO_SMMU_LPASS_CFG_SMMUX_CB2_TLBSLPTER_ADDR A:0xfd002048
y.create.l HWIO_SMMU_LPASS_CFG_SMMUX_CB3_TLBSLPTER_ADDR A:0xfd003048
y.create.l HWIO_SMMU_LPASS_CFG_SMMUX_CB0_BFBCR_ADDR A:0xfd00004c
y.create.l HWIO_SMMU_LPASS_CFG_SMMUX_CB1_BFBCR_ADDR A:0xfd00104c
y.create.l HWIO_SMMU_LPASS_CFG_SMMUX_CB2_BFBCR_ADDR A:0xfd00204c
y.create.l HWIO_SMMU_LPASS_CFG_SMMUX_CB3_BFBCR_ADDR A:0xfd00304c
y.create.l HWIO_SMMU_LPASS_CFG_SMMUX_CB0_TLBIALL_ADDR A:0xfd000800
y.create.l HWIO_SMMU_LPASS_CFG_SMMUX_CB1_TLBIALL_ADDR A:0xfd001800
y.create.l HWIO_SMMU_LPASS_CFG_SMMUX_CB2_TLBIALL_ADDR A:0xfd002800
y.create.l HWIO_SMMU_LPASS_CFG_SMMUX_CB3_TLBIALL_ADDR A:0xfd003800
y.create.l HWIO_SMMU_LPASS_CFG_SMMUX_CB0_TLBIASID_ADDR A:0xfd000804
y.create.l HWIO_SMMU_LPASS_CFG_SMMUX_CB1_TLBIASID_ADDR A:0xfd001804
y.create.l HWIO_SMMU_LPASS_CFG_SMMUX_CB2_TLBIASID_ADDR A:0xfd002804
y.create.l HWIO_SMMU_LPASS_CFG_SMMUX_CB3_TLBIASID_ADDR A:0xfd003804
y.create.l HWIO_SMMU_LPASS_CFG_SMMUX_CB0_TLBIVA_ADDR A:0xfd000808
y.create.l HWIO_SMMU_LPASS_CFG_SMMUX_CB1_TLBIVA_ADDR A:0xfd001808
y.create.l HWIO_SMMU_LPASS_CFG_SMMUX_CB2_TLBIVA_ADDR A:0xfd002808
y.create.l HWIO_SMMU_LPASS_CFG_SMMUX_CB3_TLBIVA_ADDR A:0xfd003808
y.create.l HWIO_SMMU_LPASS_CFG_SMMUX_CB0_TLBIVAA_ADDR A:0xfd00080c
y.create.l HWIO_SMMU_LPASS_CFG_SMMUX_CB1_TLBIVAA_ADDR A:0xfd00180c
y.create.l HWIO_SMMU_LPASS_CFG_SMMUX_CB2_TLBIVAA_ADDR A:0xfd00280c
y.create.l HWIO_SMMU_LPASS_CFG_SMMUX_CB3_TLBIVAA_ADDR A:0xfd00380c
y.create.l HWIO_SMMU_LPASS_CFG_SMMUX_CB0_V2PRR_ADDR A:0xfd000810
y.create.l HWIO_SMMU_LPASS_CFG_SMMUX_CB1_V2PRR_ADDR A:0xfd001810
y.create.l HWIO_SMMU_LPASS_CFG_SMMUX_CB2_V2PRR_ADDR A:0xfd002810
y.create.l HWIO_SMMU_LPASS_CFG_SMMUX_CB3_V2PRR_ADDR A:0xfd003810
y.create.l HWIO_SMMU_LPASS_CFG_SMMUX_CB0_V2PPW_ADDR A:0xfd000814
y.create.l HWIO_SMMU_LPASS_CFG_SMMUX_CB1_V2PPW_ADDR A:0xfd001814
y.create.l HWIO_SMMU_LPASS_CFG_SMMUX_CB2_V2PPW_ADDR A:0xfd002814
y.create.l HWIO_SMMU_LPASS_CFG_SMMUX_CB3_V2PPW_ADDR A:0xfd003814
y.create.l HWIO_SMMU_LPASS_CFG_SMMUX_CB0_V2PUR_ADDR A:0xfd000818
y.create.l HWIO_SMMU_LPASS_CFG_SMMUX_CB1_V2PUR_ADDR A:0xfd001818
y.create.l HWIO_SMMU_LPASS_CFG_SMMUX_CB2_V2PUR_ADDR A:0xfd002818
y.create.l HWIO_SMMU_LPASS_CFG_SMMUX_CB3_V2PUR_ADDR A:0xfd003818
y.create.l HWIO_SMMU_LPASS_CFG_SMMUX_CB0_V2PUW_ADDR A:0xfd00081c
y.create.l HWIO_SMMU_LPASS_CFG_SMMUX_CB1_V2PUW_ADDR A:0xfd00181c
y.create.l HWIO_SMMU_LPASS_CFG_SMMUX_CB2_V2PUW_ADDR A:0xfd00281c
y.create.l HWIO_SMMU_LPASS_CFG_SMMUX_CB3_V2PUW_ADDR A:0xfd00381c
y.create.l HWIO_SMMU_LPASS_CFG_SMMUX_CB0_RESUME_ADDR A:0xfd000820
y.create.l HWIO_SMMU_LPASS_CFG_SMMUX_CB1_RESUME_ADDR A:0xfd001820
y.create.l HWIO_SMMU_LPASS_CFG_SMMUX_CB2_RESUME_ADDR A:0xfd002820
y.create.l HWIO_SMMU_LPASS_CFG_SMMUX_CB3_RESUME_ADDR A:0xfd003820
y.create.l HWIO_SMMU_LPASS_CFG_SMMUX_M2VCBR0_ADDR A:0xfd00f000
y.create.l HWIO_SMMU_LPASS_CFG_SMMUX_M2VCBR1_ADDR A:0xfd00f004
y.create.l HWIO_SMMU_LPASS_CFG_SMMUX_M2VCBR2_ADDR A:0xfd00f008
y.create.l HWIO_SMMU_LPASS_CFG_SMMUX_M2VCBR3_ADDR A:0xfd00f00c
y.create.l HWIO_SMMU_LPASS_CFG_SMMUX_M2VCBR4_ADDR A:0xfd00f010
y.create.l HWIO_SMMU_LPASS_CFG_SMMUX_M2VCBR5_ADDR A:0xfd00f014
y.create.l HWIO_SMMU_LPASS_CFG_SMMUX_M2VCBR6_ADDR A:0xfd00f018
y.create.l HWIO_SMMU_LPASS_CFG_SMMUX_M2VCBR7_ADDR A:0xfd00f01c
y.create.l HWIO_SMMU_LPASS_CFG_SMMUX_M2VCBR8_ADDR A:0xfd00f020
y.create.l HWIO_SMMU_LPASS_CFG_SMMUX_M2VCBR9_ADDR A:0xfd00f024
y.create.l HWIO_SMMU_LPASS_CFG_SMMUX_CBACR0_ADDR A:0xfd00f800
y.create.l HWIO_SMMU_LPASS_CFG_SMMUX_CBACR1_ADDR A:0xfd00f804
y.create.l HWIO_SMMU_LPASS_CFG_SMMUX_CBACR2_ADDR A:0xfd00f808
y.create.l HWIO_SMMU_LPASS_CFG_SMMUX_CBACR3_ADDR A:0xfd00f80c
y.create.l HWIO_SMMU_LPASS_CFG_SMMUX_CBACR4_ADDR A:0xfd00f810
y.create.l HWIO_SMMU_LPASS_CFG_SMMUX_CBACR5_ADDR A:0xfd00f814
y.create.l HWIO_SMMU_LPASS_CFG_SMMUX_CBACR6_ADDR A:0xfd00f818
y.create.l HWIO_SMMU_LPASS_CFG_SMMUX_CBACR7_ADDR A:0xfd00f81c
y.create.l HWIO_SMMU_LPASS_CFG_SMMUX_CBACR8_ADDR A:0xfd00f820
y.create.l HWIO_SMMU_LPASS_CFG_SMMUX_TLBRSW_ADDR A:0xfd00fe00
y.create.l HWIO_SMMU_LPASS_CFG_SMMUX_TLBTR0_ADDR A:0xfd00fe80
y.create.l HWIO_SMMU_LPASS_CFG_SMMUX_TLBTR1_ADDR A:0xfd00fe84
y.create.l HWIO_SMMU_LPASS_CFG_SMMUX_TLBTR2_ADDR A:0xfd00fe88
y.create.l HWIO_SMMU_LPASS_CFG_SMMUX_TESTBUSCR_ADDR A:0xfd00fe8c
y.create.l HWIO_SMMU_LPASS_CFG_SMMUX_VR0_ADDR A:0xfd00fefc
y.create.l HWIO_SMMU_LPASS_CFG_SMMUX_TLBIALL_ADDR A:0xfd00ff00
y.create.l HWIO_SMMU_LPASS_CFG_SMMUX_TLBIVMID_ADDR A:0xfd00ff04
y.create.l HWIO_SMMU_LPASS_CFG_SMMUX_CR_ADDR A:0xfd00ff80
y.create.l HWIO_SMMU_LPASS_CFG_SMMUX_EAR_ADDR A:0xfd00ff84
y.create.l HWIO_SMMU_LPASS_CFG_SMMUX_ESR_ADDR A:0xfd00ff88
y.create.l HWIO_SMMU_LPASS_CFG_SMMUX_ESRRESTORE_ADDR A:0xfd00ff8c
y.create.l HWIO_SMMU_LPASS_CFG_SMMUX_ESYNR0_ADDR A:0xfd00ff90
y.create.l HWIO_SMMU_LPASS_CFG_SMMUX_ESYNR1_ADDR A:0xfd00ff94
y.create.l HWIO_SMMU_LPASS_CFG_SMMUX_REV_ADDR A:0xfd00fff4
y.create.l HWIO_SMMU_LPASS_CFG_SMMUX_IDR_ADDR A:0xfd00fff8
y.create.l HWIO_SMMU_LPASS_CFG_SMMUX_RPU_ACR_ADDR A:0xfd00fffc
y.create.l HWIO_SMMU_LPASS_CFG_SMMU_EMMC_ADDR A:0xfd00e000
y.create.l HWIO_SMMU_LPASS_CFG_SMMU_EMCS_ADDR A:0xfd00e004
y.create.l HWIO_SMMU_LPASS_CFG_SMMU_EMCC0_ADDR A:0xfd00e100
y.create.l HWIO_SMMU_LPASS_CFG_SMMU_EMCC1_ADDR A:0xfd00e104
y.create.l HWIO_SMMU_LPASS_CFG_SMMU_EMCC2_ADDR A:0xfd00e108
y.create.l HWIO_SMMU_LPASS_CFG_SMMU_EMCC3_ADDR A:0xfd00e10c
y.create.l HWIO_SMMU_LPASS_CFG_SMMU_EMC0_ADDR A:0xfd00e200
y.create.l HWIO_SMMU_LPASS_CFG_SMMU_EMC1_ADDR A:0xfd00e204
y.create.l HWIO_SMMU_LPASS_CFG_SMMU_EMC2_ADDR A:0xfd00e208
y.create.l HWIO_SMMU_LPASS_CFG_SMMU_EMC3_ADDR A:0xfd00e20c
y.create.l HWIO_SMMU_PERIPH_CFG_SMMUX_CB0_SCTLR_ADDR A:0xfd010000
y.create.l HWIO_SMMU_PERIPH_CFG_SMMUX_CB1_SCTLR_ADDR A:0xfd011000
y.create.l HWIO_SMMU_PERIPH_CFG_SMMUX_CB2_SCTLR_ADDR A:0xfd012000
y.create.l HWIO_SMMU_PERIPH_CFG_SMMUX_CB3_SCTLR_ADDR A:0xfd013000
y.create.l HWIO_SMMU_PERIPH_CFG_SMMUX_CB4_SCTLR_ADDR A:0xfd014000
y.create.l HWIO_SMMU_PERIPH_CFG_SMMUX_CB5_SCTLR_ADDR A:0xfd015000
y.create.l HWIO_SMMU_PERIPH_CFG_SMMUX_CB6_SCTLR_ADDR A:0xfd016000
y.create.l HWIO_SMMU_PERIPH_CFG_SMMUX_CB7_SCTLR_ADDR A:0xfd017000
y.create.l HWIO_SMMU_PERIPH_CFG_SMMUX_CB0_ACTLR_ADDR A:0xfd010004
y.create.l HWIO_SMMU_PERIPH_CFG_SMMUX_CB1_ACTLR_ADDR A:0xfd011004
y.create.l HWIO_SMMU_PERIPH_CFG_SMMUX_CB2_ACTLR_ADDR A:0xfd012004
y.create.l HWIO_SMMU_PERIPH_CFG_SMMUX_CB3_ACTLR_ADDR A:0xfd013004
y.create.l HWIO_SMMU_PERIPH_CFG_SMMUX_CB4_ACTLR_ADDR A:0xfd014004
y.create.l HWIO_SMMU_PERIPH_CFG_SMMUX_CB5_ACTLR_ADDR A:0xfd015004
y.create.l HWIO_SMMU_PERIPH_CFG_SMMUX_CB6_ACTLR_ADDR A:0xfd016004
y.create.l HWIO_SMMU_PERIPH_CFG_SMMUX_CB7_ACTLR_ADDR A:0xfd017004
y.create.l HWIO_SMMU_PERIPH_CFG_SMMUX_CB0_CONTEXTIDR_ADDR A:0xfd010008
y.create.l HWIO_SMMU_PERIPH_CFG_SMMUX_CB1_CONTEXTIDR_ADDR A:0xfd011008
y.create.l HWIO_SMMU_PERIPH_CFG_SMMUX_CB2_CONTEXTIDR_ADDR A:0xfd012008
y.create.l HWIO_SMMU_PERIPH_CFG_SMMUX_CB3_CONTEXTIDR_ADDR A:0xfd013008
y.create.l HWIO_SMMU_PERIPH_CFG_SMMUX_CB4_CONTEXTIDR_ADDR A:0xfd014008
y.create.l HWIO_SMMU_PERIPH_CFG_SMMUX_CB5_CONTEXTIDR_ADDR A:0xfd015008
y.create.l HWIO_SMMU_PERIPH_CFG_SMMUX_CB6_CONTEXTIDR_ADDR A:0xfd016008
y.create.l HWIO_SMMU_PERIPH_CFG_SMMUX_CB7_CONTEXTIDR_ADDR A:0xfd017008
y.create.l HWIO_SMMU_PERIPH_CFG_SMMUX_CB0_TTBR0_ADDR A:0xfd010010
y.create.l HWIO_SMMU_PERIPH_CFG_SMMUX_CB1_TTBR0_ADDR A:0xfd011010
y.create.l HWIO_SMMU_PERIPH_CFG_SMMUX_CB2_TTBR0_ADDR A:0xfd012010
y.create.l HWIO_SMMU_PERIPH_CFG_SMMUX_CB3_TTBR0_ADDR A:0xfd013010
y.create.l HWIO_SMMU_PERIPH_CFG_SMMUX_CB4_TTBR0_ADDR A:0xfd014010
y.create.l HWIO_SMMU_PERIPH_CFG_SMMUX_CB5_TTBR0_ADDR A:0xfd015010
y.create.l HWIO_SMMU_PERIPH_CFG_SMMUX_CB6_TTBR0_ADDR A:0xfd016010
y.create.l HWIO_SMMU_PERIPH_CFG_SMMUX_CB7_TTBR0_ADDR A:0xfd017010
y.create.l HWIO_SMMU_PERIPH_CFG_SMMUX_CB0_TTBR1_ADDR A:0xfd010014
y.create.l HWIO_SMMU_PERIPH_CFG_SMMUX_CB1_TTBR1_ADDR A:0xfd011014
y.create.l HWIO_SMMU_PERIPH_CFG_SMMUX_CB2_TTBR1_ADDR A:0xfd012014
y.create.l HWIO_SMMU_PERIPH_CFG_SMMUX_CB3_TTBR1_ADDR A:0xfd013014
y.create.l HWIO_SMMU_PERIPH_CFG_SMMUX_CB4_TTBR1_ADDR A:0xfd014014
y.create.l HWIO_SMMU_PERIPH_CFG_SMMUX_CB5_TTBR1_ADDR A:0xfd015014
y.create.l HWIO_SMMU_PERIPH_CFG_SMMUX_CB6_TTBR1_ADDR A:0xfd016014
y.create.l HWIO_SMMU_PERIPH_CFG_SMMUX_CB7_TTBR1_ADDR A:0xfd017014
y.create.l HWIO_SMMU_PERIPH_CFG_SMMUX_CB0_TTBCR_ADDR A:0xfd010018
y.create.l HWIO_SMMU_PERIPH_CFG_SMMUX_CB1_TTBCR_ADDR A:0xfd011018
y.create.l HWIO_SMMU_PERIPH_CFG_SMMUX_CB2_TTBCR_ADDR A:0xfd012018
y.create.l HWIO_SMMU_PERIPH_CFG_SMMUX_CB3_TTBCR_ADDR A:0xfd013018
y.create.l HWIO_SMMU_PERIPH_CFG_SMMUX_CB4_TTBCR_ADDR A:0xfd014018
y.create.l HWIO_SMMU_PERIPH_CFG_SMMUX_CB5_TTBCR_ADDR A:0xfd015018
y.create.l HWIO_SMMU_PERIPH_CFG_SMMUX_CB6_TTBCR_ADDR A:0xfd016018
y.create.l HWIO_SMMU_PERIPH_CFG_SMMUX_CB7_TTBCR_ADDR A:0xfd017018
y.create.l HWIO_SMMU_PERIPH_CFG_SMMUX_CB0_PAR_ADDR A:0xfd01001c
y.create.l HWIO_SMMU_PERIPH_CFG_SMMUX_CB1_PAR_ADDR A:0xfd01101c
y.create.l HWIO_SMMU_PERIPH_CFG_SMMUX_CB2_PAR_ADDR A:0xfd01201c
y.create.l HWIO_SMMU_PERIPH_CFG_SMMUX_CB3_PAR_ADDR A:0xfd01301c
y.create.l HWIO_SMMU_PERIPH_CFG_SMMUX_CB4_PAR_ADDR A:0xfd01401c
y.create.l HWIO_SMMU_PERIPH_CFG_SMMUX_CB5_PAR_ADDR A:0xfd01501c
y.create.l HWIO_SMMU_PERIPH_CFG_SMMUX_CB6_PAR_ADDR A:0xfd01601c
y.create.l HWIO_SMMU_PERIPH_CFG_SMMUX_CB7_PAR_ADDR A:0xfd01701c
y.create.l HWIO_SMMU_PERIPH_CFG_SMMUX_CB0_FSR_ADDR A:0xfd010020
y.create.l HWIO_SMMU_PERIPH_CFG_SMMUX_CB1_FSR_ADDR A:0xfd011020
y.create.l HWIO_SMMU_PERIPH_CFG_SMMUX_CB2_FSR_ADDR A:0xfd012020
y.create.l HWIO_SMMU_PERIPH_CFG_SMMUX_CB3_FSR_ADDR A:0xfd013020
y.create.l HWIO_SMMU_PERIPH_CFG_SMMUX_CB4_FSR_ADDR A:0xfd014020
y.create.l HWIO_SMMU_PERIPH_CFG_SMMUX_CB5_FSR_ADDR A:0xfd015020
y.create.l HWIO_SMMU_PERIPH_CFG_SMMUX_CB6_FSR_ADDR A:0xfd016020
y.create.l HWIO_SMMU_PERIPH_CFG_SMMUX_CB7_FSR_ADDR A:0xfd017020
y.create.l HWIO_SMMU_PERIPH_CFG_SMMUX_CB0_FSRRESTORE_ADDR A:0xfd010024
y.create.l HWIO_SMMU_PERIPH_CFG_SMMUX_CB1_FSRRESTORE_ADDR A:0xfd011024
y.create.l HWIO_SMMU_PERIPH_CFG_SMMUX_CB2_FSRRESTORE_ADDR A:0xfd012024
y.create.l HWIO_SMMU_PERIPH_CFG_SMMUX_CB3_FSRRESTORE_ADDR A:0xfd013024
y.create.l HWIO_SMMU_PERIPH_CFG_SMMUX_CB4_FSRRESTORE_ADDR A:0xfd014024
y.create.l HWIO_SMMU_PERIPH_CFG_SMMUX_CB5_FSRRESTORE_ADDR A:0xfd015024
y.create.l HWIO_SMMU_PERIPH_CFG_SMMUX_CB6_FSRRESTORE_ADDR A:0xfd016024
y.create.l HWIO_SMMU_PERIPH_CFG_SMMUX_CB7_FSRRESTORE_ADDR A:0xfd017024
y.create.l HWIO_SMMU_PERIPH_CFG_SMMUX_CB0_FAR_ADDR A:0xfd010028
y.create.l HWIO_SMMU_PERIPH_CFG_SMMUX_CB1_FAR_ADDR A:0xfd011028
y.create.l HWIO_SMMU_PERIPH_CFG_SMMUX_CB2_FAR_ADDR A:0xfd012028
y.create.l HWIO_SMMU_PERIPH_CFG_SMMUX_CB3_FAR_ADDR A:0xfd013028
y.create.l HWIO_SMMU_PERIPH_CFG_SMMUX_CB4_FAR_ADDR A:0xfd014028
y.create.l HWIO_SMMU_PERIPH_CFG_SMMUX_CB5_FAR_ADDR A:0xfd015028
y.create.l HWIO_SMMU_PERIPH_CFG_SMMUX_CB6_FAR_ADDR A:0xfd016028
y.create.l HWIO_SMMU_PERIPH_CFG_SMMUX_CB7_FAR_ADDR A:0xfd017028
y.create.l HWIO_SMMU_PERIPH_CFG_SMMUX_CB0_FSYNR0_ADDR A:0xfd01002c
y.create.l HWIO_SMMU_PERIPH_CFG_SMMUX_CB1_FSYNR0_ADDR A:0xfd01102c
y.create.l HWIO_SMMU_PERIPH_CFG_SMMUX_CB2_FSYNR0_ADDR A:0xfd01202c
y.create.l HWIO_SMMU_PERIPH_CFG_SMMUX_CB3_FSYNR0_ADDR A:0xfd01302c
y.create.l HWIO_SMMU_PERIPH_CFG_SMMUX_CB4_FSYNR0_ADDR A:0xfd01402c
y.create.l HWIO_SMMU_PERIPH_CFG_SMMUX_CB5_FSYNR0_ADDR A:0xfd01502c
y.create.l HWIO_SMMU_PERIPH_CFG_SMMUX_CB6_FSYNR0_ADDR A:0xfd01602c
y.create.l HWIO_SMMU_PERIPH_CFG_SMMUX_CB7_FSYNR0_ADDR A:0xfd01702c
y.create.l HWIO_SMMU_PERIPH_CFG_SMMUX_CB0_FSYNR1_ADDR A:0xfd010030
y.create.l HWIO_SMMU_PERIPH_CFG_SMMUX_CB1_FSYNR1_ADDR A:0xfd011030
y.create.l HWIO_SMMU_PERIPH_CFG_SMMUX_CB2_FSYNR1_ADDR A:0xfd012030
y.create.l HWIO_SMMU_PERIPH_CFG_SMMUX_CB3_FSYNR1_ADDR A:0xfd013030
y.create.l HWIO_SMMU_PERIPH_CFG_SMMUX_CB4_FSYNR1_ADDR A:0xfd014030
y.create.l HWIO_SMMU_PERIPH_CFG_SMMUX_CB5_FSYNR1_ADDR A:0xfd015030
y.create.l HWIO_SMMU_PERIPH_CFG_SMMUX_CB6_FSYNR1_ADDR A:0xfd016030
y.create.l HWIO_SMMU_PERIPH_CFG_SMMUX_CB7_FSYNR1_ADDR A:0xfd017030
y.create.l HWIO_SMMU_PERIPH_CFG_SMMUX_CB0_PRRR_ADDR A:0xfd010034
y.create.l HWIO_SMMU_PERIPH_CFG_SMMUX_CB1_PRRR_ADDR A:0xfd011034
y.create.l HWIO_SMMU_PERIPH_CFG_SMMUX_CB2_PRRR_ADDR A:0xfd012034
y.create.l HWIO_SMMU_PERIPH_CFG_SMMUX_CB3_PRRR_ADDR A:0xfd013034
y.create.l HWIO_SMMU_PERIPH_CFG_SMMUX_CB4_PRRR_ADDR A:0xfd014034
y.create.l HWIO_SMMU_PERIPH_CFG_SMMUX_CB5_PRRR_ADDR A:0xfd015034
y.create.l HWIO_SMMU_PERIPH_CFG_SMMUX_CB6_PRRR_ADDR A:0xfd016034
y.create.l HWIO_SMMU_PERIPH_CFG_SMMUX_CB7_PRRR_ADDR A:0xfd017034
y.create.l HWIO_SMMU_PERIPH_CFG_SMMUX_CB0_NMRR_ADDR A:0xfd010038
y.create.l HWIO_SMMU_PERIPH_CFG_SMMUX_CB1_NMRR_ADDR A:0xfd011038
y.create.l HWIO_SMMU_PERIPH_CFG_SMMUX_CB2_NMRR_ADDR A:0xfd012038
y.create.l HWIO_SMMU_PERIPH_CFG_SMMUX_CB3_NMRR_ADDR A:0xfd013038
y.create.l HWIO_SMMU_PERIPH_CFG_SMMUX_CB4_NMRR_ADDR A:0xfd014038
y.create.l HWIO_SMMU_PERIPH_CFG_SMMUX_CB5_NMRR_ADDR A:0xfd015038
y.create.l HWIO_SMMU_PERIPH_CFG_SMMUX_CB6_NMRR_ADDR A:0xfd016038
y.create.l HWIO_SMMU_PERIPH_CFG_SMMUX_CB7_NMRR_ADDR A:0xfd017038
y.create.l HWIO_SMMU_PERIPH_CFG_SMMUX_CB0_TLBLKCR_ADDR A:0xfd01003c
y.create.l HWIO_SMMU_PERIPH_CFG_SMMUX_CB1_TLBLKCR_ADDR A:0xfd01103c
y.create.l HWIO_SMMU_PERIPH_CFG_SMMUX_CB2_TLBLKCR_ADDR A:0xfd01203c
y.create.l HWIO_SMMU_PERIPH_CFG_SMMUX_CB3_TLBLKCR_ADDR A:0xfd01303c
y.create.l HWIO_SMMU_PERIPH_CFG_SMMUX_CB4_TLBLKCR_ADDR A:0xfd01403c
y.create.l HWIO_SMMU_PERIPH_CFG_SMMUX_CB5_TLBLKCR_ADDR A:0xfd01503c
y.create.l HWIO_SMMU_PERIPH_CFG_SMMUX_CB6_TLBLKCR_ADDR A:0xfd01603c
y.create.l HWIO_SMMU_PERIPH_CFG_SMMUX_CB7_TLBLKCR_ADDR A:0xfd01703c
y.create.l HWIO_SMMU_PERIPH_CFG_SMMUX_CB0_V2PSR_ADDR A:0xfd010040
y.create.l HWIO_SMMU_PERIPH_CFG_SMMUX_CB1_V2PSR_ADDR A:0xfd011040
y.create.l HWIO_SMMU_PERIPH_CFG_SMMUX_CB2_V2PSR_ADDR A:0xfd012040
y.create.l HWIO_SMMU_PERIPH_CFG_SMMUX_CB3_V2PSR_ADDR A:0xfd013040
y.create.l HWIO_SMMU_PERIPH_CFG_SMMUX_CB4_V2PSR_ADDR A:0xfd014040
y.create.l HWIO_SMMU_PERIPH_CFG_SMMUX_CB5_V2PSR_ADDR A:0xfd015040
y.create.l HWIO_SMMU_PERIPH_CFG_SMMUX_CB6_V2PSR_ADDR A:0xfd016040
y.create.l HWIO_SMMU_PERIPH_CFG_SMMUX_CB7_V2PSR_ADDR A:0xfd017040
y.create.l HWIO_SMMU_PERIPH_CFG_SMMUX_CB0_TLBFLPTER_ADDR A:0xfd010044
y.create.l HWIO_SMMU_PERIPH_CFG_SMMUX_CB1_TLBFLPTER_ADDR A:0xfd011044
y.create.l HWIO_SMMU_PERIPH_CFG_SMMUX_CB2_TLBFLPTER_ADDR A:0xfd012044
y.create.l HWIO_SMMU_PERIPH_CFG_SMMUX_CB3_TLBFLPTER_ADDR A:0xfd013044
y.create.l HWIO_SMMU_PERIPH_CFG_SMMUX_CB4_TLBFLPTER_ADDR A:0xfd014044
y.create.l HWIO_SMMU_PERIPH_CFG_SMMUX_CB5_TLBFLPTER_ADDR A:0xfd015044
y.create.l HWIO_SMMU_PERIPH_CFG_SMMUX_CB6_TLBFLPTER_ADDR A:0xfd016044
y.create.l HWIO_SMMU_PERIPH_CFG_SMMUX_CB7_TLBFLPTER_ADDR A:0xfd017044
y.create.l HWIO_SMMU_PERIPH_CFG_SMMUX_CB0_TLBSLPTER_ADDR A:0xfd010048
y.create.l HWIO_SMMU_PERIPH_CFG_SMMUX_CB1_TLBSLPTER_ADDR A:0xfd011048
y.create.l HWIO_SMMU_PERIPH_CFG_SMMUX_CB2_TLBSLPTER_ADDR A:0xfd012048
y.create.l HWIO_SMMU_PERIPH_CFG_SMMUX_CB3_TLBSLPTER_ADDR A:0xfd013048
y.create.l HWIO_SMMU_PERIPH_CFG_SMMUX_CB4_TLBSLPTER_ADDR A:0xfd014048
y.create.l HWIO_SMMU_PERIPH_CFG_SMMUX_CB5_TLBSLPTER_ADDR A:0xfd015048
y.create.l HWIO_SMMU_PERIPH_CFG_SMMUX_CB6_TLBSLPTER_ADDR A:0xfd016048
y.create.l HWIO_SMMU_PERIPH_CFG_SMMUX_CB7_TLBSLPTER_ADDR A:0xfd017048
y.create.l HWIO_SMMU_PERIPH_CFG_SMMUX_CB0_BFBCR_ADDR A:0xfd01004c
y.create.l HWIO_SMMU_PERIPH_CFG_SMMUX_CB1_BFBCR_ADDR A:0xfd01104c
y.create.l HWIO_SMMU_PERIPH_CFG_SMMUX_CB2_BFBCR_ADDR A:0xfd01204c
y.create.l HWIO_SMMU_PERIPH_CFG_SMMUX_CB3_BFBCR_ADDR A:0xfd01304c
y.create.l HWIO_SMMU_PERIPH_CFG_SMMUX_CB4_BFBCR_ADDR A:0xfd01404c
y.create.l HWIO_SMMU_PERIPH_CFG_SMMUX_CB5_BFBCR_ADDR A:0xfd01504c
y.create.l HWIO_SMMU_PERIPH_CFG_SMMUX_CB6_BFBCR_ADDR A:0xfd01604c
y.create.l HWIO_SMMU_PERIPH_CFG_SMMUX_CB7_BFBCR_ADDR A:0xfd01704c
y.create.l HWIO_SMMU_PERIPH_CFG_SMMUX_CB0_TLBIALL_ADDR A:0xfd010800
y.create.l HWIO_SMMU_PERIPH_CFG_SMMUX_CB1_TLBIALL_ADDR A:0xfd011800
y.create.l HWIO_SMMU_PERIPH_CFG_SMMUX_CB2_TLBIALL_ADDR A:0xfd012800
y.create.l HWIO_SMMU_PERIPH_CFG_SMMUX_CB3_TLBIALL_ADDR A:0xfd013800
y.create.l HWIO_SMMU_PERIPH_CFG_SMMUX_CB4_TLBIALL_ADDR A:0xfd014800
y.create.l HWIO_SMMU_PERIPH_CFG_SMMUX_CB5_TLBIALL_ADDR A:0xfd015800
y.create.l HWIO_SMMU_PERIPH_CFG_SMMUX_CB6_TLBIALL_ADDR A:0xfd016800
y.create.l HWIO_SMMU_PERIPH_CFG_SMMUX_CB7_TLBIALL_ADDR A:0xfd017800
y.create.l HWIO_SMMU_PERIPH_CFG_SMMUX_CB0_TLBIASID_ADDR A:0xfd010804
y.create.l HWIO_SMMU_PERIPH_CFG_SMMUX_CB1_TLBIASID_ADDR A:0xfd011804
y.create.l HWIO_SMMU_PERIPH_CFG_SMMUX_CB2_TLBIASID_ADDR A:0xfd012804
y.create.l HWIO_SMMU_PERIPH_CFG_SMMUX_CB3_TLBIASID_ADDR A:0xfd013804
y.create.l HWIO_SMMU_PERIPH_CFG_SMMUX_CB4_TLBIASID_ADDR A:0xfd014804
y.create.l HWIO_SMMU_PERIPH_CFG_SMMUX_CB5_TLBIASID_ADDR A:0xfd015804
y.create.l HWIO_SMMU_PERIPH_CFG_SMMUX_CB6_TLBIASID_ADDR A:0xfd016804
y.create.l HWIO_SMMU_PERIPH_CFG_SMMUX_CB7_TLBIASID_ADDR A:0xfd017804
y.create.l HWIO_SMMU_PERIPH_CFG_SMMUX_CB0_TLBIVA_ADDR A:0xfd010808
y.create.l HWIO_SMMU_PERIPH_CFG_SMMUX_CB1_TLBIVA_ADDR A:0xfd011808
y.create.l HWIO_SMMU_PERIPH_CFG_SMMUX_CB2_TLBIVA_ADDR A:0xfd012808
y.create.l HWIO_SMMU_PERIPH_CFG_SMMUX_CB3_TLBIVA_ADDR A:0xfd013808
y.create.l HWIO_SMMU_PERIPH_CFG_SMMUX_CB4_TLBIVA_ADDR A:0xfd014808
y.create.l HWIO_SMMU_PERIPH_CFG_SMMUX_CB5_TLBIVA_ADDR A:0xfd015808
y.create.l HWIO_SMMU_PERIPH_CFG_SMMUX_CB6_TLBIVA_ADDR A:0xfd016808
y.create.l HWIO_SMMU_PERIPH_CFG_SMMUX_CB7_TLBIVA_ADDR A:0xfd017808
y.create.l HWIO_SMMU_PERIPH_CFG_SMMUX_CB0_TLBIVAA_ADDR A:0xfd01080c
y.create.l HWIO_SMMU_PERIPH_CFG_SMMUX_CB1_TLBIVAA_ADDR A:0xfd01180c
y.create.l HWIO_SMMU_PERIPH_CFG_SMMUX_CB2_TLBIVAA_ADDR A:0xfd01280c
y.create.l HWIO_SMMU_PERIPH_CFG_SMMUX_CB3_TLBIVAA_ADDR A:0xfd01380c
y.create.l HWIO_SMMU_PERIPH_CFG_SMMUX_CB4_TLBIVAA_ADDR A:0xfd01480c
y.create.l HWIO_SMMU_PERIPH_CFG_SMMUX_CB5_TLBIVAA_ADDR A:0xfd01580c
y.create.l HWIO_SMMU_PERIPH_CFG_SMMUX_CB6_TLBIVAA_ADDR A:0xfd01680c
y.create.l HWIO_SMMU_PERIPH_CFG_SMMUX_CB7_TLBIVAA_ADDR A:0xfd01780c
y.create.l HWIO_SMMU_PERIPH_CFG_SMMUX_CB0_V2PRR_ADDR A:0xfd010810
y.create.l HWIO_SMMU_PERIPH_CFG_SMMUX_CB1_V2PRR_ADDR A:0xfd011810
y.create.l HWIO_SMMU_PERIPH_CFG_SMMUX_CB2_V2PRR_ADDR A:0xfd012810
y.create.l HWIO_SMMU_PERIPH_CFG_SMMUX_CB3_V2PRR_ADDR A:0xfd013810
y.create.l HWIO_SMMU_PERIPH_CFG_SMMUX_CB4_V2PRR_ADDR A:0xfd014810
y.create.l HWIO_SMMU_PERIPH_CFG_SMMUX_CB5_V2PRR_ADDR A:0xfd015810
y.create.l HWIO_SMMU_PERIPH_CFG_SMMUX_CB6_V2PRR_ADDR A:0xfd016810
y.create.l HWIO_SMMU_PERIPH_CFG_SMMUX_CB7_V2PRR_ADDR A:0xfd017810
y.create.l HWIO_SMMU_PERIPH_CFG_SMMUX_CB0_V2PPW_ADDR A:0xfd010814
y.create.l HWIO_SMMU_PERIPH_CFG_SMMUX_CB1_V2PPW_ADDR A:0xfd011814
y.create.l HWIO_SMMU_PERIPH_CFG_SMMUX_CB2_V2PPW_ADDR A:0xfd012814
y.create.l HWIO_SMMU_PERIPH_CFG_SMMUX_CB3_V2PPW_ADDR A:0xfd013814
y.create.l HWIO_SMMU_PERIPH_CFG_SMMUX_CB4_V2PPW_ADDR A:0xfd014814
y.create.l HWIO_SMMU_PERIPH_CFG_SMMUX_CB5_V2PPW_ADDR A:0xfd015814
y.create.l HWIO_SMMU_PERIPH_CFG_SMMUX_CB6_V2PPW_ADDR A:0xfd016814
y.create.l HWIO_SMMU_PERIPH_CFG_SMMUX_CB7_V2PPW_ADDR A:0xfd017814
y.create.l HWIO_SMMU_PERIPH_CFG_SMMUX_CB0_V2PUR_ADDR A:0xfd010818
y.create.l HWIO_SMMU_PERIPH_CFG_SMMUX_CB1_V2PUR_ADDR A:0xfd011818
y.create.l HWIO_SMMU_PERIPH_CFG_SMMUX_CB2_V2PUR_ADDR A:0xfd012818
y.create.l HWIO_SMMU_PERIPH_CFG_SMMUX_CB3_V2PUR_ADDR A:0xfd013818
y.create.l HWIO_SMMU_PERIPH_CFG_SMMUX_CB4_V2PUR_ADDR A:0xfd014818
y.create.l HWIO_SMMU_PERIPH_CFG_SMMUX_CB5_V2PUR_ADDR A:0xfd015818
y.create.l HWIO_SMMU_PERIPH_CFG_SMMUX_CB6_V2PUR_ADDR A:0xfd016818
y.create.l HWIO_SMMU_PERIPH_CFG_SMMUX_CB7_V2PUR_ADDR A:0xfd017818
y.create.l HWIO_SMMU_PERIPH_CFG_SMMUX_CB0_V2PUW_ADDR A:0xfd01081c
y.create.l HWIO_SMMU_PERIPH_CFG_SMMUX_CB1_V2PUW_ADDR A:0xfd01181c
y.create.l HWIO_SMMU_PERIPH_CFG_SMMUX_CB2_V2PUW_ADDR A:0xfd01281c
y.create.l HWIO_SMMU_PERIPH_CFG_SMMUX_CB3_V2PUW_ADDR A:0xfd01381c
y.create.l HWIO_SMMU_PERIPH_CFG_SMMUX_CB4_V2PUW_ADDR A:0xfd01481c
y.create.l HWIO_SMMU_PERIPH_CFG_SMMUX_CB5_V2PUW_ADDR A:0xfd01581c
y.create.l HWIO_SMMU_PERIPH_CFG_SMMUX_CB6_V2PUW_ADDR A:0xfd01681c
y.create.l HWIO_SMMU_PERIPH_CFG_SMMUX_CB7_V2PUW_ADDR A:0xfd01781c
y.create.l HWIO_SMMU_PERIPH_CFG_SMMUX_CB0_RESUME_ADDR A:0xfd010820
y.create.l HWIO_SMMU_PERIPH_CFG_SMMUX_CB1_RESUME_ADDR A:0xfd011820
y.create.l HWIO_SMMU_PERIPH_CFG_SMMUX_CB2_RESUME_ADDR A:0xfd012820
y.create.l HWIO_SMMU_PERIPH_CFG_SMMUX_CB3_RESUME_ADDR A:0xfd013820
y.create.l HWIO_SMMU_PERIPH_CFG_SMMUX_CB4_RESUME_ADDR A:0xfd014820
y.create.l HWIO_SMMU_PERIPH_CFG_SMMUX_CB5_RESUME_ADDR A:0xfd015820
y.create.l HWIO_SMMU_PERIPH_CFG_SMMUX_CB6_RESUME_ADDR A:0xfd016820
y.create.l HWIO_SMMU_PERIPH_CFG_SMMUX_CB7_RESUME_ADDR A:0xfd017820
y.create.l HWIO_SMMU_PERIPH_CFG_SMMUX_M2VCBR0_ADDR A:0xfd01f000
y.create.l HWIO_SMMU_PERIPH_CFG_SMMUX_M2VCBR1_ADDR A:0xfd01f004
y.create.l HWIO_SMMU_PERIPH_CFG_SMMUX_M2VCBR2_ADDR A:0xfd01f008
y.create.l HWIO_SMMU_PERIPH_CFG_SMMUX_M2VCBR3_ADDR A:0xfd01f00c
y.create.l HWIO_SMMU_PERIPH_CFG_SMMUX_M2VCBR4_ADDR A:0xfd01f010
y.create.l HWIO_SMMU_PERIPH_CFG_SMMUX_M2VCBR5_ADDR A:0xfd01f014
y.create.l HWIO_SMMU_PERIPH_CFG_SMMUX_M2VCBR6_ADDR A:0xfd01f018
y.create.l HWIO_SMMU_PERIPH_CFG_SMMUX_M2VCBR7_ADDR A:0xfd01f01c
y.create.l HWIO_SMMU_PERIPH_CFG_SMMUX_M2VCBR8_ADDR A:0xfd01f020
y.create.l HWIO_SMMU_PERIPH_CFG_SMMUX_M2VCBR9_ADDR A:0xfd01f024
y.create.l HWIO_SMMU_PERIPH_CFG_SMMUX_CBACR0_ADDR A:0xfd01f800
y.create.l HWIO_SMMU_PERIPH_CFG_SMMUX_CBACR1_ADDR A:0xfd01f804
y.create.l HWIO_SMMU_PERIPH_CFG_SMMUX_CBACR2_ADDR A:0xfd01f808
y.create.l HWIO_SMMU_PERIPH_CFG_SMMUX_CBACR3_ADDR A:0xfd01f80c
y.create.l HWIO_SMMU_PERIPH_CFG_SMMUX_CBACR4_ADDR A:0xfd01f810
y.create.l HWIO_SMMU_PERIPH_CFG_SMMUX_CBACR5_ADDR A:0xfd01f814
y.create.l HWIO_SMMU_PERIPH_CFG_SMMUX_CBACR6_ADDR A:0xfd01f818
y.create.l HWIO_SMMU_PERIPH_CFG_SMMUX_CBACR7_ADDR A:0xfd01f81c
y.create.l HWIO_SMMU_PERIPH_CFG_SMMUX_CBACR8_ADDR A:0xfd01f820
y.create.l HWIO_SMMU_PERIPH_CFG_SMMUX_TLBRSW_ADDR A:0xfd01fe00
y.create.l HWIO_SMMU_PERIPH_CFG_SMMUX_TLBTR0_ADDR A:0xfd01fe80
y.create.l HWIO_SMMU_PERIPH_CFG_SMMUX_TLBTR1_ADDR A:0xfd01fe84
y.create.l HWIO_SMMU_PERIPH_CFG_SMMUX_TLBTR2_ADDR A:0xfd01fe88
y.create.l HWIO_SMMU_PERIPH_CFG_SMMUX_TESTBUSCR_ADDR A:0xfd01fe8c
y.create.l HWIO_SMMU_PERIPH_CFG_SMMUX_VR0_ADDR A:0xfd01fefc
y.create.l HWIO_SMMU_PERIPH_CFG_SMMUX_TLBIALL_ADDR A:0xfd01ff00
y.create.l HWIO_SMMU_PERIPH_CFG_SMMUX_TLBIVMID_ADDR A:0xfd01ff04
y.create.l HWIO_SMMU_PERIPH_CFG_SMMUX_CR_ADDR A:0xfd01ff80
y.create.l HWIO_SMMU_PERIPH_CFG_SMMUX_EAR_ADDR A:0xfd01ff84
y.create.l HWIO_SMMU_PERIPH_CFG_SMMUX_ESR_ADDR A:0xfd01ff88
y.create.l HWIO_SMMU_PERIPH_CFG_SMMUX_ESRRESTORE_ADDR A:0xfd01ff8c
y.create.l HWIO_SMMU_PERIPH_CFG_SMMUX_ESYNR0_ADDR A:0xfd01ff90
y.create.l HWIO_SMMU_PERIPH_CFG_SMMUX_ESYNR1_ADDR A:0xfd01ff94
y.create.l HWIO_SMMU_PERIPH_CFG_SMMUX_REV_ADDR A:0xfd01fff4
y.create.l HWIO_SMMU_PERIPH_CFG_SMMUX_IDR_ADDR A:0xfd01fff8
y.create.l HWIO_SMMU_PERIPH_CFG_SMMUX_RPU_ACR_ADDR A:0xfd01fffc
y.create.l HWIO_SMMU_PERIPH_CFG_SMMU_EMMC_ADDR A:0xfd01e000
y.create.l HWIO_SMMU_PERIPH_CFG_SMMU_EMCS_ADDR A:0xfd01e004
y.create.l HWIO_SMMU_PERIPH_CFG_SMMU_EMCC0_ADDR A:0xfd01e100
y.create.l HWIO_SMMU_PERIPH_CFG_SMMU_EMCC1_ADDR A:0xfd01e104
y.create.l HWIO_SMMU_PERIPH_CFG_SMMU_EMCC2_ADDR A:0xfd01e108
y.create.l HWIO_SMMU_PERIPH_CFG_SMMU_EMCC3_ADDR A:0xfd01e10c
y.create.l HWIO_SMMU_PERIPH_CFG_SMMU_EMC0_ADDR A:0xfd01e200
y.create.l HWIO_SMMU_PERIPH_CFG_SMMU_EMC1_ADDR A:0xfd01e204
y.create.l HWIO_SMMU_PERIPH_CFG_SMMU_EMC2_ADDR A:0xfd01e208
y.create.l HWIO_SMMU_PERIPH_CFG_SMMU_EMC3_ADDR A:0xfd01e20c
y.create.l HWIO_SNOC_0_ABT_HW_VERSION_ADDR A:0xfea00000
y.create.l HWIO_SNOC_0_ABT_INST_ID_ADDR A:0xfea00004
y.create.l HWIO_SNOC_0_ABT_NUM_SLAVES_ADDR A:0xfea00008
y.create.l HWIO_SNOC_0_ABT_TIMER_LOADVAL_ADDR A:0xfea0000c
y.create.l HWIO_SNOC_0_ABT_TIMER_MODE_ADDR A:0xfea00010
y.create.l HWIO_SNOC_0_ABT_INTR_STATUS_ADDR A:0xfea00014
y.create.l HWIO_SNOC_0_ABT_INTR_CLEAR_ADDR A:0xfea00018
y.create.l HWIO_SNOC_0_ABT_INTR_ENABLE_ADDR A:0xfea0001c
y.create.l HWIO_SNOC_0_ABT_SYND_VALID_ADDR A:0xfea00020
y.create.l HWIO_SNOC_0_ABT_SYND_CLEAR_ADDR A:0xfea00024
y.create.l HWIO_SNOC_0_ABT_SYND_ID_ADDR A:0xfea00028
y.create.l HWIO_SNOC_0_ABT_SYND_ADDR0_ADDR A:0xfea0002c
y.create.l HWIO_SNOC_0_ABT_SYND_ADDR1_ADDR A:0xfea00030
y.create.l HWIO_SNOC_0_ABT_SYND_HREADY_ADDR A:0xfea00034
y.create.l HWIO_SNOC_3_ABT_HW_VERSION_ADDR A:0xfea02000
y.create.l HWIO_SNOC_3_ABT_INST_ID_ADDR A:0xfea02004
y.create.l HWIO_SNOC_3_ABT_NUM_SLAVES_ADDR A:0xfea02008
y.create.l HWIO_SNOC_3_ABT_TIMER_LOADVAL_ADDR A:0xfea0200c
y.create.l HWIO_SNOC_3_ABT_TIMER_MODE_ADDR A:0xfea02010
y.create.l HWIO_SNOC_3_ABT_INTR_STATUS_ADDR A:0xfea02014
y.create.l HWIO_SNOC_3_ABT_INTR_CLEAR_ADDR A:0xfea02018
y.create.l HWIO_SNOC_3_ABT_INTR_ENABLE_ADDR A:0xfea0201c
y.create.l HWIO_SNOC_3_ABT_SYND_VALID_ADDR A:0xfea02020
y.create.l HWIO_SNOC_3_ABT_SYND_CLEAR_ADDR A:0xfea02024
y.create.l HWIO_SNOC_3_ABT_SYND_ID_ADDR A:0xfea02028
y.create.l HWIO_SNOC_3_ABT_SYND_ADDR0_ADDR A:0xfea0202c
y.create.l HWIO_SNOC_3_ABT_SYND_ADDR1_ADDR A:0xfea02030
y.create.l HWIO_SNOC_3_ABT_SYND_HREADY_ADDR A:0xfea02034
y.create.l HWIO_SPDM_CREG_CFG0_ADDR A:0xfc4b0000
y.create.l HWIO_SPDM_CREG_HW_INFO_ADDR A:0xfc4b0004
y.create.l HWIO_SPDM_CREG_HW_VERSION_ADDR A:0xfc4b0008
y.create.l HWIO_SPDM_CREG_MUTEX_0_ADDR A:0xfc4b0100
y.create.l HWIO_SPDM_OLEM_CFG0_ADDR A:0xfc4b1000
y.create.l HWIO_SPDM_OLEM_CFG1_ADDR A:0xfc4b1004
y.create.l HWIO_SPDM_OLEM_CFG2_ADDR A:0xfc4b1008
y.create.l HWIO_SPDM_OLEM_CFG3_ADDR A:0xfc4b100c
y.create.l HWIO_SPDM_OLEM_CFG4_ADDR A:0xfc4b1010
y.create.l HWIO_SPDM_OLEM_CFG5_ADDR A:0xfc4b1014
y.create.l HWIO_SPDM_OLEM_CFG6_ADDR A:0xfc4b1018
y.create.l HWIO_SPDM_OLEM_CYCLE_C0_OUT_ADDR A:0xfc4b1020
y.create.l HWIO_SPDM_OLEM_CYCLE_C1_OUT_ADDR A:0xfc4b1024
y.create.l HWIO_SPDM_OLEM_CYCLE_C2_OUT_ADDR A:0xfc4b1028
y.create.l HWIO_SPDM_OLEM_CYCLE_C3_OUT_ADDR A:0xfc4b102c
y.create.l HWIO_SPDM_OLEM_CYCLE_C4_OUT_ADDR A:0xfc4b1030
y.create.l HWIO_SPDM_OLEM_CYCLE_C5_OUT_ADDR A:0xfc4b1034
y.create.l HWIO_SPDM_OLEM_CYCLE_C6_OUT_ADDR A:0xfc4b1038
y.create.l HWIO_SPDM_OLEM_CYCLE_C7_OUT_ADDR A:0xfc4b103c
y.create.l HWIO_SPDM_OLEM_CYCLE_C8_OUT_ADDR A:0xfc4b1040
y.create.l HWIO_SPDM_OLEM_CYCLE_C9_OUT_ADDR A:0xfc4b1044
y.create.l HWIO_SPDM_OLEM_EVENT_C0_OUT_ADDR A:0xfc4b10a0
y.create.l HWIO_SPDM_OLEM_EVENT_C1_OUT_ADDR A:0xfc4b10a4
y.create.l HWIO_SPDM_OLEM_EVENT_C2_OUT_ADDR A:0xfc4b10a8
y.create.l HWIO_SPDM_OLEM_EVENT_C3_OUT_ADDR A:0xfc4b10ac
y.create.l HWIO_SPDM_OLEM_EVENT_C4_OUT_ADDR A:0xfc4b10b0
y.create.l HWIO_SPDM_OLEM_EVENT_C5_OUT_ADDR A:0xfc4b10b4
y.create.l HWIO_SPDM_OLEM_EVENT_C6_OUT_ADDR A:0xfc4b10b8
y.create.l HWIO_SPDM_OLEM_EVENT_C7_OUT_ADDR A:0xfc4b10bc
y.create.l HWIO_SPDM_OLEM_EVENT_C8_OUT_ADDR A:0xfc4b10c0
y.create.l HWIO_SPDM_OLEM_EVENT_C9_OUT_ADDR A:0xfc4b10c4
y.create.l HWIO_SPDM_OLEM_MULTIBIT_C0_OUT_ADDR A:0xfc4b1120
y.create.l HWIO_SPDM_OLEM_MULTIBIT_C1_OUT_ADDR A:0xfc4b1124
y.create.l HWIO_SPDM_OLEM_MULTIBIT_C2_OUT_ADDR A:0xfc4b1128
y.create.l HWIO_SPDM_OLEM_MULTIBIT_C3_OUT_ADDR A:0xfc4b112c
y.create.l HWIO_SPDM_OLEM_MULTIBIT_C4_OUT_ADDR A:0xfc4b1130
y.create.l HWIO_SPDM_OLEM_MULTIBIT_C5_OUT_ADDR A:0xfc4b1134
y.create.l HWIO_SPDM_OLEM_MULTIBIT_C6_OUT_ADDR A:0xfc4b1138
y.create.l HWIO_SPDM_OLEM_MULTIBIT_C7_OUT_ADDR A:0xfc4b113c
y.create.l HWIO_SPDM_RT_LOW_THRESH_STATUS_ADDR A:0xfc4b2000
y.create.l HWIO_SPDM_RT_HIGH_THRESH_STATUS_ADDR A:0xfc4b2004
y.create.l HWIO_SPDM_RT_LOW_IRQ_EN_0_ADDR A:0xfc4b2010
y.create.l HWIO_SPDM_RT_LOW_IRQ_EN_1_ADDR A:0xfc4b2014
y.create.l HWIO_SPDM_RT_LOW_IRQ_EN_2_ADDR A:0xfc4b2018
y.create.l HWIO_SPDM_RT_LOW_IRQ_EN_3_ADDR A:0xfc4b201c
y.create.l HWIO_SPDM_RT_HIGH_IRQ_EN_0_ADDR A:0xfc4b2020
y.create.l HWIO_SPDM_RT_HIGH_IRQ_EN_1_ADDR A:0xfc4b2024
y.create.l HWIO_SPDM_RT_HIGH_IRQ_EN_2_ADDR A:0xfc4b2028
y.create.l HWIO_SPDM_RT_HIGH_IRQ_EN_3_ADDR A:0xfc4b202c
y.create.l HWIO_SPDM_RT_IRQ_TIMER_0_ADDR A:0xfc4b2030
y.create.l HWIO_SPDM_RT_IRQ_TIMER_1_ADDR A:0xfc4b2034
y.create.l HWIO_SPDM_RT_IRQ_TIMER_2_ADDR A:0xfc4b2038
y.create.l HWIO_SPDM_RT_IRQ_TIMER_3_ADDR A:0xfc4b203c
y.create.l HWIO_SPDM_RT_DIAG_MUX_SEL_ADDR A:0xfc4b2040
y.create.l HWIO_SPDM_RT_MON_EN_ADDR A:0xfc4b2050
y.create.l HWIO_SPDM_RT_MON_EN_SET_ADDR A:0xfc4b2054
y.create.l HWIO_SPDM_RT_MON_EN_CLEAR_ADDR A:0xfc4b2058
y.create.l HWIO_SPDM_RT_MON_RST_ADDR A:0xfc4b2060
y.create.l HWIO_SPDM_RT_MON_RST_SET_ADDR A:0xfc4b2064
y.create.l HWIO_SPDM_RT_MON_RST_CLEAR_ADDR A:0xfc4b2068
y.create.l HWIO_SPDM_RT_MON_CFG_0_ADDR A:0xfc4b2100
y.create.l HWIO_SPDM_RT_MON_CFG_1_ADDR A:0xfc4b2110
y.create.l HWIO_SPDM_RT_MON_CFG_2_ADDR A:0xfc4b2120
y.create.l HWIO_SPDM_RT_MON_CFG_3_ADDR A:0xfc4b2130
y.create.l HWIO_SPDM_RT_MON_CFG_4_ADDR A:0xfc4b2140
y.create.l HWIO_SPDM_RT_MON_CFG_5_ADDR A:0xfc4b2150
y.create.l HWIO_SPDM_RT_MON_CFG_6_ADDR A:0xfc4b2160
y.create.l HWIO_SPDM_RT_MON_CFG_7_ADDR A:0xfc4b2170
y.create.l HWIO_SPDM_RT_MON_CFG_8_ADDR A:0xfc4b2180
y.create.l HWIO_SPDM_RT_MON_CFG_9_ADDR A:0xfc4b2190
y.create.l HWIO_SPDM_RT_THRESH_CFG_0_ADDR A:0xfc4b2104
y.create.l HWIO_SPDM_RT_THRESH_CFG_1_ADDR A:0xfc4b2114
y.create.l HWIO_SPDM_RT_THRESH_CFG_2_ADDR A:0xfc4b2124
y.create.l HWIO_SPDM_RT_THRESH_CFG_3_ADDR A:0xfc4b2134
y.create.l HWIO_SPDM_RT_THRESH_CFG_4_ADDR A:0xfc4b2144
y.create.l HWIO_SPDM_RT_THRESH_CFG_5_ADDR A:0xfc4b2154
y.create.l HWIO_SPDM_RT_THRESH_CFG_6_ADDR A:0xfc4b2164
y.create.l HWIO_SPDM_RT_THRESH_CFG_7_ADDR A:0xfc4b2174
y.create.l HWIO_SPDM_RT_THRESH_CFG_8_ADDR A:0xfc4b2184
y.create.l HWIO_SPDM_RT_THRESH_CFG_9_ADDR A:0xfc4b2194
y.create.l HWIO_SPDM_RT_MON_STATUS_0_ADDR A:0xfc4b2108
y.create.l HWIO_SPDM_RT_MON_STATUS_1_ADDR A:0xfc4b2118
y.create.l HWIO_SPDM_RT_MON_STATUS_2_ADDR A:0xfc4b2128
y.create.l HWIO_SPDM_RT_MON_STATUS_3_ADDR A:0xfc4b2138
y.create.l HWIO_SPDM_RT_MON_STATUS_4_ADDR A:0xfc4b2148
y.create.l HWIO_SPDM_RT_MON_STATUS_5_ADDR A:0xfc4b2158
y.create.l HWIO_SPDM_RT_MON_STATUS_6_ADDR A:0xfc4b2168
y.create.l HWIO_SPDM_RT_MON_STATUS_7_ADDR A:0xfc4b2178
y.create.l HWIO_SPDM_RT_MON_STATUS_8_ADDR A:0xfc4b2188
y.create.l HWIO_SPDM_RT_MON_STATUS_9_ADDR A:0xfc4b2198
y.create.l HWIO_SPDM_XPU_SCR_ADDR A:0xfc4b3000
y.create.l HWIO_SPDM_XPU_SWDR_ADDR A:0xfc4b3004
y.create.l HWIO_SPDM_XPU_SEAR0_ADDR A:0xfc4b3040
y.create.l HWIO_SPDM_XPU_SESR_ADDR A:0xfc4b3048
y.create.l HWIO_SPDM_XPU_SESRRESTORE_ADDR A:0xfc4b304c
y.create.l HWIO_SPDM_XPU_SESYNR0_ADDR A:0xfc4b3050
y.create.l HWIO_SPDM_XPU_SESYNR1_ADDR A:0xfc4b3054
y.create.l HWIO_SPDM_XPU_SESYNR2_ADDR A:0xfc4b3058
y.create.l HWIO_SPDM_XPU_MCR_ADDR A:0xfc4b3100
y.create.l HWIO_SPDM_XPU_MEAR0_ADDR A:0xfc4b3140
y.create.l HWIO_SPDM_XPU_MESR_ADDR A:0xfc4b3148
y.create.l HWIO_SPDM_XPU_MESRRESTORE_ADDR A:0xfc4b314c
y.create.l HWIO_SPDM_XPU_MESYNR0_ADDR A:0xfc4b3150
y.create.l HWIO_SPDM_XPU_MESYNR1_ADDR A:0xfc4b3154
y.create.l HWIO_SPDM_XPU_MESYNR2_ADDR A:0xfc4b3158
y.create.l HWIO_SPDM_XPU_CR_ADDR A:0xfc4b3080
y.create.l HWIO_SPDM_XPU_RPU_ACR0_ADDR A:0xfc4b30a0
y.create.l HWIO_SPDM_XPU_EAR0_ADDR A:0xfc4b30c0
y.create.l HWIO_SPDM_XPU_ESR_ADDR A:0xfc4b30c8
y.create.l HWIO_SPDM_XPU_ESRRESTORE_ADDR A:0xfc4b30cc
y.create.l HWIO_SPDM_XPU_ESYNR0_ADDR A:0xfc4b30d0
y.create.l HWIO_SPDM_XPU_ESYNR1_ADDR A:0xfc4b30d4
y.create.l HWIO_SPDM_XPU_ESYNR2_ADDR A:0xfc4b30d8
y.create.l HWIO_SPDM_XPU_IDR0_ADDR A:0xfc4b3074
y.create.l HWIO_SPDM_XPU_IDR1_ADDR A:0xfc4b3078
y.create.l HWIO_SPDM_XPU_REV_ADDR A:0xfc4b307c
y.create.l HWIO_SPDM_XPU_RG0_RACR0_ADDR A:0xfc4b3200
y.create.l HWIO_SPDM_XPU_RG0_SCR_ADDR A:0xfc4b3250
y.create.l HWIO_SPDM_XPU_RG0_MCR_ADDR A:0xfc4b3254
y.create.l HWIO_SPDM_SREG_CFG0_ADDR A:0xfc4b4000
y.create.l HWIO_SPDM_SREG_CFG1_ADDR A:0xfc4b4004
y.create.l HWIO_SPDM_SREG_MUTEX_0_ADDR A:0xfc4b4100
y.create.l HWIO_SPDM_VMIDMT_SCR0_ADDR A:0xfc4b5000
y.create.l HWIO_SPDM_VMIDMT_SCR1_ADDR A:0xfc4b5004
y.create.l HWIO_SPDM_VMIDMT_SCR2_ADDR A:0xfc4b5008
y.create.l HWIO_SPDM_VMIDMT_SACR_ADDR A:0xfc4b5010
y.create.l HWIO_SPDM_VMIDMT_SIDR0_ADDR A:0xfc4b5020
y.create.l HWIO_SPDM_VMIDMT_SIDR1_ADDR A:0xfc4b5024
y.create.l HWIO_SPDM_VMIDMT_SIDR2_ADDR A:0xfc4b5028
y.create.l HWIO_SPDM_VMIDMT_SIDR4_ADDR A:0xfc4b5030
y.create.l HWIO_SPDM_VMIDMT_SIDR5_ADDR A:0xfc4b5034
y.create.l HWIO_SPDM_VMIDMT_SIDR7_ADDR A:0xfc4b503c
y.create.l HWIO_SPDM_VMIDMT_SGFAR0_ADDR A:0xfc4b5040
y.create.l HWIO_SPDM_VMIDMT_SGFSR_ADDR A:0xfc4b5048
y.create.l HWIO_SPDM_VMIDMT_SGFSRRESTORE_ADDR A:0xfc4b504c
y.create.l HWIO_SPDM_VMIDMT_SGFSYNDR0_ADDR A:0xfc4b5050
y.create.l HWIO_SPDM_VMIDMT_SGFSYNDR1_ADDR A:0xfc4b5054
y.create.l HWIO_SPDM_VMIDMT_SGFSYNDR2_ADDR A:0xfc4b5058
y.create.l HWIO_SPDM_VMIDMT_VMIDMTSCR0_ADDR A:0xfc4b5090
y.create.l HWIO_SPDM_VMIDMT_CR0_ADDR A:0xfc4b5000
y.create.l HWIO_SPDM_VMIDMT_CR2_ADDR A:0xfc4b5008
y.create.l HWIO_SPDM_VMIDMT_ACR_ADDR A:0xfc4b5010
y.create.l HWIO_SPDM_VMIDMT_IDR0_ADDR A:0xfc4b5020
y.create.l HWIO_SPDM_VMIDMT_IDR1_ADDR A:0xfc4b5024
y.create.l HWIO_SPDM_VMIDMT_IDR2_ADDR A:0xfc4b5028
y.create.l HWIO_SPDM_VMIDMT_IDR4_ADDR A:0xfc4b5030
y.create.l HWIO_SPDM_VMIDMT_IDR5_ADDR A:0xfc4b5034
y.create.l HWIO_SPDM_VMIDMT_IDR7_ADDR A:0xfc4b503c
y.create.l HWIO_SPDM_VMIDMT_GFAR0_ADDR A:0xfc4b5040
y.create.l HWIO_SPDM_VMIDMT_GFSR_ADDR A:0xfc4b5048
y.create.l HWIO_SPDM_VMIDMT_GFSRRESTORE_ADDR A:0xfc4b504c
y.create.l HWIO_SPDM_VMIDMT_GFSYNDR0_ADDR A:0xfc4b5050
y.create.l HWIO_SPDM_VMIDMT_GFSYNDR1_ADDR A:0xfc4b5054
y.create.l HWIO_SPDM_VMIDMT_GFSYNDR2_ADDR A:0xfc4b5058
y.create.l HWIO_SPDM_VMIDMT_VMIDMTCR0_ADDR A:0xfc4b5090
y.create.l HWIO_SPDM_VMIDMT_VMIDMTACR_ADDR A:0xfc4b509c
y.create.l HWIO_SPDM_VMIDMT_NSCR0_ADDR A:0xfc4b5400
y.create.l HWIO_SPDM_VMIDMT_NSCR2_ADDR A:0xfc4b5408
y.create.l HWIO_SPDM_VMIDMT_NSACR_ADDR A:0xfc4b5410
y.create.l HWIO_SPDM_VMIDMT_NSGFAR0_ADDR A:0xfc4b5440
y.create.l HWIO_SPDM_VMIDMT_NSGFSR_ADDR A:0xfc4b5448
y.create.l HWIO_SPDM_VMIDMT_NSGFSRRESTORE_ADDR A:0xfc4b544c
y.create.l HWIO_SPDM_VMIDMT_NSGFSYNDR0_ADDR A:0xfc4b5450
y.create.l HWIO_SPDM_VMIDMT_NSGFSYNDR1_ADDR A:0xfc4b5454
y.create.l HWIO_SPDM_VMIDMT_NSGFSYNDR2_ADDR A:0xfc4b5458
y.create.l HWIO_SPDM_VMIDMT_NSVMIDMTCR0_ADDR A:0xfc4b5490
y.create.l HWIO_SPDM_VMIDMT_SSDR0_ADDR A:0xfc4b5080
y.create.l HWIO_SPDM_VMIDMT_S2VR0_ADDR A:0xfc4b5c00
y.create.l HWIO_SPDM_VMIDMT_AS2VR0_ADDR A:0xfc4b5e00
y.create.l HWIO_SNOC_OBS_ID_COREID_ADDR A:0xfc460000
y.create.l HWIO_SNOC_OBS_ID_REVISIONID_ADDR A:0xfc460004
y.create.l HWIO_SNOC_OBS_ERRCTL_ADDR A:0xfc460008
y.create.l HWIO_SNOC_OBS_ERRSTATUS_ADDR A:0xfc46000c
y.create.l HWIO_SNOC_OBS_ERRLOG0_ADDR A:0xfc460010
y.create.l HWIO_SNOC_OBS_ERRLOG1_ADDR A:0xfc460014
y.create.l HWIO_SNOC_OBS_ERRLOG2_ADDR A:0xfc460018
y.create.l HWIO_SNOC_OBS_ERRLOG3_ADDR A:0xfc46001c
y.create.l HWIO_SNOC_OBS_ERRLOG5_ADDR A:0xfc460024
y.create.l HWIO_SNOC_OBS_DBG_ID_COREID_ADDR A:0xfc460080
y.create.l HWIO_SNOC_OBS_DBG_ID_REVISIONID_ADDR A:0xfc460084
y.create.l HWIO_SNOC_OBS_DBG_ATBID_ADDR A:0xfc460088
y.create.l HWIO_SNOC_QHM_LPASS_TFILT_ID_COREID_ADDR A:0xfc461000
y.create.l HWIO_SNOC_QHM_LPASS_TFILT_ID_REVISIONID_ADDR A:0xfc461004
y.create.l HWIO_SNOC_QHM_LPASS_TFILT_MODE_ADDR A:0xfc461008
y.create.l HWIO_SNOC_QHM_LPASS_TFILT_ADDRBASE_LOW_ADDR A:0xfc46100c
y.create.l HWIO_SNOC_QHM_LPASS_TFILT_ADDRWINDOWSIZE_ADDR A:0xfc461014
y.create.l HWIO_SNOC_QHM_LPASS_TFILT_SRCIDBASE_ADDR A:0xfc461018
y.create.l HWIO_SNOC_QHM_LPASS_TFILT_SRCIDMASK_ADDR A:0xfc46101c
y.create.l HWIO_SNOC_QHM_LPASS_TFILT_OPCODE_ADDR A:0xfc461020
y.create.l HWIO_SNOC_QDSS_BAM_TFILT_ID_COREID_ADDR A:0xfc461080
y.create.l HWIO_SNOC_QDSS_BAM_TFILT_ID_REVISIONID_ADDR A:0xfc461084
y.create.l HWIO_SNOC_QDSS_BAM_TFILT_MODE_ADDR A:0xfc461088
y.create.l HWIO_SNOC_QDSS_BAM_TFILT_ADDRBASE_LOW_ADDR A:0xfc46108c
y.create.l HWIO_SNOC_QDSS_BAM_TFILT_ADDRWINDOWSIZE_ADDR A:0xfc461094
y.create.l HWIO_SNOC_QDSS_BAM_TFILT_SRCIDBASE_ADDR A:0xfc461098
y.create.l HWIO_SNOC_QDSS_BAM_TFILT_SRCIDMASK_ADDR A:0xfc46109c
y.create.l HWIO_SNOC_QDSS_BAM_TFILT_OPCODE_ADDR A:0xfc4610a0
y.create.l HWIO_SNOC_CRYPTO0_TFILT_ID_COREID_ADDR A:0xfc461100
y.create.l HWIO_SNOC_CRYPTO0_TFILT_ID_REVISIONID_ADDR A:0xfc461104
y.create.l HWIO_SNOC_CRYPTO0_TFILT_MODE_ADDR A:0xfc461108
y.create.l HWIO_SNOC_CRYPTO0_TFILT_ADDRBASE_LOW_ADDR A:0xfc46110c
y.create.l HWIO_SNOC_CRYPTO0_TFILT_ADDRBASE_HIGH_ADDR A:0xfc461110
y.create.l HWIO_SNOC_CRYPTO0_TFILT_ADDRWINDOWSIZE_ADDR A:0xfc461114
y.create.l HWIO_SNOC_CRYPTO0_TFILT_SRCIDBASE_ADDR A:0xfc461118
y.create.l HWIO_SNOC_CRYPTO0_TFILT_SRCIDMASK_ADDR A:0xfc46111c
y.create.l HWIO_SNOC_CRYPTO0_TFILT_OPCODE_ADDR A:0xfc461120
y.create.l HWIO_SNOC_MSS_TFILT_ID_COREID_ADDR A:0xfc461280
y.create.l HWIO_SNOC_MSS_TFILT_ID_REVISIONID_ADDR A:0xfc461284
y.create.l HWIO_SNOC_MSS_TFILT_MODE_ADDR A:0xfc461288
y.create.l HWIO_SNOC_MSS_TFILT_ADDRBASE_LOW_ADDR A:0xfc46128c
y.create.l HWIO_SNOC_MSS_TFILT_ADDRBASE_HIGH_ADDR A:0xfc461290
y.create.l HWIO_SNOC_MSS_TFILT_ADDRWINDOWSIZE_ADDR A:0xfc461294
y.create.l HWIO_SNOC_MSS_TFILT_SRCIDBASE_ADDR A:0xfc461298
y.create.l HWIO_SNOC_MSS_TFILT_SRCIDMASK_ADDR A:0xfc46129c
y.create.l HWIO_SNOC_MSS_TFILT_OPCODE_ADDR A:0xfc4612a0
y.create.l HWIO_SNOC_MSS_NAV_TFILT_ID_COREID_ADDR A:0xfc461300
y.create.l HWIO_SNOC_MSS_NAV_TFILT_ID_REVISIONID_ADDR A:0xfc461304
y.create.l HWIO_SNOC_MSS_NAV_TFILT_MODE_ADDR A:0xfc461308
y.create.l HWIO_SNOC_MSS_NAV_TFILT_ADDRBASE_LOW_ADDR A:0xfc46130c
y.create.l HWIO_SNOC_MSS_NAV_TFILT_ADDRBASE_HIGH_ADDR A:0xfc461310
y.create.l HWIO_SNOC_MSS_NAV_TFILT_ADDRWINDOWSIZE_ADDR A:0xfc461314
y.create.l HWIO_SNOC_MSS_NAV_TFILT_SRCIDBASE_ADDR A:0xfc461318
y.create.l HWIO_SNOC_MSS_NAV_TFILT_SRCIDMASK_ADDR A:0xfc46131c
y.create.l HWIO_SNOC_MSS_NAV_TFILT_OPCODE_ADDR A:0xfc461320
y.create.l HWIO_SNOC_PNOC_TFILT_ID_COREID_ADDR A:0xfc461400
y.create.l HWIO_SNOC_PNOC_TFILT_ID_REVISIONID_ADDR A:0xfc461404
y.create.l HWIO_SNOC_PNOC_TFILT_MODE_ADDR A:0xfc461408
y.create.l HWIO_SNOC_PNOC_TFILT_ADDRBASE_LOW_ADDR A:0xfc46140c
y.create.l HWIO_SNOC_PNOC_TFILT_ADDRBASE_HIGH_ADDR A:0xfc461410
y.create.l HWIO_SNOC_PNOC_TFILT_ADDRWINDOWSIZE_ADDR A:0xfc461414
y.create.l HWIO_SNOC_PNOC_TFILT_SRCIDBASE_ADDR A:0xfc461418
y.create.l HWIO_SNOC_PNOC_TFILT_SRCIDMASK_ADDR A:0xfc46141c
y.create.l HWIO_SNOC_PNOC_TFILT_OPCODE_ADDR A:0xfc461420
y.create.l HWIO_SNOC_WCSS_TFILT_ID_COREID_ADDR A:0xfc461480
y.create.l HWIO_SNOC_WCSS_TFILT_ID_REVISIONID_ADDR A:0xfc461484
y.create.l HWIO_SNOC_WCSS_TFILT_MODE_ADDR A:0xfc461488
y.create.l HWIO_SNOC_WCSS_TFILT_ADDRBASE_LOW_ADDR A:0xfc46148c
y.create.l HWIO_SNOC_WCSS_TFILT_ADDRBASE_HIGH_ADDR A:0xfc461490
y.create.l HWIO_SNOC_WCSS_TFILT_ADDRWINDOWSIZE_ADDR A:0xfc461494
y.create.l HWIO_SNOC_WCSS_TFILT_SRCIDBASE_ADDR A:0xfc461498
y.create.l HWIO_SNOC_WCSS_TFILT_SRCIDMASK_ADDR A:0xfc46149c
y.create.l HWIO_SNOC_WCSS_TFILT_OPCODE_ADDR A:0xfc4614a0
y.create.l HWIO_SNOC_QDSS_ETR_TFILT_ID_COREID_ADDR A:0xfc461500
y.create.l HWIO_SNOC_QDSS_ETR_TFILT_ID_REVISIONID_ADDR A:0xfc461504
y.create.l HWIO_SNOC_QDSS_ETR_TFILT_MODE_ADDR A:0xfc461508
y.create.l HWIO_SNOC_QDSS_ETR_TFILT_ADDRBASE_LOW_ADDR A:0xfc46150c
y.create.l HWIO_SNOC_QDSS_ETR_TFILT_ADDRWINDOWSIZE_ADDR A:0xfc461514
y.create.l HWIO_SNOC_QDSS_ETR_TFILT_SRCIDBASE_ADDR A:0xfc461518
y.create.l HWIO_SNOC_QDSS_ETR_TFILT_SRCIDMASK_ADDR A:0xfc46151c
y.create.l HWIO_SNOC_QDSS_ETR_TFILT_OPCODE_ADDR A:0xfc461520
y.create.l HWIO_SNOC_QXM_BIMC_TFILT_ID_COREID_ADDR A:0xfc461580
y.create.l HWIO_SNOC_QXM_BIMC_TFILT_ID_REVISIONID_ADDR A:0xfc461584
y.create.l HWIO_SNOC_QXM_BIMC_TFILT_MODE_ADDR A:0xfc461588
y.create.l HWIO_SNOC_QXM_BIMC_TFILT_ADDRBASE_LOW_ADDR A:0xfc46158c
y.create.l HWIO_SNOC_QXM_BIMC_TFILT_ADDRBASE_HIGH_ADDR A:0xfc461590
y.create.l HWIO_SNOC_QXM_BIMC_TFILT_ADDRWINDOWSIZE_ADDR A:0xfc461594
y.create.l HWIO_SNOC_QXM_BIMC_TFILT_SRCIDBASE_ADDR A:0xfc461598
y.create.l HWIO_SNOC_QXM_BIMC_TFILT_SRCIDMASK_ADDR A:0xfc46159c
y.create.l HWIO_SNOC_QXM_BIMC_TFILT_OPCODE_ADDR A:0xfc4615a0
y.create.l HWIO_SNOC_TPRB0_TPROF_ID_COREID_ADDR A:0xfc461600
y.create.l HWIO_SNOC_TPRB0_TPROF_ID_REVISIONID_ADDR A:0xfc461604
y.create.l HWIO_SNOC_TPRB0_TPROF_EN_ADDR A:0xfc461608
y.create.l HWIO_SNOC_TPRB0_TPROF_MODE_ADDR A:0xfc46160c
y.create.l HWIO_SNOC_TPRB0_TPROF_OBSERVEDSEL_0_ADDR A:0xfc461610
y.create.l HWIO_SNOC_TPRB0_TPROF_OBSERVEDSEL_1_ADDR A:0xfc461614
y.create.l HWIO_SNOC_TPRB0_TPROF_NTENURELINES_0_ADDR A:0xfc461620
y.create.l HWIO_SNOC_TPRB0_TPROF_THRESHOLDS_0_0_ADDR A:0xfc46162c
y.create.l HWIO_SNOC_TPRB0_TPROF_THRESHOLDS_0_1_ADDR A:0xfc461630
y.create.l HWIO_SNOC_TPRB0_TPROF_THRESHOLDS_0_2_ADDR A:0xfc461634
y.create.l HWIO_SNOC_TPRB0_TPROF_THRESHOLDS_1_0_ADDR A:0xfc46163c
y.create.l HWIO_SNOC_TPRB0_TPROF_THRESHOLDS_1_1_ADDR A:0xfc461640
y.create.l HWIO_SNOC_TPRB0_TPROF_THRESHOLDS_1_2_ADDR A:0xfc461644
y.create.l HWIO_SNOC_TPRB0_TPROF_OVERFLOWSTATUS_ADDR A:0xfc46166c
y.create.l HWIO_SNOC_TPRB0_TPROF_OVERFLOWRESET_ADDR A:0xfc461670
y.create.l HWIO_SNOC_TPRB0_TPROF_PENDINGEVENTMODE_ADDR A:0xfc461674
y.create.l HWIO_SNOC_TPRB0_TPROF_PRESCALER_ADDR A:0xfc461678
y.create.l HWIO_SNOC_TPRB1_TPROF_ID_COREID_ADDR A:0xfc461680
y.create.l HWIO_SNOC_TPRB1_TPROF_ID_REVISIONID_ADDR A:0xfc461684
y.create.l HWIO_SNOC_TPRB1_TPROF_EN_ADDR A:0xfc461688
y.create.l HWIO_SNOC_TPRB1_TPROF_MODE_ADDR A:0xfc46168c
y.create.l HWIO_SNOC_TPRB1_TPROF_OBSERVEDSEL_0_ADDR A:0xfc461690
y.create.l HWIO_SNOC_TPRB1_TPROF_OBSERVEDSEL_1_ADDR A:0xfc461694
y.create.l HWIO_SNOC_TPRB1_TPROF_NTENURELINES_0_ADDR A:0xfc4616a0
y.create.l HWIO_SNOC_TPRB1_TPROF_THRESHOLDS_0_0_ADDR A:0xfc4616ac
y.create.l HWIO_SNOC_TPRB1_TPROF_THRESHOLDS_0_1_ADDR A:0xfc4616b0
y.create.l HWIO_SNOC_TPRB1_TPROF_THRESHOLDS_0_2_ADDR A:0xfc4616b4
y.create.l HWIO_SNOC_TPRB1_TPROF_THRESHOLDS_1_0_ADDR A:0xfc4616bc
y.create.l HWIO_SNOC_TPRB1_TPROF_THRESHOLDS_1_1_ADDR A:0xfc4616c0
y.create.l HWIO_SNOC_TPRB1_TPROF_THRESHOLDS_1_2_ADDR A:0xfc4616c4
y.create.l HWIO_SNOC_TPRB1_TPROF_OVERFLOWSTATUS_ADDR A:0xfc4616ec
y.create.l HWIO_SNOC_TPRB1_TPROF_OVERFLOWRESET_ADDR A:0xfc4616f0
y.create.l HWIO_SNOC_TPRB1_TPROF_PENDINGEVENTMODE_ADDR A:0xfc4616f4
y.create.l HWIO_SNOC_TPRB1_TPROF_PRESCALER_ADDR A:0xfc4616f8
y.create.l HWIO_SNOC_TPRB2_TPROF_ID_COREID_ADDR A:0xfc461700
y.create.l HWIO_SNOC_TPRB2_TPROF_ID_REVISIONID_ADDR A:0xfc461704
y.create.l HWIO_SNOC_TPRB2_TPROF_EN_ADDR A:0xfc461708
y.create.l HWIO_SNOC_TPRB2_TPROF_MODE_ADDR A:0xfc46170c
y.create.l HWIO_SNOC_TPRB2_TPROF_OBSERVEDSEL_0_ADDR A:0xfc461710
y.create.l HWIO_SNOC_TPRB2_TPROF_OBSERVEDSEL_1_ADDR A:0xfc461714
y.create.l HWIO_SNOC_TPRB2_TPROF_NTENURELINES_0_ADDR A:0xfc461720
y.create.l HWIO_SNOC_TPRB2_TPROF_THRESHOLDS_0_0_ADDR A:0xfc46172c
y.create.l HWIO_SNOC_TPRB2_TPROF_THRESHOLDS_0_1_ADDR A:0xfc461730
y.create.l HWIO_SNOC_TPRB2_TPROF_THRESHOLDS_0_2_ADDR A:0xfc461734
y.create.l HWIO_SNOC_TPRB2_TPROF_THRESHOLDS_1_0_ADDR A:0xfc46173c
y.create.l HWIO_SNOC_TPRB2_TPROF_THRESHOLDS_1_1_ADDR A:0xfc461740
y.create.l HWIO_SNOC_TPRB2_TPROF_THRESHOLDS_1_2_ADDR A:0xfc461744
y.create.l HWIO_SNOC_TPRB2_TPROF_OVERFLOWSTATUS_ADDR A:0xfc46176c
y.create.l HWIO_SNOC_TPRB2_TPROF_OVERFLOWRESET_ADDR A:0xfc461770
y.create.l HWIO_SNOC_TPRB2_TPROF_PENDINGEVENTMODE_ADDR A:0xfc461774
y.create.l HWIO_SNOC_TPRB2_TPROF_PRESCALER_ADDR A:0xfc461778
y.create.l HWIO_SNOC_EPRB0_SPROF_ID_COREID_ADDR A:0xfc461800
y.create.l HWIO_SNOC_EPRB0_SPROF_ID_REVISIONID_ADDR A:0xfc461804
y.create.l HWIO_SNOC_EPRB0_SPROF_MAINCTL_ADDR A:0xfc461808
y.create.l HWIO_SNOC_EPRB0_SPROF_CFGCTL_ADDR A:0xfc46180c
y.create.l HWIO_SNOC_EPRB0_SPROF_TRACEPORTSEL_ADDR A:0xfc461810
y.create.l HWIO_SNOC_EPRB0_SPROF_FILTERLUT_ADDR A:0xfc461814
y.create.l HWIO_SNOC_EPRB0_SPROF_TRACEALARMEN_ADDR A:0xfc461818
y.create.l HWIO_SNOC_EPRB0_SPROF_TRACEALARMSTATUS_ADDR A:0xfc46181c
y.create.l HWIO_SNOC_EPRB0_SPROF_TRACEALARMCLR_ADDR A:0xfc461820
y.create.l HWIO_SNOC_EPRB0_SPROF_STATPERIOD_ADDR A:0xfc461824
y.create.l HWIO_SNOC_EPRB0_SPROF_STATGO_ADDR A:0xfc461828
y.create.l HWIO_SNOC_EPRB0_SPROF_STATALARMMIN_ADDR A:0xfc46182c
y.create.l HWIO_SNOC_EPRB0_SPROF_STATALARMMAX_ADDR A:0xfc461830
y.create.l HWIO_SNOC_EPRB0_SPROF_STATALARMSTATUS_ADDR A:0xfc461834
y.create.l HWIO_SNOC_EPRB0_SPROF_STATALARMCLR_ADDR A:0xfc461838
y.create.l HWIO_SNOC_EPRB0_SPROF_FILTERS_0_ROUTEIDBASE_ADDR A:0xfc461844
y.create.l HWIO_SNOC_EPRB0_SPROF_FILTERS_0_ROUTEIDMASK_ADDR A:0xfc461848
y.create.l HWIO_SNOC_EPRB0_SPROF_FILTERS_0_ADDRBASE_LOW_ADDR A:0xfc46184c
y.create.l HWIO_SNOC_EPRB0_SPROF_FILTERS_0_ADDRBASE_HIGH_ADDR A:0xfc461850
y.create.l HWIO_SNOC_EPRB0_SPROF_FILTERS_0_WINDOWSIZE_ADDR A:0xfc461854
y.create.l HWIO_SNOC_EPRB0_SPROF_FILTERS_0_OPCODE_ADDR A:0xfc461860
y.create.l HWIO_SNOC_EPRB0_SPROF_FILTERS_0_STATUS_ADDR A:0xfc461864
y.create.l HWIO_SNOC_EPRB0_SPROF_FILTERS_0_LENGTH_ADDR A:0xfc461868
y.create.l HWIO_SNOC_EPRB0_SPROF_FILTERS_0_URGENCY_ADDR A:0xfc46186c
y.create.l HWIO_SNOC_EPRB0_SPROF_FILTERS_1_ROUTEIDBASE_ADDR A:0xfc461880
y.create.l HWIO_SNOC_EPRB0_SPROF_FILTERS_1_ROUTEIDMASK_ADDR A:0xfc461884
y.create.l HWIO_SNOC_EPRB0_SPROF_FILTERS_1_ADDRBASE_LOW_ADDR A:0xfc461888
y.create.l HWIO_SNOC_EPRB0_SPROF_FILTERS_1_ADDRBASE_HIGH_ADDR A:0xfc46188c
y.create.l HWIO_SNOC_EPRB0_SPROF_FILTERS_1_WINDOWSIZE_ADDR A:0xfc461890
y.create.l HWIO_SNOC_EPRB0_SPROF_FILTERS_1_OPCODE_ADDR A:0xfc46189c
y.create.l HWIO_SNOC_EPRB0_SPROF_FILTERS_1_STATUS_ADDR A:0xfc4618a0
y.create.l HWIO_SNOC_EPRB0_SPROF_FILTERS_1_LENGTH_ADDR A:0xfc4618a4
y.create.l HWIO_SNOC_EPRB0_SPROF_FILTERS_1_URGENCY_ADDR A:0xfc4618a8
y.create.l HWIO_SNOC_EPRB0_SPROF_FILTERS_2_ROUTEIDBASE_ADDR A:0xfc4618bc
y.create.l HWIO_SNOC_EPRB0_SPROF_FILTERS_2_ROUTEIDMASK_ADDR A:0xfc4618c0
y.create.l HWIO_SNOC_EPRB0_SPROF_FILTERS_2_ADDRBASE_LOW_ADDR A:0xfc4618c4
y.create.l HWIO_SNOC_EPRB0_SPROF_FILTERS_2_ADDRBASE_HIGH_ADDR A:0xfc4618c8
y.create.l HWIO_SNOC_EPRB0_SPROF_FILTERS_2_WINDOWSIZE_ADDR A:0xfc4618cc
y.create.l HWIO_SNOC_EPRB0_SPROF_FILTERS_2_OPCODE_ADDR A:0xfc4618d8
y.create.l HWIO_SNOC_EPRB0_SPROF_FILTERS_2_STATUS_ADDR A:0xfc4618dc
y.create.l HWIO_SNOC_EPRB0_SPROF_FILTERS_2_LENGTH_ADDR A:0xfc4618e0
y.create.l HWIO_SNOC_EPRB0_SPROF_FILTERS_2_URGENCY_ADDR A:0xfc4618e4
y.create.l HWIO_SNOC_EPRB0_SPROF_FILTERS_3_ROUTEIDBASE_ADDR A:0xfc4618f8
y.create.l HWIO_SNOC_EPRB0_SPROF_FILTERS_3_ROUTEIDMASK_ADDR A:0xfc4618fc
y.create.l HWIO_SNOC_EPRB0_SPROF_FILTERS_3_ADDRBASE_LOW_ADDR A:0xfc461900
y.create.l HWIO_SNOC_EPRB0_SPROF_FILTERS_3_ADDRBASE_HIGH_ADDR A:0xfc461904
y.create.l HWIO_SNOC_EPRB0_SPROF_FILTERS_3_WINDOWSIZE_ADDR A:0xfc461908
y.create.l HWIO_SNOC_EPRB0_SPROF_FILTERS_3_OPCODE_ADDR A:0xfc461914
y.create.l HWIO_SNOC_EPRB0_SPROF_FILTERS_3_STATUS_ADDR A:0xfc461918
y.create.l HWIO_SNOC_EPRB0_SPROF_FILTERS_3_LENGTH_ADDR A:0xfc46191c
y.create.l HWIO_SNOC_EPRB0_SPROF_FILTERS_3_URGENCY_ADDR A:0xfc461920
y.create.l HWIO_SNOC_EPRB0_SPROF_COUNTERS_0_PORTSEL_ADDR A:0xfc461934
y.create.l HWIO_SNOC_EPRB0_SPROF_COUNTERS_0_SRC_ADDR A:0xfc461938
y.create.l HWIO_SNOC_EPRB0_SPROF_COUNTERS_0_ALARMMODE_ADDR A:0xfc46193c
y.create.l HWIO_SNOC_EPRB0_SPROF_COUNTERS_0_VAL_ADDR A:0xfc461940
y.create.l HWIO_SNOC_EPRB0_SPROF_COUNTERS_1_PORTSEL_ADDR A:0xfc461948
y.create.l HWIO_SNOC_EPRB0_SPROF_COUNTERS_1_SRC_ADDR A:0xfc46194c
y.create.l HWIO_SNOC_EPRB0_SPROF_COUNTERS_1_ALARMMODE_ADDR A:0xfc461950
y.create.l HWIO_SNOC_EPRB0_SPROF_COUNTERS_1_VAL_ADDR A:0xfc461954
y.create.l HWIO_SNOC_EPRB0_SPROF_COUNTERS_2_PORTSEL_ADDR A:0xfc46195c
y.create.l HWIO_SNOC_EPRB0_SPROF_COUNTERS_2_SRC_ADDR A:0xfc461960
y.create.l HWIO_SNOC_EPRB0_SPROF_COUNTERS_2_ALARMMODE_ADDR A:0xfc461964
y.create.l HWIO_SNOC_EPRB0_SPROF_COUNTERS_2_VAL_ADDR A:0xfc461968
y.create.l HWIO_SNOC_EPRB0_SPROF_COUNTERS_3_PORTSEL_ADDR A:0xfc461970
y.create.l HWIO_SNOC_EPRB0_SPROF_COUNTERS_3_SRC_ADDR A:0xfc461974
y.create.l HWIO_SNOC_EPRB0_SPROF_COUNTERS_3_ALARMMODE_ADDR A:0xfc461978
y.create.l HWIO_SNOC_EPRB0_SPROF_COUNTERS_3_VAL_ADDR A:0xfc46197c
y.create.l HWIO_SNOC_EPRB0_SPROF_COUNTERS_4_PORTSEL_ADDR A:0xfc461984
y.create.l HWIO_SNOC_EPRB0_SPROF_COUNTERS_4_SRC_ADDR A:0xfc461988
y.create.l HWIO_SNOC_EPRB0_SPROF_COUNTERS_4_ALARMMODE_ADDR A:0xfc46198c
y.create.l HWIO_SNOC_EPRB0_SPROF_COUNTERS_4_VAL_ADDR A:0xfc461990
y.create.l HWIO_SNOC_EPRB0_SPROF_COUNTERS_5_PORTSEL_ADDR A:0xfc461998
y.create.l HWIO_SNOC_EPRB0_SPROF_COUNTERS_5_SRC_ADDR A:0xfc46199c
y.create.l HWIO_SNOC_EPRB0_SPROF_COUNTERS_5_ALARMMODE_ADDR A:0xfc4619a0
y.create.l HWIO_SNOC_EPRB0_SPROF_COUNTERS_5_VAL_ADDR A:0xfc4619a4
y.create.l HWIO_SNOC_EPRB0_SPROF_COUNTERS_6_PORTSEL_ADDR A:0xfc4619ac
y.create.l HWIO_SNOC_EPRB0_SPROF_COUNTERS_6_SRC_ADDR A:0xfc4619b0
y.create.l HWIO_SNOC_EPRB0_SPROF_COUNTERS_6_ALARMMODE_ADDR A:0xfc4619b4
y.create.l HWIO_SNOC_EPRB0_SPROF_COUNTERS_6_VAL_ADDR A:0xfc4619b8
y.create.l HWIO_SNOC_EPRB0_SPROF_COUNTERS_7_PORTSEL_ADDR A:0xfc4619c0
y.create.l HWIO_SNOC_EPRB0_SPROF_COUNTERS_7_SRC_ADDR A:0xfc4619c4
y.create.l HWIO_SNOC_EPRB0_SPROF_COUNTERS_7_ALARMMODE_ADDR A:0xfc4619c8
y.create.l HWIO_SNOC_EPRB0_SPROF_COUNTERS_7_VAL_ADDR A:0xfc4619cc
y.create.l HWIO_SNOC_EPRB0_SPROF_COUNTERS_8_PORTSEL_ADDR A:0xfc4619d4
y.create.l HWIO_SNOC_EPRB0_SPROF_COUNTERS_8_SRC_ADDR A:0xfc4619d8
y.create.l HWIO_SNOC_EPRB0_SPROF_COUNTERS_8_ALARMMODE_ADDR A:0xfc4619dc
y.create.l HWIO_SNOC_EPRB0_SPROF_COUNTERS_8_VAL_ADDR A:0xfc4619e0
y.create.l HWIO_SNOC_EPRB0_SPROF_COUNTERS_9_PORTSEL_ADDR A:0xfc4619e8
y.create.l HWIO_SNOC_EPRB0_SPROF_COUNTERS_9_SRC_ADDR A:0xfc4619ec
y.create.l HWIO_SNOC_EPRB0_SPROF_COUNTERS_9_ALARMMODE_ADDR A:0xfc4619f0
y.create.l HWIO_SNOC_EPRB0_SPROF_COUNTERS_9_VAL_ADDR A:0xfc4619f4
y.create.l HWIO_SNOC_EPRB1_SPROF_ID_COREID_ADDR A:0xfc461c00
y.create.l HWIO_SNOC_EPRB1_SPROF_ID_REVISIONID_ADDR A:0xfc461c04
y.create.l HWIO_SNOC_EPRB1_SPROF_MAINCTL_ADDR A:0xfc461c08
y.create.l HWIO_SNOC_EPRB1_SPROF_CFGCTL_ADDR A:0xfc461c0c
y.create.l HWIO_SNOC_EPRB1_SPROF_TRACEPORTSEL_ADDR A:0xfc461c10
y.create.l HWIO_SNOC_EPRB1_SPROF_FILTERLUT_ADDR A:0xfc461c14
y.create.l HWIO_SNOC_EPRB1_SPROF_TRACEALARMEN_ADDR A:0xfc461c18
y.create.l HWIO_SNOC_EPRB1_SPROF_TRACEALARMSTATUS_ADDR A:0xfc461c1c
y.create.l HWIO_SNOC_EPRB1_SPROF_TRACEALARMCLR_ADDR A:0xfc461c20
y.create.l HWIO_SNOC_EPRB1_SPROF_STATPERIOD_ADDR A:0xfc461c24
y.create.l HWIO_SNOC_EPRB1_SPROF_STATGO_ADDR A:0xfc461c28
y.create.l HWIO_SNOC_EPRB1_SPROF_STATALARMMIN_ADDR A:0xfc461c2c
y.create.l HWIO_SNOC_EPRB1_SPROF_STATALARMMAX_ADDR A:0xfc461c30
y.create.l HWIO_SNOC_EPRB1_SPROF_STATALARMSTATUS_ADDR A:0xfc461c34
y.create.l HWIO_SNOC_EPRB1_SPROF_STATALARMCLR_ADDR A:0xfc461c38
y.create.l HWIO_SNOC_EPRB1_SPROF_FILTERS_0_ROUTEIDBASE_ADDR A:0xfc461c44
y.create.l HWIO_SNOC_EPRB1_SPROF_FILTERS_0_ROUTEIDMASK_ADDR A:0xfc461c48
y.create.l HWIO_SNOC_EPRB1_SPROF_FILTERS_0_ADDRBASE_LOW_ADDR A:0xfc461c4c
y.create.l HWIO_SNOC_EPRB1_SPROF_FILTERS_0_ADDRBASE_HIGH_ADDR A:0xfc461c50
y.create.l HWIO_SNOC_EPRB1_SPROF_FILTERS_0_WINDOWSIZE_ADDR A:0xfc461c54
y.create.l HWIO_SNOC_EPRB1_SPROF_FILTERS_0_OPCODE_ADDR A:0xfc461c60
y.create.l HWIO_SNOC_EPRB1_SPROF_FILTERS_0_STATUS_ADDR A:0xfc461c64
y.create.l HWIO_SNOC_EPRB1_SPROF_FILTERS_0_LENGTH_ADDR A:0xfc461c68
y.create.l HWIO_SNOC_EPRB1_SPROF_FILTERS_0_URGENCY_ADDR A:0xfc461c6c
y.create.l HWIO_SNOC_EPRB1_SPROF_FILTERS_1_ROUTEIDBASE_ADDR A:0xfc461c80
y.create.l HWIO_SNOC_EPRB1_SPROF_FILTERS_1_ROUTEIDMASK_ADDR A:0xfc461c84
y.create.l HWIO_SNOC_EPRB1_SPROF_FILTERS_1_ADDRBASE_LOW_ADDR A:0xfc461c88
y.create.l HWIO_SNOC_EPRB1_SPROF_FILTERS_1_ADDRBASE_HIGH_ADDR A:0xfc461c8c
y.create.l HWIO_SNOC_EPRB1_SPROF_FILTERS_1_WINDOWSIZE_ADDR A:0xfc461c90
y.create.l HWIO_SNOC_EPRB1_SPROF_FILTERS_1_OPCODE_ADDR A:0xfc461c9c
y.create.l HWIO_SNOC_EPRB1_SPROF_FILTERS_1_STATUS_ADDR A:0xfc461ca0
y.create.l HWIO_SNOC_EPRB1_SPROF_FILTERS_1_LENGTH_ADDR A:0xfc461ca4
y.create.l HWIO_SNOC_EPRB1_SPROF_FILTERS_1_URGENCY_ADDR A:0xfc461ca8
y.create.l HWIO_SNOC_EPRB1_SPROF_FILTERS_2_ROUTEIDBASE_ADDR A:0xfc461cbc
y.create.l HWIO_SNOC_EPRB1_SPROF_FILTERS_2_ROUTEIDMASK_ADDR A:0xfc461cc0
y.create.l HWIO_SNOC_EPRB1_SPROF_FILTERS_2_ADDRBASE_LOW_ADDR A:0xfc461cc4
y.create.l HWIO_SNOC_EPRB1_SPROF_FILTERS_2_ADDRBASE_HIGH_ADDR A:0xfc461cc8
y.create.l HWIO_SNOC_EPRB1_SPROF_FILTERS_2_WINDOWSIZE_ADDR A:0xfc461ccc
y.create.l HWIO_SNOC_EPRB1_SPROF_FILTERS_2_OPCODE_ADDR A:0xfc461cd8
y.create.l HWIO_SNOC_EPRB1_SPROF_FILTERS_2_STATUS_ADDR A:0xfc461cdc
y.create.l HWIO_SNOC_EPRB1_SPROF_FILTERS_2_LENGTH_ADDR A:0xfc461ce0
y.create.l HWIO_SNOC_EPRB1_SPROF_FILTERS_2_URGENCY_ADDR A:0xfc461ce4
y.create.l HWIO_SNOC_EPRB1_SPROF_FILTERS_3_ROUTEIDBASE_ADDR A:0xfc461cf8
y.create.l HWIO_SNOC_EPRB1_SPROF_FILTERS_3_ROUTEIDMASK_ADDR A:0xfc461cfc
y.create.l HWIO_SNOC_EPRB1_SPROF_FILTERS_3_ADDRBASE_LOW_ADDR A:0xfc461d00
y.create.l HWIO_SNOC_EPRB1_SPROF_FILTERS_3_ADDRBASE_HIGH_ADDR A:0xfc461d04
y.create.l HWIO_SNOC_EPRB1_SPROF_FILTERS_3_WINDOWSIZE_ADDR A:0xfc461d08
y.create.l HWIO_SNOC_EPRB1_SPROF_FILTERS_3_OPCODE_ADDR A:0xfc461d14
y.create.l HWIO_SNOC_EPRB1_SPROF_FILTERS_3_STATUS_ADDR A:0xfc461d18
y.create.l HWIO_SNOC_EPRB1_SPROF_FILTERS_3_LENGTH_ADDR A:0xfc461d1c
y.create.l HWIO_SNOC_EPRB1_SPROF_FILTERS_3_URGENCY_ADDR A:0xfc461d20
y.create.l HWIO_SNOC_EPRB1_SPROF_COUNTERS_0_PORTSEL_ADDR A:0xfc461d34
y.create.l HWIO_SNOC_EPRB1_SPROF_COUNTERS_0_SRC_ADDR A:0xfc461d38
y.create.l HWIO_SNOC_EPRB1_SPROF_COUNTERS_0_ALARMMODE_ADDR A:0xfc461d3c
y.create.l HWIO_SNOC_EPRB1_SPROF_COUNTERS_0_VAL_ADDR A:0xfc461d40
y.create.l HWIO_SNOC_EPRB1_SPROF_COUNTERS_1_PORTSEL_ADDR A:0xfc461d48
y.create.l HWIO_SNOC_EPRB1_SPROF_COUNTERS_1_SRC_ADDR A:0xfc461d4c
y.create.l HWIO_SNOC_EPRB1_SPROF_COUNTERS_1_ALARMMODE_ADDR A:0xfc461d50
y.create.l HWIO_SNOC_EPRB1_SPROF_COUNTERS_1_VAL_ADDR A:0xfc461d54
y.create.l HWIO_SNOC_EPRB1_SPROF_COUNTERS_2_PORTSEL_ADDR A:0xfc461d5c
y.create.l HWIO_SNOC_EPRB1_SPROF_COUNTERS_2_SRC_ADDR A:0xfc461d60
y.create.l HWIO_SNOC_EPRB1_SPROF_COUNTERS_2_ALARMMODE_ADDR A:0xfc461d64
y.create.l HWIO_SNOC_EPRB1_SPROF_COUNTERS_2_VAL_ADDR A:0xfc461d68
y.create.l HWIO_SNOC_EPRB1_SPROF_COUNTERS_3_PORTSEL_ADDR A:0xfc461d70
y.create.l HWIO_SNOC_EPRB1_SPROF_COUNTERS_3_SRC_ADDR A:0xfc461d74
y.create.l HWIO_SNOC_EPRB1_SPROF_COUNTERS_3_ALARMMODE_ADDR A:0xfc461d78
y.create.l HWIO_SNOC_EPRB1_SPROF_COUNTERS_3_VAL_ADDR A:0xfc461d7c
y.create.l HWIO_SNOC_EPRB1_SPROF_COUNTERS_4_PORTSEL_ADDR A:0xfc461d84
y.create.l HWIO_SNOC_EPRB1_SPROF_COUNTERS_4_SRC_ADDR A:0xfc461d88
y.create.l HWIO_SNOC_EPRB1_SPROF_COUNTERS_4_ALARMMODE_ADDR A:0xfc461d8c
y.create.l HWIO_SNOC_EPRB1_SPROF_COUNTERS_4_VAL_ADDR A:0xfc461d90
y.create.l HWIO_SNOC_EPRB1_SPROF_COUNTERS_5_PORTSEL_ADDR A:0xfc461d98
y.create.l HWIO_SNOC_EPRB1_SPROF_COUNTERS_5_SRC_ADDR A:0xfc461d9c
y.create.l HWIO_SNOC_EPRB1_SPROF_COUNTERS_5_ALARMMODE_ADDR A:0xfc461da0
y.create.l HWIO_SNOC_EPRB1_SPROF_COUNTERS_5_VAL_ADDR A:0xfc461da4
y.create.l HWIO_SNOC_EPRB1_SPROF_COUNTERS_6_PORTSEL_ADDR A:0xfc461dac
y.create.l HWIO_SNOC_EPRB1_SPROF_COUNTERS_6_SRC_ADDR A:0xfc461db0
y.create.l HWIO_SNOC_EPRB1_SPROF_COUNTERS_6_ALARMMODE_ADDR A:0xfc461db4
y.create.l HWIO_SNOC_EPRB1_SPROF_COUNTERS_6_VAL_ADDR A:0xfc461db8
y.create.l HWIO_SNOC_EPRB1_SPROF_COUNTERS_7_PORTSEL_ADDR A:0xfc461dc0
y.create.l HWIO_SNOC_EPRB1_SPROF_COUNTERS_7_SRC_ADDR A:0xfc461dc4
y.create.l HWIO_SNOC_EPRB1_SPROF_COUNTERS_7_ALARMMODE_ADDR A:0xfc461dc8
y.create.l HWIO_SNOC_EPRB1_SPROF_COUNTERS_7_VAL_ADDR A:0xfc461dcc
y.create.l HWIO_SNOC_EPRB1_SPROF_COUNTERS_8_PORTSEL_ADDR A:0xfc461dd4
y.create.l HWIO_SNOC_EPRB1_SPROF_COUNTERS_8_SRC_ADDR A:0xfc461dd8
y.create.l HWIO_SNOC_EPRB1_SPROF_COUNTERS_8_ALARMMODE_ADDR A:0xfc461ddc
y.create.l HWIO_SNOC_EPRB1_SPROF_COUNTERS_8_VAL_ADDR A:0xfc461de0
y.create.l HWIO_SNOC_EPRB1_SPROF_COUNTERS_9_PORTSEL_ADDR A:0xfc461de8
y.create.l HWIO_SNOC_EPRB1_SPROF_COUNTERS_9_SRC_ADDR A:0xfc461dec
y.create.l HWIO_SNOC_EPRB1_SPROF_COUNTERS_9_ALARMMODE_ADDR A:0xfc461df0
y.create.l HWIO_SNOC_EPRB1_SPROF_COUNTERS_9_VAL_ADDR A:0xfc461df4
y.create.l HWIO_SNOC_TPRB0_SPROF_ID_COREID_ADDR A:0xfc462000
y.create.l HWIO_SNOC_TPRB0_SPROF_ID_REVISIONID_ADDR A:0xfc462004
y.create.l HWIO_SNOC_TPRB0_SPROF_MAINCTL_ADDR A:0xfc462008
y.create.l HWIO_SNOC_TPRB0_SPROF_CFGCTL_ADDR A:0xfc46200c
y.create.l HWIO_SNOC_TPRB0_SPROF_STATPERIOD_ADDR A:0xfc462024
y.create.l HWIO_SNOC_TPRB0_SPROF_STATGO_ADDR A:0xfc462028
y.create.l HWIO_SNOC_TPRB0_SPROF_STATALARMMIN_ADDR A:0xfc46202c
y.create.l HWIO_SNOC_TPRB0_SPROF_STATALARMMAX_ADDR A:0xfc462030
y.create.l HWIO_SNOC_TPRB0_SPROF_STATALARMSTATUS_ADDR A:0xfc462034
y.create.l HWIO_SNOC_TPRB0_SPROF_STATALARMCLR_ADDR A:0xfc462038
y.create.l HWIO_SNOC_TPRB0_SPROF_COUNTERS_0_SRC_ADDR A:0xfc462138
y.create.l HWIO_SNOC_TPRB0_SPROF_COUNTERS_0_ALARMMODE_ADDR A:0xfc46213c
y.create.l HWIO_SNOC_TPRB0_SPROF_COUNTERS_0_VAL_ADDR A:0xfc462140
y.create.l HWIO_SNOC_TPRB0_SPROF_COUNTERS_1_SRC_ADDR A:0xfc46214c
y.create.l HWIO_SNOC_TPRB0_SPROF_COUNTERS_1_ALARMMODE_ADDR A:0xfc462150
y.create.l HWIO_SNOC_TPRB0_SPROF_COUNTERS_1_VAL_ADDR A:0xfc462154
y.create.l HWIO_SNOC_TPRB0_SPROF_COUNTERS_2_SRC_ADDR A:0xfc462160
y.create.l HWIO_SNOC_TPRB0_SPROF_COUNTERS_2_ALARMMODE_ADDR A:0xfc462164
y.create.l HWIO_SNOC_TPRB0_SPROF_COUNTERS_2_VAL_ADDR A:0xfc462168
y.create.l HWIO_SNOC_TPRB0_SPROF_COUNTERS_3_SRC_ADDR A:0xfc462174
y.create.l HWIO_SNOC_TPRB0_SPROF_COUNTERS_3_ALARMMODE_ADDR A:0xfc462178
y.create.l HWIO_SNOC_TPRB0_SPROF_COUNTERS_3_VAL_ADDR A:0xfc46217c
y.create.l HWIO_SNOC_TPRB0_SPROF_COUNTERS_4_SRC_ADDR A:0xfc462188
y.create.l HWIO_SNOC_TPRB0_SPROF_COUNTERS_4_ALARMMODE_ADDR A:0xfc46218c
y.create.l HWIO_SNOC_TPRB0_SPROF_COUNTERS_4_VAL_ADDR A:0xfc462190
y.create.l HWIO_SNOC_TPRB0_SPROF_COUNTERS_5_SRC_ADDR A:0xfc46219c
y.create.l HWIO_SNOC_TPRB0_SPROF_COUNTERS_5_ALARMMODE_ADDR A:0xfc4621a0
y.create.l HWIO_SNOC_TPRB0_SPROF_COUNTERS_5_VAL_ADDR A:0xfc4621a4
y.create.l HWIO_SNOC_TPRB0_SPROF_COUNTERS_6_SRC_ADDR A:0xfc4621b0
y.create.l HWIO_SNOC_TPRB0_SPROF_COUNTERS_6_ALARMMODE_ADDR A:0xfc4621b4
y.create.l HWIO_SNOC_TPRB0_SPROF_COUNTERS_6_VAL_ADDR A:0xfc4621b8
y.create.l HWIO_SNOC_TPRB0_SPROF_COUNTERS_7_SRC_ADDR A:0xfc4621c4
y.create.l HWIO_SNOC_TPRB0_SPROF_COUNTERS_7_ALARMMODE_ADDR A:0xfc4621c8
y.create.l HWIO_SNOC_TPRB0_SPROF_COUNTERS_7_VAL_ADDR A:0xfc4621cc
y.create.l HWIO_SNOC_TPRB0_SPROF_COUNTERS_8_SRC_ADDR A:0xfc4621d8
y.create.l HWIO_SNOC_TPRB0_SPROF_COUNTERS_8_ALARMMODE_ADDR A:0xfc4621dc
y.create.l HWIO_SNOC_TPRB0_SPROF_COUNTERS_8_VAL_ADDR A:0xfc4621e0
y.create.l HWIO_SNOC_TPRB0_SPROF_COUNTERS_9_SRC_ADDR A:0xfc4621ec
y.create.l HWIO_SNOC_TPRB0_SPROF_COUNTERS_9_ALARMMODE_ADDR A:0xfc4621f0
y.create.l HWIO_SNOC_TPRB0_SPROF_COUNTERS_9_VAL_ADDR A:0xfc4621f4
y.create.l HWIO_SNOC_TPRB0_SPROF_COUNTERS_10_SRC_ADDR A:0xfc462200
y.create.l HWIO_SNOC_TPRB0_SPROF_COUNTERS_10_ALARMMODE_ADDR A:0xfc462204
y.create.l HWIO_SNOC_TPRB0_SPROF_COUNTERS_10_VAL_ADDR A:0xfc462208
y.create.l HWIO_SNOC_TPRB0_SPROF_COUNTERS_11_SRC_ADDR A:0xfc462214
y.create.l HWIO_SNOC_TPRB0_SPROF_COUNTERS_11_ALARMMODE_ADDR A:0xfc462218
y.create.l HWIO_SNOC_TPRB0_SPROF_COUNTERS_11_VAL_ADDR A:0xfc46221c
y.create.l HWIO_SNOC_TPRB0_SPROF_COUNTERS_12_SRC_ADDR A:0xfc462228
y.create.l HWIO_SNOC_TPRB0_SPROF_COUNTERS_12_ALARMMODE_ADDR A:0xfc46222c
y.create.l HWIO_SNOC_TPRB0_SPROF_COUNTERS_12_VAL_ADDR A:0xfc462230
y.create.l HWIO_SNOC_TPRB0_SPROF_COUNTERS_13_SRC_ADDR A:0xfc46223c
y.create.l HWIO_SNOC_TPRB0_SPROF_COUNTERS_13_ALARMMODE_ADDR A:0xfc462240
y.create.l HWIO_SNOC_TPRB0_SPROF_COUNTERS_13_VAL_ADDR A:0xfc462244
y.create.l HWIO_SNOC_TPRB0_SPROF_COUNTERS_14_SRC_ADDR A:0xfc462250
y.create.l HWIO_SNOC_TPRB0_SPROF_COUNTERS_14_ALARMMODE_ADDR A:0xfc462254
y.create.l HWIO_SNOC_TPRB0_SPROF_COUNTERS_14_VAL_ADDR A:0xfc462258
y.create.l HWIO_SNOC_TPRB0_SPROF_COUNTERS_15_SRC_ADDR A:0xfc462264
y.create.l HWIO_SNOC_TPRB0_SPROF_COUNTERS_15_ALARMMODE_ADDR A:0xfc462268
y.create.l HWIO_SNOC_TPRB0_SPROF_COUNTERS_15_VAL_ADDR A:0xfc46226c
y.create.l HWIO_SNOC_TPRB1_SPROF_ID_COREID_ADDR A:0xfc462400
y.create.l HWIO_SNOC_TPRB1_SPROF_ID_REVISIONID_ADDR A:0xfc462404
y.create.l HWIO_SNOC_TPRB1_SPROF_MAINCTL_ADDR A:0xfc462408
y.create.l HWIO_SNOC_TPRB1_SPROF_CFGCTL_ADDR A:0xfc46240c
y.create.l HWIO_SNOC_TPRB1_SPROF_STATPERIOD_ADDR A:0xfc462424
y.create.l HWIO_SNOC_TPRB1_SPROF_STATGO_ADDR A:0xfc462428
y.create.l HWIO_SNOC_TPRB1_SPROF_STATALARMMIN_ADDR A:0xfc46242c
y.create.l HWIO_SNOC_TPRB1_SPROF_STATALARMMAX_ADDR A:0xfc462430
y.create.l HWIO_SNOC_TPRB1_SPROF_STATALARMSTATUS_ADDR A:0xfc462434
y.create.l HWIO_SNOC_TPRB1_SPROF_STATALARMCLR_ADDR A:0xfc462438
y.create.l HWIO_SNOC_TPRB1_SPROF_COUNTERS_0_SRC_ADDR A:0xfc462538
y.create.l HWIO_SNOC_TPRB1_SPROF_COUNTERS_0_ALARMMODE_ADDR A:0xfc46253c
y.create.l HWIO_SNOC_TPRB1_SPROF_COUNTERS_0_VAL_ADDR A:0xfc462540
y.create.l HWIO_SNOC_TPRB1_SPROF_COUNTERS_1_SRC_ADDR A:0xfc46254c
y.create.l HWIO_SNOC_TPRB1_SPROF_COUNTERS_1_ALARMMODE_ADDR A:0xfc462550
y.create.l HWIO_SNOC_TPRB1_SPROF_COUNTERS_1_VAL_ADDR A:0xfc462554
y.create.l HWIO_SNOC_TPRB1_SPROF_COUNTERS_2_SRC_ADDR A:0xfc462560
y.create.l HWIO_SNOC_TPRB1_SPROF_COUNTERS_2_ALARMMODE_ADDR A:0xfc462564
y.create.l HWIO_SNOC_TPRB1_SPROF_COUNTERS_2_VAL_ADDR A:0xfc462568
y.create.l HWIO_SNOC_TPRB1_SPROF_COUNTERS_3_SRC_ADDR A:0xfc462574
y.create.l HWIO_SNOC_TPRB1_SPROF_COUNTERS_3_ALARMMODE_ADDR A:0xfc462578
y.create.l HWIO_SNOC_TPRB1_SPROF_COUNTERS_3_VAL_ADDR A:0xfc46257c
y.create.l HWIO_SNOC_TPRB1_SPROF_COUNTERS_4_SRC_ADDR A:0xfc462588
y.create.l HWIO_SNOC_TPRB1_SPROF_COUNTERS_4_ALARMMODE_ADDR A:0xfc46258c
y.create.l HWIO_SNOC_TPRB1_SPROF_COUNTERS_4_VAL_ADDR A:0xfc462590
y.create.l HWIO_SNOC_TPRB1_SPROF_COUNTERS_5_SRC_ADDR A:0xfc46259c
y.create.l HWIO_SNOC_TPRB1_SPROF_COUNTERS_5_ALARMMODE_ADDR A:0xfc4625a0
y.create.l HWIO_SNOC_TPRB1_SPROF_COUNTERS_5_VAL_ADDR A:0xfc4625a4
y.create.l HWIO_SNOC_TPRB1_SPROF_COUNTERS_6_SRC_ADDR A:0xfc4625b0
y.create.l HWIO_SNOC_TPRB1_SPROF_COUNTERS_6_ALARMMODE_ADDR A:0xfc4625b4
y.create.l HWIO_SNOC_TPRB1_SPROF_COUNTERS_6_VAL_ADDR A:0xfc4625b8
y.create.l HWIO_SNOC_TPRB1_SPROF_COUNTERS_7_SRC_ADDR A:0xfc4625c4
y.create.l HWIO_SNOC_TPRB1_SPROF_COUNTERS_7_ALARMMODE_ADDR A:0xfc4625c8
y.create.l HWIO_SNOC_TPRB1_SPROF_COUNTERS_7_VAL_ADDR A:0xfc4625cc
y.create.l HWIO_SNOC_TPRB1_SPROF_COUNTERS_8_SRC_ADDR A:0xfc4625d8
y.create.l HWIO_SNOC_TPRB1_SPROF_COUNTERS_8_ALARMMODE_ADDR A:0xfc4625dc
y.create.l HWIO_SNOC_TPRB1_SPROF_COUNTERS_8_VAL_ADDR A:0xfc4625e0
y.create.l HWIO_SNOC_TPRB1_SPROF_COUNTERS_9_SRC_ADDR A:0xfc4625ec
y.create.l HWIO_SNOC_TPRB1_SPROF_COUNTERS_9_ALARMMODE_ADDR A:0xfc4625f0
y.create.l HWIO_SNOC_TPRB1_SPROF_COUNTERS_9_VAL_ADDR A:0xfc4625f4
y.create.l HWIO_SNOC_TPRB1_SPROF_COUNTERS_10_SRC_ADDR A:0xfc462600
y.create.l HWIO_SNOC_TPRB1_SPROF_COUNTERS_10_ALARMMODE_ADDR A:0xfc462604
y.create.l HWIO_SNOC_TPRB1_SPROF_COUNTERS_10_VAL_ADDR A:0xfc462608
y.create.l HWIO_SNOC_TPRB1_SPROF_COUNTERS_11_SRC_ADDR A:0xfc462614
y.create.l HWIO_SNOC_TPRB1_SPROF_COUNTERS_11_ALARMMODE_ADDR A:0xfc462618
y.create.l HWIO_SNOC_TPRB1_SPROF_COUNTERS_11_VAL_ADDR A:0xfc46261c
y.create.l HWIO_SNOC_TPRB1_SPROF_COUNTERS_12_SRC_ADDR A:0xfc462628
y.create.l HWIO_SNOC_TPRB1_SPROF_COUNTERS_12_ALARMMODE_ADDR A:0xfc46262c
y.create.l HWIO_SNOC_TPRB1_SPROF_COUNTERS_12_VAL_ADDR A:0xfc462630
y.create.l HWIO_SNOC_TPRB1_SPROF_COUNTERS_13_SRC_ADDR A:0xfc46263c
y.create.l HWIO_SNOC_TPRB1_SPROF_COUNTERS_13_ALARMMODE_ADDR A:0xfc462640
y.create.l HWIO_SNOC_TPRB1_SPROF_COUNTERS_13_VAL_ADDR A:0xfc462644
y.create.l HWIO_SNOC_TPRB1_SPROF_COUNTERS_14_SRC_ADDR A:0xfc462650
y.create.l HWIO_SNOC_TPRB1_SPROF_COUNTERS_14_ALARMMODE_ADDR A:0xfc462654
y.create.l HWIO_SNOC_TPRB1_SPROF_COUNTERS_14_VAL_ADDR A:0xfc462658
y.create.l HWIO_SNOC_TPRB1_SPROF_COUNTERS_15_SRC_ADDR A:0xfc462664
y.create.l HWIO_SNOC_TPRB1_SPROF_COUNTERS_15_ALARMMODE_ADDR A:0xfc462668
y.create.l HWIO_SNOC_TPRB1_SPROF_COUNTERS_15_VAL_ADDR A:0xfc46266c
y.create.l HWIO_SNOC_TPRB2_SPROF_ID_COREID_ADDR A:0xfc462800
y.create.l HWIO_SNOC_TPRB2_SPROF_ID_REVISIONID_ADDR A:0xfc462804
y.create.l HWIO_SNOC_TPRB2_SPROF_MAINCTL_ADDR A:0xfc462808
y.create.l HWIO_SNOC_TPRB2_SPROF_CFGCTL_ADDR A:0xfc46280c
y.create.l HWIO_SNOC_TPRB2_SPROF_STATPERIOD_ADDR A:0xfc462824
y.create.l HWIO_SNOC_TPRB2_SPROF_STATGO_ADDR A:0xfc462828
y.create.l HWIO_SNOC_TPRB2_SPROF_STATALARMMIN_ADDR A:0xfc46282c
y.create.l HWIO_SNOC_TPRB2_SPROF_STATALARMMAX_ADDR A:0xfc462830
y.create.l HWIO_SNOC_TPRB2_SPROF_STATALARMSTATUS_ADDR A:0xfc462834
y.create.l HWIO_SNOC_TPRB2_SPROF_STATALARMCLR_ADDR A:0xfc462838
y.create.l HWIO_SNOC_TPRB2_SPROF_COUNTERS_0_SRC_ADDR A:0xfc462938
y.create.l HWIO_SNOC_TPRB2_SPROF_COUNTERS_0_ALARMMODE_ADDR A:0xfc46293c
y.create.l HWIO_SNOC_TPRB2_SPROF_COUNTERS_0_VAL_ADDR A:0xfc462940
y.create.l HWIO_SNOC_TPRB2_SPROF_COUNTERS_1_SRC_ADDR A:0xfc46294c
y.create.l HWIO_SNOC_TPRB2_SPROF_COUNTERS_1_ALARMMODE_ADDR A:0xfc462950
y.create.l HWIO_SNOC_TPRB2_SPROF_COUNTERS_1_VAL_ADDR A:0xfc462954
y.create.l HWIO_SNOC_TPRB2_SPROF_COUNTERS_2_SRC_ADDR A:0xfc462960
y.create.l HWIO_SNOC_TPRB2_SPROF_COUNTERS_2_ALARMMODE_ADDR A:0xfc462964
y.create.l HWIO_SNOC_TPRB2_SPROF_COUNTERS_2_VAL_ADDR A:0xfc462968
y.create.l HWIO_SNOC_TPRB2_SPROF_COUNTERS_3_SRC_ADDR A:0xfc462974
y.create.l HWIO_SNOC_TPRB2_SPROF_COUNTERS_3_ALARMMODE_ADDR A:0xfc462978
y.create.l HWIO_SNOC_TPRB2_SPROF_COUNTERS_3_VAL_ADDR A:0xfc46297c
y.create.l HWIO_SNOC_TPRB2_SPROF_COUNTERS_4_SRC_ADDR A:0xfc462988
y.create.l HWIO_SNOC_TPRB2_SPROF_COUNTERS_4_ALARMMODE_ADDR A:0xfc46298c
y.create.l HWIO_SNOC_TPRB2_SPROF_COUNTERS_4_VAL_ADDR A:0xfc462990
y.create.l HWIO_SNOC_TPRB2_SPROF_COUNTERS_5_SRC_ADDR A:0xfc46299c
y.create.l HWIO_SNOC_TPRB2_SPROF_COUNTERS_5_ALARMMODE_ADDR A:0xfc4629a0
y.create.l HWIO_SNOC_TPRB2_SPROF_COUNTERS_5_VAL_ADDR A:0xfc4629a4
y.create.l HWIO_SNOC_TPRB2_SPROF_COUNTERS_6_SRC_ADDR A:0xfc4629b0
y.create.l HWIO_SNOC_TPRB2_SPROF_COUNTERS_6_ALARMMODE_ADDR A:0xfc4629b4
y.create.l HWIO_SNOC_TPRB2_SPROF_COUNTERS_6_VAL_ADDR A:0xfc4629b8
y.create.l HWIO_SNOC_TPRB2_SPROF_COUNTERS_7_SRC_ADDR A:0xfc4629c4
y.create.l HWIO_SNOC_TPRB2_SPROF_COUNTERS_7_ALARMMODE_ADDR A:0xfc4629c8
y.create.l HWIO_SNOC_TPRB2_SPROF_COUNTERS_7_VAL_ADDR A:0xfc4629cc
y.create.l HWIO_SNOC_TPRB2_SPROF_COUNTERS_8_SRC_ADDR A:0xfc4629d8
y.create.l HWIO_SNOC_TPRB2_SPROF_COUNTERS_8_ALARMMODE_ADDR A:0xfc4629dc
y.create.l HWIO_SNOC_TPRB2_SPROF_COUNTERS_8_VAL_ADDR A:0xfc4629e0
y.create.l HWIO_SNOC_TPRB2_SPROF_COUNTERS_9_SRC_ADDR A:0xfc4629ec
y.create.l HWIO_SNOC_TPRB2_SPROF_COUNTERS_9_ALARMMODE_ADDR A:0xfc4629f0
y.create.l HWIO_SNOC_TPRB2_SPROF_COUNTERS_9_VAL_ADDR A:0xfc4629f4
y.create.l HWIO_SNOC_TPRB2_SPROF_COUNTERS_10_SRC_ADDR A:0xfc462a00
y.create.l HWIO_SNOC_TPRB2_SPROF_COUNTERS_10_ALARMMODE_ADDR A:0xfc462a04
y.create.l HWIO_SNOC_TPRB2_SPROF_COUNTERS_10_VAL_ADDR A:0xfc462a08
y.create.l HWIO_SNOC_TPRB2_SPROF_COUNTERS_11_SRC_ADDR A:0xfc462a14
y.create.l HWIO_SNOC_TPRB2_SPROF_COUNTERS_11_ALARMMODE_ADDR A:0xfc462a18
y.create.l HWIO_SNOC_TPRB2_SPROF_COUNTERS_11_VAL_ADDR A:0xfc462a1c
y.create.l HWIO_SNOC_TPRB2_SPROF_COUNTERS_12_SRC_ADDR A:0xfc462a28
y.create.l HWIO_SNOC_TPRB2_SPROF_COUNTERS_12_ALARMMODE_ADDR A:0xfc462a2c
y.create.l HWIO_SNOC_TPRB2_SPROF_COUNTERS_12_VAL_ADDR A:0xfc462a30
y.create.l HWIO_SNOC_TPRB2_SPROF_COUNTERS_13_SRC_ADDR A:0xfc462a3c
y.create.l HWIO_SNOC_TPRB2_SPROF_COUNTERS_13_ALARMMODE_ADDR A:0xfc462a40
y.create.l HWIO_SNOC_TPRB2_SPROF_COUNTERS_13_VAL_ADDR A:0xfc462a44
y.create.l HWIO_SNOC_TPRB2_SPROF_COUNTERS_14_SRC_ADDR A:0xfc462a50
y.create.l HWIO_SNOC_TPRB2_SPROF_COUNTERS_14_ALARMMODE_ADDR A:0xfc462a54
y.create.l HWIO_SNOC_TPRB2_SPROF_COUNTERS_14_VAL_ADDR A:0xfc462a58
y.create.l HWIO_SNOC_TPRB2_SPROF_COUNTERS_15_SRC_ADDR A:0xfc462a64
y.create.l HWIO_SNOC_TPRB2_SPROF_COUNTERS_15_ALARMMODE_ADDR A:0xfc462a68
y.create.l HWIO_SNOC_TPRB2_SPROF_COUNTERS_15_VAL_ADDR A:0xfc462a6c
y.create.l HWIO_SNOC_QHM_LPASS_QOS_ID_COREID_ADDR A:0xfc463000
y.create.l HWIO_SNOC_QHM_LPASS_QOS_ID_REVISIONID_ADDR A:0xfc463004
y.create.l HWIO_SNOC_QHM_LPASS_QOS_PRIORITY_ADDR A:0xfc463008
y.create.l HWIO_SNOC_QDSS_BAM_QOS_ID_COREID_ADDR A:0xfc463080
y.create.l HWIO_SNOC_QDSS_BAM_QOS_ID_REVISIONID_ADDR A:0xfc463084
y.create.l HWIO_SNOC_QDSS_BAM_QOS_PRIORITY_ADDR A:0xfc463088
y.create.l HWIO_SNOC_CRYPTO0_QOS_ID_COREID_ADDR A:0xfc463100
y.create.l HWIO_SNOC_CRYPTO0_QOS_ID_REVISIONID_ADDR A:0xfc463104
y.create.l HWIO_SNOC_CRYPTO0_QOS_PRIORITY_ADDR A:0xfc463108
y.create.l HWIO_SNOC_MSS_QOS_ID_COREID_ADDR A:0xfc463280
y.create.l HWIO_SNOC_MSS_QOS_ID_REVISIONID_ADDR A:0xfc463284
y.create.l HWIO_SNOC_MSS_QOS_PRIORITY_ADDR A:0xfc463288
y.create.l HWIO_SNOC_MSS_QOS_MODE_ADDR A:0xfc46328c
y.create.l HWIO_SNOC_MSS_QOS_BANDWIDTH_ADDR A:0xfc463290
y.create.l HWIO_SNOC_MSS_QOS_SATURATION_ADDR A:0xfc463294
y.create.l HWIO_SNOC_MSS_NAV_QOS_ID_COREID_ADDR A:0xfc463300
y.create.l HWIO_SNOC_MSS_NAV_QOS_ID_REVISIONID_ADDR A:0xfc463304
y.create.l HWIO_SNOC_MSS_NAV_QOS_PRIORITY_ADDR A:0xfc463308
y.create.l HWIO_SNOC_PNOC_QOS_ID_COREID_ADDR A:0xfc463400
y.create.l HWIO_SNOC_PNOC_QOS_ID_REVISIONID_ADDR A:0xfc463404
y.create.l HWIO_SNOC_PNOC_QOS_PRIORITY_ADDR A:0xfc463408
y.create.l HWIO_SNOC_WCSS_QOS_ID_COREID_ADDR A:0xfc463480
y.create.l HWIO_SNOC_WCSS_QOS_ID_REVISIONID_ADDR A:0xfc463484
y.create.l HWIO_SNOC_WCSS_QOS_PRIORITY_ADDR A:0xfc463488
y.create.l HWIO_SNOC_QDSS_ETR_QOS_ID_COREID_ADDR A:0xfc463500
y.create.l HWIO_SNOC_QDSS_ETR_QOS_ID_REVISIONID_ADDR A:0xfc463504
y.create.l HWIO_SNOC_QDSS_ETR_QOS_PRIORITY_ADDR A:0xfc463508
y.create.l HWIO_TLMM_XPU_SCR_ADDR A:0xfd500000
y.create.l HWIO_TLMM_XPU_SWDR_ADDR A:0xfd500004
y.create.l HWIO_TLMM_XPU_SEAR0_ADDR A:0xfd500040
y.create.l HWIO_TLMM_XPU_SESR_ADDR A:0xfd500048
y.create.l HWIO_TLMM_XPU_SESRRESTORE_ADDR A:0xfd50004c
y.create.l HWIO_TLMM_XPU_SESYNR0_ADDR A:0xfd500050
y.create.l HWIO_TLMM_XPU_SESYNR1_ADDR A:0xfd500054
y.create.l HWIO_TLMM_XPU_SESYNR2_ADDR A:0xfd500058
y.create.l HWIO_TLMM_XPU_MCR_ADDR A:0xfd500100
y.create.l HWIO_TLMM_XPU_MEAR0_ADDR A:0xfd500140
y.create.l HWIO_TLMM_XPU_MESR_ADDR A:0xfd500148
y.create.l HWIO_TLMM_XPU_MESRRESTORE_ADDR A:0xfd50014c
y.create.l HWIO_TLMM_XPU_MESYNR0_ADDR A:0xfd500150
y.create.l HWIO_TLMM_XPU_MESYNR1_ADDR A:0xfd500154
y.create.l HWIO_TLMM_XPU_MESYNR2_ADDR A:0xfd500158
y.create.l HWIO_TLMM_XPU_CR_ADDR A:0xfd500080
y.create.l HWIO_TLMM_XPU_RPU_ACR0_ADDR A:0xfd5000a0
y.create.l HWIO_TLMM_XPU_EAR0_ADDR A:0xfd5000c0
y.create.l HWIO_TLMM_XPU_ESR_ADDR A:0xfd5000c8
y.create.l HWIO_TLMM_XPU_ESRRESTORE_ADDR A:0xfd5000cc
y.create.l HWIO_TLMM_XPU_ESYNR0_ADDR A:0xfd5000d0
y.create.l HWIO_TLMM_XPU_ESYNR1_ADDR A:0xfd5000d4
y.create.l HWIO_TLMM_XPU_ESYNR2_ADDR A:0xfd5000d8
y.create.l HWIO_TLMM_XPU_IDR0_ADDR A:0xfd500074
y.create.l HWIO_TLMM_XPU_IDR1_ADDR A:0xfd500078
y.create.l HWIO_TLMM_XPU_REV_ADDR A:0xfd50007c
y.create.l HWIO_TLMM_XPU_RG0_RACR0_ADDR A:0xfd500200
y.create.l HWIO_TLMM_XPU_RG1_RACR0_ADDR A:0xfd500280
y.create.l HWIO_TLMM_XPU_RG2_RACR0_ADDR A:0xfd500300
y.create.l HWIO_TLMM_XPU_RG3_RACR0_ADDR A:0xfd500380
y.create.l HWIO_TLMM_XPU_RG4_RACR0_ADDR A:0xfd500400
y.create.l HWIO_TLMM_XPU_RG5_RACR0_ADDR A:0xfd500480
y.create.l HWIO_TLMM_XPU_RG6_RACR0_ADDR A:0xfd500500
y.create.l HWIO_TLMM_XPU_RG7_RACR0_ADDR A:0xfd500580
y.create.l HWIO_TLMM_XPU_RG8_RACR0_ADDR A:0xfd500600
y.create.l HWIO_TLMM_XPU_RG9_RACR0_ADDR A:0xfd500680
y.create.l HWIO_TLMM_XPU_RG0_SCR_ADDR A:0xfd500250
y.create.l HWIO_TLMM_XPU_RG1_SCR_ADDR A:0xfd5002d0
y.create.l HWIO_TLMM_XPU_RG2_SCR_ADDR A:0xfd500350
y.create.l HWIO_TLMM_XPU_RG3_SCR_ADDR A:0xfd5003d0
y.create.l HWIO_TLMM_XPU_RG4_SCR_ADDR A:0xfd500450
y.create.l HWIO_TLMM_XPU_RG5_SCR_ADDR A:0xfd5004d0
y.create.l HWIO_TLMM_XPU_RG6_SCR_ADDR A:0xfd500550
y.create.l HWIO_TLMM_XPU_RG7_SCR_ADDR A:0xfd5005d0
y.create.l HWIO_TLMM_XPU_RG8_SCR_ADDR A:0xfd500650
y.create.l HWIO_TLMM_XPU_RG9_SCR_ADDR A:0xfd5006d0
y.create.l HWIO_TLMM_XPU_RG0_MCR_ADDR A:0xfd500254
y.create.l HWIO_TLMM_XPU_RG1_MCR_ADDR A:0xfd5002d4
y.create.l HWIO_TLMM_XPU_RG2_MCR_ADDR A:0xfd500354
y.create.l HWIO_TLMM_XPU_RG3_MCR_ADDR A:0xfd5003d4
y.create.l HWIO_TLMM_XPU_RG4_MCR_ADDR A:0xfd500454
y.create.l HWIO_TLMM_XPU_RG5_MCR_ADDR A:0xfd5004d4
y.create.l HWIO_TLMM_XPU_RG6_MCR_ADDR A:0xfd500554
y.create.l HWIO_TLMM_XPU_RG7_MCR_ADDR A:0xfd5005d4
y.create.l HWIO_TLMM_XPU_RG8_MCR_ADDR A:0xfd500654
y.create.l HWIO_TLMM_XPU_RG9_MCR_ADDR A:0xfd5006d4
y.create.l HWIO_TLMM_GPIO_CFG0_ADDR A:0xfd511000
y.create.l HWIO_TLMM_GPIO_CFG1_ADDR A:0xfd511010
y.create.l HWIO_TLMM_GPIO_CFG2_ADDR A:0xfd511020
y.create.l HWIO_TLMM_GPIO_CFG3_ADDR A:0xfd511030
y.create.l HWIO_TLMM_GPIO_CFG4_ADDR A:0xfd511040
y.create.l HWIO_TLMM_GPIO_CFG5_ADDR A:0xfd511050
y.create.l HWIO_TLMM_GPIO_CFG6_ADDR A:0xfd511060
y.create.l HWIO_TLMM_GPIO_CFG7_ADDR A:0xfd511070
y.create.l HWIO_TLMM_GPIO_CFG8_ADDR A:0xfd511080
y.create.l HWIO_TLMM_GPIO_CFG9_ADDR A:0xfd511090
y.create.l HWIO_TLMM_GPIO_IN_OUT0_ADDR A:0xfd511004
y.create.l HWIO_TLMM_GPIO_IN_OUT1_ADDR A:0xfd511014
y.create.l HWIO_TLMM_GPIO_IN_OUT2_ADDR A:0xfd511024
y.create.l HWIO_TLMM_GPIO_IN_OUT3_ADDR A:0xfd511034
y.create.l HWIO_TLMM_GPIO_IN_OUT4_ADDR A:0xfd511044
y.create.l HWIO_TLMM_GPIO_IN_OUT5_ADDR A:0xfd511054
y.create.l HWIO_TLMM_GPIO_IN_OUT6_ADDR A:0xfd511064
y.create.l HWIO_TLMM_GPIO_IN_OUT7_ADDR A:0xfd511074
y.create.l HWIO_TLMM_GPIO_IN_OUT8_ADDR A:0xfd511084
y.create.l HWIO_TLMM_GPIO_IN_OUT9_ADDR A:0xfd511094
y.create.l HWIO_TLMM_GPIO_INTR_CFG0_ADDR A:0xfd511008
y.create.l HWIO_TLMM_GPIO_INTR_CFG1_ADDR A:0xfd511018
y.create.l HWIO_TLMM_GPIO_INTR_CFG2_ADDR A:0xfd511028
y.create.l HWIO_TLMM_GPIO_INTR_CFG3_ADDR A:0xfd511038
y.create.l HWIO_TLMM_GPIO_INTR_CFG4_ADDR A:0xfd511048
y.create.l HWIO_TLMM_GPIO_INTR_CFG5_ADDR A:0xfd511058
y.create.l HWIO_TLMM_GPIO_INTR_CFG6_ADDR A:0xfd511068
y.create.l HWIO_TLMM_GPIO_INTR_CFG7_ADDR A:0xfd511078
y.create.l HWIO_TLMM_GPIO_INTR_CFG8_ADDR A:0xfd511088
y.create.l HWIO_TLMM_GPIO_INTR_CFG9_ADDR A:0xfd511098
y.create.l HWIO_TLMM_GPIO_INTR_STATUS0_ADDR A:0xfd51100c
y.create.l HWIO_TLMM_GPIO_INTR_STATUS1_ADDR A:0xfd51101c
y.create.l HWIO_TLMM_GPIO_INTR_STATUS2_ADDR A:0xfd51102c
y.create.l HWIO_TLMM_GPIO_INTR_STATUS3_ADDR A:0xfd51103c
y.create.l HWIO_TLMM_GPIO_INTR_STATUS4_ADDR A:0xfd51104c
y.create.l HWIO_TLMM_GPIO_INTR_STATUS5_ADDR A:0xfd51105c
y.create.l HWIO_TLMM_GPIO_INTR_STATUS6_ADDR A:0xfd51106c
y.create.l HWIO_TLMM_GPIO_INTR_STATUS7_ADDR A:0xfd51107c
y.create.l HWIO_TLMM_GPIO_INTR_STATUS8_ADDR A:0xfd51108c
y.create.l HWIO_TLMM_GPIO_INTR_STATUS9_ADDR A:0xfd51109c
y.create.l HWIO_TLMM_CLK_GATE_EN_ADDR A:0xfd512000
y.create.l HWIO_TLMM_IE_CTRL_DISABLE_ADDR A:0xfd512004
y.create.l HWIO_TLMM_MPM_WAKEUP_INT_EN_0_ADDR A:0xfd512008
y.create.l HWIO_TLMM_MPM_WAKEUP_INT_EN_1_ADDR A:0xfd51200c
y.create.l HWIO_TLMM_INT_JTAG_CTL_ADDR A:0xfd512010
y.create.l HWIO_TLMM_ETM_MODE_ADDR A:0xfd512014
y.create.l HWIO_TLMM_DBG_BUS_OUT_SEL_ADDR A:0xfd512018
y.create.l HWIO_TLMM_CHIP_MODE_ADDR A:0xfd512020
y.create.l HWIO_TLMM_SPARE_ADDR A:0xfd512024
y.create.l HWIO_TLMM_HW_REVISION_NUMBER_ADDR A:0xfd512028
y.create.l HWIO_TLMM_SLIMBUS_CTL_ADDR A:0xfd512030
y.create.l HWIO_TLMM_RFFE_CTL_ADDR A:0xfd512034
y.create.l HWIO_TLMM_RESOUT_HDRV_CTL_ADDR A:0xfd512038
y.create.l HWIO_TLMM_JTAG_HDRV_CTL_ADDR A:0xfd51203c
y.create.l HWIO_TLMM_PMIC_HDRV_PULL_CTL_ADDR A:0xfd512040
y.create.l HWIO_TLMM_SDC1_HDRV_PULL_CTL_ADDR A:0xfd512044
y.create.l HWIO_TLMM_SDC2_HDRV_PULL_CTL_ADDR A:0xfd512048
y.create.l HWIO_TLMM_MODE_PULL_CTL_ADDR A:0xfd51204c
y.create.l HWIO_TLMM_CDC_PULL_CTL_ADDR A:0xfd512050
y.create.l HWIO_TLMM_CDC_HDRV_CTL_ADDR A:0xfd512054
y.create.l HWIO_TLMM_CDC_HDRV_PULL_CTL_ADDR A:0xfd512058
y.create.l HWIO_TLMM_DIR_CONN_INTR0_CFG_WCSS_ADDR A:0xfd512100
y.create.l HWIO_TLMM_DIR_CONN_INTR1_CFG_WCSS_ADDR A:0xfd512104
y.create.l HWIO_TLMM_DIR_CONN_INTR0_CFG_SENSORS_ADDR A:0xfd512200
y.create.l HWIO_TLMM_DIR_CONN_INTR1_CFG_SENSORS_ADDR A:0xfd512204
y.create.l HWIO_TLMM_DIR_CONN_INTR2_CFG_SENSORS_ADDR A:0xfd512208
y.create.l HWIO_TLMM_DIR_CONN_INTR3_CFG_SENSORS_ADDR A:0xfd51220c
y.create.l HWIO_TLMM_DIR_CONN_INTR4_CFG_SENSORS_ADDR A:0xfd512210
y.create.l HWIO_TLMM_DIR_CONN_INTR5_CFG_SENSORS_ADDR A:0xfd512214
y.create.l HWIO_TLMM_DIR_CONN_INTR6_CFG_SENSORS_ADDR A:0xfd512218
y.create.l HWIO_TLMM_DIR_CONN_INTR7_CFG_SENSORS_ADDR A:0xfd51221c
y.create.l HWIO_TLMM_DIR_CONN_INTR8_CFG_SENSORS_ADDR A:0xfd512220
y.create.l HWIO_TLMM_DIR_CONN_INTR9_CFG_SENSORS_ADDR A:0xfd512224
y.create.l HWIO_TLMM_DIR_CONN_INTR0_CFG_LPA_DSP_ADDR A:0xfd512500
y.create.l HWIO_TLMM_DIR_CONN_INTR1_CFG_LPA_DSP_ADDR A:0xfd512504
y.create.l HWIO_TLMM_DIR_CONN_INTR2_CFG_LPA_DSP_ADDR A:0xfd512508
y.create.l HWIO_TLMM_DIR_CONN_INTR3_CFG_LPA_DSP_ADDR A:0xfd51250c
y.create.l HWIO_TLMM_DIR_CONN_INTR4_CFG_LPA_DSP_ADDR A:0xfd512510
y.create.l HWIO_TLMM_DIR_CONN_INTR5_CFG_LPA_DSP_ADDR A:0xfd512514
y.create.l HWIO_TLMM_DIR_CONN_INTR0_CFG_RPM_ADDR A:0xfd512700
y.create.l HWIO_TLMM_DIR_CONN_INTR0_CFG_KPSS_ADDR A:0xfd512800
y.create.l HWIO_TLMM_DIR_CONN_INTR1_CFG_KPSS_ADDR A:0xfd512804
y.create.l HWIO_TLMM_DIR_CONN_INTR2_CFG_KPSS_ADDR A:0xfd512808
y.create.l HWIO_TLMM_DIR_CONN_INTR3_CFG_KPSS_ADDR A:0xfd51280c
y.create.l HWIO_TLMM_DIR_CONN_INTR4_CFG_KPSS_ADDR A:0xfd512810
y.create.l HWIO_TLMM_DIR_CONN_INTR5_CFG_KPSS_ADDR A:0xfd512814
y.create.l HWIO_TLMM_DIR_CONN_INTR6_CFG_KPSS_ADDR A:0xfd512818
y.create.l HWIO_TLMM_DIR_CONN_INTR7_CFG_KPSS_ADDR A:0xfd51281c
y.create.l HWIO_TLMM_DIR_CONN_INTR0_CFG_MSS_ADDR A:0xfd512a00
y.create.l HWIO_TLMM_DIR_CONN_INTR1_CFG_MSS_ADDR A:0xfd512a04
y.create.l HWIO_TLMM_GPIO_OUT_0_ADDR A:0xfd513000
y.create.l HWIO_TLMM_GPIO_OUT_1_ADDR A:0xfd513004
y.create.l HWIO_TLMM_GPIO_OUT_2_ADDR A:0xfd513008
y.create.l HWIO_TLMM_GPIO_OUT_3_ADDR A:0xfd51300c
y.create.l HWIO_TLMM_GPIO_OUT_CLR_0_ADDR A:0xfd513020
y.create.l HWIO_TLMM_GPIO_OUT_CLR_1_ADDR A:0xfd513024
y.create.l HWIO_TLMM_GPIO_OUT_CLR_2_ADDR A:0xfd513028
y.create.l HWIO_TLMM_GPIO_OUT_CLR_3_ADDR A:0xfd51302c
y.create.l HWIO_TLMM_GPIO_OUT_SET_0_ADDR A:0xfd513040
y.create.l HWIO_TLMM_GPIO_OUT_SET_1_ADDR A:0xfd513044
y.create.l HWIO_TLMM_GPIO_OUT_SET_2_ADDR A:0xfd513048
y.create.l HWIO_TLMM_GPIO_OUT_SET_3_ADDR A:0xfd51304c
y.create.l HWIO_TLMM_GPIO_IN_0_ADDR A:0xfd513060
y.create.l HWIO_TLMM_GPIO_IN_1_ADDR A:0xfd513064
y.create.l HWIO_TLMM_GPIO_IN_2_ADDR A:0xfd513068
y.create.l HWIO_TLMM_GPIO_IN_3_ADDR A:0xfd51306c
y.create.l HWIO_TLMM_GPIO_OE_0_ADDR A:0xfd513080
y.create.l HWIO_TLMM_GPIO_OE_1_ADDR A:0xfd513084
y.create.l HWIO_TLMM_GPIO_OE_2_ADDR A:0xfd513088
y.create.l HWIO_TLMM_GPIO_OE_3_ADDR A:0xfd51308c
y.create.l HWIO_TLMM_GPIO_OE_CLR_0_ADDR A:0xfd513100
y.create.l HWIO_TLMM_GPIO_OE_CLR_1_ADDR A:0xfd513104
y.create.l HWIO_TLMM_GPIO_OE_CLR_2_ADDR A:0xfd513108
y.create.l HWIO_TLMM_GPIO_OE_CLR_3_ADDR A:0xfd51310c
y.create.l HWIO_TLMM_GPIO_OE_SET_0_ADDR A:0xfd513120
y.create.l HWIO_TLMM_GPIO_OE_SET_1_ADDR A:0xfd513124
y.create.l HWIO_TLMM_GPIO_OE_SET_2_ADDR A:0xfd513128
y.create.l HWIO_TLMM_GPIO_OE_SET_3_ADDR A:0xfd51312c
y.create.l HWIO_WCSS_A_BT_SYSCLK_CMPR_EN_ADDR A:0xfb440050
y.create.l HWIO_WCSS_A_BT_SYSCLK_CMPR_INTGR_ADDR A:0xfb440054
y.create.l HWIO_WCSS_A_BT_SYSCLK_CMPR_FRACT_ADDR A:0xfb440058
y.create.l HWIO_WCSS_A_BT_SYSCLK_COUNTVAL_ADDR A:0xfb440070
y.create.l HWIO_WCSS_A_BT_SYSCLK_DEBUG_SEL_ADDR A:0xfb4400cc
y.create.l HWIO_WCSS_A_BT_SYSCLK_DEBUG_CONTROL_1_ADDR A:0xfb4400d4
y.create.l HWIO_WCSS_A_BT_SYSCLK_DEBUG_CONTROL_2_ADDR A:0xfb4400d8
y.create.l HWIO_WCSS_A_BT_SYSCLK_CONTROL_ADDR A:0xfb440100
y.create.l HWIO_WCSS_A_BT_SYSCLK_COMPLETE_ADDR A:0xfb440104
y.create.l HWIO_WCSS_A_BT_SYSCLK_CLKN_CAPTURE_CTL_ADDR A:0xfb440120
y.create.l HWIO_WCSS_A_BT_SYSCLK_CLKN_CAPTURE_INTEGER_VAL_ADDR A:0xfb440124
y.create.l HWIO_WCSS_A_BT_SYSCLK_CLKN_CAPTURE_FRACT_VAL_ADDR A:0xfb440128
y.create.l HWIO_WCSS_A_BT_SYSCLK_MASTER_MEM_ADDR_ADDR A:0xfb440130
y.create.l HWIO_WCSS_A_BT_SYSCLK_SLAVE_BT_ADDR_ADDR A:0xfb440134
y.create.l HWIO_WCSS_A_BT_SYSCLK_PVC_SSBI2_INTR_ADDR A:0xfb4400a0
y.create.l HWIO_WCSS_A_BT_INT_0_INTERRUPT_CONTROL_ADDR A:0xfb3ff000
y.create.l HWIO_WCSS_A_BT_INT_0_BTC_INTERRUPT_MASK_ADDR A:0xfb3ff004
y.create.l HWIO_WCSS_A_BT_INT_0_BTC_INTERRUPT_STATUS_AND_ACKNOWLEDGE_ADDR A:0xfb3ff008
y.create.l HWIO_WCSS_A_BT_INT_0_BTC_PRESLOT_FILTER_ADDR A:0xfb3ff00c
y.create.l HWIO_WCSS_A_BT_INT_0_BTC_SLOT_BURST_TIMER_ADDR A:0xfb3ff010
y.create.l HWIO_WCSS_A_BT_BLUETOOTH_CLOCK_N_COMPARATOR_INTERRUPT_CONTROL_STATUS_ADDR A:0xfb3ff014
y.create.l HWIO_WCSS_A_BT_CAPTURED_BT_CLKN_INTEGER_PORTION_ADDR A:0xfb3ff018
y.create.l HWIO_WCSS_A_BT_CAPTURED_BT_CLKN_FRACTIONAL_PORTION_ADDR A:0xfb3ff01c
y.create.l HWIO_WCSS_A_BT_CAPTURED_BT_CLKA_INTEGER_PORTION_ADDR A:0xfb3ff020
y.create.l HWIO_WCSS_A_BT_CAPTURED_BT_CLKA_FRACTIONAL_PORTION_ADDR A:0xfb3ff024
y.create.l HWIO_WCSS_A_BT_BT_CLOCK_CONTROL_ADDR A:0xfb3ff028
y.create.l HWIO_WCSS_A_BT_BT_CLOCK_ALU_COMMAND_ADDR A:0xfb3ff02c
y.create.l HWIO_WCSS_A_BT_BT_CLOCK_ALU_INTEGER_OPERAND_ADDR A:0xfb3ff030
y.create.l HWIO_WCSS_A_BT_BT_CLOCK_ALU_FRACTIONAL_OPERAND_ADDR A:0xfb3ff034
y.create.l HWIO_WCSS_A_BT_BT_CLOCK_ALU_INTEGER_ACCUMULATOR_ADDR A:0xfb3ff038
y.create.l HWIO_WCSS_A_BT_BT_CLOCK_ALU_FRACTIONAL_ACCUMULATOR_ADDR A:0xfb3ff03c
y.create.l HWIO_WCSS_A_BT_LTE_FRAME_SYNC_CAPTURED_BT_CLKN_INTEGER_PORTION_ADDR A:0xfb3ff040
y.create.l HWIO_WCSS_A_BT_LTE_FRAME_SYNC_CAPTURED_BT_CLKN_FRACTIONAL_PORTION_ADDR A:0xfb3ff044
y.create.l HWIO_WCSS_A_BT_ENCRYPTION_CONTROL_ADDR A:0xfb3ff048
y.create.l HWIO_WCSS_A_BT_ENCRYPTION_K_C_KEY_0_LE_SESSION_KEY_0_ADDR A:0xfb3ff04c
y.create.l HWIO_WCSS_A_BT_ENCRYPTION_K_C_KEY_1_LE_SESSION_KEY_1_ADDR A:0xfb3ff050
y.create.l HWIO_WCSS_A_BT_ENCRYPTION_K_C_KEY_2_LE_SESSION_KEY_2_ADDR A:0xfb3ff054
y.create.l HWIO_WCSS_A_BT_ENCRYPTION_K_C_KEY_3_LE_SESSION_KEY_3_ADDR A:0xfb3ff058
y.create.l HWIO_WCSS_A_BT_CAPTURED_UAP_ADDR A:0xfb3ff05c
y.create.l HWIO_WCSS_A_BT_BT_DEVICE_ADDRESS_0_ADDR A:0xfb3ff060
y.create.l HWIO_WCSS_A_BT_BT_DEVICE_ADDRESS_1_ADDR A:0xfb3ff064
y.create.l HWIO_WCSS_A_BT_HOP_CONTROL_ADDR A:0xfb3ff068
y.create.l HWIO_WCSS_A_BT_HOP_N_COUNT_ADDR A:0xfb3ff06c
y.create.l HWIO_WCSS_A_BT_HOP_OFFSET_ADDR A:0xfb3ff070
y.create.l HWIO_WCSS_A_BT_HOP_COEXISTENCE_LOW_CHANNEL_ADDR A:0xfb3ff074
y.create.l HWIO_WCSS_A_BT_HOP_COEXISTENCE_HIGH_CHANNEL_ADDR A:0xfb3ff078
y.create.l HWIO_WCSS_A_BT_HOP_AFH_CHANNEL_MAP_0_ADDR A:0xfb3ff07c
y.create.l HWIO_WCSS_A_BT_HOP_AFH_CHANNEL_MAP_1_ADDR A:0xfb3ff080
y.create.l HWIO_WCSS_A_BT_HOP_AFH_CHANNEL_MAP_2_ADDR A:0xfb3ff084
y.create.l HWIO_WCSS_A_BT_HOP_HALF_SLOT_0_BCA_CHANNEL_ADDR A:0xfb3ff088
y.create.l HWIO_WCSS_A_BT_HOP_HALF_SLOT_1_BCA_CHANNEL_ADDR A:0xfb3ff08c
y.create.l HWIO_WCSS_A_BT_HOP_FREQUENCY_ADDR A:0xfb3ff090
y.create.l HWIO_WCSS_A_BT_LE_CHANNEL_INDEX_ADDR A:0xfb3ff094
y.create.l HWIO_WCSS_A_BT_HOP_FREQUENCY_1_ADDR A:0xfb3ff098
y.create.l HWIO_WCSS_A_BT_LC_COMMAND_HALF_SLOT_0_ADDR A:0xfb3ff0a0
y.create.l HWIO_WCSS_A_BT_LC_COMMAND_HALF_SLOT_1_ADDR A:0xfb3ff0a4
y.create.l HWIO_WCSS_A_BT_LC_ABORT_ISSUE_AND_STATUS_ADDR A:0xfb3ff0a8
y.create.l HWIO_WCSS_A_BT_LLR_TRIGGER_REPETITION_ADDR A:0xfb3ff0ac
y.create.l HWIO_WCSS_A_BT_RX_CONTROL_ADDR A:0xfb3ff0b0
y.create.l HWIO_WCSS_A_BT_RX_NORMAL_APERTURE_WINDOW_ADDR A:0xfb3ff0b4
y.create.l HWIO_WCSS_A_BT_RX_WIDE_APERTURE_WINDOW_ADDR A:0xfb3ff0b8
y.create.l HWIO_WCSS_A_BT_RX_BCA_WINDOW_ADDR A:0xfb3ff0bc
y.create.l HWIO_WCSS_A_BT_SW_WHITEN_SEED_ADDR A:0xfb3ff0c0
y.create.l HWIO_WCSS_A_BT_RX_ACL_HEADER_THRESHOLD_ADDR A:0xfb3ff0c4
y.create.l HWIO_WCSS_A_BT_RX_SCO_HEADER_THRESHOLD_ADDR A:0xfb3ff0c8
y.create.l HWIO_WCSS_A_BT_HOP_OFFSET_1_ADDR A:0xfb3ff0cc
y.create.l HWIO_WCSS_A_BT_RX_SYNC_WORD_0_ADDR A:0xfb3ff0d0
y.create.l HWIO_WCSS_A_BT_RX_SYNC_WORD_1_ADDR A:0xfb3ff0d4
y.create.l HWIO_WCSS_A_BT_RX_SCO_PAYLOAD_LENGTH_ADDR A:0xfb3ff0d8
y.create.l HWIO_WCSS_A_BT_RX_AM_ADDRESS_ARRAY_POINTER_ADDR A:0xfb3ff0dc
y.create.l HWIO_WCSS_A_BT_RX_BUFFER_SCO_POINTER_ADDR A:0xfb3ff0e0
y.create.l HWIO_WCSS_A_BT_RX_BUFFER_ACL_POINTER_ADDR A:0xfb3ff0e4
y.create.l HWIO_WCSS_A_BT_RX_BUFFER_LMP_POINTER_ADDR A:0xfb3ff0e8
y.create.l HWIO_WCSS_A_BT_RX_BUFFER_CONTROL_POINTER_ADDR A:0xfb3ff0ec
y.create.l HWIO_WCSS_A_BT_RX_BUFFER_LE_POINTER_ADDR A:0xfb3ff0f0
y.create.l HWIO_WCSS_A_BT_RX_LOW_POWER_CONTROL_ADDR A:0xfb3ff0f4
y.create.l HWIO_WCSS_A_BT_RX_LPPS_BIST_TIMER_INIT_VALUE_ADDR A:0xfb3ff0f8
y.create.l HWIO_WCSS_A_BT_SYNC_WORD_ADDR A:0xfb3ff0fc
y.create.l HWIO_WCSS_A_BT_RX_COMPOSITE_STATUS_ADDR A:0xfb3ff100
y.create.l HWIO_WCSS_A_BT_RX_DETAILED_BAD_STATUS_ADDR A:0xfb3ff104
y.create.l HWIO_WCSS_A_BT_RX_FEC_AND_DONE_STATUS_ADDR A:0xfb3ff108
y.create.l HWIO_WCSS_A_BT_RX_FRAME_TIMING_ERROR_ADDR A:0xfb3ff10c
y.create.l HWIO_WCSS_A_BT_RX_PACKET_HEADER_ERROR_COUNT_ADDR A:0xfb3ff11c
y.create.l HWIO_WCSS_A_BT_RX_PAYLOAD_2_3_FEC_ERROR_DETECTED_COUNT_ADDR A:0xfb3ff124
y.create.l HWIO_WCSS_A_BT_RX_PAYLOAD_FEC_ERROR_CORRECTED_COUNT_ADDR A:0xfb3ff128
y.create.l HWIO_WCSS_A_BT_RX_ENERGY_DETECT_COUNT_ADDR A:0xfb3ff12c
y.create.l HWIO_WCSS_A_BT_RX_LE_PAYLOAD_HEADER_DATA_ADDR A:0xfb3ff134
y.create.l HWIO_WCSS_A_BT_RX_PACKET_HEADER_DATA_ADDR A:0xfb3ff138
y.create.l HWIO_WCSS_A_BT_RX_PAYLOAD_HEADER_DATA_ADDR A:0xfb3ff13c
y.create.l HWIO_WCSS_A_BT_RX_PACKET_HEADER_HEC_ADDR A:0xfb3ff144
y.create.l HWIO_WCSS_A_BT_RX_PAYLOAD_CRC_ADDR A:0xfb3ff148
y.create.l HWIO_WCSS_A_BT_TX_SCO_PAYLOAD_LENGTH_ADDR A:0xfb3ff14c
y.create.l HWIO_WCSS_A_BT_TX_BUFFER_POINTER_ADDR A:0xfb3ff150
y.create.l HWIO_WCSS_A_BT_TX_STATUS_ADDR A:0xfb3ff158
y.create.l HWIO_WCSS_A_BT_COEXISTENCE_RF_ACTIVE_DELAY_TIMER_ADDR A:0xfb3ff15c
y.create.l HWIO_WCSS_A_BT_SOFTWARE_CAPTURE_CALCULATE_COMMAND_ADDR A:0xfb3ff160
y.create.l HWIO_WCSS_A_BT_COEXISTENCE_COMMAND_ADDR A:0xfb3ff164
y.create.l HWIO_WCSS_A_BT_COEXISTENCE_CONTROL_ADDR A:0xfb3ff168
y.create.l HWIO_WCSS_A_BT_COEXISTENCE_ENABLE_AND_POLARITY_ADDR A:0xfb3ff16c
y.create.l HWIO_WCSS_A_BT_COEXISTENCE_STATUS_ADDR A:0xfb3ff170
y.create.l HWIO_WCSS_A_BT_TEST_MUX_CONTROL_ADDR A:0xfb3ff178
y.create.l HWIO_WCSS_A_BT_TEST_MUX_DEBUG_OUTPUT_ADDR A:0xfb3ff17c
y.create.l HWIO_WCSS_A_BT_HARDWARE_VERIFICATION_CONTROL_1_ADDR A:0xfb3ff184
y.create.l HWIO_WCSS_A_BT_HARDWARE_VERIFICATION_CONTROL_2_ADDR A:0xfb3ff188
y.create.l HWIO_WCSS_A_BT_HARDWARE_VERIFICATION_CONTROL_3_ADDR A:0xfb3ff18c
y.create.l HWIO_WCSS_A_BT_HARDWARE_VERIFICATION_CLEAR_STATE_MACHINES_ADDR A:0xfb3ff190
y.create.l HWIO_WCSS_A_BT_HARDWARE_VERIFICATION_STATUS_1_ADDR A:0xfb3ff194
y.create.l HWIO_WCSS_A_BT_HARDWARE_VERIFICATION_STATUS_2_ADDR A:0xfb3ff198
y.create.l HWIO_WCSS_A_BT_BT_CORE_VERSION_ADDR A:0xfb3ff19c
y.create.l HWIO_WCSS_A_BT_PACKET_CONTROL_ADDR A:0xfb3ff1a0
y.create.l HWIO_WCSS_A_BT_TEST_CONTROL_ADDR A:0xfb3ff1a4
y.create.l HWIO_WCSS_A_BT_LE_CONTROL_2_ADDR A:0xfb3ff1a8
y.create.l HWIO_WCSS_A_BT_BLUETOOTH_CLOCK_N_INTEGER_COMPARE_VALUE_0_ADDR A:0xfb3ff1ac
y.create.l HWIO_WCSS_A_BT_BLUETOOTH_CLOCK_N_FRACTIONAL_COMPARE_VALUE_0_ADDR A:0xfb3ff1b0
y.create.l HWIO_WCSS_A_BT_BLUETOOTH_CLOCK_N_INTEGER_COMPARE_VALUE_1_ADDR A:0xfb3ff1b4
y.create.l HWIO_WCSS_A_BT_BLUETOOTH_CLOCK_N_FRACTIONAL_COMPARE_VALUE_1_ADDR A:0xfb3ff1b8
y.create.l HWIO_WCSS_A_BT_BURST_COEXISTENCE_COMMAND_ADDR A:0xfb3ff1bc
y.create.l HWIO_WCSS_A_BT_BURST_COEXISTENCE_STATUS_ADDR A:0xfb3ff1c0
y.create.l HWIO_WCSS_A_BT_BURST_PRESLOT_ADDR A:0xfb3ff1c4
y.create.l HWIO_WCSS_A_BT_BURST_TX_COMMAND_ADDR A:0xfb3ff1c8
y.create.l HWIO_WCSS_A_BT_BURST_TX_HOP_STROBE_ADDR A:0xfb3ff1cc
y.create.l HWIO_WCSS_A_BT_BURST_TX_ON_ADDR A:0xfb3ff1d0
y.create.l HWIO_WCSS_A_BT_BURST_RX_COMMAND_ADDR A:0xfb3ff1d4
y.create.l HWIO_WCSS_A_BT_BURST_RX_HOP_STROBE_ADDR A:0xfb3ff1d8
y.create.l HWIO_WCSS_A_BT_BURST_RX_ON_ADDR A:0xfb3ff1dc
y.create.l HWIO_WCSS_A_BT_RX_ACCESS_CODE_DETECT_HARD_ALIGN_ADDR A:0xfb3ff1e0
y.create.l HWIO_WCSS_A_BT_RX_PACKET_HEADER_HARD_ALIGN_ADDR A:0xfb3ff1e4
y.create.l HWIO_WCSS_A_BT_TX_GUARD_SYNC_LENGTH_ADDR A:0xfb3ff1e8
y.create.l HWIO_WCSS_A_BT_SOFTWARE_INTERRUPT_LATENCY_ADDR A:0xfb3ff1ec
y.create.l HWIO_WCSS_A_BT_RX_DEMODULATOR_DELAY_ADDR A:0xfb3ff1f0
y.create.l HWIO_WCSS_A_BT_TX_PACKET_HEADER_HARD_ALIGN_ADDR A:0xfb3ff1f4
y.create.l HWIO_WCSS_A_BT_BT_TO_LPASS_AUDIO_ADDR A:0xfb3ff1fc
y.create.l HWIO_WCSS_A_BT_LC_RX_AGC_RSSI_OUT_0_ADDR A:0xfb3ff200
y.create.l HWIO_WCSS_A_BT_LC_RX_AGC_RSSI_OUT_1_ADDR A:0xfb3ff204
y.create.l HWIO_WCSS_A_BT_LC_SIF_CTRL_ADDR A:0xfb3ff208
y.create.l HWIO_WCSS_A_BT_INT_0_LE_BTC_SLOT_BURST_TIMER_ADDR A:0xfb3ff348
y.create.l HWIO_WCSS_A_BT_LE_BURST_COEXISTENCE_COMMAND_ADDR A:0xfb3ff34c
y.create.l HWIO_WCSS_A_BT_LE_BURST_COEXISTENCE_STATUS_ADDR A:0xfb3ff350
y.create.l HWIO_WCSS_A_BT_LE_BURST_PRESLOT_ADDR A:0xfb3ff354
y.create.l HWIO_WCSS_A_BT_LE_BURST_TX_COMMAND_ADDR A:0xfb3ff358
y.create.l HWIO_WCSS_A_BT_LE_BURST_TX_HOP_STROBE_ADDR A:0xfb3ff35c
y.create.l HWIO_WCSS_A_BT_LE_BURST_TX_ON_ADDR A:0xfb3ff360
y.create.l HWIO_WCSS_A_BT_LE_BURST_RX_COMMAND_ADDR A:0xfb3ff364
y.create.l HWIO_WCSS_A_BT_LE_BURST_RX_HOP_STROBE_ADDR A:0xfb3ff368
y.create.l HWIO_WCSS_A_BT_LE_BURST_RX_ON_ADDR A:0xfb3ff36c
y.create.l HWIO_WCSS_A_BT_PACKET_REPEAT_NUMBER_ADDR A:0xfb3ff370
y.create.l HWIO_WCSS_A_BT_GOOD_CRC_COUNTER_ADDR A:0xfb3ff374
y.create.l HWIO_WCSS_A_BT_LE_RX_HARD_ALIGN_ADDR A:0xfb3ff378
y.create.l HWIO_WCSS_A_BT_LE_CONTROL_ADDR A:0xfb3ff37c
y.create.l HWIO_WCSS_A_BT_LE_HOP_OFFSET_ADDR A:0xfb3ff380
y.create.l HWIO_WCSS_A_BT_BLUETOOTH_CLOCK_N_INTEGER_COMPARE_VALUE_2_ADDR A:0xfb3ff388
y.create.l HWIO_WCSS_A_BT_BLUETOOTH_CLOCK_N_FRACTIONAL_COMPARE_VALUE_2_ADDR A:0xfb3ff38c
y.create.l HWIO_WCSS_A_BT_CRYPTO_TX_PAYLOAD_BUFFER_POINTER_AND_LENGTH_ADDR A:0xfb3ff390
y.create.l HWIO_WCSS_A_BT_CRYPTO_KEYN_ADDR A:0xfb3ff394
y.create.l HWIO_WCSS_A_BT_CRYPTO_A0_B0_B1_ADDR A:0xfb3ff398
y.create.l HWIO_WCSS_A_BT_ERROR_STATUS_REGISTER_ADDR A:0xfb3ff39c
y.create.l HWIO_WCSS_A_BT_CLOCK_GATING_ADDR A:0xfb3ff3a0
y.create.l HWIO_WCSS_A_BT_GAM_GAS_CONFIG_ADDR A:0xfb3ff3a4
y.create.l HWIO_WCSS_A_BT_ESCO_CRYPTO_A0_B0_B1_ADDR A:0xfb3ff3a8
y.create.l HWIO_WCSS_A_CRYPTO4_CRYPTO_VERSION_ADDR A:0xfb400000
y.create.l HWIO_WCSS_A_CRYPTO4_CRYPTO_DATA_IN_ADDR A:0xfb400008
y.create.l HWIO_WCSS_A_CRYPTO4_CRYPTO_DATA_OUT_ADDR A:0xfb400010
y.create.l HWIO_WCSS_A_CRYPTO4_CRYPTO_STATUS_ADDR A:0xfb400100
y.create.l HWIO_WCSS_A_CRYPTO4_CRYPTO_ENGINES_AVAIL_ADDR A:0xfb400104
y.create.l HWIO_WCSS_A_CRYPTO4_CRYPTO_SEG_SIZE_ADDR A:0xfb400200
y.create.l HWIO_WCSS_A_CRYPTO4_CRYPTO_GOPROC_ADDR A:0xfb400204
y.create.l HWIO_WCSS_A_CRYPTO4_CRYPTO_ENCR_SEG_CFG_ADDR A:0xfb400300
y.create.l HWIO_WCSS_A_CRYPTO4_CRYPTO_ENCR_SEG_SIZE_ADDR A:0xfb400304
y.create.l HWIO_WCSS_A_CRYPTO4_CRYPTO_ENCR_SEG_START_ADDR A:0xfb400308
y.create.l HWIO_WCSS_A_CRYPTO4_CRYPTO_ENCR_KEY0_ADDR A:0xfb400310
y.create.l HWIO_WCSS_A_CRYPTO4_CRYPTO_ENCR_KEY1_ADDR A:0xfb400314
y.create.l HWIO_WCSS_A_CRYPTO4_CRYPTO_ENCR_KEY2_ADDR A:0xfb400318
y.create.l HWIO_WCSS_A_CRYPTO4_CRYPTO_ENCR_KEY3_ADDR A:0xfb40031c
y.create.l HWIO_WCSS_A_CRYPTO4_CRYPTO_ENCR_KEY4_ADDR A:0xfb400320
y.create.l HWIO_WCSS_A_CRYPTO4_CRYPTO_ENCR_KEY5_ADDR A:0xfb400324
y.create.l HWIO_WCSS_A_CRYPTO4_CRYPTO_ENCR_KEY6_ADDR A:0xfb400328
y.create.l HWIO_WCSS_A_CRYPTO4_CRYPTO_ENCR_KEY7_ADDR A:0xfb40032c
y.create.l HWIO_WCSS_A_CRYPTO4_CRYPTO_ENCR_XTS_KEY0_ADDR A:0xfb400330
y.create.l HWIO_WCSS_A_CRYPTO4_CRYPTO_ENCR_XTS_KEY1_ADDR A:0xfb400334
y.create.l HWIO_WCSS_A_CRYPTO4_CRYPTO_ENCR_XTS_KEY2_ADDR A:0xfb400338
y.create.l HWIO_WCSS_A_CRYPTO4_CRYPTO_ENCR_XTS_KEY3_ADDR A:0xfb40033c
y.create.l HWIO_WCSS_A_CRYPTO4_CRYPTO_ENCR_XTS_KEY4_ADDR A:0xfb400340
y.create.l HWIO_WCSS_A_CRYPTO4_CRYPTO_ENCR_XTS_KEY5_ADDR A:0xfb400344
y.create.l HWIO_WCSS_A_CRYPTO4_CRYPTO_ENCR_XTS_KEY6_ADDR A:0xfb400348
y.create.l HWIO_WCSS_A_CRYPTO4_CRYPTO_ENCR_XTS_KEY7_ADDR A:0xfb40034c
y.create.l HWIO_WCSS_A_CRYPTO4_CRYPTO_ENCR_CNTR0_IV0_ADDR A:0xfb400350
y.create.l HWIO_WCSS_A_CRYPTO4_CRYPTO_ENCR_CNTR1_IV1_ADDR A:0xfb400354
y.create.l HWIO_WCSS_A_CRYPTO4_CRYPTO_ENCR_CNTR2_IV2_ADDR A:0xfb400358
y.create.l HWIO_WCSS_A_CRYPTO4_CRYPTO_ENCR_CNTR3_IV3_ADDR A:0xfb40035c
y.create.l HWIO_WCSS_A_CRYPTO4_CRYPTO_ENCR_CNTR_MASK_ADDR A:0xfb400360
y.create.l HWIO_WCSS_A_CRYPTO4_CRYPTO_ENCR_XTS_DU_SIZE_ADDR A:0xfb400364
y.create.l HWIO_WCSS_A_CRYPTO4_CRYPTO_AUTH_SEG_CFG_ADDR A:0xfb400400
y.create.l HWIO_WCSS_A_CRYPTO4_CRYPTO_AUTH_SEG_SIZE_ADDR A:0xfb400404
y.create.l HWIO_WCSS_A_CRYPTO4_CRYPTO_AUTH_SEG_START_ADDR A:0xfb400408
y.create.l HWIO_WCSS_A_CRYPTO4_CRYPTO_AUTH_KEY0_ADDR A:0xfb400410
y.create.l HWIO_WCSS_A_CRYPTO4_CRYPTO_AUTH_KEY1_ADDR A:0xfb400414
y.create.l HWIO_WCSS_A_CRYPTO4_CRYPTO_AUTH_KEY2_ADDR A:0xfb400418
y.create.l HWIO_WCSS_A_CRYPTO4_CRYPTO_AUTH_KEY3_ADDR A:0xfb40041c
y.create.l HWIO_WCSS_A_CRYPTO4_CRYPTO_AUTH_KEY4_ADDR A:0xfb400420
y.create.l HWIO_WCSS_A_CRYPTO4_CRYPTO_AUTH_KEY5_ADDR A:0xfb400424
y.create.l HWIO_WCSS_A_CRYPTO4_CRYPTO_AUTH_KEY6_ADDR A:0xfb400428
y.create.l HWIO_WCSS_A_CRYPTO4_CRYPTO_AUTH_KEY7_ADDR A:0xfb40042c
y.create.l HWIO_WCSS_A_CRYPTO4_CRYPTO_AUTH_KEY8_ADDR A:0xfb400430
y.create.l HWIO_WCSS_A_CRYPTO4_CRYPTO_AUTH_KEY9_ADDR A:0xfb400434
y.create.l HWIO_WCSS_A_CRYPTO4_CRYPTO_AUTH_IV0_ADDR A:0xfb400450
y.create.l HWIO_WCSS_A_CRYPTO4_CRYPTO_AUTH_IV1_ADDR A:0xfb400454
y.create.l HWIO_WCSS_A_CRYPTO4_CRYPTO_AUTH_IV2_ADDR A:0xfb400458
y.create.l HWIO_WCSS_A_CRYPTO4_CRYPTO_AUTH_IV3_ADDR A:0xfb40045c
y.create.l HWIO_WCSS_A_CRYPTO4_CRYPTO_AUTH_IV4_ADDR A:0xfb400460
y.create.l HWIO_WCSS_A_CRYPTO4_CRYPTO_AUTH_IV5_ADDR A:0xfb400464
y.create.l HWIO_WCSS_A_CRYPTO4_CRYPTO_AUTH_IV6_ADDR A:0xfb400468
y.create.l HWIO_WCSS_A_CRYPTO4_CRYPTO_AUTH_IV7_ADDR A:0xfb40046c
y.create.l HWIO_WCSS_A_CRYPTO4_CRYPTO_AUTH_IV8_ADDR A:0xfb400470
y.create.l HWIO_WCSS_A_CRYPTO4_CRYPTO_AUTH_IV9_ADDR A:0xfb400474
y.create.l HWIO_WCSS_A_CRYPTO4_CRYPTO_AUTH_INFO_NONCE0_ADDR A:0xfb400490
y.create.l HWIO_WCSS_A_CRYPTO4_CRYPTO_AUTH_INFO_NONCE1_ADDR A:0xfb400494
y.create.l HWIO_WCSS_A_CRYPTO4_CRYPTO_AUTH_INFO_NONCE2_ADDR A:0xfb400498
y.create.l HWIO_WCSS_A_CRYPTO4_CRYPTO_AUTH_INFO_NONCE3_ADDR A:0xfb40049c
y.create.l HWIO_WCSS_A_CRYPTO4_CRYPTO_AUTH_BYTECNT0_ADDR A:0xfb4004a0
y.create.l HWIO_WCSS_A_CRYPTO4_CRYPTO_AUTH_BYTECNT1_ADDR A:0xfb4004a4
y.create.l HWIO_WCSS_A_CRYPTO4_CRYPTO_AUTH_BYTECNT2_ADDR A:0xfb4004a8
y.create.l HWIO_WCSS_A_CRYPTO4_CRYPTO_AUTH_BYTECNT3_ADDR A:0xfb4004ac
y.create.l HWIO_WCSS_A_CRYPTO4_CRYPTO_AUTH_EXP_MAC0_ADDR A:0xfb4004b0
y.create.l HWIO_WCSS_A_CRYPTO4_CRYPTO_AUTH_EXP_MAC1_ADDR A:0xfb4004b4
y.create.l HWIO_WCSS_A_CRYPTO4_CRYPTO_AUTH_EXP_MAC2_ADDR A:0xfb4004b8
y.create.l HWIO_WCSS_A_CRYPTO4_CRYPTO_AUTH_EXP_MAC3_ADDR A:0xfb4004bc
y.create.l HWIO_WCSS_A_CRYPTO4_CRYPTO_AUTH_EXP_MAC4_ADDR A:0xfb4004c0
y.create.l HWIO_WCSS_A_CRYPTO4_CRYPTO_AUTH_EXP_MAC5_ADDR A:0xfb4004c4
y.create.l HWIO_WCSS_A_CRYPTO4_CRYPTO_AUTH_EXP_MAC6_ADDR A:0xfb4004c8
y.create.l HWIO_WCSS_A_CRYPTO4_CRYPTO_AUTH_EXP_MAC7_ADDR A:0xfb4004cc
y.create.l HWIO_WCSS_A_CRYPTO4_CRYPTO_CONFIG_ADDR A:0xfb400500
y.create.l HWIO_WCSS_A_CRYPTO4_CRYPTO_SACR_ADDR A:0xfb400504
y.create.l HWIO_WCSS_A_CRYPTO4_CRYPTO_DEBUG_ADDR A:0xfb400508
y.create.l HWIO_WCSS_A_CRYPTO4_CRYPTO_DATA_SHADOW0_ADDR A:0xfb408000
y.create.l HWIO_WCSS_A_CRYPTO4_CRYPTO_DATA_SHADOW8191_ADDR A:0xfb40fffc
y.create.l HWIO_WCSS_A_QTA_BT_INTR_ADDR A:0xfb4c0000
y.create.l HWIO_WCSS_A_QTA_BT_INTR_EN_ADDR A:0xfb4c0004
y.create.l HWIO_WCSS_A_QTA_BT_UART_CTRL_ADDR A:0xfb4c0008
y.create.l HWIO_WCSS_A_QTA_BT_HW_CTRL_ADDR A:0xfb4c000c
y.create.l HWIO_WCSS_A_QTA_BT_HW_TX_BUFFER_MODIFY_ADDR A:0xfb4c0010
y.create.l HWIO_WCSS_A_QTA_BT_SW_CTRL_ADDR A:0xfb4c0014
y.create.l HWIO_WCSS_A_QTA_BT_SW_TX_FIFO_IN_ADDR A:0xfb4c0018
y.create.l HWIO_WCSS_A_QTA_BT_SW_RX_FIFO_OUT_ADDR A:0xfb4c001c
y.create.l HWIO_WCSS_A_QTA_BT_TESTBUS_ADDR A:0xfb4c0020
y.create.l HWIO_WCSS_A_BT_SSBI2_CFG_SSBI2_PVC_FIFO_ADDR A:0xfb4afffc
y.create.l HWIO_WCSS_A_SSBI2_CFG_SSBI2_CTL_ADDR A:0xfb4a0000
y.create.l HWIO_WCSS_A_SSBI2_CFG_SSBI2_INT_ENABLE_ADDR A:0xfb4a0004
y.create.l HWIO_WCSS_A_SSBI2_CFG_SSBI2_PRIORITIES_ADDR A:0xfb4a0008
y.create.l HWIO_WCSS_A_SSBI2_CFG_SSBI2_BANKS_2_3_CTL_ADDR A:0xfb4a000c
y.create.l HWIO_WCSS_A_SSBI2_CFG_SSBI2_ILLEGAL_STATUS_ADDR A:0xfb4a0010
y.create.l HWIO_WCSS_A_SSBI2_CFG_SSBI2_TEST_BUS_CTL_ADDR A:0xfb4a0014
y.create.l HWIO_WCSS_A_SSBI2_CFG_SSBI2_VIT0_ADDR A:0xfb4a0020
y.create.l HWIO_WCSS_A_SSBI2_CFG_SSBI2_VIT1_ADDR A:0xfb4a0024
y.create.l HWIO_WCSS_A_SSBI2_CFG_SSBI2_VIT2_ADDR A:0xfb4a0028
y.create.l HWIO_WCSS_A_SSBI2_CFG_SSBI2_VIT3_ADDR A:0xfb4a002c
y.create.l HWIO_WCSS_A_SSBI2_CFG_SSBI2_VIT4_ADDR A:0xfb4a0030
y.create.l HWIO_WCSS_A_SSBI2_CFG_SSBI2_VIT5_ADDR A:0xfb4a0034
y.create.l HWIO_WCSS_A_SSBI2_CFG_SSBI2_VIT6_ADDR A:0xfb4a0038
y.create.l HWIO_WCSS_A_SSBI2_CFG_SSBI2_PVC_CTL_ADDR A:0xfb4a00a0
y.create.l HWIO_WCSS_A_SSBI2_CFG_SSBI2_PVC_TABLE0_ADDR A:0xfb4a00a4
y.create.l HWIO_WCSS_A_SSBI2_CFG_SSBI2_PVC_TABLE1_ADDR A:0xfb4a00a8
y.create.l HWIO_WCSS_A_SSBI2_CFG_SSBI2_PVC_TABLE2_ADDR A:0xfb4a00ac
y.create.l HWIO_WCSS_A_SSBI2_CFG_SSBI2_PVC_TABLE3_ADDR A:0xfb4a00b0
y.create.l HWIO_WCSS_A_SSBI2_CFG_SSBI2_PVC_TABLE4_ADDR A:0xfb4a00b4
y.create.l HWIO_WCSS_A_SSBI2_CFG_SSBI2_PVC_TABLE5_ADDR A:0xfb4a00b8
y.create.l HWIO_WCSS_A_SSBI2_CFG_SSBI2_PVC_TABLE6_ADDR A:0xfb4a00bc
y.create.l HWIO_WCSS_A_SSBI2_CFG_SSBI2_PVC_TABLE7_ADDR A:0xfb4a00c0
y.create.l HWIO_WCSS_A_SSBI2_CFG_SSBI2_PVC_TABLE8_ADDR A:0xfb4a00c4
y.create.l HWIO_WCSS_A_SSBI2_CFG_SSBI2_PVC_TABLE9_ADDR A:0xfb4a00c8
y.create.l HWIO_WCSS_A_SSBI2_CMD_SSBI2_CMD_ADDR A:0xfb480000
y.create.l HWIO_WCSS_A_SSBI2_CMD_SSBI2_RD_STATUS_ADDR A:0xfb480004
y.create.l HWIO_WCSS_A_VMIDMT_VMIDMT_SCR0_ADDR A:0xfb220000
y.create.l HWIO_WCSS_A_VMIDMT_VMIDMT_SCR1_ADDR A:0xfb220004
y.create.l HWIO_WCSS_A_VMIDMT_VMIDMT_SCR2_ADDR A:0xfb220008
y.create.l HWIO_WCSS_A_VMIDMT_VMIDMT_SACR_ADDR A:0xfb220010
y.create.l HWIO_WCSS_A_VMIDMT_VMIDMT_SIDR0_ADDR A:0xfb220020
y.create.l HWIO_WCSS_A_VMIDMT_VMIDMT_SIDR1_ADDR A:0xfb220024
y.create.l HWIO_WCSS_A_VMIDMT_VMIDMT_SIDR2_ADDR A:0xfb220028
y.create.l HWIO_WCSS_A_VMIDMT_VMIDMT_SIDR4_ADDR A:0xfb220030
y.create.l HWIO_WCSS_A_VMIDMT_VMIDMT_SIDR5_ADDR A:0xfb220034
y.create.l HWIO_WCSS_A_VMIDMT_VMIDMT_SIDR7_ADDR A:0xfb22003c
y.create.l HWIO_WCSS_A_VMIDMT_VMIDMT_SGFAR0_ADDR A:0xfb220040
y.create.l HWIO_WCSS_A_VMIDMT_VMIDMT_SGFSR_ADDR A:0xfb220048
y.create.l HWIO_WCSS_A_VMIDMT_VMIDMT_SGFSRRESTORE_ADDR A:0xfb22004c
y.create.l HWIO_WCSS_A_VMIDMT_VMIDMT_SGFSYNDR0_ADDR A:0xfb220050
y.create.l HWIO_WCSS_A_VMIDMT_VMIDMT_SGFSYNDR1_ADDR A:0xfb220054
y.create.l HWIO_WCSS_A_VMIDMT_VMIDMT_SGFSYNDR2_ADDR A:0xfb220058
y.create.l HWIO_WCSS_A_VMIDMT_VMIDMT_VMIDMTSCR0_ADDR A:0xfb220090
y.create.l HWIO_WCSS_A_VMIDMT_VMIDMT_CR0_ADDR A:0xfb220000
y.create.l HWIO_WCSS_A_VMIDMT_VMIDMT_CR2_ADDR A:0xfb220008
y.create.l HWIO_WCSS_A_VMIDMT_VMIDMT_ACR_ADDR A:0xfb220010
y.create.l HWIO_WCSS_A_VMIDMT_VMIDMT_IDR0_ADDR A:0xfb220020
y.create.l HWIO_WCSS_A_VMIDMT_VMIDMT_IDR1_ADDR A:0xfb220024
y.create.l HWIO_WCSS_A_VMIDMT_VMIDMT_IDR2_ADDR A:0xfb220028
y.create.l HWIO_WCSS_A_VMIDMT_VMIDMT_IDR4_ADDR A:0xfb220030
y.create.l HWIO_WCSS_A_VMIDMT_VMIDMT_IDR5_ADDR A:0xfb220034
y.create.l HWIO_WCSS_A_VMIDMT_VMIDMT_IDR7_ADDR A:0xfb22003c
y.create.l HWIO_WCSS_A_VMIDMT_VMIDMT_GFAR0_ADDR A:0xfb220040
y.create.l HWIO_WCSS_A_VMIDMT_VMIDMT_GFSR_ADDR A:0xfb220048
y.create.l HWIO_WCSS_A_VMIDMT_VMIDMT_GFSRRESTORE_ADDR A:0xfb22004c
y.create.l HWIO_WCSS_A_VMIDMT_VMIDMT_GFSYNDR0_ADDR A:0xfb220050
y.create.l HWIO_WCSS_A_VMIDMT_VMIDMT_GFSYNDR1_ADDR A:0xfb220054
y.create.l HWIO_WCSS_A_VMIDMT_VMIDMT_GFSYNDR2_ADDR A:0xfb220058
y.create.l HWIO_WCSS_A_VMIDMT_VMIDMT_VMIDMTCR0_ADDR A:0xfb220090
y.create.l HWIO_WCSS_A_VMIDMT_VMIDMT_VMIDMTACR_ADDR A:0xfb22009c
y.create.l HWIO_WCSS_A_VMIDMT_VMIDMT_NSCR0_ADDR A:0xfb220400
y.create.l HWIO_WCSS_A_VMIDMT_VMIDMT_NSCR2_ADDR A:0xfb220408
y.create.l HWIO_WCSS_A_VMIDMT_VMIDMT_NSACR_ADDR A:0xfb220410
y.create.l HWIO_WCSS_A_VMIDMT_VMIDMT_NSGFAR0_ADDR A:0xfb220440
y.create.l HWIO_WCSS_A_VMIDMT_VMIDMT_NSGFSR_ADDR A:0xfb220448
y.create.l HWIO_WCSS_A_VMIDMT_VMIDMT_NSGFSRRESTORE_ADDR A:0xfb22044c
y.create.l HWIO_WCSS_A_VMIDMT_VMIDMT_NSGFSYNDR0_ADDR A:0xfb220450
y.create.l HWIO_WCSS_A_VMIDMT_VMIDMT_NSGFSYNDR1_ADDR A:0xfb220454
y.create.l HWIO_WCSS_A_VMIDMT_VMIDMT_NSGFSYNDR2_ADDR A:0xfb220458
y.create.l HWIO_WCSS_A_VMIDMT_VMIDMT_NSVMIDMTCR0_ADDR A:0xfb220490
y.create.l HWIO_WCSS_A_VMIDMT_VMIDMT_SSDR0_ADDR A:0xfb220080
y.create.l HWIO_WCSS_A_VMIDMT_VMIDMT_MSDR0_ADDR A:0xfb220480
y.create.l HWIO_WCSS_A_VMIDMT_VMIDMT_MCR_ADDR A:0xfb220494
y.create.l HWIO_WCSS_A_VMIDMT_VMIDMT_S2VR0_ADDR A:0xfb220c00
y.create.l HWIO_WCSS_A_VMIDMT_VMIDMT_AS2VR0_ADDR A:0xfb220e00
y.create.l HWIO_WCSS_A_XPU_XPU_SCR_ADDR A:0xfb21f000
y.create.l HWIO_WCSS_A_XPU_XPU_SWDR_ADDR A:0xfb21f004
y.create.l HWIO_WCSS_A_XPU_XPU_SEAR0_ADDR A:0xfb21f040
y.create.l HWIO_WCSS_A_XPU_XPU_SESR_ADDR A:0xfb21f048
y.create.l HWIO_WCSS_A_XPU_XPU_SESRRESTORE_ADDR A:0xfb21f04c
y.create.l HWIO_WCSS_A_XPU_XPU_SESYNR0_ADDR A:0xfb21f050
y.create.l HWIO_WCSS_A_XPU_XPU_SESYNR1_ADDR A:0xfb21f054
y.create.l HWIO_WCSS_A_XPU_XPU_SESYNR2_ADDR A:0xfb21f058
y.create.l HWIO_WCSS_A_XPU_XPU_MCR_ADDR A:0xfb21f100
y.create.l HWIO_WCSS_A_XPU_XPU_MEAR0_ADDR A:0xfb21f140
y.create.l HWIO_WCSS_A_XPU_XPU_MESR_ADDR A:0xfb21f148
y.create.l HWIO_WCSS_A_XPU_XPU_MESRRESTORE_ADDR A:0xfb21f14c
y.create.l HWIO_WCSS_A_XPU_XPU_MESYNR0_ADDR A:0xfb21f150
y.create.l HWIO_WCSS_A_XPU_XPU_MESYNR1_ADDR A:0xfb21f154
y.create.l HWIO_WCSS_A_XPU_XPU_MESYNR2_ADDR A:0xfb21f158
y.create.l HWIO_WCSS_A_XPU_XPU_CR_ADDR A:0xfb21f080
y.create.l HWIO_WCSS_A_XPU_XPU_RPU_ACR0_ADDR A:0xfb21f0a0
y.create.l HWIO_WCSS_A_XPU_XPU_EAR0_ADDR A:0xfb21f0c0
y.create.l HWIO_WCSS_A_XPU_XPU_ESR_ADDR A:0xfb21f0c8
y.create.l HWIO_WCSS_A_XPU_XPU_ESRRESTORE_ADDR A:0xfb21f0cc
y.create.l HWIO_WCSS_A_XPU_XPU_ESYNR0_ADDR A:0xfb21f0d0
y.create.l HWIO_WCSS_A_XPU_XPU_ESYNR1_ADDR A:0xfb21f0d4
y.create.l HWIO_WCSS_A_XPU_XPU_ESYNR2_ADDR A:0xfb21f0d8
y.create.l HWIO_WCSS_A_XPU_XPU_IDR0_ADDR A:0xfb21f074
y.create.l HWIO_WCSS_A_XPU_XPU_IDR1_ADDR A:0xfb21f078
y.create.l HWIO_WCSS_A_XPU_XPU_REV_ADDR A:0xfb21f07c
y.create.l HWIO_WCSS_A_XPU_XPU_RG0_RACR0_ADDR A:0xfb21f200
y.create.l HWIO_WCSS_A_XPU_XPU_RG1_RACR0_ADDR A:0xfb21f280
y.create.l HWIO_WCSS_A_XPU_XPU_RG0_WACR0_ADDR A:0xfb21f220
y.create.l HWIO_WCSS_A_XPU_XPU_RG1_WACR0_ADDR A:0xfb21f2a0
y.create.l HWIO_WCSS_A_XPU_XPU_RG0_SCR_ADDR A:0xfb21f250
y.create.l HWIO_WCSS_A_XPU_XPU_RG1_SCR_ADDR A:0xfb21f2d0
y.create.l HWIO_WCSS_A_XPU_XPU_RG0_MCR_ADDR A:0xfb21f254
y.create.l HWIO_WCSS_A_XPU_XPU_RG1_MCR_ADDR A:0xfb21f2d4
y.create.l HWIO_WCSS_A_PMU_TOP_BCR_ADDR A:0xfb21b000
y.create.l HWIO_WCSS_A_PMU_TOP_AHB_CBCR_ADDR A:0xfb21b008
y.create.l HWIO_WCSS_A_PMU_BUS_TIMEOUT_CBCR_ADDR A:0xfb21b00c
y.create.l HWIO_WCSS_A_PMU_TOP_SLP_CBCR_ADDR A:0xfb21b010
y.create.l HWIO_WCSS_A_PMU_TOP_XO_CBCR_ADDR A:0xfb21b014
y.create.l HWIO_WCSS_A_PMU_AXI_M_CBCR_ADDR A:0xfb21b018
y.create.l HWIO_WCSS_A_PMU_COMMON_SS_BCR_ADDR A:0xfb21b020
y.create.l HWIO_WCSS_A_PMU_COMMON_GDSCR_ADDR A:0xfb21b024
y.create.l HWIO_WCSS_A_PMU_COMMON_PHY_DBG_CBCR_ADDR A:0xfb21b028
y.create.l HWIO_WCSS_A_PMU_COMMON_TRC_CBCR_ADDR A:0xfb21b02c
y.create.l HWIO_WCSS_A_PMU_COMMON_CPU_CBCR_ADDR A:0xfb21b030
y.create.l HWIO_WCSS_A_PMU_COMMON_AHB_CBCR_ADDR A:0xfb21b034
y.create.l HWIO_WCSS_A_PMU_COMMON_BT_32M_CBCR_ADDR A:0xfb21b038
y.create.l HWIO_WCSS_A_PMU_COMMON_BT_FM_19M_CBCR_ADDR A:0xfb21b03c
y.create.l HWIO_WCSS_A_PMU_COMMON_SLP_CBCR_ADDR A:0xfb21b040
y.create.l HWIO_WCSS_A_PMU_COMMON_XO_CBCR_ADDR A:0xfb21b044
y.create.l HWIO_WCSS_A_PMU_WLAN_BCR_ADDR A:0xfb21b050
y.create.l HWIO_WCSS_A_PMU_WLAN_GDSCR_ADDR A:0xfb21b054
y.create.l HWIO_WCSS_A_PMU_WLAN_RFA_CAL_CBCR_ADDR A:0xfb21b058
y.create.l HWIO_WCSS_A_PMU_WLAN_PHY_MAIN1_FAST_CBCR_ADDR A:0xfb21b05c
y.create.l HWIO_WCSS_A_PMU_WLAN_PHY_MAIN1_TX_CBCR_ADDR A:0xfb21b060
y.create.l HWIO_WCSS_A_PMU_WLAN_PHY_MAIN1_RX_CBCR_ADDR A:0xfb21b064
y.create.l HWIO_WCSS_A_PMU_WLAN_PHY_MAIN2_CBCR_ADDR A:0xfb21b068
y.create.l HWIO_WCSS_A_PMU_WLAN_PHY_DBG_CBCR_ADDR A:0xfb21b06c
y.create.l HWIO_WCSS_A_PMU_WLAN_PHY_DAC_CBCR_ADDR A:0xfb21b070
y.create.l HWIO_WCSS_A_PMU_WLAN_AHB_CBCR_ADDR A:0xfb21b074
y.create.l HWIO_WCSS_A_PMU_WLAN_PHY_ADC_CBCR_ADDR A:0xfb21b078
y.create.l HWIO_WCSS_A_PMU_WLAN_RFIF_CBCR_ADDR A:0xfb21b07c
y.create.l HWIO_WCSS_A_PMU_ADC_240M_CBCR_ADDR A:0xfb21b080
y.create.l HWIO_WCSS_A_PMU_DAC_SM_CBCR_ADDR A:0xfb21b084
y.create.l HWIO_WCSS_A_PMU_PHY_FAST_CMD_RCGR_ADDR A:0xfb21b0a0
y.create.l HWIO_WCSS_A_PMU_PHY_FAST_CFG_RCGR_ADDR A:0xfb21b0a4
y.create.l HWIO_WCSS_A_PMU_PHY_CMD_RCGR_ADDR A:0xfb21b0c0
y.create.l HWIO_WCSS_A_PMU_PHY_CFG_RCGR_ADDR A:0xfb21b0c4
y.create.l HWIO_WCSS_A_PMU_PHY_M_ADDR A:0xfb21b0c8
y.create.l HWIO_WCSS_A_PMU_PHY_N_ADDR A:0xfb21b0cc
y.create.l HWIO_WCSS_A_PMU_PHY_D_ADDR A:0xfb21b0d0
y.create.l HWIO_WCSS_A_PMU_ADCDAC_CMD_RCGR_ADDR A:0xfb21b0e0
y.create.l HWIO_WCSS_A_PMU_ADCDAC_CFG_RCGR_ADDR A:0xfb21b0e4
y.create.l HWIO_WCSS_A_PMU_ADCDAC_M_ADDR A:0xfb21b0e8
y.create.l HWIO_WCSS_A_PMU_ADCDAC_N_ADDR A:0xfb21b0ec
y.create.l HWIO_WCSS_A_PMU_ADCDAC_D_ADDR A:0xfb21b0f0
y.create.l HWIO_WCSS_A_PMU_RFIF_CMD_RCGR_ADDR A:0xfb21b100
y.create.l HWIO_WCSS_A_PMU_RFIF_CFG_RCGR_ADDR A:0xfb21b104
y.create.l HWIO_WCSS_A_PMU_RFIF_M_ADDR A:0xfb21b108
y.create.l HWIO_WCSS_A_PMU_RFIF_N_ADDR A:0xfb21b10c
y.create.l HWIO_WCSS_A_PMU_RFIF_D_ADDR A:0xfb21b110
y.create.l HWIO_WCSS_A_PMU_CPU_AHB_CMD_RCGR_ADDR A:0xfb21b120
y.create.l HWIO_WCSS_A_PMU_CPU_AHB_CFG_RCGR_ADDR A:0xfb21b124
y.create.l HWIO_WCSS_A_PMU_CPU_AHB_MISC_ADDR A:0xfb21b134
y.create.l HWIO_WCSS_A_PMU_BT_32M_CMD_RCGR_ADDR A:0xfb21b140
y.create.l HWIO_WCSS_A_PMU_BT_32M_CFG_RCGR_ADDR A:0xfb21b144
y.create.l HWIO_WCSS_A_PMU_BT_FM_19M_CMD_RCGR_ADDR A:0xfb21b160
y.create.l HWIO_WCSS_A_PMU_BT_FM_19M_CFG_RCGR_ADDR A:0xfb21b164
y.create.l HWIO_WCSS_A_PMU_SLP_CMD_RCGR_ADDR A:0xfb21b180
y.create.l HWIO_WCSS_A_PMU_SLP_CFG_RCGR_ADDR A:0xfb21b184
y.create.l HWIO_WCSS_A_PMU_XO_CMD_RCGR_ADDR A:0xfb21b1a0
y.create.l HWIO_WCSS_A_PMU_XO_CFG_RCGR_ADDR A:0xfb21b1a4
y.create.l HWIO_WCSS_A_PMU_PLL_MODE_ADDR A:0xfb21b1c0
y.create.l HWIO_WCSS_A_PMU_PLL_L_VAL_ADDR A:0xfb21b1c4
y.create.l HWIO_WCSS_A_PMU_PLL_M_VAL_ADDR A:0xfb21b1c8
y.create.l HWIO_WCSS_A_PMU_PLL_N_VAL_ADDR A:0xfb21b1cc
y.create.l HWIO_WCSS_A_PMU_PLL_USER_CTL_ADDR A:0xfb21b1d0
y.create.l HWIO_WCSS_A_PMU_PLL_CONFIG_CTL_ADDR A:0xfb21b1d4
y.create.l HWIO_WCSS_A_PMU_PLL_TEST_CTL_ADDR A:0xfb21b1d8
y.create.l HWIO_WCSS_A_PMU_PLL_STATUS_ADDR A:0xfb21b1dc
y.create.l HWIO_WCSS_A_PMU_WCSS_DEBUG_CLK_CTL_ADDR A:0xfb21b1e0
y.create.l HWIO_WCSS_A_PMU_HW_VERSION_ADDR A:0xfb21c000
y.create.l HWIO_WCSS_A_PMU_CFG_ADDR A:0xfb21c004
y.create.l HWIO_WCSS_A_PMU_OVRD_EN_ADDR A:0xfb21c008
y.create.l HWIO_WCSS_A_PMU_OVRD_VAL_ADDR A:0xfb21c00c
y.create.l HWIO_WCSS_A_PMU_SLP_TMR_CTL_ADDR A:0xfb21c010
y.create.l HWIO_WCSS_A_PMU_SLP_TMR_STS_ADDR A:0xfb21c014
y.create.l HWIO_WCSS_A_PMU_SLP_TMR_VAL_WR_ADDR A:0xfb21c018
y.create.l HWIO_WCSS_A_PMU_SLP_TMR_VAL_ADDR A:0xfb21c01c
y.create.l HWIO_WCSS_A_PMU_WLAN_SLP_TMR_CTL_ADDR A:0xfb21c020
y.create.l HWIO_WCSS_A_PMU_WLAN_SLP_TMR_STS_ADDR A:0xfb21c024
y.create.l HWIO_WCSS_A_PMU_WLAN_SLP_TMR_EXP_ADDR A:0xfb21c028
y.create.l HWIO_WCSS_A_PMU_BT_SLP_TMR_CTL_ADDR A:0xfb21c02c
y.create.l HWIO_WCSS_A_PMU_BT_SLP_TMR_STS_ADDR A:0xfb21c030
y.create.l HWIO_WCSS_A_PMU_BT_SLP_TMR_EXP_ADDR A:0xfb21c034
y.create.l HWIO_WCSS_A_PMU_PWR_CNTL_ADCDAC_ADDR A:0xfb21c038
y.create.l HWIO_WCSS_A_PMU_WMAC_CSR_ADDR A:0xfb21c03c
y.create.l HWIO_WCSS_A_PMU_COMMON_CSR_ADDR A:0xfb21c040
y.create.l HWIO_WCSS_A_PMU_ROOT_CLK_ENABLE_ADDR A:0xfb21c044
y.create.l HWIO_WCSS_A_PMU_CLKGATE_DISABLE_ADDR A:0xfb21c048
y.create.l HWIO_WCSS_A_PMU_SOFT_RESET_ADDR A:0xfb21c04c
y.create.l HWIO_WCSS_A_PMU_PMU_TESTBUS_CTL_ADDR A:0xfb21c050
y.create.l HWIO_WCSS_A_PMU_PMU_TESTBUS_STS_ADDR A:0xfb21c054
y.create.l HWIO_WCSS_A_PMU_TESTBUS_CTL_ADDR A:0xfb21c058
y.create.l HWIO_WCSS_A_PMU_TESTBUS_STS_ADDR A:0xfb21c05c
y.create.l HWIO_WCSS_A_PMU_WLAN_POWER_MEASURE_ADDR A:0xfb21c060
y.create.l HWIO_WCSS_A_PMU_WCSS_IPC_ADDR A:0xfb21c064
y.create.l HWIO_WCSS_A_PMU_WDOG_CTL_ADDR A:0xfb21c068
y.create.l HWIO_WCSS_A_PMU_WDOG_STS_ADDR A:0xfb21c06c
y.create.l HWIO_WCSS_A_PMU_WDOG_COUNT_ADDR A:0xfb21c070
y.create.l HWIO_WCSS_A_PMU_WDOG_BITE_SECURE_ADDR A:0xfb21c074
y.create.l HWIO_WCSS_A_PMU_WDOG_BARK_TIME_ADDR A:0xfb21c078
y.create.l HWIO_WCSS_A_PMU_WDOG_BITE_TIME_ADDR A:0xfb21c07c
y.create.l HWIO_WCSS_A_PMU_WDOG_TEST_ADDR A:0xfb21c080
y.create.l HWIO_WCSS_A_PMU_SPARE_IN_ADDR A:0xfb21c084
y.create.l HWIO_WCSS_A_PMU_SPARE_OUT_ADDR A:0xfb21c088
y.create.l HWIO_WCSS_A_PMU_AOA2AB_CTL_ADDR A:0xfb21c08c
y.create.l HWIO_WCSS_A_PMU_AOA2AB_WRAP_ADDR_ADDR A:0xfb21c090
y.create.l HWIO_WCSS_A_PMU_AOA2AB_AHB_ERR_ADDR_ADDR A:0xfb21c094
y.create.l HWIO_WCSS_A_PMU_SPM_DBG_ADDR A:0xfb21c098
y.create.l HWIO_WCSS_A_PMU_DAC_CAL_CTL_ADDR A:0xfb21c09c
y.create.l HWIO_WCSS_A_PMU_BT_SW_EVENT_ADDR A:0xfb21c0a0
y.create.l HWIO_WCSS_A_PMU_HW_EVENT_CTL_0_ADDR A:0xfb21c0a4
y.create.l HWIO_WCSS_A_PMU_HW_EVENT_CTL_1_ADDR A:0xfb21c0a8
y.create.l HWIO_WCSS_A_PMU_HW_EVENT_CTL_2_ADDR A:0xfb21c0ac
y.create.l HWIO_WCSS_A_PMU_HW_EVENT_CTL_3_ADDR A:0xfb21c0b0
y.create.l HWIO_WCSS_A_PMU_HW_EVENT_CTL_4_ADDR A:0xfb21c0b4
y.create.l HWIO_WCSS_A_PMU_HW_EVENT_CTL_5_ADDR A:0xfb21c0b8
y.create.l HWIO_WCSS_A_PMU_HW_EVENT_CTL_6_ADDR A:0xfb21c0bc
y.create.l HWIO_WCSS_A_PMU_HW_EVENT_CTL_7_ADDR A:0xfb21c0c0
y.create.l HWIO_WCSS_A_PMU_HW_EVENT_CTL_8_ADDR A:0xfb21c0c4
y.create.l HWIO_WCSS_A_PMU_HW_EVENT_CTL_9_ADDR A:0xfb21c0c8
y.create.l HWIO_WCSS_A_PMU_HW_EVENT_CTL_10_ADDR A:0xfb21c0cc
y.create.l HWIO_WCSS_A_PMU_HW_EVENT_CTL_11_ADDR A:0xfb21c0d0
y.create.l HWIO_WCSS_A_PMU_HW_EVENT_CTL_12_ADDR A:0xfb21c0d4
y.create.l HWIO_WCSS_A_PMU_HW_EVENT_CTL_13_ADDR A:0xfb21c0d8
y.create.l HWIO_WCSS_A_PMU_HW_EVENT_CTL_14_ADDR A:0xfb21c0dc
y.create.l HWIO_WCSS_A_PMU_HW_EVENT_CTL_15_ADDR A:0xfb21c0e0
y.create.l HWIO_WCSS_A_PMU_HW_EVENT_CTL_16_ADDR A:0xfb21c0e4
y.create.l HWIO_WCSS_A_PMU_HW_EVENT_CTL_17_ADDR A:0xfb21c0e8
y.create.l HWIO_WCSS_A_PMU_HW_EVENT_CTL_18_ADDR A:0xfb21c0ec
y.create.l HWIO_WCSS_A_PMU_HW_EVENT_CTL_19_ADDR A:0xfb21c0f0
y.create.l HWIO_WCSS_A_PMU_HW_EVENT_CTL_20_ADDR A:0xfb21c0f4
y.create.l HWIO_WCSS_A_PMU_HW_EVENT_CTL_21_ADDR A:0xfb21c0f8
y.create.l HWIO_WCSS_A_PMU_HW_EVENT_CTL_22_ADDR A:0xfb21c0fc
y.create.l HWIO_WCSS_A_PMU_HW_EVENT_CTL_23_ADDR A:0xfb21c100
y.create.l HWIO_WCSS_A_PMU_HW_EVENT_CTL_24_ADDR A:0xfb21c104
y.create.l HWIO_WCSS_A_PMU_HW_EVENT_CTL_25_ADDR A:0xfb21c108
y.create.l HWIO_WCSS_A_PMU_HW_EVENT_CTL_26_ADDR A:0xfb21c10c
y.create.l HWIO_WCSS_A_PMU_HW_EVENT_CTL_27_ADDR A:0xfb21c110
y.create.l HWIO_WCSS_A_PMU_HW_EVENT_CTL_28_ADDR A:0xfb21c114
y.create.l HWIO_WCSS_A_PMU_HW_EVENT_CTL_29_ADDR A:0xfb21c118
y.create.l HWIO_WCSS_A_PMU_HW_EVENT_CTL_30_ADDR A:0xfb21c11c
y.create.l HWIO_WCSS_A_PMU_HW_EVENT_CTL_31_ADDR A:0xfb21c120
y.create.l HWIO_WCSS_A_PMU_IRIS_XO_SETTLE_TIME_ADDR A:0xfb21c124
y.create.l HWIO_WCSS_A_PMU_IRIS_XO_SETTLE_TIMER_CSR_ADDR A:0xfb21c128
y.create.l HWIO_WCSS_A_PMU_IRIS_XO_TIMER_ADDR A:0xfb21c12c
y.create.l HWIO_WCSS_A_PMU_COMMON_SS_MEM_SLP_CTL_ADDR A:0xfb21c130
y.create.l HWIO_WCSS_A_PMU_IRIS_REG_READ_ADDR A:0xfb21c134
y.create.l HWIO_WCSS_A_PMU_CCPU_CTL_ADDR A:0xfb21d000
y.create.l HWIO_WCSS_A_PMU_CCPU_BOOT_REMAP_ADDR_ADDR A:0xfb21d004
y.create.l HWIO_WCSS_A_AOAHB_AOAHB_AOWBR_PL_ADDR A:0xfb21a000
y.create.l HWIO_WCSS_A_AOAHB_AOAHB_AOA2AB_PL_ADDR A:0xfb21a004
y.create.l HWIO_WCSS_A_AOAHB_AOAHB_DFLT_MST_ADDR A:0xfb21a048
y.create.l HWIO_WCSS_A_AOAHB_AOAHB_VERSION_ADDR A:0xfb21a090
y.create.l HWIO_WCSS_A_SAW2_SAW2_SECURE_ADDR A:0xfb219000
y.create.l HWIO_WCSS_A_SAW2_SAW2_ID_ADDR A:0xfb219004
y.create.l HWIO_WCSS_A_SAW2_SAW2_CFG_ADDR A:0xfb219008
y.create.l HWIO_WCSS_A_SAW2_SAW2_SPM_STS_ADDR A:0xfb21900c
y.create.l HWIO_WCSS_A_SAW2_SAW2_AVS_STS_ADDR A:0xfb219010
y.create.l HWIO_WCSS_A_SAW2_SAW2_PMIC_STS_ADDR A:0xfb219014
y.create.l HWIO_WCSS_A_SAW2_SAW2_RST_ADDR A:0xfb219018
y.create.l HWIO_WCSS_A_SAW2_SAW2_SPM_CTL_ADDR A:0xfb219030
y.create.l HWIO_WCSS_A_SAW2_SAW2_SPM_DLY_ADDR A:0xfb219034
y.create.l HWIO_WCSS_A_SAW2_SAW2_SPM_SLP_SEQ_ENTRY_0_ADDR A:0xfb219080
y.create.l HWIO_WCSS_A_SAW2_SAW2_SPM_SLP_SEQ_ENTRY_1_ADDR A:0xfb219084
y.create.l HWIO_WCSS_A_SAW2_SAW2_SPM_SLP_SEQ_ENTRY_2_ADDR A:0xfb219088
y.create.l HWIO_WCSS_A_SAW2_SAW2_SPM_SLP_SEQ_ENTRY_3_ADDR A:0xfb21908c
y.create.l HWIO_WCSS_A_SAW2_SAW2_SPM_SLP_SEQ_ENTRY_4_ADDR A:0xfb219090
y.create.l HWIO_WCSS_A_SAW2_SAW2_SPM_SLP_SEQ_ENTRY_5_ADDR A:0xfb219094
y.create.l HWIO_WCSS_A_SAW2_SAW2_SPM_SLP_SEQ_ENTRY_6_ADDR A:0xfb219098
y.create.l HWIO_WCSS_A_SAW2_SAW2_SPM_SLP_SEQ_ENTRY_7_ADDR A:0xfb21909c
y.create.l HWIO_WCSS_A_SAW2_SAW2_SPM_SLP_SEQ_ENTRY_8_ADDR A:0xfb2190a0
y.create.l HWIO_WCSS_A_SAW2_SAW2_SPM_SLP_SEQ_ENTRY_9_ADDR A:0xfb2190a4
y.create.l HWIO_WCSS_A_SAW2_SAW2_VERSION_ADDR A:0xfb219fd0
y.create.l HWIO_WCSS_A_QTMR_AC_QTMR_AC_CNTFRQ_ADDR A:0xfb211000
y.create.l HWIO_WCSS_A_QTMR_AC_QTMR_AC_CNTSR_ADDR A:0xfb211004
y.create.l HWIO_WCSS_A_QTMR_AC_QTMR_AC_CNTTID_ADDR A:0xfb211008
y.create.l HWIO_WCSS_A_QTMR_AC_QTMR_AC_CNTACR_0_ADDR A:0xfb211040
y.create.l HWIO_WCSS_A_QTMR_AC_QTMR_AC_CNTACR_1_ADDR A:0xfb211044
y.create.l HWIO_WCSS_A_QTMR_AC_QTMR_AC_CNTACR_2_ADDR A:0xfb211048
y.create.l HWIO_WCSS_A_QTMR_AC_QTMR_AC_CNTACR_3_ADDR A:0xfb21104c
y.create.l HWIO_WCSS_A_QTMR_AC_QTMR_AC_CNTACR_4_ADDR A:0xfb211050
y.create.l HWIO_WCSS_A_QTMR_AC_QTMR_AC_CNTVOFF_LO_0_ADDR A:0xfb211080
y.create.l HWIO_WCSS_A_QTMR_AC_QTMR_AC_CNTVOFF_LO_1_ADDR A:0xfb211088
y.create.l HWIO_WCSS_A_QTMR_AC_QTMR_AC_CNTVOFF_LO_2_ADDR A:0xfb211090
y.create.l HWIO_WCSS_A_QTMR_AC_QTMR_AC_CNTVOFF_LO_3_ADDR A:0xfb211098
y.create.l HWIO_WCSS_A_QTMR_AC_QTMR_AC_CNTVOFF_LO_4_ADDR A:0xfb2110a0
y.create.l HWIO_WCSS_A_QTMR_AC_QTMR_AC_CNTVOFF_HI_0_ADDR A:0xfb211084
y.create.l HWIO_WCSS_A_QTMR_AC_QTMR_AC_CNTVOFF_HI_1_ADDR A:0xfb21108c
y.create.l HWIO_WCSS_A_QTMR_AC_QTMR_AC_CNTVOFF_HI_2_ADDR A:0xfb211094
y.create.l HWIO_WCSS_A_QTMR_AC_QTMR_AC_CNTVOFF_HI_3_ADDR A:0xfb21109c
y.create.l HWIO_WCSS_A_QTMR_AC_QTMR_AC_CNTVOFF_HI_4_ADDR A:0xfb2110a4
y.create.l HWIO_WCSS_A_QTMR_AC_QTMR_AC_CFG_ADDR A:0xfb211fc0
y.create.l HWIO_WCSS_A_QTMR_AC_QTMR_AC_VERSION_ADDR A:0xfb211fd0
y.create.l HWIO_WCSS_A_QTMR_V1_T0_QTMR_V1_CNTPCT_LO_ADDR A:0xfb212000
y.create.l HWIO_WCSS_A_QTMR_V1_T0_QTMR_V1_CNTPCT_HI_ADDR A:0xfb212004
y.create.l HWIO_WCSS_A_QTMR_V1_T0_QTMR_V1_CNTVCT_LO_ADDR A:0xfb212008
y.create.l HWIO_WCSS_A_QTMR_V1_T0_QTMR_V1_CNTVCT_HI_ADDR A:0xfb21200c
y.create.l HWIO_WCSS_A_QTMR_V1_T0_QTMR_V1_CNTFRQ_ADDR A:0xfb212010
y.create.l HWIO_WCSS_A_QTMR_V1_T0_QTMR_V1_CNTPL0ACR_ADDR A:0xfb212014
y.create.l HWIO_WCSS_A_QTMR_V1_T0_QTMR_V1_CNTVOFF_LO_ADDR A:0xfb212018
y.create.l HWIO_WCSS_A_QTMR_V1_T0_QTMR_V1_CNTVOFF_HI_ADDR A:0xfb21201c
y.create.l HWIO_WCSS_A_QTMR_V1_T0_QTMR_V1_CNTP_CVAL_LO_ADDR A:0xfb212020
y.create.l HWIO_WCSS_A_QTMR_V1_T0_QTMR_V1_CNTP_CVAL_HI_ADDR A:0xfb212024
y.create.l HWIO_WCSS_A_QTMR_V1_T0_QTMR_V1_CNTP_TVAL_ADDR A:0xfb212028
y.create.l HWIO_WCSS_A_QTMR_V1_T0_QTMR_V1_CNTP_CTL_ADDR A:0xfb21202c
y.create.l HWIO_WCSS_A_QTMR_V1_T0_QTMR_V1_CNTV_CVAL_LO_ADDR A:0xfb212030
y.create.l HWIO_WCSS_A_QTMR_V1_T0_QTMR_V1_CNTV_CVAL_HI_ADDR A:0xfb212034
y.create.l HWIO_WCSS_A_QTMR_V1_T0_QTMR_V1_CNTV_TVAL_ADDR A:0xfb212038
y.create.l HWIO_WCSS_A_QTMR_V1_T0_QTMR_V1_CNTV_CTL_ADDR A:0xfb21203c
y.create.l HWIO_WCSS_A_QTMR_V1_T0_QTMR_V1_VERSION_ADDR A:0xfb212fd0
y.create.l HWIO_WCSS_A_QTMR_V1_T1_QTMR_V1_CNTPCT_LO_ADDR A:0xfb213000
y.create.l HWIO_WCSS_A_QTMR_V1_T1_QTMR_V1_CNTPCT_HI_ADDR A:0xfb213004
y.create.l HWIO_WCSS_A_QTMR_V1_T1_QTMR_V1_CNTVCT_LO_ADDR A:0xfb213008
y.create.l HWIO_WCSS_A_QTMR_V1_T1_QTMR_V1_CNTVCT_HI_ADDR A:0xfb21300c
y.create.l HWIO_WCSS_A_QTMR_V1_T1_QTMR_V1_CNTFRQ_ADDR A:0xfb213010
y.create.l HWIO_WCSS_A_QTMR_V1_T1_QTMR_V1_CNTPL0ACR_ADDR A:0xfb213014
y.create.l HWIO_WCSS_A_QTMR_V1_T1_QTMR_V1_CNTVOFF_LO_ADDR A:0xfb213018
y.create.l HWIO_WCSS_A_QTMR_V1_T1_QTMR_V1_CNTVOFF_HI_ADDR A:0xfb21301c
y.create.l HWIO_WCSS_A_QTMR_V1_T1_QTMR_V1_CNTP_CVAL_LO_ADDR A:0xfb213020
y.create.l HWIO_WCSS_A_QTMR_V1_T1_QTMR_V1_CNTP_CVAL_HI_ADDR A:0xfb213024
y.create.l HWIO_WCSS_A_QTMR_V1_T1_QTMR_V1_CNTP_TVAL_ADDR A:0xfb213028
y.create.l HWIO_WCSS_A_QTMR_V1_T1_QTMR_V1_CNTP_CTL_ADDR A:0xfb21302c
y.create.l HWIO_WCSS_A_QTMR_V1_T1_QTMR_V1_CNTV_CVAL_LO_ADDR A:0xfb213030
y.create.l HWIO_WCSS_A_QTMR_V1_T1_QTMR_V1_CNTV_CVAL_HI_ADDR A:0xfb213034
y.create.l HWIO_WCSS_A_QTMR_V1_T1_QTMR_V1_CNTV_TVAL_ADDR A:0xfb213038
y.create.l HWIO_WCSS_A_QTMR_V1_T1_QTMR_V1_CNTV_CTL_ADDR A:0xfb21303c
y.create.l HWIO_WCSS_A_QTMR_V1_T1_QTMR_V1_VERSION_ADDR A:0xfb213fd0
y.create.l HWIO_WCSS_A_QTMR_V1_T2_QTMR_V1_CNTPCT_LO_ADDR A:0xfb214000
y.create.l HWIO_WCSS_A_QTMR_V1_T2_QTMR_V1_CNTPCT_HI_ADDR A:0xfb214004
y.create.l HWIO_WCSS_A_QTMR_V1_T2_QTMR_V1_CNTVCT_LO_ADDR A:0xfb214008
y.create.l HWIO_WCSS_A_QTMR_V1_T2_QTMR_V1_CNTVCT_HI_ADDR A:0xfb21400c
y.create.l HWIO_WCSS_A_QTMR_V1_T2_QTMR_V1_CNTFRQ_ADDR A:0xfb214010
y.create.l HWIO_WCSS_A_QTMR_V1_T2_QTMR_V1_CNTPL0ACR_ADDR A:0xfb214014
y.create.l HWIO_WCSS_A_QTMR_V1_T2_QTMR_V1_CNTVOFF_LO_ADDR A:0xfb214018
y.create.l HWIO_WCSS_A_QTMR_V1_T2_QTMR_V1_CNTVOFF_HI_ADDR A:0xfb21401c
y.create.l HWIO_WCSS_A_QTMR_V1_T2_QTMR_V1_CNTP_CVAL_LO_ADDR A:0xfb214020
y.create.l HWIO_WCSS_A_QTMR_V1_T2_QTMR_V1_CNTP_CVAL_HI_ADDR A:0xfb214024
y.create.l HWIO_WCSS_A_QTMR_V1_T2_QTMR_V1_CNTP_TVAL_ADDR A:0xfb214028
y.create.l HWIO_WCSS_A_QTMR_V1_T2_QTMR_V1_CNTP_CTL_ADDR A:0xfb21402c
y.create.l HWIO_WCSS_A_QTMR_V1_T2_QTMR_V1_CNTV_CVAL_LO_ADDR A:0xfb214030
y.create.l HWIO_WCSS_A_QTMR_V1_T2_QTMR_V1_CNTV_CVAL_HI_ADDR A:0xfb214034
y.create.l HWIO_WCSS_A_QTMR_V1_T2_QTMR_V1_CNTV_TVAL_ADDR A:0xfb214038
y.create.l HWIO_WCSS_A_QTMR_V1_T2_QTMR_V1_CNTV_CTL_ADDR A:0xfb21403c
y.create.l HWIO_WCSS_A_QTMR_V1_T2_QTMR_V1_VERSION_ADDR A:0xfb214fd0
y.create.l HWIO_WCSS_A_QTMR_V1_T3_QTMR_V1_CNTPCT_LO_ADDR A:0xfb215000
y.create.l HWIO_WCSS_A_QTMR_V1_T3_QTMR_V1_CNTPCT_HI_ADDR A:0xfb215004
y.create.l HWIO_WCSS_A_QTMR_V1_T3_QTMR_V1_CNTVCT_LO_ADDR A:0xfb215008
y.create.l HWIO_WCSS_A_QTMR_V1_T3_QTMR_V1_CNTVCT_HI_ADDR A:0xfb21500c
y.create.l HWIO_WCSS_A_QTMR_V1_T3_QTMR_V1_CNTFRQ_ADDR A:0xfb215010
y.create.l HWIO_WCSS_A_QTMR_V1_T3_QTMR_V1_CNTPL0ACR_ADDR A:0xfb215014
y.create.l HWIO_WCSS_A_QTMR_V1_T3_QTMR_V1_CNTVOFF_LO_ADDR A:0xfb215018
y.create.l HWIO_WCSS_A_QTMR_V1_T3_QTMR_V1_CNTVOFF_HI_ADDR A:0xfb21501c
y.create.l HWIO_WCSS_A_QTMR_V1_T3_QTMR_V1_CNTP_CVAL_LO_ADDR A:0xfb215020
y.create.l HWIO_WCSS_A_QTMR_V1_T3_QTMR_V1_CNTP_CVAL_HI_ADDR A:0xfb215024
y.create.l HWIO_WCSS_A_QTMR_V1_T3_QTMR_V1_CNTP_TVAL_ADDR A:0xfb215028
y.create.l HWIO_WCSS_A_QTMR_V1_T3_QTMR_V1_CNTP_CTL_ADDR A:0xfb21502c
y.create.l HWIO_WCSS_A_QTMR_V1_T3_QTMR_V1_CNTV_CVAL_LO_ADDR A:0xfb215030
y.create.l HWIO_WCSS_A_QTMR_V1_T3_QTMR_V1_CNTV_CVAL_HI_ADDR A:0xfb215034
y.create.l HWIO_WCSS_A_QTMR_V1_T3_QTMR_V1_CNTV_TVAL_ADDR A:0xfb215038
y.create.l HWIO_WCSS_A_QTMR_V1_T3_QTMR_V1_CNTV_CTL_ADDR A:0xfb21503c
y.create.l HWIO_WCSS_A_QTMR_V1_T3_QTMR_V1_VERSION_ADDR A:0xfb215fd0
y.create.l HWIO_WCSS_A_QTMR_V1_T4_QTMR_V1_CNTPCT_LO_ADDR A:0xfb216000
y.create.l HWIO_WCSS_A_QTMR_V1_T4_QTMR_V1_CNTPCT_HI_ADDR A:0xfb216004
y.create.l HWIO_WCSS_A_QTMR_V1_T4_QTMR_V1_CNTVCT_LO_ADDR A:0xfb216008
y.create.l HWIO_WCSS_A_QTMR_V1_T4_QTMR_V1_CNTVCT_HI_ADDR A:0xfb21600c
y.create.l HWIO_WCSS_A_QTMR_V1_T4_QTMR_V1_CNTFRQ_ADDR A:0xfb216010
y.create.l HWIO_WCSS_A_QTMR_V1_T4_QTMR_V1_CNTPL0ACR_ADDR A:0xfb216014
y.create.l HWIO_WCSS_A_QTMR_V1_T4_QTMR_V1_CNTVOFF_LO_ADDR A:0xfb216018
y.create.l HWIO_WCSS_A_QTMR_V1_T4_QTMR_V1_CNTVOFF_HI_ADDR A:0xfb21601c
y.create.l HWIO_WCSS_A_QTMR_V1_T4_QTMR_V1_CNTP_CVAL_LO_ADDR A:0xfb216020
y.create.l HWIO_WCSS_A_QTMR_V1_T4_QTMR_V1_CNTP_CVAL_HI_ADDR A:0xfb216024
y.create.l HWIO_WCSS_A_QTMR_V1_T4_QTMR_V1_CNTP_TVAL_ADDR A:0xfb216028
y.create.l HWIO_WCSS_A_QTMR_V1_T4_QTMR_V1_CNTP_CTL_ADDR A:0xfb21602c
y.create.l HWIO_WCSS_A_QTMR_V1_T4_QTMR_V1_CNTV_CVAL_LO_ADDR A:0xfb216030
y.create.l HWIO_WCSS_A_QTMR_V1_T4_QTMR_V1_CNTV_CVAL_HI_ADDR A:0xfb216034
y.create.l HWIO_WCSS_A_QTMR_V1_T4_QTMR_V1_CNTV_TVAL_ADDR A:0xfb216038
y.create.l HWIO_WCSS_A_QTMR_V1_T4_QTMR_V1_CNTV_CTL_ADDR A:0xfb21603c
y.create.l HWIO_WCSS_A_QTMR_V1_T4_QTMR_V1_VERSION_ADDR A:0xfb216fd0
y.create.l HWIO_WCSS_A_QGIC2_GICD_CTLR_ADDR A:0xfb20a000
y.create.l HWIO_WCSS_A_QGIC2_GICD_TYPER_ADDR A:0xfb20a004
y.create.l HWIO_WCSS_A_QGIC2_GICD_IIDR_ADDR A:0xfb20a008
y.create.l HWIO_WCSS_A_QGIC2_GICD_ANSACR_ADDR A:0xfb20a020
y.create.l HWIO_WCSS_A_QGIC2_GICD_CGCR_ADDR A:0xfb20a024
y.create.l HWIO_WCSS_A_QGIC2_GICD_HW_VERSION_ADDR A:0xfb20a030
y.create.l HWIO_WCSS_A_QGIC2_GICD_ISR0_ADDR A:0xfb20a080
y.create.l HWIO_WCSS_A_QGIC2_GICD_ISR1_ADDR A:0xfb20a084
y.create.l HWIO_WCSS_A_QGIC2_GICD_ISR2_ADDR A:0xfb20a088
y.create.l HWIO_WCSS_A_QGIC2_GICD_ISR3_ADDR A:0xfb20a08c
y.create.l HWIO_WCSS_A_QGIC2_GICD_ISR4_ADDR A:0xfb20a090
y.create.l HWIO_WCSS_A_QGIC2_GICD_ISR5_ADDR A:0xfb20a094
y.create.l HWIO_WCSS_A_QGIC2_GICD_ISR6_ADDR A:0xfb20a098
y.create.l HWIO_WCSS_A_QGIC2_GICD_ISR7_ADDR A:0xfb20a09c
y.create.l HWIO_WCSS_A_QGIC2_GICD_ISR8_ADDR A:0xfb20a0a0
y.create.l HWIO_WCSS_A_QGIC2_GICD_ISENABLER0_ADDR A:0xfb20a100
y.create.l HWIO_WCSS_A_QGIC2_GICD_ISENABLER1_ADDR A:0xfb20a104
y.create.l HWIO_WCSS_A_QGIC2_GICD_ISENABLER2_ADDR A:0xfb20a108
y.create.l HWIO_WCSS_A_QGIC2_GICD_ISENABLER3_ADDR A:0xfb20a10c
y.create.l HWIO_WCSS_A_QGIC2_GICD_ISENABLER4_ADDR A:0xfb20a110
y.create.l HWIO_WCSS_A_QGIC2_GICD_ISENABLER5_ADDR A:0xfb20a114
y.create.l HWIO_WCSS_A_QGIC2_GICD_ISENABLER6_ADDR A:0xfb20a118
y.create.l HWIO_WCSS_A_QGIC2_GICD_ISENABLER7_ADDR A:0xfb20a11c
y.create.l HWIO_WCSS_A_QGIC2_GICD_ISENABLER8_ADDR A:0xfb20a120
y.create.l HWIO_WCSS_A_QGIC2_GICD_ICENABLER0_ADDR A:0xfb20a180
y.create.l HWIO_WCSS_A_QGIC2_GICD_ICENABLER1_ADDR A:0xfb20a184
y.create.l HWIO_WCSS_A_QGIC2_GICD_ICENABLER2_ADDR A:0xfb20a188
y.create.l HWIO_WCSS_A_QGIC2_GICD_ICENABLER3_ADDR A:0xfb20a18c
y.create.l HWIO_WCSS_A_QGIC2_GICD_ICENABLER4_ADDR A:0xfb20a190
y.create.l HWIO_WCSS_A_QGIC2_GICD_ICENABLER5_ADDR A:0xfb20a194
y.create.l HWIO_WCSS_A_QGIC2_GICD_ICENABLER6_ADDR A:0xfb20a198
y.create.l HWIO_WCSS_A_QGIC2_GICD_ICENABLER7_ADDR A:0xfb20a19c
y.create.l HWIO_WCSS_A_QGIC2_GICD_ICENABLER8_ADDR A:0xfb20a1a0
y.create.l HWIO_WCSS_A_QGIC2_GICD_ISPENDR0_ADDR A:0xfb20a200
y.create.l HWIO_WCSS_A_QGIC2_GICD_ISPENDR1_ADDR A:0xfb20a204
y.create.l HWIO_WCSS_A_QGIC2_GICD_ISPENDR2_ADDR A:0xfb20a208
y.create.l HWIO_WCSS_A_QGIC2_GICD_ISPENDR3_ADDR A:0xfb20a20c
y.create.l HWIO_WCSS_A_QGIC2_GICD_ISPENDR4_ADDR A:0xfb20a210
y.create.l HWIO_WCSS_A_QGIC2_GICD_ISPENDR5_ADDR A:0xfb20a214
y.create.l HWIO_WCSS_A_QGIC2_GICD_ISPENDR6_ADDR A:0xfb20a218
y.create.l HWIO_WCSS_A_QGIC2_GICD_ISPENDR7_ADDR A:0xfb20a21c
y.create.l HWIO_WCSS_A_QGIC2_GICD_ISPENDR8_ADDR A:0xfb20a220
y.create.l HWIO_WCSS_A_QGIC2_GICD_ICPENDR0_ADDR A:0xfb20a280
y.create.l HWIO_WCSS_A_QGIC2_GICD_ICPENDR1_ADDR A:0xfb20a284
y.create.l HWIO_WCSS_A_QGIC2_GICD_ICPENDR2_ADDR A:0xfb20a288
y.create.l HWIO_WCSS_A_QGIC2_GICD_ICPENDR3_ADDR A:0xfb20a28c
y.create.l HWIO_WCSS_A_QGIC2_GICD_ICPENDR4_ADDR A:0xfb20a290
y.create.l HWIO_WCSS_A_QGIC2_GICD_ICPENDR5_ADDR A:0xfb20a294
y.create.l HWIO_WCSS_A_QGIC2_GICD_ICPENDR6_ADDR A:0xfb20a298
y.create.l HWIO_WCSS_A_QGIC2_GICD_ICPENDR7_ADDR A:0xfb20a29c
y.create.l HWIO_WCSS_A_QGIC2_GICD_ICPENDR8_ADDR A:0xfb20a2a0
y.create.l HWIO_WCSS_A_QGIC2_GICD_ISACTIVER0_ADDR A:0xfb20a300
y.create.l HWIO_WCSS_A_QGIC2_GICD_ISACTIVER1_ADDR A:0xfb20a304
y.create.l HWIO_WCSS_A_QGIC2_GICD_ISACTIVER2_ADDR A:0xfb20a308
y.create.l HWIO_WCSS_A_QGIC2_GICD_ISACTIVER3_ADDR A:0xfb20a30c
y.create.l HWIO_WCSS_A_QGIC2_GICD_ISACTIVER4_ADDR A:0xfb20a310
y.create.l HWIO_WCSS_A_QGIC2_GICD_ISACTIVER5_ADDR A:0xfb20a314
y.create.l HWIO_WCSS_A_QGIC2_GICD_ISACTIVER6_ADDR A:0xfb20a318
y.create.l HWIO_WCSS_A_QGIC2_GICD_ISACTIVER7_ADDR A:0xfb20a31c
y.create.l HWIO_WCSS_A_QGIC2_GICD_ISACTIVER8_ADDR A:0xfb20a320
y.create.l HWIO_WCSS_A_QGIC2_GICD_ICACTIVER0_ADDR A:0xfb20a380
y.create.l HWIO_WCSS_A_QGIC2_GICD_ICACTIVER1_ADDR A:0xfb20a384
y.create.l HWIO_WCSS_A_QGIC2_GICD_ICACTIVER2_ADDR A:0xfb20a388
y.create.l HWIO_WCSS_A_QGIC2_GICD_ICACTIVER3_ADDR A:0xfb20a38c
y.create.l HWIO_WCSS_A_QGIC2_GICD_ICACTIVER4_ADDR A:0xfb20a390
y.create.l HWIO_WCSS_A_QGIC2_GICD_ICACTIVER5_ADDR A:0xfb20a394
y.create.l HWIO_WCSS_A_QGIC2_GICD_ICACTIVER6_ADDR A:0xfb20a398
y.create.l HWIO_WCSS_A_QGIC2_GICD_ICACTIVER7_ADDR A:0xfb20a39c
y.create.l HWIO_WCSS_A_QGIC2_GICD_ICACTIVER8_ADDR A:0xfb20a3a0
y.create.l HWIO_WCSS_A_QGIC2_GICD_IPRIORITYR0_ADDR A:0xfb20a400
y.create.l HWIO_WCSS_A_QGIC2_GICD_IPRIORITYR1_ADDR A:0xfb20a404
y.create.l HWIO_WCSS_A_QGIC2_GICD_IPRIORITYR2_ADDR A:0xfb20a408
y.create.l HWIO_WCSS_A_QGIC2_GICD_IPRIORITYR3_ADDR A:0xfb20a40c
y.create.l HWIO_WCSS_A_QGIC2_GICD_IPRIORITYR4_ADDR A:0xfb20a410
y.create.l HWIO_WCSS_A_QGIC2_GICD_IPRIORITYR5_ADDR A:0xfb20a414
y.create.l HWIO_WCSS_A_QGIC2_GICD_IPRIORITYR6_ADDR A:0xfb20a418
y.create.l HWIO_WCSS_A_QGIC2_GICD_IPRIORITYR7_ADDR A:0xfb20a41c
y.create.l HWIO_WCSS_A_QGIC2_GICD_IPRIORITYR8_ADDR A:0xfb20a420
y.create.l HWIO_WCSS_A_QGIC2_GICD_IPRIORITYR9_ADDR A:0xfb20a424
y.create.l HWIO_WCSS_A_QGIC2_GICD_ITARGETSR0_ADDR A:0xfb20a800
y.create.l HWIO_WCSS_A_QGIC2_GICD_ITARGETSR1_ADDR A:0xfb20a804
y.create.l HWIO_WCSS_A_QGIC2_GICD_ITARGETSR2_ADDR A:0xfb20a808
y.create.l HWIO_WCSS_A_QGIC2_GICD_ITARGETSR3_ADDR A:0xfb20a80c
y.create.l HWIO_WCSS_A_QGIC2_GICD_ITARGETSR4_ADDR A:0xfb20a810
y.create.l HWIO_WCSS_A_QGIC2_GICD_ITARGETSR5_ADDR A:0xfb20a814
y.create.l HWIO_WCSS_A_QGIC2_GICD_ITARGETSR6_ADDR A:0xfb20a818
y.create.l HWIO_WCSS_A_QGIC2_GICD_ITARGETSR7_ADDR A:0xfb20a81c
y.create.l HWIO_WCSS_A_QGIC2_GICD_ITARGETSR8_ADDR A:0xfb20a820
y.create.l HWIO_WCSS_A_QGIC2_GICD_ITARGETSR9_ADDR A:0xfb20a824
y.create.l HWIO_WCSS_A_QGIC2_GICD_ICFGR0_ADDR A:0xfb20ac00
y.create.l HWIO_WCSS_A_QGIC2_GICD_ICFGR1_ADDR A:0xfb20ac04
y.create.l HWIO_WCSS_A_QGIC2_GICD_ICFGR2_ADDR A:0xfb20ac08
y.create.l HWIO_WCSS_A_QGIC2_GICD_ICFGR3_ADDR A:0xfb20ac0c
y.create.l HWIO_WCSS_A_QGIC2_GICD_ICFGR4_ADDR A:0xfb20ac10
y.create.l HWIO_WCSS_A_QGIC2_GICD_ICFGR5_ADDR A:0xfb20ac14
y.create.l HWIO_WCSS_A_QGIC2_GICD_ICFGR6_ADDR A:0xfb20ac18
y.create.l HWIO_WCSS_A_QGIC2_GICD_ICFGR7_ADDR A:0xfb20ac1c
y.create.l HWIO_WCSS_A_QGIC2_GICD_ICFGR8_ADDR A:0xfb20ac20
y.create.l HWIO_WCSS_A_QGIC2_GICD_ICFGR9_ADDR A:0xfb20ac24
y.create.l HWIO_WCSS_A_QGIC2_GICD_SGIR_ADDR A:0xfb20af00
y.create.l HWIO_WCSS_A_QGIC2_GICD_CPENDSGIR0_ADDR A:0xfb20af10
y.create.l HWIO_WCSS_A_QGIC2_GICD_CPENDSGIR1_ADDR A:0xfb20af14
y.create.l HWIO_WCSS_A_QGIC2_GICD_CPENDSGIR2_ADDR A:0xfb20af18
y.create.l HWIO_WCSS_A_QGIC2_GICD_CPENDSGIR3_ADDR A:0xfb20af1c
y.create.l HWIO_WCSS_A_QGIC2_GICD_SPENDSGIR0_ADDR A:0xfb20af20
y.create.l HWIO_WCSS_A_QGIC2_GICD_SPENDSGIR1_ADDR A:0xfb20af24
y.create.l HWIO_WCSS_A_QGIC2_GICD_SPENDSGIR2_ADDR A:0xfb20af28
y.create.l HWIO_WCSS_A_QGIC2_GICD_SPENDSGIR3_ADDR A:0xfb20af2c
y.create.l HWIO_WCSS_A_QGIC2_GICD_PIDR0_ADDR A:0xfb20afd0
y.create.l HWIO_WCSS_A_QGIC2_GICD_PIDR1_ADDR A:0xfb20afd4
y.create.l HWIO_WCSS_A_QGIC2_GICD_PIDR2_ADDR A:0xfb20afd8
y.create.l HWIO_WCSS_A_QGIC2_GICD_PIDR3_ADDR A:0xfb20afdc
y.create.l HWIO_WCSS_A_QGIC2_GICD_PIDR4_ADDR A:0xfb20afe0
y.create.l HWIO_WCSS_A_QGIC2_GICD_PIDR5_ADDR A:0xfb20afe4
y.create.l HWIO_WCSS_A_QGIC2_GICD_PIDR6_ADDR A:0xfb20afe8
y.create.l HWIO_WCSS_A_QGIC2_GICD_PIDR7_ADDR A:0xfb20afec
y.create.l HWIO_WCSS_A_QGIC2_GICD_CIDR0_ADDR A:0xfb20aff0
y.create.l HWIO_WCSS_A_QGIC2_GICD_CIDR1_ADDR A:0xfb20aff4
y.create.l HWIO_WCSS_A_QGIC2_GICD_CIDR2_ADDR A:0xfb20aff8
y.create.l HWIO_WCSS_A_QGIC2_GICD_CIDR3_ADDR A:0xfb20affc
y.create.l HWIO_WCSS_A_QGIC2_GICH_HCR_ADDR A:0xfb20b000
y.create.l HWIO_WCSS_A_QGIC2_GICH_VTR_ADDR A:0xfb20b004
y.create.l HWIO_WCSS_A_QGIC2_GICH_VMCR_ADDR A:0xfb20b008
y.create.l HWIO_WCSS_A_QGIC2_GICH_MISR_ADDR A:0xfb20b010
y.create.l HWIO_WCSS_A_QGIC2_GICH_EISR_ADDR A:0xfb20b020
y.create.l HWIO_WCSS_A_QGIC2_GICH_ELRSR_ADDR A:0xfb20b030
y.create.l HWIO_WCSS_A_QGIC2_GICH_APR_ADDR A:0xfb20b0f0
y.create.l HWIO_WCSS_A_QGIC2_GICH_LR0_ADDR A:0xfb20b100
y.create.l HWIO_WCSS_A_QGIC2_GICH_LR1_ADDR A:0xfb20b104
y.create.l HWIO_WCSS_A_QGIC2_GICH_LR2_ADDR A:0xfb20b108
y.create.l HWIO_WCSS_A_QGIC2_GICH_LR3_ADDR A:0xfb20b10c
y.create.l HWIO_WCSS_A_QGIC2_GICH_SW_LR_ADDR A:0xfb20b120
y.create.l HWIO_WCSS_A_QGIC2_GICC_CTLR_ADDR A:0xfb20c000
y.create.l HWIO_WCSS_A_QGIC2_GICC_PMR_ADDR A:0xfb20c004
y.create.l HWIO_WCSS_A_QGIC2_GICC_BPR_ADDR A:0xfb20c008
y.create.l HWIO_WCSS_A_QGIC2_GICC_IAR_ADDR A:0xfb20c00c
y.create.l HWIO_WCSS_A_QGIC2_GICC_EOIR_ADDR A:0xfb20c010
y.create.l HWIO_WCSS_A_QGIC2_GICC_RPR_ADDR A:0xfb20c014
y.create.l HWIO_WCSS_A_QGIC2_GICC_HPPIR_ADDR A:0xfb20c018
y.create.l HWIO_WCSS_A_QGIC2_GICC_ABPR_ADDR A:0xfb20c01c
y.create.l HWIO_WCSS_A_QGIC2_GICC_AIAR_ADDR A:0xfb20c020
y.create.l HWIO_WCSS_A_QGIC2_GICC_AEOIR_ADDR A:0xfb20c024
y.create.l HWIO_WCSS_A_QGIC2_GICC_AHPPIR_ADDR A:0xfb20c028
y.create.l HWIO_WCSS_A_QGIC2_GICC_APR_ADDR A:0xfb20c0d0
y.create.l HWIO_WCSS_A_QGIC2_GICC_NSAPR_ADDR A:0xfb20c0e0
y.create.l HWIO_WCSS_A_QGIC2_GICC_IIDR_ADDR A:0xfb20c0fc
y.create.l HWIO_WCSS_A_QGIC2_GICC_DIR_ADDR A:0xfb20d000
y.create.l HWIO_WCSS_A_QGIC2_GICV_CTLR_ADDR A:0xfb20e000
y.create.l HWIO_WCSS_A_QGIC2_GICV_PMR_ADDR A:0xfb20e004
y.create.l HWIO_WCSS_A_QGIC2_GICV_BPR_ADDR A:0xfb20e008
y.create.l HWIO_WCSS_A_QGIC2_GICV_IAR_ADDR A:0xfb20e00c
y.create.l HWIO_WCSS_A_QGIC2_GICV_EOIR_ADDR A:0xfb20e010
y.create.l HWIO_WCSS_A_QGIC2_GICV_RPR_ADDR A:0xfb20e014
y.create.l HWIO_WCSS_A_QGIC2_GICV_HPPIR_ADDR A:0xfb20e018
y.create.l HWIO_WCSS_A_QGIC2_GICV_ABPR_ADDR A:0xfb20e01c
y.create.l HWIO_WCSS_A_QGIC2_GICV_AIAR_ADDR A:0xfb20e020
y.create.l HWIO_WCSS_A_QGIC2_GICV_AEOIR_ADDR A:0xfb20e024
y.create.l HWIO_WCSS_A_QGIC2_GICV_AHPPIR_ADDR A:0xfb20e028
y.create.l HWIO_WCSS_A_QGIC2_GICV_APR_ADDR A:0xfb20e0d0
y.create.l HWIO_WCSS_A_QGIC2_GICV_IIDR_ADDR A:0xfb20e0fc
y.create.l HWIO_WCSS_A_QGIC2_GICV_DIR_ADDR A:0xfb20f000
y.create.l HWIO_WCSS_A_LTE_CXM_CXM_WLAN_TX_GRANT_SEL_ADDR A:0xfb208000
y.create.l HWIO_WCSS_A_LTE_CXM_CXM_WLAN_RX_GRANT_SEL_ADDR A:0xfb208004
y.create.l HWIO_WCSS_A_LTE_CXM_CXM_WLAN_TX_RX_GRANT_EN_ADDR A:0xfb208008
y.create.l HWIO_WCSS_A_LTE_CXM_CXM_TIMER_COUNTER_ADDR A:0xfb20800c
y.create.l HWIO_WCSS_A_LTE_CXM_CXM_SW_CAPTURE_CLK_ADDR A:0xfb208014
y.create.l HWIO_WCSS_A_LTE_CXM_CXM_SW_CAPTURE_SEL_ADDR A:0xfb208018
y.create.l HWIO_WCSS_A_LTE_CXM_LTE_CXM_COUNTER_CAPTURED_ADDR A:0xfb20801c
y.create.l HWIO_WCSS_A_LTE_CXM_CXM_CP_INTERRUPT_CTRL_ADDR A:0xfb208020
y.create.l HWIO_WCSS_A_LTE_CXM_CXM_CP_INTERRUPT_MASK_N_ADDR A:0xfb208024
y.create.l HWIO_WCSS_A_LTE_CXM_CXM_CP_INTERRUPT_RESET_N_ADDR A:0xfb208028
y.create.l HWIO_WCSS_A_LTE_CXM_CXM_CP_INTERRUPT_STATUS_ADDR A:0xfb20802c
y.create.l HWIO_WCSS_A_LTE_CXM_CXM_WLAN_TX_GRANT_ENABLE1_ADDR A:0xfb208030
y.create.l HWIO_WCSS_A_LTE_CXM_CXM_WLAN_TX_GRANT_THRESHOLD1_ADDR A:0xfb208034
y.create.l HWIO_WCSS_A_LTE_CXM_CXM_WLAN_TX_GRANT_VALUE1_ADDR A:0xfb208038
y.create.l HWIO_WCSS_A_LTE_CXM_CXM_WLAN_TX_GRANT_ENABLE2_ADDR A:0xfb20803c
y.create.l HWIO_WCSS_A_LTE_CXM_CXM_WLAN_TX_GRANT_THRESHOLD2_ADDR A:0xfb208040
y.create.l HWIO_WCSS_A_LTE_CXM_CXM_WLAN_TX_GRANT_VALUE2_ADDR A:0xfb208044
y.create.l HWIO_WCSS_A_LTE_CXM_CXM_WLAN_RX_GRANT_ENABLE1_ADDR A:0xfb208048
y.create.l HWIO_WCSS_A_LTE_CXM_CXM_WLAN_RX_GRANT_THRESHOLD1_ADDR A:0xfb20804c
y.create.l HWIO_WCSS_A_LTE_CXM_CXM_WLAN_RX_GRANT_VALUE1_ADDR A:0xfb208050
y.create.l HWIO_WCSS_A_LTE_CXM_CXM_WLAN_RX_GRANT_ENABLE2_ADDR A:0xfb208054
y.create.l HWIO_WCSS_A_LTE_CXM_CXM_WLAN_RX_GRANT_THRESHOLD2_ADDR A:0xfb208058
y.create.l HWIO_WCSS_A_LTE_CXM_CXM_WLAN_RX_GRANT_VALUE2_ADDR A:0xfb20805c
y.create.l HWIO_WCSS_A_LTE_CXM_CXM_BT_TX_GRANT_ENABLE1_ADDR A:0xfb208060
y.create.l HWIO_WCSS_A_LTE_CXM_CXM_BT_TX_GRANT_THRESHOLD1_ADDR A:0xfb208064
y.create.l HWIO_WCSS_A_LTE_CXM_CXM_BT_TX_GRANT_VALUE1_ADDR A:0xfb208068
y.create.l HWIO_WCSS_A_LTE_CXM_CXM_BT_TX_GRANT_ENABLE2_ADDR A:0xfb20806c
y.create.l HWIO_WCSS_A_LTE_CXM_CXM_BT_TX_GRANT_THRESHOLD2_ADDR A:0xfb208070
y.create.l HWIO_WCSS_A_LTE_CXM_CXM_BT_TX_GRANT_VALUE2_ADDR A:0xfb208074
y.create.l HWIO_WCSS_A_LTE_CXM_CXM_BT_RX_GRANT_ENABLE1_ADDR A:0xfb208078
y.create.l HWIO_WCSS_A_LTE_CXM_CXM_BT_RX_GRANT_THRESHOLD1_ADDR A:0xfb20807c
y.create.l HWIO_WCSS_A_LTE_CXM_CXM_BT_RX_GRANT_VALUE1_ADDR A:0xfb208080
y.create.l HWIO_WCSS_A_LTE_CXM_CXM_BT_RX_GRANT_ENABLE2_ADDR A:0xfb208084
y.create.l HWIO_WCSS_A_LTE_CXM_CXM_BT_RX_GRANT_THRESHOLD2_ADDR A:0xfb208088
y.create.l HWIO_WCSS_A_LTE_CXM_CXM_BT_RX_GRANT_VALUE2_ADDR A:0xfb20808c
y.create.l HWIO_WCSS_A_LTE_CXM_CXM_BT_RX_TX_GRANT_SEL_ADDR A:0xfb208090
y.create.l HWIO_WCSS_A_LTE_CXM_CXM_BT_TX_RX_GRANT_EN_ADDR A:0xfb208094
y.create.l HWIO_WCSS_A_LTE_CXM_CXM_CP_INTERRUPT_STROBE_0_START_COUNT_ADDR A:0xfb208098
y.create.l HWIO_WCSS_A_LTE_CXM_CXM_CP_INTERRUPT_STROBE_1_START_COUNT_ADDR A:0xfb20809c
y.create.l HWIO_WCSS_A_LTE_CXM_CXM_CP_INTERRUPT_STROBE_2_START_COUNT_ADDR A:0xfb2080a0
y.create.l HWIO_WCSS_A_LTE_CXM_CXM_CP_INTERRUPT_STROBE_3_START_COUNT_ADDR A:0xfb2080a4
y.create.l HWIO_WCSS_A_LTE_CXM_CXM_CP_INTERRUPT_STROBE_0_PERIODICITY_ADDR A:0xfb2080a8
y.create.l HWIO_WCSS_A_LTE_CXM_CXM_CP_INTERRUPT_STROBE_1_PERIODICITY_ADDR A:0xfb2080ac
y.create.l HWIO_WCSS_A_LTE_CXM_CXM_CP_INTERRUPT_STROBE_2_PERIODICITY_ADDR A:0xfb2080b0
y.create.l HWIO_WCSS_A_LTE_CXM_CXM_CP_INTERRUPT_STROBE_3_PERIODICITY_ADDR A:0xfb2080b4
y.create.l HWIO_WCSS_A_LTE_CXM_CXM_WCN_PRIORITY_ENABLES_ADDR A:0xfb2080b8
y.create.l HWIO_WCSS_A_LTE_CXM_CXM_WCN_PRIORITY_THRESHOLD1_ADDR A:0xfb2080bc
y.create.l HWIO_WCSS_A_LTE_CXM_CXM_WCN_PRIORITY_THRESHOLD2_ADDR A:0xfb2080c0
y.create.l HWIO_WCSS_A_LTE_CXM_CXM_LTE_ACTIVE_FRAME_SYNC_VALUE_ADDR A:0xfb2080c4
y.create.l HWIO_WCSS_A_SPDM_AHBTM_CFG_ADDR A:0xfb203000
y.create.l HWIO_WCSS_A_SPDM_AHBTM_C0_CFG0_ADDR A:0xfb203020
y.create.l HWIO_WCSS_A_SPDM_AHBTM_C1_CFG0_ADDR A:0xfb203040
y.create.l HWIO_WCSS_A_SPDM_AHBTM_C2_CFG0_ADDR A:0xfb203060
y.create.l HWIO_WCSS_A_SPDM_AHBTM_C3_CFG0_ADDR A:0xfb203080
y.create.l HWIO_WCSS_A_SPDM_AHBTM_C4_CFG0_ADDR A:0xfb2030a0
y.create.l HWIO_WCSS_A_SPDM_AHBTM_C5_CFG0_ADDR A:0xfb2030c0
y.create.l HWIO_WCSS_A_SPDM_AHBTM_C6_CFG0_ADDR A:0xfb2030e0
y.create.l HWIO_WCSS_A_SPDM_AHBTM_C7_CFG0_ADDR A:0xfb203100
y.create.l HWIO_WCSS_A_SPDM_AHBTM_C0_CFG1_ADDR A:0xfb203024
y.create.l HWIO_WCSS_A_SPDM_AHBTM_C1_CFG1_ADDR A:0xfb203044
y.create.l HWIO_WCSS_A_SPDM_AHBTM_C2_CFG1_ADDR A:0xfb203064
y.create.l HWIO_WCSS_A_SPDM_AHBTM_C3_CFG1_ADDR A:0xfb203084
y.create.l HWIO_WCSS_A_SPDM_AHBTM_C4_CFG1_ADDR A:0xfb2030a4
y.create.l HWIO_WCSS_A_SPDM_AHBTM_C5_CFG1_ADDR A:0xfb2030c4
y.create.l HWIO_WCSS_A_SPDM_AHBTM_C6_CFG1_ADDR A:0xfb2030e4
y.create.l HWIO_WCSS_A_SPDM_AHBTM_C7_CFG1_ADDR A:0xfb203104
y.create.l HWIO_WCSS_A_SPDM_AHBTM_C0_CFG2_ADDR A:0xfb203028
y.create.l HWIO_WCSS_A_SPDM_AHBTM_C1_CFG2_ADDR A:0xfb203048
y.create.l HWIO_WCSS_A_SPDM_AHBTM_C2_CFG2_ADDR A:0xfb203068
y.create.l HWIO_WCSS_A_SPDM_AHBTM_C3_CFG2_ADDR A:0xfb203088
y.create.l HWIO_WCSS_A_SPDM_AHBTM_C4_CFG2_ADDR A:0xfb2030a8
y.create.l HWIO_WCSS_A_SPDM_AHBTM_C5_CFG2_ADDR A:0xfb2030c8
y.create.l HWIO_WCSS_A_SPDM_AHBTM_C6_CFG2_ADDR A:0xfb2030e8
y.create.l HWIO_WCSS_A_SPDM_AHBTM_C7_CFG2_ADDR A:0xfb203108
y.create.l HWIO_WCSS_A_SPDM_AHBTM_C0_CFG3_ADDR A:0xfb20302c
y.create.l HWIO_WCSS_A_SPDM_AHBTM_C1_CFG3_ADDR A:0xfb20304c
y.create.l HWIO_WCSS_A_SPDM_AHBTM_C2_CFG3_ADDR A:0xfb20306c
y.create.l HWIO_WCSS_A_SPDM_AHBTM_C3_CFG3_ADDR A:0xfb20308c
y.create.l HWIO_WCSS_A_SPDM_AHBTM_C4_CFG3_ADDR A:0xfb2030ac
y.create.l HWIO_WCSS_A_SPDM_AHBTM_C5_CFG3_ADDR A:0xfb2030cc
y.create.l HWIO_WCSS_A_SPDM_AHBTM_C6_CFG3_ADDR A:0xfb2030ec
y.create.l HWIO_WCSS_A_SPDM_AHBTM_C7_CFG3_ADDR A:0xfb20310c
y.create.l HWIO_WCSS_A_SPDM_AHBTM_C0_CFG4_ADDR A:0xfb203030
y.create.l HWIO_WCSS_A_SPDM_AHBTM_C1_CFG4_ADDR A:0xfb203050
y.create.l HWIO_WCSS_A_SPDM_AHBTM_C2_CFG4_ADDR A:0xfb203070
y.create.l HWIO_WCSS_A_SPDM_AHBTM_C3_CFG4_ADDR A:0xfb203090
y.create.l HWIO_WCSS_A_SPDM_AHBTM_C4_CFG4_ADDR A:0xfb2030b0
y.create.l HWIO_WCSS_A_SPDM_AHBTM_C5_CFG4_ADDR A:0xfb2030d0
y.create.l HWIO_WCSS_A_SPDM_AHBTM_C6_CFG4_ADDR A:0xfb2030f0
y.create.l HWIO_WCSS_A_SPDM_AHBTM_C7_CFG4_ADDR A:0xfb203110
y.create.l HWIO_WCSS_A_SPDM_AHBTM_C0_CFG5_ADDR A:0xfb203034
y.create.l HWIO_WCSS_A_SPDM_AHBTM_C1_CFG5_ADDR A:0xfb203054
y.create.l HWIO_WCSS_A_SPDM_AHBTM_C2_CFG5_ADDR A:0xfb203074
y.create.l HWIO_WCSS_A_SPDM_AHBTM_C3_CFG5_ADDR A:0xfb203094
y.create.l HWIO_WCSS_A_SPDM_AHBTM_C4_CFG5_ADDR A:0xfb2030b4
y.create.l HWIO_WCSS_A_SPDM_AHBTM_C5_CFG5_ADDR A:0xfb2030d4
y.create.l HWIO_WCSS_A_SPDM_AHBTM_C6_CFG5_ADDR A:0xfb2030f4
y.create.l HWIO_WCSS_A_SPDM_AHBTM_C7_CFG5_ADDR A:0xfb203114
y.create.l HWIO_WCSS_A_SPDM_AHBTM_C0_CFG6_ADDR A:0xfb203038
y.create.l HWIO_WCSS_A_SPDM_AHBTM_C1_CFG6_ADDR A:0xfb203058
y.create.l HWIO_WCSS_A_SPDM_AHBTM_C2_CFG6_ADDR A:0xfb203078
y.create.l HWIO_WCSS_A_SPDM_AHBTM_C3_CFG6_ADDR A:0xfb203098
y.create.l HWIO_WCSS_A_SPDM_AHBTM_C4_CFG6_ADDR A:0xfb2030b8
y.create.l HWIO_WCSS_A_SPDM_AHBTM_C5_CFG6_ADDR A:0xfb2030d8
y.create.l HWIO_WCSS_A_SPDM_AHBTM_C6_CFG6_ADDR A:0xfb2030f8
y.create.l HWIO_WCSS_A_SPDM_AHBTM_C7_CFG6_ADDR A:0xfb203118
y.create.l HWIO_WCSS_A_DXE_0_DMA_CSR_ADDR A:0xfb202000
y.create.l HWIO_WCSS_A_DXE_0_DMA_ENCH_ADDR A:0xfb202004
y.create.l HWIO_WCSS_A_DXE_0_DMA_CH_EN_ADDR A:0xfb202008
y.create.l HWIO_WCSS_A_DXE_0_DMA_CH_DONE_ADDR A:0xfb20200c
y.create.l HWIO_WCSS_A_DXE_0_DMA_CH_ERR_ADDR A:0xfb202010
y.create.l HWIO_WCSS_A_DXE_0_DMA_CH_STOP_ADDR A:0xfb202014
y.create.l HWIO_WCSS_A_DXE_0_INT_MSK_ADDR A:0xfb202018
y.create.l HWIO_WCSS_A_DXE_0_INT_SRC_MSKD_ADDR A:0xfb20201c
y.create.l HWIO_WCSS_A_DXE_0_INT_SRC_RAW_ADDR A:0xfb202020
y.create.l HWIO_WCSS_A_DXE_0_INT_ED_SRC_ADDR A:0xfb202024
y.create.l HWIO_WCSS_A_DXE_0_INT_DONE_SRC_ADDR A:0xfb202028
y.create.l HWIO_WCSS_A_DXE_0_INT_ERR_SRC_ADDR A:0xfb20202c
y.create.l HWIO_WCSS_A_DXE_0_INT_CLR_ADDR A:0xfb202030
y.create.l HWIO_WCSS_A_DXE_0_INT_ED_CLR_ADDR A:0xfb202034
y.create.l HWIO_WCSS_A_DXE_0_INT_DONE_CLR_ADDR A:0xfb202038
y.create.l HWIO_WCSS_A_DXE_0_INT_ERR_CLR_ADDR A:0xfb20203c
y.create.l HWIO_WCSS_A_DXE_0_DMA_CH_PRES_ADDR A:0xfb202040
y.create.l HWIO_WCSS_A_DXE_0_TSTBUS_CTRL_ADDR A:0xfb202044
y.create.l HWIO_WCSS_A_DXE_0_TSTBUS_LOW_ADDR A:0xfb202048
y.create.l HWIO_WCSS_A_DXE_0_TSTBUS_HIGH_ADDR A:0xfb20204c
y.create.l HWIO_WCSS_A_DXE_0_PF_BD_ADDR A:0xfb202050
y.create.l HWIO_WCSS_A_DXE_0_PF_PDU_ADDR A:0xfb202054
y.create.l HWIO_WCSS_A_DXE_0_REVISION_ADDR A:0xfb202058
y.create.l HWIO_WCSS_A_DXE_0_BMU_SB_QDAT_AVAIL_ADDR A:0xfb20205c
y.create.l HWIO_WCSS_A_DXE_0_BMU_SB_PDU_AVAIL_ADDR A:0xfb202060
y.create.l HWIO_WCSS_A_DXE_0_STATE_ADDR A:0xfb202064
y.create.l HWIO_WCSS_A_DXE_0_ARB_CH_MSK_ADDR A:0xfb202068
y.create.l HWIO_WCSS_A_DXE_0_UIF_SB_ADDR A:0xfb20206c
y.create.l HWIO_WCSS_A_DXE_0_TIMESTAMP_ADDR A:0xfb202070
y.create.l HWIO_WCSS_A_DXE_0_ARB_CH_MSK_CLR_ADDR A:0xfb202074
y.create.l HWIO_WCSS_A_DXE_0_CTR_PRES_ADDR A:0xfb202078
y.create.l HWIO_WCSS_A_DXE_0_CTR_CLR_ADDR A:0xfb20207c
y.create.l HWIO_WCSS_A_DXE_0_BD_TMPLTL_ADDR A:0xfb202080
y.create.l HWIO_WCSS_A_DXE_0_BD_TMPLTH_ADDR A:0xfb202084
y.create.l HWIO_WCSS_A_DXE_0_BDT_DAT_START_ADDR A:0xfb202088
y.create.l HWIO_WCSS_A_DXE_0_COUNTER0_ADDR A:0xfb202200
y.create.l HWIO_WCSS_A_DXE_0_COUNTER1_ADDR A:0xfb202204
y.create.l HWIO_WCSS_A_DXE_0_COUNTER2_ADDR A:0xfb202208
y.create.l HWIO_WCSS_A_DXE_0_COUNTER3_ADDR A:0xfb20220c
y.create.l HWIO_WCSS_A_DXE_0_COUNTER4_ADDR A:0xfb202210
y.create.l HWIO_WCSS_A_DXE_0_COUNTER5_ADDR A:0xfb202214
y.create.l HWIO_WCSS_A_DXE_0_COUNTER6_ADDR A:0xfb202218
y.create.l HWIO_WCSS_A_DXE_0_COUNTER7_ADDR A:0xfb20221c
y.create.l HWIO_WCSS_A_DXE_0_CH0_CTRL_ADDR A:0xfb202400
y.create.l HWIO_WCSS_A_DXE_0_CH0_STATUS_ADDR A:0xfb202404
y.create.l HWIO_WCSS_A_DXE_0_CH0_SZ_ADDR A:0xfb202408
y.create.l HWIO_WCSS_A_DXE_0_CH0_SADRL_ADDR A:0xfb20240c
y.create.l HWIO_WCSS_A_DXE_0_CH0_SADRH_ADDR A:0xfb202410
y.create.l HWIO_WCSS_A_DXE_0_CH0_DADRL_ADDR A:0xfb202414
y.create.l HWIO_WCSS_A_DXE_0_CH0_DADRH_ADDR A:0xfb202418
y.create.l HWIO_WCSS_A_DXE_0_CH0_DESCL_ADDR A:0xfb20241c
y.create.l HWIO_WCSS_A_DXE_0_CH0_DESCH_ADDR A:0xfb202420
y.create.l HWIO_WCSS_A_DXE_0_CH0_LST_DESCL_ADDR A:0xfb202424
y.create.l HWIO_WCSS_A_DXE_0_CH0_LST_DESCH_ADDR A:0xfb202428
y.create.l HWIO_WCSS_A_DXE_0_CH0_BD_ADDR A:0xfb20242c
y.create.l HWIO_WCSS_A_DXE_0_CH0_HEAD_ADDR A:0xfb202430
y.create.l HWIO_WCSS_A_DXE_0_CH0_TAIL_ADDR A:0xfb202434
y.create.l HWIO_WCSS_A_DXE_0_CH0_PDU_ADDR A:0xfb202438
y.create.l HWIO_WCSS_A_DXE_0_CH0_TSTMP_ADDR A:0xfb20243c
y.create.l HWIO_WCSS_A_DXE_0_CH1_CTRL_ADDR A:0xfb202440
y.create.l HWIO_WCSS_A_DXE_0_CH1_STATUS_ADDR A:0xfb202444
y.create.l HWIO_WCSS_A_DXE_0_CH1_SZ_ADDR A:0xfb202448
y.create.l HWIO_WCSS_A_DXE_0_CH1_SADRL_ADDR A:0xfb20244c
y.create.l HWIO_WCSS_A_DXE_0_CH1_SADRH_ADDR A:0xfb202450
y.create.l HWIO_WCSS_A_DXE_0_CH1_DADRL_ADDR A:0xfb202454
y.create.l HWIO_WCSS_A_DXE_0_CH1_DADRH_ADDR A:0xfb202458
y.create.l HWIO_WCSS_A_DXE_0_CH1_DESCL_ADDR A:0xfb20245c
y.create.l HWIO_WCSS_A_DXE_0_CH1_DESCH_ADDR A:0xfb202460
y.create.l HWIO_WCSS_A_DXE_0_CH1_LST_DESCL_ADDR A:0xfb202464
y.create.l HWIO_WCSS_A_DXE_0_CH1_LST_DESCH_ADDR A:0xfb202468
y.create.l HWIO_WCSS_A_DXE_0_CH1_BD_ADDR A:0xfb20246c
y.create.l HWIO_WCSS_A_DXE_0_CH1_HEAD_ADDR A:0xfb202470
y.create.l HWIO_WCSS_A_DXE_0_CH1_TAIL_ADDR A:0xfb202474
y.create.l HWIO_WCSS_A_DXE_0_CH1_PDU_ADDR A:0xfb202478
y.create.l HWIO_WCSS_A_DXE_0_CH1_TSTMP_ADDR A:0xfb20247c
y.create.l HWIO_WCSS_A_DXE_0_CH2_CTRL_ADDR A:0xfb202480
y.create.l HWIO_WCSS_A_DXE_0_CH2_STATUS_ADDR A:0xfb202484
y.create.l HWIO_WCSS_A_DXE_0_CH2_SZ_ADDR A:0xfb202488
y.create.l HWIO_WCSS_A_DXE_0_CH2_SADRL_ADDR A:0xfb20248c
y.create.l HWIO_WCSS_A_DXE_0_CH2_SADRH_ADDR A:0xfb202490
y.create.l HWIO_WCSS_A_DXE_0_CH2_DADRL_ADDR A:0xfb202494
y.create.l HWIO_WCSS_A_DXE_0_CH2_DADRH_ADDR A:0xfb202498
y.create.l HWIO_WCSS_A_DXE_0_CH2_DESCL_ADDR A:0xfb20249c
y.create.l HWIO_WCSS_A_DXE_0_CH2_DESCH_ADDR A:0xfb2024a0
y.create.l HWIO_WCSS_A_DXE_0_CH2_LST_DESCL_ADDR A:0xfb2024a4
y.create.l HWIO_WCSS_A_DXE_0_CH2_LST_DESCH_ADDR A:0xfb2024a8
y.create.l HWIO_WCSS_A_DXE_0_CH2_BD_ADDR A:0xfb2024ac
y.create.l HWIO_WCSS_A_DXE_0_CH2_HEAD_ADDR A:0xfb2024b0
y.create.l HWIO_WCSS_A_DXE_0_CH2_TAIL_ADDR A:0xfb2024b4
y.create.l HWIO_WCSS_A_DXE_0_CH2_PDU_ADDR A:0xfb2024b8
y.create.l HWIO_WCSS_A_DXE_0_CH2_TSTMP_ADDR A:0xfb2024bc
y.create.l HWIO_WCSS_A_DXE_0_CH3_CTRL_ADDR A:0xfb2024c0
y.create.l HWIO_WCSS_A_DXE_0_CH3_STATUS_ADDR A:0xfb2024c4
y.create.l HWIO_WCSS_A_DXE_0_CH3_SZ_ADDR A:0xfb2024c8
y.create.l HWIO_WCSS_A_DXE_0_CH3_SADRL_ADDR A:0xfb2024cc
y.create.l HWIO_WCSS_A_DXE_0_CH3_SADRH_ADDR A:0xfb2024d0
y.create.l HWIO_WCSS_A_DXE_0_CH3_DADRL_ADDR A:0xfb2024d4
y.create.l HWIO_WCSS_A_DXE_0_CH3_DADRH_ADDR A:0xfb2024d8
y.create.l HWIO_WCSS_A_DXE_0_CH3_DESCL_ADDR A:0xfb2024dc
y.create.l HWIO_WCSS_A_DXE_0_CH3_DESCH_ADDR A:0xfb2024e0
y.create.l HWIO_WCSS_A_DXE_0_CH3_LST_DESCL_ADDR A:0xfb2024e4
y.create.l HWIO_WCSS_A_DXE_0_CH3_LST_DESCH_ADDR A:0xfb2024e8
y.create.l HWIO_WCSS_A_DXE_0_CH3_BD_ADDR A:0xfb2024ec
y.create.l HWIO_WCSS_A_DXE_0_CH3_HEAD_ADDR A:0xfb2024f0
y.create.l HWIO_WCSS_A_DXE_0_CH3_TAIL_ADDR A:0xfb2024f4
y.create.l HWIO_WCSS_A_DXE_0_CH3_PDU_ADDR A:0xfb2024f8
y.create.l HWIO_WCSS_A_DXE_0_CH3_TSTMP_ADDR A:0xfb2024fc
y.create.l HWIO_WCSS_A_DXE_0_CH4_CTRL_ADDR A:0xfb202500
y.create.l HWIO_WCSS_A_DXE_0_CH4_STATUS_ADDR A:0xfb202504
y.create.l HWIO_WCSS_A_DXE_0_CH4_SZ_ADDR A:0xfb202508
y.create.l HWIO_WCSS_A_DXE_0_CH4_SADRL_ADDR A:0xfb20250c
y.create.l HWIO_WCSS_A_DXE_0_CH4_SADRH_ADDR A:0xfb202510
y.create.l HWIO_WCSS_A_DXE_0_CH4_DADRL_ADDR A:0xfb202514
y.create.l HWIO_WCSS_A_DXE_0_CH4_DADRH_ADDR A:0xfb202518
y.create.l HWIO_WCSS_A_DXE_0_CH4_DESCL_ADDR A:0xfb20251c
y.create.l HWIO_WCSS_A_DXE_0_CH4_DESCH_ADDR A:0xfb202520
y.create.l HWIO_WCSS_A_DXE_0_CH4_LST_DESCL_ADDR A:0xfb202524
y.create.l HWIO_WCSS_A_DXE_0_CH4_LST_DESCH_ADDR A:0xfb202528
y.create.l HWIO_WCSS_A_DXE_0_CH4_BD_ADDR A:0xfb20252c
y.create.l HWIO_WCSS_A_DXE_0_CH4_HEAD_ADDR A:0xfb202530
y.create.l HWIO_WCSS_A_DXE_0_CH4_TAIL_ADDR A:0xfb202534
y.create.l HWIO_WCSS_A_DXE_0_CH4_PDU_ADDR A:0xfb202538
y.create.l HWIO_WCSS_A_DXE_0_CH4_TSTMP_ADDR A:0xfb20253c
y.create.l HWIO_WCSS_A_DXE_0_CH5_CTRL_ADDR A:0xfb202540
y.create.l HWIO_WCSS_A_DXE_0_CH5_STATUS_ADDR A:0xfb202544
y.create.l HWIO_WCSS_A_DXE_0_CH5_SZ_ADDR A:0xfb202548
y.create.l HWIO_WCSS_A_DXE_0_CH5_SADRL_ADDR A:0xfb20254c
y.create.l HWIO_WCSS_A_DXE_0_CH5_SADRH_ADDR A:0xfb202550
y.create.l HWIO_WCSS_A_DXE_0_CH5_DADRL_ADDR A:0xfb202554
y.create.l HWIO_WCSS_A_DXE_0_CH5_DADRH_ADDR A:0xfb202558
y.create.l HWIO_WCSS_A_DXE_0_CH5_DESCL_ADDR A:0xfb20255c
y.create.l HWIO_WCSS_A_DXE_0_CH5_DESCH_ADDR A:0xfb202560
y.create.l HWIO_WCSS_A_DXE_0_CH5_LST_DESCL_ADDR A:0xfb202564
y.create.l HWIO_WCSS_A_DXE_0_CH5_LST_DESCH_ADDR A:0xfb202568
y.create.l HWIO_WCSS_A_DXE_0_CH5_BD_ADDR A:0xfb20256c
y.create.l HWIO_WCSS_A_DXE_0_CH5_HEAD_ADDR A:0xfb202570
y.create.l HWIO_WCSS_A_DXE_0_CH5_TAIL_ADDR A:0xfb202574
y.create.l HWIO_WCSS_A_DXE_0_CH5_PDU_ADDR A:0xfb202578
y.create.l HWIO_WCSS_A_DXE_0_CH5_TSTMP_ADDR A:0xfb20257c
y.create.l HWIO_WCSS_A_DXE_0_CH6_CTRL_ADDR A:0xfb202580
y.create.l HWIO_WCSS_A_DXE_0_CH6_STATUS_ADDR A:0xfb202584
y.create.l HWIO_WCSS_A_DXE_0_CH6_SZ_ADDR A:0xfb202588
y.create.l HWIO_WCSS_A_DXE_0_CH6_SADRL_ADDR A:0xfb20258c
y.create.l HWIO_WCSS_A_DXE_0_CH6_SADRH_ADDR A:0xfb202590
y.create.l HWIO_WCSS_A_DXE_0_CH6_DADRL_ADDR A:0xfb202594
y.create.l HWIO_WCSS_A_DXE_0_CH6_DADRH_ADDR A:0xfb202598
y.create.l HWIO_WCSS_A_DXE_0_CH6_DESCL_ADDR A:0xfb20259c
y.create.l HWIO_WCSS_A_DXE_0_CH6_DESCH_ADDR A:0xfb2025a0
y.create.l HWIO_WCSS_A_DXE_0_CH6_LST_DESCL_ADDR A:0xfb2025a4
y.create.l HWIO_WCSS_A_DXE_0_CH6_LST_DESCH_ADDR A:0xfb2025a8
y.create.l HWIO_WCSS_A_DXE_0_CH6_BD_ADDR A:0xfb2025ac
y.create.l HWIO_WCSS_A_DXE_0_CH6_HEAD_ADDR A:0xfb2025b0
y.create.l HWIO_WCSS_A_DXE_0_CH6_TAIL_ADDR A:0xfb2025b4
y.create.l HWIO_WCSS_A_DXE_0_CH6_PDU_ADDR A:0xfb2025b8
y.create.l HWIO_WCSS_A_DXE_0_CH6_TSTMP_ADDR A:0xfb2025bc
y.create.l HWIO_WCSS_A_DXE_0_CH7_CTRL_ADDR A:0xfb2025c0
y.create.l HWIO_WCSS_A_DXE_0_CH7_STATUS_ADDR A:0xfb2025c4
y.create.l HWIO_WCSS_A_DXE_0_CH7_SZ_ADDR A:0xfb2025c8
y.create.l HWIO_WCSS_A_DXE_0_CH7_SADRL_ADDR A:0xfb2025cc
y.create.l HWIO_WCSS_A_DXE_0_CH7_SADRH_ADDR A:0xfb2025d0
y.create.l HWIO_WCSS_A_DXE_0_CH7_DADRL_ADDR A:0xfb2025d4
y.create.l HWIO_WCSS_A_DXE_0_CH7_DADRH_ADDR A:0xfb2025d8
y.create.l HWIO_WCSS_A_DXE_0_CH7_DESCL_ADDR A:0xfb2025dc
y.create.l HWIO_WCSS_A_DXE_0_CH7_DESCH_ADDR A:0xfb2025e0
y.create.l HWIO_WCSS_A_DXE_0_CH7_LST_DESCL_ADDR A:0xfb2025e4
y.create.l HWIO_WCSS_A_DXE_0_CH7_LST_DESCH_ADDR A:0xfb2025e8
y.create.l HWIO_WCSS_A_DXE_0_CH7_BD_ADDR A:0xfb2025ec
y.create.l HWIO_WCSS_A_DXE_0_CH7_HEAD_ADDR A:0xfb2025f0
y.create.l HWIO_WCSS_A_DXE_0_CH7_TAIL_ADDR A:0xfb2025f4
y.create.l HWIO_WCSS_A_DXE_0_CH7_PDU_ADDR A:0xfb2025f8
y.create.l HWIO_WCSS_A_DXE_0_CH7_TSTMP_ADDR A:0xfb2025fc
y.create.l HWIO_WCSS_A_CMEM_CMEM_INT_ADDR A:0xfb201000
y.create.l HWIO_WCSS_A_CMEM_CMEM_INT_EN_ADDR A:0xfb201004
y.create.l HWIO_WCSS_A_CMEM_CMEM_INT_CLR_ADDR A:0xfb201008
y.create.l HWIO_WCSS_A_CMEM_CMEM_MEM_CFG_ADDR A:0xfb20100c
y.create.l HWIO_WCSS_A_CMEM_CMEM_TRANSBLK_CODE_ADDR A:0xfb201010
y.create.l HWIO_WCSS_A_CMEM_CMEM_TRANSBLK_START_ADDR_ADDR A:0xfb201014
y.create.l HWIO_WCSS_A_CMEM_CMEM_TRANSBLK_END_ADDR_ADDR A:0xfb201018
y.create.l HWIO_WCSS_A_CMEM_CMEM_TRANSBLK_PORT_EN_ADDR A:0xfb20101c
y.create.l HWIO_WCSS_A_CMEM_CMEM_ARB_POLICY_ADDR A:0xfb201020
y.create.l HWIO_WCSS_A_CMEM_CMEM_PRIORITY_ADDR A:0xfb201024
y.create.l HWIO_WCSS_A_CMEM_CMEM_TEST_OUT_SEL_ADDR A:0xfb201028
y.create.l HWIO_WCSS_A_CMEM_CMEM_INVALID_HISTORY_ADDR A:0xfb20102c
y.create.l HWIO_WCSS_A_CMEM_CMEM_INVALID_ADDR0_ADDR A:0xfb201030
y.create.l HWIO_WCSS_A_CMEM_CMEM_INVALID_ADDR1_ADDR A:0xfb201034
y.create.l HWIO_WCSS_A_CMEM_CMEM_INVALID_ADDR2_ADDR A:0xfb201038
y.create.l HWIO_WCSS_A_CMEM_CMEM_INVALID_ADDR3_ADDR A:0xfb20103c
y.create.l HWIO_WCSS_A_CMEM_CMEM_INVALID_CTL_ADDR A:0xfb201040
y.create.l HWIO_WCSS_A_CMEM_CMEM_SPARE_OUT_ADDR A:0xfb201044
y.create.l HWIO_WCSS_A_CMEM_CMEM_CNT_CTRL_ADDR A:0xfb201048
y.create.l HWIO_WCSS_A_CMEM_CMEM_CAHB_BUSY_CNT_ADDR A:0xfb20104c
y.create.l HWIO_WCSS_A_CMEM_CMEM_CAHB_IDLE_CNT_ADDR A:0xfb201050
y.create.l HWIO_WCSS_A_CMEM_CMEM_CAHB_ACTIVE_CNT_ADDR A:0xfb201054
y.create.l HWIO_WCSS_A_CMEM_CMEM_DAHB_BUSY_CNT_ADDR A:0xfb201058
y.create.l HWIO_WCSS_A_CMEM_CMEM_DAHB_IDLE_CNT_ADDR A:0xfb20105c
y.create.l HWIO_WCSS_A_CMEM_CMEM_DAHB_ACTIVE_CNT_ADDR A:0xfb201060
y.create.l HWIO_WCSS_A_CMEM_CMEM_ACPU_BUSY_CNT_ADDR A:0xfb201064
y.create.l HWIO_WCSS_A_CMEM_CMEM_ACPU_IDLE_CNT_ADDR A:0xfb201068
y.create.l HWIO_WCSS_A_CMEM_CMEM_ACPU_ACTIVE_CNT_ADDR A:0xfb20106c
y.create.l HWIO_WCSS_A_CMEM_CMEM_TESTBUS_HI_ADDR A:0xfb201070
y.create.l HWIO_WCSS_A_CMEM_CMEM_TESTBUS_LO_ADDR A:0xfb201074
y.create.l HWIO_WCSS_A_CMEM_CMEM_CLK_GATE_ADDR A:0xfb201078
y.create.l HWIO_WCSS_A_CMEM_CMEM_CAHB_RX_CTL_ADDR A:0xfb20107c
y.create.l HWIO_WCSS_A_CMEM_CMEM_DAHB_RX_CTL_ADDR A:0xfb201080
y.create.l HWIO_WCSS_A_CCAHB_CCAHB_BT_PL_ADDR A:0xfb200000
y.create.l HWIO_WCSS_A_CCAHB_CCAHB_FM_PL_ADDR A:0xfb200004
y.create.l HWIO_WCSS_A_CCAHB_CCAHB_RRI_PL_ADDR A:0xfb200008
y.create.l HWIO_WCSS_A_CCAHB_CCAHB_DXE_PL_ADDR A:0xfb20000c
y.create.l HWIO_WCSS_A_CCAHB_CCAHB_CCPU_PL_ADDR A:0xfb200010
y.create.l HWIO_WCSS_A_CCAHB_CCAHB_A2AB_PL_ADDR A:0xfb200014
y.create.l HWIO_WCSS_A_CCAHB_CCAHB_CBR_PL_ADDR A:0xfb200018
y.create.l HWIO_WCSS_A_CCAHB_CCAHB_DFLT_MST_ADDR A:0xfb200048
y.create.l HWIO_WCSS_A_CCAHB_CCAHB_VERSION_ADDR A:0xfb200090
y.create.l HWIO_WCSS_A_FM_SSBI2_CFG_SSBI2_CTL_ADDR A:0xfb1e0000
y.create.l HWIO_WCSS_A_FM_SSBI2_CFG_SSBI2_INT_ENABLE_ADDR A:0xfb1e0004
y.create.l HWIO_WCSS_A_FM_SSBI2_CFG_SSBI2_PRIORITIES_ADDR A:0xfb1e0008
y.create.l HWIO_WCSS_A_FM_SSBI2_CFG_SSBI2_BANKS_2_3_CTL_ADDR A:0xfb1e000c
y.create.l HWIO_WCSS_A_FM_SSBI2_CFG_SSBI2_ILLEGAL_STATUS_ADDR A:0xfb1e0010
y.create.l HWIO_WCSS_A_FM_SSBI2_CFG_SSBI2_TEST_BUS_CTL_ADDR A:0xfb1e0014
y.create.l HWIO_WCSS_A_FM_SSBI2_CFG_SSBI2_VIT0_ADDR A:0xfb1e0020
y.create.l HWIO_WCSS_A_FM_SSBI2_CFG_SSBI2_VIT1_ADDR A:0xfb1e0024
y.create.l HWIO_WCSS_A_FM_SSBI2_CFG_SSBI2_VIT2_ADDR A:0xfb1e0028
y.create.l HWIO_WCSS_A_FM_SSBI2_CFG_SSBI2_VIT3_ADDR A:0xfb1e002c
y.create.l HWIO_WCSS_A_FM_SSBI2_CFG_SSBI2_VIT4_ADDR A:0xfb1e0030
y.create.l HWIO_WCSS_A_FM_SSBI2_CFG_SSBI2_VIT5_ADDR A:0xfb1e0034
y.create.l HWIO_WCSS_A_FM_SSBI2_CFG_SSBI2_VIT6_ADDR A:0xfb1e0038
y.create.l HWIO_WCSS_A_FM_SSBI2_CFG_SSBI2_PVC_CTL_ADDR A:0xfb1e00a0
y.create.l HWIO_WCSS_A_FM_SSBI2_CFG_SSBI2_PVC_TABLE0_ADDR A:0xfb1e00a4
y.create.l HWIO_WCSS_A_FM_SSBI2_CFG_SSBI2_PVC_TABLE1_ADDR A:0xfb1e00a8
y.create.l HWIO_WCSS_A_FM_SSBI2_CFG_SSBI2_PVC_TABLE2_ADDR A:0xfb1e00ac
y.create.l HWIO_WCSS_A_FM_SSBI2_CFG_SSBI2_PVC_TABLE3_ADDR A:0xfb1e00b0
y.create.l HWIO_WCSS_A_FM_SSBI2_CFG_SSBI2_PVC_TABLE4_ADDR A:0xfb1e00b4
y.create.l HWIO_WCSS_A_FM_SSBI2_CFG_SSBI2_PVC_TABLE5_ADDR A:0xfb1e00b8
y.create.l HWIO_WCSS_A_FM_SSBI2_CFG_SSBI2_PVC_TABLE6_ADDR A:0xfb1e00bc
y.create.l HWIO_WCSS_A_FM_SSBI2_CFG_SSBI2_PVC_TABLE7_ADDR A:0xfb1e00c0
y.create.l HWIO_WCSS_A_FM_SSBI2_CFG_SSBI2_PVC_TABLE8_ADDR A:0xfb1e00c4
y.create.l HWIO_WCSS_A_FM_SSBI2_CFG_SSBI2_PVC_TABLE9_ADDR A:0xfb1e00c8
y.create.l HWIO_WCSS_A_FM_SSBI2_CMD_SSBI2_CMD_ADDR A:0xfb1c0000
y.create.l HWIO_WCSS_A_FM_SSBI2_CMD_SSBI2_RD_STATUS_ADDR A:0xfb1c0004
y.create.l HWIO_WCSS_A_FM_TX_CONTROL_ADDR A:0xfb180000
y.create.l HWIO_WCSS_A_FM_TX_MODULATION_ADDR A:0xfb180004
y.create.l HWIO_WCSS_A_FM_TX_AUDIO_LIMIT_ADDR A:0xfb180008
y.create.l HWIO_WCSS_A_FM_TX_RDS_CONTROL_ADDR A:0xfb18000c
y.create.l HWIO_WCSS_A_FM_TX_RDS_BLK_DATA_A_B_ADDR A:0xfb180010
y.create.l HWIO_WCSS_A_FM_TX_RDS_BLK_DATA_C_D_ADDR A:0xfb180014
y.create.l HWIO_WCSS_A_FM_TX_SOFT_RESET_ADDR A:0xfb180018
y.create.l HWIO_WCSS_A_FM_TX_TMUX_SEL_ADDR A:0xfb18001c
y.create.l HWIO_WCSS_A_FM_RX_CONTROL_ADDR A:0xfb190000
y.create.l HWIO_WCSS_A_FM_RX_SOFT_RESET_ADDR A:0xfb190004
y.create.l HWIO_WCSS_A_FM_RX_TMUX_SEL_ADDR A:0xfb190024
y.create.l HWIO_WCSS_A_FM_RX_DEMOD_GLITCH_THRESHOLD_ADDR A:0xfb190028
y.create.l HWIO_WCSS_A_FM_RX_GLITCH_STOP_SRCH_CNT_ADDR A:0xfb19002c
y.create.l HWIO_WCSS_A_FM_RX_GLITCH_START_SRCH_CNT_ADDR A:0xfb190030
y.create.l HWIO_WCSS_A_FM_RX_GLITCH_BLANK_CNT_TH_ADDR A:0xfb190034
y.create.l HWIO_WCSS_A_FM_RX_PLL_BANK_CHG_STB_ADDR A:0xfb190038
y.create.l HWIO_WCSS_A_FM_RX_PHASE_COMP_BYPASS_ADDR A:0xfb19003c
y.create.l HWIO_WCSS_A_FM_RX_MPX_DCC_CTRL_ADDR A:0xfb190040
y.create.l HWIO_WCSS_A_FM_RX_MPX_DCC_Z_DELAY_REGISTER_ADDR A:0xfb190044
y.create.l HWIO_WCSS_A_FM_RX_PILOT_DET_THRESHOLD_ADDR A:0xfb190048
y.create.l HWIO_WCSS_A_FM_RX_DELTA_R57K_PHASE_ADJUST_ADDR A:0xfb19004c
y.create.l HWIO_WCSS_A_FM_RX_BLEND_WEIGHT_ADDR A:0xfb190050
y.create.l HWIO_WCSS_A_FM_RX_SOFTMUTE_WEIGHT_ADDR A:0xfb190054
y.create.l HWIO_WCSS_A_FM_RX_BLEND_SOFTMUTE_LPF_M_SEL_ADDR A:0xfb190058
y.create.l HWIO_WCSS_A_FM_RX_MS_DECODER_CNTL_ADDR A:0xfb19005c
y.create.l HWIO_WCSS_A_FM_RX_MS_DECODER_STEREO_ON_ADDR A:0xfb190060
y.create.l HWIO_WCSS_A_FM_RX_RDS_CTRL_ADDR A:0xfb190064
y.create.l HWIO_WCSS_A_FM_RX_RDS_IQ_DET_CTRL_ADDR A:0xfb190068
y.create.l HWIO_WCSS_A_FM_RX_RDS_ACQ_MODE_ADDR A:0xfb19006c
y.create.l HWIO_WCSS_A_FM_RX_RDS_TRK_MODE_ADDR A:0xfb190070
y.create.l HWIO_WCSS_A_FM_RX_RDS_STROBE_MARGIN_ADDR A:0xfb190074
y.create.l HWIO_WCSS_A_FM_RX_RDS_MF_LPF_CNT_ADDR A:0xfb190078
y.create.l HWIO_WCSS_A_FM_RX_RDS_IQ_AN_INT_DUR_SEL_ADDR A:0xfb19007c
y.create.l HWIO_WCSS_A_FM_RX_RDS_IQ_ANALYZER_SELECT_ADDR A:0xfb190080
y.create.l HWIO_WCSS_A_FM_RX_RDS_IQ_AN_DET_THRESH_ADDR A:0xfb190084
y.create.l HWIO_WCSS_A_FM_RX_RDS_RECEIVE_MODE_SELECT_ADDR A:0xfb190088
y.create.l HWIO_WCSS_A_FM_RX_RDS_STATUS_ADDR A:0xfb19008c
y.create.l HWIO_WCSS_A_FM_RX_RDS_IQ_BUFFER_ADDR A:0xfb190090
y.create.l HWIO_WCSS_A_FM_RX_RDS_TIME_TRACKING_THRESHOLD_ADDR A:0xfb190094
y.create.l HWIO_WCSS_A_FM_RX_RDS_PEAK_INDEX_ADDR A:0xfb190098
y.create.l HWIO_WCSS_A_FM_RX_RDS_DL_CONFIG_ADDR A:0xfb19009c
y.create.l HWIO_WCSS_A_FM_RX_RDS_T1Q1E_ADDR A:0xfb1900a0
y.create.l HWIO_WCSS_A_FM_RX_RDS_T1Q2E_ADDR A:0xfb1900a4
y.create.l HWIO_WCSS_A_FM_RX_RDS_BLOCK_DATA_0_1_ADDR A:0xfb1900a8
y.create.l HWIO_WCSS_A_FM_RX_RDS_BLOCK_DATA_2_3_ADDR A:0xfb1900ac
y.create.l HWIO_WCSS_A_FM_RX_RDS_BLOCK_STATUS_ADDR A:0xfb1900b0
y.create.l HWIO_WCSS_A_FM_RX_RDS_BLOCK_DATA_RAW_0_ADDR A:0xfb1900b4
y.create.l HWIO_WCSS_A_FM_RX_RDS_BLOCK_DATA_RAW_1_ADDR A:0xfb1900b8
y.create.l HWIO_WCSS_A_FM_RX_RDS_BLOCK_DATA_RAW_2_ADDR A:0xfb1900bc
y.create.l HWIO_WCSS_A_FM_RX_RDS_BLOCK_DATA_RAW_3_ADDR A:0xfb1900c0
y.create.l HWIO_WCSS_A_FM_RX_RDS_TMUX_SEL_ADDR A:0xfb1900c4
y.create.l HWIO_WCSS_A_FM_RX_BLENDING_READBACK_ADDR A:0xfb1900c8
y.create.l HWIO_WCSS_A_FM_RX_MUTE_READBACK_ADDR A:0xfb1900cc
y.create.l HWIO_WCSS_A_FM_RX_PLL_FREERUN_EN_ADDR A:0xfb1900d0
y.create.l HWIO_WCSS_A_FM_RX_ROT_CTRL_ADDR A:0xfb1900d4
y.create.l HWIO_WCSS_A_FM_SPUR_COMP_FIXED_VALUE_ADDR A:0xfb1900d8
y.create.l HWIO_WCSS_A_FM_SPUR_COMP_DC_VALUE_RD_BACK_ADDR A:0xfb1900e4
y.create.l HWIO_WCSS_A_FM_DEMOD_DC_IF_OFFSET_ADDR A:0xfb1900e0
y.create.l HWIO_WCSS_A_FM_GAS_GAM_CTRL_ADDR A:0xfb1a0000
y.create.l HWIO_WCSS_A_FM_FM_INTR_EVENT_ADDR A:0xfb1a0004
y.create.l HWIO_WCSS_A_FM_FM_INTR_ENABLE_ADDR A:0xfb1a0008
y.create.l HWIO_WCSS_A_FM_FM_BUFFER_START_ADDRESS_ADDR A:0xfb1a000c
y.create.l HWIO_WCSS_A_FM_FM_BUFFER_LENGTH_ADDR A:0xfb1a0010
y.create.l HWIO_WCSS_A_FM_FM_BUFFER_HEAD_ADDR A:0xfb1a0014
y.create.l HWIO_WCSS_A_FM_FM_BUFFER_TAIL_ADDR A:0xfb1a0018
y.create.l HWIO_WCSS_A_FM_AUDIO_INTR_CONTROL_ADDR A:0xfb1a001c
y.create.l HWIO_WCSS_A_FM_CLR_AUDIO_LEVEL_INTR_ADDR A:0xfb1a0020
y.create.l HWIO_WCSS_A_FM_AUDIO_SAMPLES_COUNTER_VFR_SNAP_READBACK_ADDR A:0xfb1a0024
y.create.l HWIO_WCSS_A_FM_AUDIO_SAMPLES_COUNTER_READBACK_ADDR A:0xfb1a0028
y.create.l HWIO_WCSS_A_FM_SW_RESET_ADDR A:0xfb1a002c
y.create.l HWIO_WCSS_A_FM_RIVA_TEST_MUX_ADDR A:0xfb1a0030
y.create.l HWIO_WCSS_A_FM_SDI_CTRL_ADDR A:0xfb1a0034
y.create.l HWIO_WCSS_A_FM_SCRAMBLER_CTRL_ADDR A:0xfb1a0038
y.create.l HWIO_WCSS_A_FM_SCRAMBLER_POLY_ADDR A:0xfb1a003c
y.create.l HWIO_WCSS_A_FM_FM_INTR_CTRL_ADDR A:0xfb1a0040
y.create.l HWIO_WCSS_A_FM_AUDIO_DATA_CONTROL_ADDR A:0xfb1a0044
y.create.l HWIO_WCSS_A_FM_FM_HW_VERSION_ADDR A:0xfb1a0048
y.create.l HWIO_WCSS_A_A2XB_A2XB_CFG_ADDR A:0xfb100400
y.create.l HWIO_WCSS_A_A2XB_INT_MSK_ADDR A:0xfb100404
y.create.l HWIO_WCSS_A_A2XB_INT_SRC_MSKD_ADDR A:0xfb100408
y.create.l HWIO_WCSS_A_A2XB_INT_SRC_ADDR A:0xfb10040c
y.create.l HWIO_WCSS_A_A2XB_INT_CLR_ADDR A:0xfb100410
y.create.l HWIO_WCSS_A_A2XB_TSTBUS_CTRL_ADDR A:0xfb100414
y.create.l HWIO_WCSS_A_A2XB_TSTBUS_ADDR A:0xfb100418
y.create.l HWIO_WCSS_A_A2XB_ERR_INFO_ADDR A:0xfb10041c
y.create.l HWIO_WCSS_A_A2XB_REVISION_ADDR A:0xfb100420
y.create.l HWIO_WCSS_A_A2XB_SPARE_ADDR A:0xfb100424
y.create.l HWIO_WCSS_A_A2XB_HALT_ADDR A:0xfb100428
y.create.l HWIO_WCSS_A_A2XB_AXI_SB_CFG_ADDR A:0xfb10042c
y.create.l HWIO_WCSS_A_ADU_CONTROL_ADDR A:0xfb082800
y.create.l HWIO_WCSS_A_ADU_INTERRUPT_STATUS_ADDR A:0xfb082804
y.create.l HWIO_WCSS_A_ADU_INTERRUPT_ENABLE_ADDR A:0xfb082808
y.create.l HWIO_WCSS_A_ADU_ADU_TEST_CTRL_ADDR A:0xfb08280c
y.create.l HWIO_WCSS_A_ADU_ADU_STATUS_ADDR A:0xfb082810
y.create.l HWIO_WCSS_A_ADU_ADU_DEBUG0_ADDR A:0xfb082814
y.create.l HWIO_WCSS_A_ADU_ADU_DEBUG1_ADDR A:0xfb082818
y.create.l HWIO_WCSS_A_ADU_ADU_DEBUG2_ADDR A:0xfb08281c
y.create.l HWIO_WCSS_A_ADU_ADU_COUNTERS1_ADDR A:0xfb082820
y.create.l HWIO_WCSS_A_ADU_ADU_COUNTERS2_ADDR A:0xfb082824
y.create.l HWIO_WCSS_A_ADU_ADU_COUNTERS3_ADDR A:0xfb082828
y.create.l HWIO_WCSS_A_ADU_CONTROL2_ADDR A:0xfb08282c
y.create.l HWIO_WCSS_A_ADU_TIMEOUT_READ_ADDR A:0xfb082830
y.create.l HWIO_WCSS_A_ADU_UMA_CONFIG_ADDR A:0xfb08283c
y.create.l HWIO_WCSS_A_ADU_UMA_CTRL_ADDR A:0xfb082840
y.create.l HWIO_WCSS_A_ADU_UMA_DESP_TABLE_ADDR_ADDR A:0xfb082844
y.create.l HWIO_WCSS_A_ADU_UMA_TX_ETHERTYPE_TABLE1_ADDR A:0xfb082848
y.create.l HWIO_WCSS_A_ADU_UMA_TX_ETHERTYPE_TABLE2_ADDR A:0xfb08284c
y.create.l HWIO_WCSS_A_ADU_UMA_RX_ETHERTYPE_TABLE1_ADDR A:0xfb082850
y.create.l HWIO_WCSS_A_ADU_UMA_RX_ETHERTYPE_TABLE2_ADDR A:0xfb082854
y.create.l HWIO_WCSS_A_ADU_UMA_TX_COUNTERS1_ADDR A:0xfb082858
y.create.l HWIO_WCSS_A_ADU_UMA_TX_COUNTERS2_ADDR A:0xfb08285c
y.create.l HWIO_WCSS_A_ADU_UMA_LLC_COUNTERS_ADDR A:0xfb082860
y.create.l HWIO_WCSS_A_ADU_UMA_INDEX_TABLE_WDATA_U_ADDR A:0xfb082864
y.create.l HWIO_WCSS_A_ADU_UMA_INDEX_TABLE_WDATA_L_ADDR A:0xfb082868
y.create.l HWIO_WCSS_A_ADU_UMA_INDEX_TABLE_ADDR_CTRL_ADDR A:0xfb08286c
y.create.l HWIO_WCSS_A_ADU_UMA_INDEX_TABLE_RDATA_U_ADDR A:0xfb082870
y.create.l HWIO_WCSS_A_ADU_UMA_INDEX_TABLE_RDATA_L_ADDR A:0xfb082874
y.create.l HWIO_WCSS_A_ADU_UMA_TX_DEFAULT_WMACADDR_U_ADDR A:0xfb082878
y.create.l HWIO_WCSS_A_ADU_UMA_TX_DEFAULT_WMACADDR_L_ADDR A:0xfb08287c
y.create.l HWIO_WCSS_A_ADU_UMA_CTRL2_ADDR A:0xfb082880
y.create.l HWIO_WCSS_A_ADU_UMA_TX_COUNTERS3_ADDR A:0xfb082884
y.create.l HWIO_WCSS_A_ADU_UMA_TX_WQ_QID_CTRL_ADDR A:0xfb0828b8
y.create.l HWIO_WCSS_A_ADU_ADU_POLL_CMD_ERROR_ADDR_ADDR A:0xfb0828c0
y.create.l HWIO_WCSS_A_ADU_ADU_SW_REG_REINIT_ADDR_ADDR A:0xfb0828c4
y.create.l HWIO_WCSS_A_ADU_ADU_SW_REG_REINIT_TRIGGER_ADDR A:0xfb0828c8
y.create.l HWIO_WCSS_A_ADU_UMA_TX_HTC_HT_ADDR A:0xfb0828cc
y.create.l HWIO_WCSS_A_ADU_UMA_TX_HTC_VHT_ADDR A:0xfb0828d0
y.create.l HWIO_WCSS_A_ADU_UMA_TX_TID_TO_QID_ADDR A:0xfb0828d4
y.create.l HWIO_WCSS_A_ADU_UMA_TX_DEFAULT_WMACADDR_U_1_ADDR A:0xfb0828d8
y.create.l HWIO_WCSS_A_ADU_UMA_TX_DEFAULT_WMACADDR_L_1_ADDR A:0xfb0828dc
y.create.l HWIO_WCSS_A_ADU_UMA_TX_DEFAULT_WMACADDR_U_2_ADDR A:0xfb0828e0
y.create.l HWIO_WCSS_A_ADU_UMA_TX_DEFAULT_WMACADDR_L_2_ADDR A:0xfb0828e4
y.create.l HWIO_WCSS_A_ADU_UMA_TX_DEFAULT_WMACADDR_U_3_ADDR A:0xfb0828e8
y.create.l HWIO_WCSS_A_ADU_UMA_TX_DEFAULT_WMACADDR_L_3_ADDR A:0xfb0828ec
y.create.l HWIO_WCSS_A_ADU_UMA_TX_DEFAULT_STAID_ADDR A:0xfb0828f0
y.create.l HWIO_WCSS_A_ADU_ADU_REINIT_CONFIG_ADDR A:0xfb0828f4
y.create.l HWIO_WCSS_A_AGC_AGC_RESET_ADDR A:0xfb013c00
y.create.l HWIO_WCSS_A_AGC_DIS_MODE_ADDR A:0xfb013c04
y.create.l HWIO_WCSS_A_AGC_RX_OVERRIDE_ADDR A:0xfb013c08
y.create.l HWIO_WCSS_A_AGC_PHY_LOOPBACK_ADDR A:0xfb013c0c
y.create.l HWIO_WCSS_A_AGC_CONFIG_XBAR_ADDR A:0xfb013c10
y.create.l HWIO_WCSS_A_AGC_CW_DETECT_ADDR A:0xfb013c14
y.create.l HWIO_WCSS_A_AGC_CW_NOTCH_TIMEOUT_ADDR A:0xfb013c18
y.create.l HWIO_WCSS_A_AGC_GAIN_MODE_ADDR A:0xfb013c1c
y.create.l HWIO_WCSS_A_AGC_TESTBUS_ADDR A:0xfb013c20
y.create.l HWIO_WCSS_A_AGC_GAINSET0_ADDR A:0xfb013c24
y.create.l HWIO_WCSS_A_AGC_GAINSET_WRITE_ADDR A:0xfb013c28
y.create.l HWIO_WCSS_A_AGC_STAT_CTRL_ADDR A:0xfb013c2c
y.create.l HWIO_WCSS_A_AGC_SUBBAND_CONFIG_ADDR A:0xfb013c30
y.create.l HWIO_WCSS_A_AGC_CHANNEL_FREQ_ADDR A:0xfb013c34
y.create.l HWIO_WCSS_A_AGC_N_ACTIVE_ADDR A:0xfb013c38
y.create.l HWIO_WCSS_A_AGC_N_LISTEN_ADDR A:0xfb013c3c
y.create.l HWIO_WCSS_A_AGC_N_MEASURE_ADDR A:0xfb013c40
y.create.l HWIO_WCSS_A_AGC_N_CAPTURE_ADDR A:0xfb013c44
y.create.l HWIO_WCSS_A_AGC_CCA_MODE_ADDR A:0xfb013c48
y.create.l HWIO_WCSS_A_AGC_CCA_GI_DET_CFG_ADDR A:0xfb013c4c
y.create.l HWIO_WCSS_A_AGC_TH_CD20_ADDR A:0xfb013c50
y.create.l HWIO_WCSS_A_AGC_TH_CD40_ADDR A:0xfb013c54
y.create.l HWIO_WCSS_A_AGC_TH_CD80_ADDR A:0xfb013c58
y.create.l HWIO_WCSS_A_AGC_TH_CS20_ADDR A:0xfb013c5c
y.create.l HWIO_WCSS_A_AGC_TH_CS40_ADDR A:0xfb013c60
y.create.l HWIO_WCSS_A_AGC_TH_CS80_ADDR A:0xfb013c64
y.create.l HWIO_WCSS_A_AGC_TH_EDET_ADDR A:0xfb013c68
y.create.l HWIO_WCSS_A_AGC_D_AGC_A_ADDR A:0xfb013c6c
y.create.l HWIO_WCSS_A_AGC_D_AGC_B_ADDR A:0xfb013c70
y.create.l HWIO_WCSS_A_AGC_RSSI_OFFSET0_ADDR A:0xfb013c74
y.create.l HWIO_WCSS_A_AGC_RSSI_BT_OFFSET0_ADDR A:0xfb013c78
y.create.l HWIO_WCSS_A_AGC_CLIP_COUNT_ADDR A:0xfb013c7c
y.create.l HWIO_WCSS_A_AGC_SAT_COUNT_ADDR A:0xfb013c80
y.create.l HWIO_WCSS_A_AGC_PIP_COUNT_ADDR A:0xfb013c84
y.create.l HWIO_WCSS_A_AGC_RXA_NOT_AVALID_COUNT_ADDR A:0xfb013c88
y.create.l HWIO_WCSS_A_AGC_RXA_HDR_INVALID_COUNT_ADDR A:0xfb013c8c
y.create.l HWIO_WCSS_A_AGC_RXB_NO_B_PKT_DET_COUNT_ADDR A:0xfb013c90
y.create.l HWIO_WCSS_A_AGC_RXB_INV_HDR_COUNT_ADDR A:0xfb013c94
y.create.l HWIO_WCSS_A_AGC_RXB_ILL_HDR_COUNT_ADDR A:0xfb013c98
y.create.l HWIO_WCSS_A_AGC_COARSE_DCO_UPDATE_COUNTER_ADDR A:0xfb013c9c
y.create.l HWIO_WCSS_A_AGC_FALSE_AC_ABORT_COUNT_ADDR A:0xfb013ca0
y.create.l HWIO_WCSS_A_AGC_LATE_AC_DET_COUNT_ADDR A:0xfb013ca4
y.create.l HWIO_WCSS_A_AGC_CCA_PKTDET_STATUS_ADDR A:0xfb013ca8
y.create.l HWIO_WCSS_A_AGC_SAMPLE_ADC_I0_ADDR A:0xfb013cac
y.create.l HWIO_WCSS_A_AGC_SAMPLE_ADC_Q0_ADDR A:0xfb013cb0
y.create.l HWIO_WCSS_A_AGC_ADC_RSSI0_ADDR A:0xfb013cb4
y.create.l HWIO_WCSS_A_AGC_FIR_RSSI0_ADDR A:0xfb013cb8
y.create.l HWIO_WCSS_A_AGC_COARSE_DCO_CHAIN0_REAL_ADDR A:0xfb013cbc
y.create.l HWIO_WCSS_A_AGC_COARSE_DCO_CHAIN0_IMAG_ADDR A:0xfb013cc0
y.create.l HWIO_WCSS_A_AGC_INIT_GAIN_ADDR A:0xfb013cc4
y.create.l HWIO_WCSS_A_AGC_MAX_GAIN_ADDR A:0xfb013cc8
y.create.l HWIO_WCSS_A_AGC_GAIN_OFFSET0_ADDR A:0xfb013ccc
y.create.l HWIO_WCSS_A_AGC_TR_SW_GAIN_THRESH0_ADDR A:0xfb013cd0
y.create.l HWIO_WCSS_A_AGC_SAT_STEP_ADDR A:0xfb013cd4
y.create.l HWIO_WCSS_A_AGC_COARSE_STEP_HT_ADDR A:0xfb013cd8
y.create.l HWIO_WCSS_A_AGC_COARSE_STEP_ADDR A:0xfb013cdc
y.create.l HWIO_WCSS_A_AGC_MAX_POWER_DIFF_ADDR A:0xfb013ce0
y.create.l HWIO_WCSS_A_AGC_TARGET_BO_ACTIVE_ADDR A:0xfb013ce4
y.create.l HWIO_WCSS_A_AGC_TARGET_BO_INACTIVE_ADDR A:0xfb013ce8
y.create.l HWIO_WCSS_A_AGC_TH_CLIP_HIGH_ADDR A:0xfb013cec
y.create.l HWIO_WCSS_A_AGC_TH_CLIP_LOW_ADDR A:0xfb013cf0
y.create.l HWIO_WCSS_A_AGC_TH_SIGNAL_HIGH_ADDR A:0xfb013cf4
y.create.l HWIO_WCSS_A_AGC_TH_SIGNAL_LOW_ADDR A:0xfb013cf8
y.create.l HWIO_WCSS_A_AGC_TH_HTSTS_CLIP_ADDR A:0xfb013cfc
y.create.l HWIO_WCSS_A_AGC_TH_VHTSTS_CLIP_ADDR A:0xfb013d00
y.create.l HWIO_WCSS_A_AGC_TH_POWER_CLIP_ADDR A:0xfb013d04
y.create.l HWIO_WCSS_A_AGC_SAT_DELAY_ADDR A:0xfb013d08
y.create.l HWIO_WCSS_A_AGC_CLIP_WINDOW_ADDR A:0xfb013d0c
y.create.l HWIO_WCSS_A_AGC_TH_NO_SIGNAL_ADDR A:0xfb013d10
y.create.l HWIO_WCSS_A_AGC_TH_DCO_CAL_ADDR A:0xfb013d14
y.create.l HWIO_WCSS_A_AGC_DET_DATA_SHIFT_ADDR A:0xfb013d18
y.create.l HWIO_WCSS_A_AGC_TH_RXB_PWR_HIGH_ADDR A:0xfb013d1c
y.create.l HWIO_WCSS_A_AGC_TH_CW_LOW_ADDR A:0xfb013d20
y.create.l HWIO_WCSS_A_AGC_TH_CW_HIGH_ADDR A:0xfb013d24
y.create.l HWIO_WCSS_A_AGC_TH_CW_RSSI_ADDR A:0xfb013d28
y.create.l HWIO_WCSS_A_AGC_CW_MODE_DELAY_ADDR A:0xfb013d2c
y.create.l HWIO_WCSS_A_AGC_TH_D0_A_ADDR A:0xfb013d30
y.create.l HWIO_WCSS_A_AGC_TH_D0_A_LOW_ADDR A:0xfb013d34
y.create.l HWIO_WCSS_A_AGC_TH_D0_B_ADDR A:0xfb013d38
y.create.l HWIO_WCSS_A_AGC_TH_D0_B_TF_EST_ADDR A:0xfb013d3c
y.create.l HWIO_WCSS_A_AGC_TH_D0_11N_ADDR A:0xfb013d40
y.create.l HWIO_WCSS_A_AGC_TH_D0_11N_LOW_ADDR A:0xfb013d44
y.create.l HWIO_WCSS_A_AGC_TH_D0_11AC_ADDR A:0xfb013d48
y.create.l HWIO_WCSS_A_AGC_TH_D0_11AC_LOW_ADDR A:0xfb013d4c
y.create.l HWIO_WCSS_A_AGC_TH_MAXCORBA_ADDR A:0xfb013d50
y.create.l HWIO_WCSS_A_AGC_TH_MAXCOR40_ADDR A:0xfb013d54
y.create.l HWIO_WCSS_A_AGC_TH_MAXCORA40_ADDR A:0xfb013d58
y.create.l HWIO_WCSS_A_AGC_TH_MAXCOR20_ADDR A:0xfb013d5c
y.create.l HWIO_WCSS_A_AGC_TH_MAXCORA80_ADDR A:0xfb013d60
y.create.l HWIO_WCSS_A_AGC_TH_MAXCORAB_ADDR A:0xfb013d64
y.create.l HWIO_WCSS_A_AGC_C11B_ADDR A:0xfb013d68
y.create.l HWIO_WCSS_A_AGC_C11BP_ADDR A:0xfb013d6c
y.create.l HWIO_WCSS_A_AGC_TH_CAP_A_ADDR A:0xfb013d70
y.create.l HWIO_WCSS_A_AGC_TH_CAP_B_ADDR A:0xfb013d74
y.create.l HWIO_WCSS_A_AGC_TH_CAP_RXA_ADDR A:0xfb013d78
y.create.l HWIO_WCSS_A_AGC_TH_CAP_RXB_ADDR A:0xfb013d7c
y.create.l HWIO_WCSS_A_AGC_TH_PIP_PWR_JUMP_ADDR A:0xfb013d80
y.create.l HWIO_WCSS_A_AGC_TH_EOP_LVL_DROP_ADDR A:0xfb013d84
y.create.l HWIO_WCSS_A_AGC_TH_CORR_DROP_ADDR A:0xfb013d88
y.create.l HWIO_WCSS_A_AGC_CORR_TIME_ADDR A:0xfb013d8c
y.create.l HWIO_WCSS_A_AGC_ALL_RX_ON_TIME_ADDR A:0xfb013d90
y.create.l HWIO_WCSS_A_AGC_TRIGGER_DELAY_ADDR A:0xfb013d94
y.create.l HWIO_WCSS_A_AGC_PWR_NOTCH_ALPHA1_ADDR A:0xfb013d98
y.create.l HWIO_WCSS_A_AGC_PWR_NOTCH_ALPHA2_ADDR A:0xfb013d9c
y.create.l HWIO_WCSS_A_AGC_PWR_NOTCH_T_ALPHA_ADDR A:0xfb013da0
y.create.l HWIO_WCSS_A_AGC_D_TX_SETTLE_ADDR A:0xfb013da4
y.create.l HWIO_WCSS_A_AGC_D_UNSATURATED_ADDR A:0xfb013da8
y.create.l HWIO_WCSS_A_AGC_D_SATURATED_ADDR A:0xfb013dac
y.create.l HWIO_WCSS_A_AGC_D_FIRANDCAL_ADDR A:0xfb013db0
y.create.l HWIO_WCSS_A_AGC_D_HT_STS_COARSE_MEAS_ADDR A:0xfb013db4
y.create.l HWIO_WCSS_A_AGC_D_HT_STS_FINE_MEAS_ADDR A:0xfb013db8
y.create.l HWIO_WCSS_A_AGC_D_VHT_STS_COARSE_MEAS_ADDR A:0xfb013dbc
y.create.l HWIO_WCSS_A_AGC_D_VHT_STS_FINE_MEAS_ADDR A:0xfb013dc0
y.create.l HWIO_WCSS_A_AGC_D_VHT_DET_TIME_ADDR A:0xfb013dc4
y.create.l HWIO_WCSS_A_AGC_SIFS_TIME_A_ADDR A:0xfb013dc8
y.create.l HWIO_WCSS_A_AGC_SIFS_TIME_B_ADDR A:0xfb013dcc
y.create.l HWIO_WCSS_A_AGC_MAX_RX_TIME_A_ADDR A:0xfb013dd0
y.create.l HWIO_WCSS_A_AGC_MAX_RX_TIME_B_ADDR A:0xfb013dd4
y.create.l HWIO_WCSS_A_AGC_RTT_CFG_ADDR A:0xfb013dd8
y.create.l HWIO_WCSS_A_AGC_RTT_SIFS_WINDOW_ADDR A:0xfb013ddc
y.create.l HWIO_WCSS_A_AGC_RTT_OFFSET_20_ADDR A:0xfb013de0
y.create.l HWIO_WCSS_A_AGC_RTT_OFFSET_40_ADDR A:0xfb013de4
y.create.l HWIO_WCSS_A_AGC_RTT_OFFSET_80_ADDR A:0xfb013de8
y.create.l HWIO_WCSS_A_AGC_RTT_VALID_COUNT_ADDR A:0xfb013dec
y.create.l HWIO_WCSS_A_AGC_RTT_DELTA_MEAS_ADDR A:0xfb013df0
y.create.l HWIO_WCSS_A_AGC_RTT_REF_TIME_MEAS_LS16_ADDR A:0xfb013df4
y.create.l HWIO_WCSS_A_AGC_RTT_REF_TIME_MEAS_MS16_ADDR A:0xfb013df8
y.create.l HWIO_WCSS_A_AGC_RDET_RSSI_THRESHOLD_ADDR A:0xfb013dfc
y.create.l HWIO_WCSS_A_AGC_RDET_MIN_IAT_WRITE_ADDR A:0xfb013e00
y.create.l HWIO_WCSS_A_AGC_RDET_MAX_IAT_WRITE_ADDR A:0xfb013e04
y.create.l HWIO_WCSS_A_AGC_RDET_PULSE_WIDTH_MARGIN_WRITE_ADDR A:0xfb013e08
y.create.l HWIO_WCSS_A_AGC_RDET_MIN_PULSE_TRAIN_COUNT1_WRITE_ADDR A:0xfb013e0c
y.create.l HWIO_WCSS_A_AGC_RDET_MIN_PULSE_TRAIN_COUNT2_WRITE_ADDR A:0xfb013e10
y.create.l HWIO_WCSS_A_AGC_RDET_MIN_PULSE_TRAIN_COUNT3_WRITE_ADDR A:0xfb013e14
y.create.l HWIO_WCSS_A_AGC_RDET_MIN_PULSE_TRAIN_COUNT4_WRITE_ADDR A:0xfb013e18
y.create.l HWIO_WCSS_A_AGC_RDET_MIN_RADAR_PULSE_WIDTH_WRITE_ADDR A:0xfb013e1c
y.create.l HWIO_WCSS_A_AGC_RDET_MAX_RADAR_PULSE_WIDTH_WRITE_ADDR A:0xfb013e20
y.create.l HWIO_WCSS_A_AGC_RDET_MIN_IAT_READ_ADDR A:0xfb013e24
y.create.l HWIO_WCSS_A_AGC_RDET_MAX_IAT_READ_ADDR A:0xfb013e28
y.create.l HWIO_WCSS_A_AGC_RDET_PULSE_WIDTH_MARGIN_READ_ADDR A:0xfb013e2c
y.create.l HWIO_WCSS_A_AGC_RDET_MIN_PULSE_TRAIN_COUNT1_READ_ADDR A:0xfb013e30
y.create.l HWIO_WCSS_A_AGC_RDET_MIN_PULSE_TRAIN_COUNT2_READ_ADDR A:0xfb013e34
y.create.l HWIO_WCSS_A_AGC_RDET_MIN_PULSE_TRAIN_COUNT3_READ_ADDR A:0xfb013e38
y.create.l HWIO_WCSS_A_AGC_RDET_MIN_PULSE_TRAIN_COUNT4_READ_ADDR A:0xfb013e3c
y.create.l HWIO_WCSS_A_AGC_RDET_MIN_RADAR_PULSE_WIDTH_READ_ADDR A:0xfb013e40
y.create.l HWIO_WCSS_A_AGC_RDET_MAX_RADAR_PULSE_WIDTH_READ_ADDR A:0xfb013e44
y.create.l HWIO_WCSS_A_AGC_RDET_RESET_ADDR A:0xfb013e48
y.create.l HWIO_WCSS_A_AGC_RDET_RADAR_DETECTED_ADDR A:0xfb013e4c
y.create.l HWIO_WCSS_A_AGC_RDET_PULSEWIDTH_ADDR A:0xfb013e50
y.create.l HWIO_WCSS_A_AGC_RDET_NUM_DETECTED_ADDR A:0xfb013e54
y.create.l HWIO_WCSS_A_AGC_RDET_MEASUREMENT_DELAY_ADDR A:0xfb013e58
y.create.l HWIO_WCSS_A_AGC_RDET_FLAG_RESET_ADDR A:0xfb013e5c
y.create.l HWIO_WCSS_A_AGC_RSSI_THRESHOLD_CLIPPED_ADDR A:0xfb013e60
y.create.l HWIO_WCSS_A_AGC_CW_PULSE_WIDTH_ADDR A:0xfb013e64
y.create.l HWIO_WCSS_A_AGC_CW_RADAR_ADDR A:0xfb013e68
y.create.l HWIO_WCSS_A_AGC_ACI_DETECT_TH_ADDR A:0xfb013e6c
y.create.l HWIO_WCSS_A_AGC_TRANSITION_COUNT_GLOBAL_EN_ADDR A:0xfb013e70
y.create.l HWIO_WCSS_A_AGC_TRANSITION_COUNT0_EN_ADDR A:0xfb013e74
y.create.l HWIO_WCSS_A_AGC_TRANSITION_COUNT1_EN_ADDR A:0xfb013e78
y.create.l HWIO_WCSS_A_AGC_TRANSITION_COUNT2_EN_ADDR A:0xfb013e7c
y.create.l HWIO_WCSS_A_AGC_TRANSITION_COUNT3_EN_ADDR A:0xfb013e80
y.create.l HWIO_WCSS_A_AGC_TRANSITION_COUNT4_EN_ADDR A:0xfb013e84
y.create.l HWIO_WCSS_A_AGC_TRANSITION_COUNT5_EN_ADDR A:0xfb013e88
y.create.l HWIO_WCSS_A_AGC_TRANSITION_COUNT6_EN_ADDR A:0xfb013e8c
y.create.l HWIO_WCSS_A_AGC_TRANSITION_COUNT7_EN_ADDR A:0xfb013e90
y.create.l HWIO_WCSS_A_AGC_TRANSITION_COUNT8_EN_ADDR A:0xfb013e94
y.create.l HWIO_WCSS_A_AGC_TRANSITION_COUNT9_EN_ADDR A:0xfb013e98
y.create.l HWIO_WCSS_A_AGC_TRANSITION_COUNT10_EN_ADDR A:0xfb013e9c
y.create.l HWIO_WCSS_A_AGC_TRANSITION_COUNT11_EN_ADDR A:0xfb013ea0
y.create.l HWIO_WCSS_A_AGC_TRANSITION_COUNT0_ADDR A:0xfb013ea4
y.create.l HWIO_WCSS_A_AGC_TRANSITION_COUNT1_ADDR A:0xfb013ea8
y.create.l HWIO_WCSS_A_AGC_TRANSITION_COUNT2_ADDR A:0xfb013eac
y.create.l HWIO_WCSS_A_AGC_TRANSITION_COUNT3_ADDR A:0xfb013eb0
y.create.l HWIO_WCSS_A_AGC_TRANSITION_COUNT4_ADDR A:0xfb013eb4
y.create.l HWIO_WCSS_A_AGC_TRANSITION_COUNT5_ADDR A:0xfb013eb8
y.create.l HWIO_WCSS_A_AGC_TRANSITION_COUNT6_ADDR A:0xfb013ebc
y.create.l HWIO_WCSS_A_AGC_TRANSITION_COUNT7_ADDR A:0xfb013ec0
y.create.l HWIO_WCSS_A_AGC_TRANSITION_COUNT8_ADDR A:0xfb013ec4
y.create.l HWIO_WCSS_A_AGC_TRANSITION_COUNT9_ADDR A:0xfb013ec8
y.create.l HWIO_WCSS_A_AGC_TRANSITION_COUNT10_ADDR A:0xfb013ecc
y.create.l HWIO_WCSS_A_AGC_TRANSITION_COUNT11_ADDR A:0xfb013ed0
y.create.l HWIO_WCSS_A_AGC_NOISE_HIST_CTRL_ADDR A:0xfb013ed4
y.create.l HWIO_WCSS_A_AGC_NOISE_HIST_BIN0_MSW_ADDR A:0xfb013ed8
y.create.l HWIO_WCSS_A_AGC_NOISE_HIST_BIN0_LSW_ADDR A:0xfb013edc
y.create.l HWIO_WCSS_A_AGC_NOISE_HIST_BIN1_MSW_ADDR A:0xfb013ee0
y.create.l HWIO_WCSS_A_AGC_NOISE_HIST_BIN1_LSW_ADDR A:0xfb013ee4
y.create.l HWIO_WCSS_A_AGC_NOISE_HIST_BIN2_MSW_ADDR A:0xfb013ee8
y.create.l HWIO_WCSS_A_AGC_NOISE_HIST_BIN2_LSW_ADDR A:0xfb013eec
y.create.l HWIO_WCSS_A_AGC_NOISE_HIST_BIN3_MSW_ADDR A:0xfb013ef0
y.create.l HWIO_WCSS_A_AGC_NOISE_HIST_BIN3_LSW_ADDR A:0xfb013ef4
y.create.l HWIO_WCSS_A_AGC_NOISE_HIST_BIN4_MSW_ADDR A:0xfb013ef8
y.create.l HWIO_WCSS_A_AGC_NOISE_HIST_BIN4_LSW_ADDR A:0xfb013efc
y.create.l HWIO_WCSS_A_AGC_NOISE_HIST_BIN5_MSW_ADDR A:0xfb013f00
y.create.l HWIO_WCSS_A_AGC_NOISE_HIST_BIN5_LSW_ADDR A:0xfb013f04
y.create.l HWIO_WCSS_A_AGC_NOISE_HIST_BIN6_MSW_ADDR A:0xfb013f08
y.create.l HWIO_WCSS_A_AGC_NOISE_HIST_BIN6_LSW_ADDR A:0xfb013f0c
y.create.l HWIO_WCSS_A_AGC_NOISE_HIST_BIN7_MSW_ADDR A:0xfb013f10
y.create.l HWIO_WCSS_A_AGC_NOISE_HIST_BIN7_LSW_ADDR A:0xfb013f14
y.create.l HWIO_WCSS_A_AGC_NOISE_HIST_BIN8_MSW_ADDR A:0xfb013f18
y.create.l HWIO_WCSS_A_AGC_NOISE_HIST_BIN8_LSW_ADDR A:0xfb013f1c
y.create.l HWIO_WCSS_A_AGC_NOISE_HIST_BIN9_MSW_ADDR A:0xfb013f20
y.create.l HWIO_WCSS_A_AGC_NOISE_HIST_BIN9_LSW_ADDR A:0xfb013f24
y.create.l HWIO_WCSS_A_AGC_NOISE_HIST_BIN10_MSW_ADDR A:0xfb013f28
y.create.l HWIO_WCSS_A_AGC_NOISE_HIST_BIN10_LSW_ADDR A:0xfb013f2c
y.create.l HWIO_WCSS_A_AGC_NOISE_HIST_BUSY_MSW_ADDR A:0xfb013f30
y.create.l HWIO_WCSS_A_AGC_NOISE_HIST_BUSY_LSW_ADDR A:0xfb013f34
y.create.l HWIO_WCSS_A_AGC_WATCHDOG_MASK_ADDR A:0xfb013f38
y.create.l HWIO_WCSS_A_AGC_TIMEOUT_STATE_ADDR A:0xfb013f3c
y.create.l HWIO_WCSS_A_AGC_AGC_WATCHDOG_TIMEOUT_WAIT_DCO_A20_ADDR A:0xfb013f40
y.create.l HWIO_WCSS_A_AGC_AGC_WATCHDOG_TIMEOUT_WAIT_DCO_A40_ADDR A:0xfb013f44
y.create.l HWIO_WCSS_A_AGC_AGC_WATCHDOG_TIMEOUT_WAIT_DCO_A80_ADDR A:0xfb013f48
y.create.l HWIO_WCSS_A_AGC_AGC_WATCHDOG_TIMEOUT_WAIT_DCO_B_ADDR A:0xfb013f4c
y.create.l HWIO_WCSS_A_AGC_AGC_WATCHDOG_TIMEOUT_WAIT_A_ADDR A:0xfb013f50
y.create.l HWIO_WCSS_A_AGC_AGC_WATCHDOG_TIMEOUT_RXA_HDR_ADDR A:0xfb013f54
y.create.l HWIO_WCSS_A_AGC_AGC_WATCHDOG_TIMEOUT_HT_STS_COARSE_ADDR A:0xfb013f58
y.create.l HWIO_WCSS_A_AGC_AGC_WATCHDOG_TIMEOUT_HT_STS_FINE_ADDR A:0xfb013f5c
y.create.l HWIO_WCSS_A_AGC_AGC_WATCHDOG_TIMEOUT_VHT_STS_COARSE_ADDR A:0xfb013f60
y.create.l HWIO_WCSS_A_AGC_AGC_WATCHDOG_TIMEOUT_VHT_STS_FINE_ADDR A:0xfb013f64
y.create.l HWIO_WCSS_A_AGC_AGC_WATCHDOG_TIMEOUT_RXA_DATA_ADDR A:0xfb013f68
y.create.l HWIO_WCSS_A_AGC_AGC_WATCHDOG_TIMEOUT_CAP_A_ADDR A:0xfb013f6c
y.create.l HWIO_WCSS_A_AGC_AGC_WATCHDOG_TIMEOUT_TF_EST_ADDR A:0xfb013f70
y.create.l HWIO_WCSS_A_AGC_AGC_WATCHDOG_TIMEOUT_WAIT_B_ADDR A:0xfb013f74
y.create.l HWIO_WCSS_A_AGC_AGC_WATCHDOG_TIMEOUT_RXB_HDR_ADDR A:0xfb013f78
y.create.l HWIO_WCSS_A_AGC_AGC_WATCHDOG_TIMEOUT_RXB_DATA_ADDR A:0xfb013f7c
y.create.l HWIO_WCSS_A_AGC_AGC_WATCHDOG_TIMEOUT_CAP_B_ADDR A:0xfb013f80
y.create.l HWIO_WCSS_A_AGC_AGC_WATCHDOG_TIMEOUT_WAIT_SIFS_ADDR A:0xfb013f84
y.create.l HWIO_WCSS_A_AGC_CCA0_WATCHDOG_TIMEOUT_ADDR A:0xfb013f88
y.create.l HWIO_WCSS_A_AGC_CCA1_WATCHDOG_TIMEOUT_ADDR A:0xfb013f8c
y.create.l HWIO_WCSS_A_AGC_CCA2_WATCHDOG_TIMEOUT_ADDR A:0xfb013f90
y.create.l HWIO_WCSS_A_AGC_CCA0_WATCHDOG_EXPIRE_COUNT_ADDR A:0xfb013f94
y.create.l HWIO_WCSS_A_AGC_CCA1_WATCHDOG_EXPIRE_COUNT_ADDR A:0xfb013f98
y.create.l HWIO_WCSS_A_AGC_CCA2_WATCHDOG_EXPIRE_COUNT_ADDR A:0xfb013f9c
y.create.l HWIO_WCSS_A_AGC_RXFIR_CONFIG_ADDR A:0xfb013fa0
y.create.l HWIO_WCSS_A_AGC_VHTSIGA_P_AID1_ADDR A:0xfb013fa4
y.create.l HWIO_WCSS_A_AGC_VHTSIGA_P_AID2_ADDR A:0xfb013fa8
y.create.l HWIO_WCSS_A_AGC_VHTSIGA_P_AID3_ADDR A:0xfb013fac
y.create.l HWIO_WCSS_A_AGC_VHTSIGA_P_AID4_ADDR A:0xfb013fb0
y.create.l HWIO_WCSS_A_AGC_VHTSIGA_P_AID5_ADDR A:0xfb013fb4
y.create.l HWIO_WCSS_A_AGC_VHTSIGA_BWENCODING_ADDR A:0xfb013fb8
y.create.l HWIO_WCSS_A_AGC_VHTSIGA_GID1_ADDR A:0xfb013fbc
y.create.l HWIO_WCSS_A_AGC_VHTSIGA_GID2_ADDR A:0xfb013fc0
y.create.l HWIO_WCSS_A_AGC_CCA_GI_DET_CFG_LGI_ADDR A:0xfb013fc4
y.create.l HWIO_WCSS_A_AGC_CCA_GI_DET_CFG_SGI_ADDR A:0xfb013fc8
y.create.l HWIO_WCSS_A_AGC_CCA_GI_DET_CFG1_ADDR A:0xfb013fcc
y.create.l HWIO_WCSS_A_BBANA_ADC_CTRL_ADDR A:0xfb014000
y.create.l HWIO_WCSS_A_BBANA_ADC_CLK_CTRL_ADDR A:0xfb014004
y.create.l HWIO_WCSS_A_BBANA_ADC_REF_CTRL_ADDR A:0xfb014008
y.create.l HWIO_WCSS_A_BBANA_ADC_CONV_ADJ_ADDR A:0xfb01400c
y.create.l HWIO_WCSS_A_BBANA_ADC_SPARE_ADDR A:0xfb014010
y.create.l HWIO_WCSS_A_BBANA_ADC_SPARE3_ADDR A:0xfb014014
y.create.l HWIO_WCSS_A_BBANA_DAC_CTRL_ADDR A:0xfb014018
y.create.l HWIO_WCSS_A_BBANA_DAC_BIAS_ADDR A:0xfb01401c
y.create.l HWIO_WCSS_A_BBANA_DEBUG_ADDR A:0xfb014020
y.create.l HWIO_WCSS_A_BBANA_DAC_CFG_ADDR A:0xfb014024
y.create.l HWIO_WCSS_A_BBANA_DAC_CAL_CTRL_ADDR A:0xfb014028
y.create.l HWIO_WCSS_A_BBANA_DAC_CAL_CFG_ADDR A:0xfb01402c
y.create.l HWIO_WCSS_A_BBANA_DAC_CAL_STATUS_ADDR A:0xfb014030
y.create.l HWIO_WCSS_A_BMU_CONTROL_ADDR A:0xfb080000
y.create.l HWIO_WCSS_A_BMU_ERR_INTR_STATUS_ADDR A:0xfb080004
y.create.l HWIO_WCSS_A_BMU_ERR_INTR_ENABLE_ADDR A:0xfb080008
y.create.l HWIO_WCSS_A_BMU_ERR_INT_ADDR_ADDR A:0xfb08000c
y.create.l HWIO_WCSS_A_BMU_ERR_INT_WDATA_ADDR A:0xfb080010
y.create.l HWIO_WCSS_A_BMU_BD_PDU_THRESHOLD0_ADDR A:0xfb080014
y.create.l HWIO_WCSS_A_BMU_BD_PDU_THRESHOLD1_ADDR A:0xfb080018
y.create.l HWIO_WCSS_A_BMU_BD_PDU_THRESHOLD2_ADDR A:0xfb08001c
y.create.l HWIO_WCSS_A_BMU_BD_PDU_THRESHOLD3_ADDR A:0xfb080020
y.create.l HWIO_WCSS_A_BMU_BD_PDU_THRESHOLD4_ADDR A:0xfb080024
y.create.l HWIO_WCSS_A_BMU_BD_PDU_THRESHOLD5_ADDR A:0xfb080028
y.create.l HWIO_WCSS_A_BMU_BD_PDU_THRESHOLD6_ADDR A:0xfb08002c
y.create.l HWIO_WCSS_A_BMU_BD_PDU_THRESHOLD7_ADDR A:0xfb080030
y.create.l HWIO_WCSS_A_BMU_BD_PDU_THRESHOLD8_ADDR A:0xfb080034
y.create.l HWIO_WCSS_A_BMU_BD_PDU_THRESHOLD9_ADDR A:0xfb080038
y.create.l HWIO_WCSS_A_BMU_BD_PDU_THRESHOLD10_ADDR A:0xfb08003c
y.create.l HWIO_WCSS_A_BMU_WQ_ENABLE_ADDR A:0xfb08006c
y.create.l HWIO_WCSS_A_BMU_DPU_WQ_ASSIGNMENT_ADDR A:0xfb080070
y.create.l HWIO_WCSS_A_BMU_TEST_CTRL_ADDR A:0xfb080074
y.create.l HWIO_WCSS_A_BMU_TEST_OUT_LOW_ADDR A:0xfb080078
y.create.l HWIO_WCSS_A_BMU_TEST_OUT_HIGH_ADDR A:0xfb08007c
y.create.l HWIO_WCSS_A_BMU_GAS_CONFIGURATION_ADDR A:0xfb080080
y.create.l HWIO_WCSS_A_BMU_AVAILABLE_BD_PDU_AFTER_RSV_ADDR A:0xfb080084
y.create.l HWIO_WCSS_A_BMU_CONTROL2_ADDR A:0xfb080088
y.create.l HWIO_WCSS_A_BMU_DISABLE_WQ_DA_ADDR A:0xfb08008c
y.create.l HWIO_WCSS_A_BMU_DISABLE_BD_PDU_AVAIL_ADDR A:0xfb080090
y.create.l HWIO_WCSS_A_BMU_LAST_FOUR_POP_TRACE_CONTROL_ADDR A:0xfb080094
y.create.l HWIO_WCSS_A_BMU_POP_CMD_TRACE_BD_INDEX0_ADDR A:0xfb080098
y.create.l HWIO_WCSS_A_BMU_POP_CMD_TRACE_BD_INDEX1_ADDR A:0xfb08009c
y.create.l HWIO_WCSS_A_BMU_POP_CMD_TRACE_BD_INDEX2_ADDR A:0xfb0800a0
y.create.l HWIO_WCSS_A_BMU_POP_CMD_TRACE_BD_INDEX3_ADDR A:0xfb0800a4
y.create.l HWIO_WCSS_A_BMU_BMU_INTERNAL_MEM_TRACE_ADDR_ADDR A:0xfb0800ac
y.create.l HWIO_WCSS_A_BMU_RELEASE_ERROR_DETAILS_ADDR A:0xfb0800b0
y.create.l HWIO_WCSS_A_BMU_RELEASE_ERROR_DETAILS_LOW_ADDR A:0xfb0800b4
y.create.l HWIO_WCSS_A_BMU_RELEASE_ERROR_DETAILS_HIGH_ADDR A:0xfb0800b8
y.create.l HWIO_WCSS_A_BMU_RELEASE_FIFO_ENTRIES_ADDR A:0xfb0800bc
y.create.l HWIO_WCSS_A_BMU_LAST_BD_PREFETCH_HEAD_ADDR A:0xfb0800c0
y.create.l HWIO_WCSS_A_BMU_BD_PREFETCH_HEAD_BD_LINK_ADDR A:0xfb0800c4
y.create.l HWIO_WCSS_A_BMU_BMU_PUSH_INTEGRITY_ERR_BD_INDEX_ADDR A:0xfb0800c8
y.create.l HWIO_WCSS_A_BMU_BMU_WATCHDOG_TIMEOUT_TIME_ADDR A:0xfb0800cc
y.create.l HWIO_WCSS_A_BMU_BMU_SM_STATES_ON_ERROR_LOW_ADDR A:0xfb0800d0
y.create.l HWIO_WCSS_A_BMU_BMU_SM_STATES_ON_ERROR_HIGH_ADDR A:0xfb0800d4
y.create.l HWIO_WCSS_A_BMU_BMU_PREFETCH_ERROR_DETAILS_ADDR A:0xfb0800d8
y.create.l HWIO_WCSS_A_BMU_CONTROL3_ADDR A:0xfb0800dc
y.create.l HWIO_WCSS_A_BMU_CONTROL4_ADDR A:0xfb0800e0
y.create.l HWIO_WCSS_A_BMU_DPU_RSV_STATUS_ADDR A:0xfb0800e4
y.create.l HWIO_WCSS_A_BMU_RECEIVE_DEBUG_CONTROL_ADDR A:0xfb0800e8
y.create.l HWIO_WCSS_A_BMU_BMU_SPARE_REG_ADDR A:0xfb0800ec
y.create.l HWIO_WCSS_A_BMU_BTQM_CONTROL1_ADDR A:0xfb0800f0
y.create.l HWIO_WCSS_A_BMU_BTQM_CONTROL2_ADDR A:0xfb0800f4
y.create.l HWIO_WCSS_A_BMU_BTQM_STATUS_ADDR A:0xfb0800f8
y.create.l HWIO_WCSS_A_BMU_BTQM_STA_ENABLE_DISABLE_CONTROL_ADDR A:0xfb0800fc
y.create.l HWIO_WCSS_A_BMU_TRANSMIT_QUEUE_ACCESS_CONTROL1_ADDR A:0xfb080100
y.create.l HWIO_WCSS_A_BMU_TRANSMIT_QUEUE_ACCESS_CONTROL2_ADDR A:0xfb080104
y.create.l HWIO_WCSS_A_BMU_TRANSMIT_QUEUE_ACCESS_CONTROL3_ADDR A:0xfb080108
y.create.l HWIO_WCSS_A_BMU_TRANSMIT_QUEUE_ACCESS_CONTROL4_ADDR A:0xfb08010c
y.create.l HWIO_WCSS_A_BMU_TRANSMIT_QUEUE_ACCESS_CONTROL5_ADDR A:0xfb080110
y.create.l HWIO_WCSS_A_BMU_TRANSMIT_QUEUE_ACCESS_CONTROL6_ADDR A:0xfb080114
y.create.l HWIO_WCSS_A_BMU_BD_INDEX_INFO_ACCESS_CONTROL1_ADDR A:0xfb080118
y.create.l HWIO_WCSS_A_BMU_BD_INDEX_INFO_ACCESS_CONTROL2_ADDR A:0xfb08011c
y.create.l HWIO_WCSS_A_BMU_BD_INDEX_INFO_ACCESS_CONTROL3_ADDR A:0xfb080120
y.create.l HWIO_WCSS_A_BMU_BD_INDEX_INFO_ACCESS_CONTROL4_ADDR A:0xfb080124
y.create.l HWIO_WCSS_A_BMU_BD_INDEX_INFO_ACCESS_CONTROL5_ADDR A:0xfb080128
y.create.l HWIO_WCSS_A_BMU_BD_INDEX_INFO_ACCESS_CONTROL6_ADDR A:0xfb08012c
y.create.l HWIO_WCSS_A_BMU_BD_INDEX_INFO_ACCESS_CONTROL7_ADDR A:0xfb080130
y.create.l HWIO_WCSS_A_BMU_BAR_AND_FRAME_DROP_CONTROL_ADDR A:0xfb080134
y.create.l HWIO_WCSS_A_BMU_TX_QUEUE_STAID_QUEUEID_CONFIG_ADDR A:0xfb080138
y.create.l HWIO_WCSS_A_BMU_ENHANCED_TRACING_CONTROL1_ADDR A:0xfb08013c
y.create.l HWIO_WCSS_A_BMU_BTQM_QUEUE_INFO_BASE_ADDR_ADDR A:0xfb080140
y.create.l HWIO_WCSS_A_BMU_QOS_QUEUEID_MAPPING1_ADDR A:0xfb080144
y.create.l HWIO_WCSS_A_BMU_QOS_QUEUEID_MAPPING2_ADDR A:0xfb080148
y.create.l HWIO_WCSS_A_BMU_QOS_QUEUEID_MAPPING3_ADDR A:0xfb08014c
y.create.l HWIO_WCSS_A_BMU_QUEUEID_BO_MAPPING1_ADDR A:0xfb080154
y.create.l HWIO_WCSS_A_BMU_QUEUEID_BO_MAPPING2_ADDR A:0xfb080158
y.create.l HWIO_WCSS_A_BMU_FAST_TRACE_READING_CONTROL_ADDR A:0xfb080160
y.create.l HWIO_WCSS_A_BMU_FAST_TRACE_READING_DATA0_ADDR A:0xfb080164
y.create.l HWIO_WCSS_A_BMU_FAST_TRACE_READING_DATA1_ADDR A:0xfb080168
y.create.l HWIO_WCSS_A_BMU_FAST_TRACE_READING_DATA2_ADDR A:0xfb08016c
y.create.l HWIO_WCSS_A_BMU_FAST_BD_LINK_SETUP_CONTROL_ADDR A:0xfb080170
y.create.l HWIO_WCSS_A_BMU_STA_CONFIG_STATUS1_ADDR A:0xfb080174
y.create.l HWIO_WCSS_A_BMU_STA_CONFIG_STATUS2_ADDR A:0xfb080178
y.create.l HWIO_WCSS_A_BMU_STA_CONFIG_STATUS3_ADDR A:0xfb08017c
y.create.l HWIO_WCSS_A_BMU_STA_CONFIG_STATUS4_ADDR A:0xfb080180
y.create.l HWIO_WCSS_A_BMU_BTQM_ERR_STATUS_ADDR A:0xfb080184
y.create.l HWIO_WCSS_A_BMU_BTQM_ERR_ENABLE_ADDR A:0xfb080188
y.create.l HWIO_WCSS_A_BMU_BTQM_ERR_STATE_ADDR A:0xfb08018c
y.create.l HWIO_WCSS_A_BMU_BTQM_ERR_STATE2_ADDR A:0xfb080190
y.create.l HWIO_WCSS_A_BMU_BTQM_TPE_INT_STATS_ADDR A:0xfb080194
y.create.l HWIO_WCSS_A_BMU_RETRY_LIMIT_DROP_CNT_ADDR A:0xfb0801b4
y.create.l HWIO_WCSS_A_BMU_TPE_DROP_CNT_ADDR A:0xfb0801b8
y.create.l HWIO_WCSS_A_BMU_BA_HANDLER_ACKED_DROP_CNT_ADDR A:0xfb0801bc
y.create.l HWIO_WCSS_A_BMU_BA_HANDLER_WINDOW_MOVED_DROP_CNT_ADDR A:0xfb0801c0
y.create.l HWIO_WCSS_A_BMU_GET_INFO_CNT_ADDR A:0xfb0801c4
y.create.l HWIO_WCSS_A_BMU_GET_BD_INDEX_CNT_ADDR A:0xfb0801c8
y.create.l HWIO_WCSS_A_BMU_PWR_SAVE_STA_CNT_ADDR A:0xfb0801cc
y.create.l HWIO_WCSS_A_BMU_BTQM_FRAME_CNT_ADDR A:0xfb0801d0
y.create.l HWIO_WCSS_A_BMU_BTQM_TIMEOUT_CHECK_CTRL_ADDR A:0xfb0801d4
y.create.l HWIO_WCSS_A_BMU_PWR_STATE_CHANGE_INT_CONTROL_ADDR A:0xfb0801d8
y.create.l HWIO_WCSS_A_BMU_BTQM_INTERRUPT_STATUS_ADDR A:0xfb0801dc
y.create.l HWIO_WCSS_A_BMU_BTQM_INTERRUPT_ENABLE_ADDR A:0xfb0801e0
y.create.l HWIO_WCSS_A_BMU_PWR_SAVE_DROP_CTRL_ADDR A:0xfb0801e4
y.create.l HWIO_WCSS_A_BMU_PWR_SAVE_DROP_INT_CONTROL_ADDR A:0xfb0801e8
y.create.l HWIO_WCSS_A_BMU_BMU_BACKUP_CONTROL_ADDR A:0xfb0801ec
y.create.l HWIO_WCSS_A_BMU_BMU_QUEUE_DELAY_ACCESS_CONTROL_ADDR A:0xfb0801f0
y.create.l HWIO_WCSS_A_BMU_QUEUE_TRANSMIT_DELAY_VALUE_ADDR A:0xfb0801f4
y.create.l HWIO_WCSS_A_BMU_DXE_RX_WQ_INDEX_ADDR A:0xfb0801f8
y.create.l HWIO_WCSS_A_BMU_BMU_SIF_DATA_LENGTH_ADDR A:0xfb0801fc
y.create.l HWIO_WCSS_A_BMU_SW_BMU_DXE_DATA_LENGTH_ADDR A:0xfb080200
y.create.l HWIO_WCSS_A_BMU_BTQM_PACKET_MEMORY_UNIT_SIZE_ADDR A:0xfb080208
y.create.l HWIO_WCSS_A_BMU_SW_ACCESS_DEBUG_STATUS_ADDR A:0xfb08020c
y.create.l HWIO_WCSS_A_BMU_BTQM_TX_THRESHOLD_ADDR A:0xfb080210
y.create.l HWIO_WCSS_A_BMU_BTQM_STAID_3_TO_0_MEM_STATUS_ADDR A:0xfb080214
y.create.l HWIO_WCSS_A_BMU_BTQM_STAID_7_TO_4_MEM_STATUS_ADDR A:0xfb080218
y.create.l HWIO_WCSS_A_BMU_BTQM_PKT_MEMORY_STATUS_ADDR A:0xfb08021c
y.create.l HWIO_WCSS_A_BMU_HP_RX_MEMORY_UPPER_LIMIT_ADDR A:0xfb080220
y.create.l HWIO_WCSS_A_BMU_LP_RX_MEMORY_UPPER_LIMIT_ADDR A:0xfb080224
y.create.l HWIO_WCSS_A_BMU_BTQM_STAID_1_TO_0_MEM_THRESHOLD_ADDR A:0xfb080228
y.create.l HWIO_WCSS_A_BMU_BTQM_STAID_3_TO_2_MEM_THRESHOLD_ADDR A:0xfb08022c
y.create.l HWIO_WCSS_A_BMU_BTQM_STAID_5_TO_4_MEM_THRESHOLD_ADDR A:0xfb080230
y.create.l HWIO_WCSS_A_BMU_BTQM_STAID_7_TO_6_MEM_THRESHOLD_ADDR A:0xfb080234
y.create.l HWIO_WCSS_A_BMU_BTQM_STAID_15_TO_0_MEM_USAGE_STATUS_ADDR A:0xfb080238
y.create.l HWIO_WCSS_A_BMU_POLL_STATUS_TIMER_THRESHOLD_ADDR A:0xfb08023c
y.create.l HWIO_WCSS_A_BMU_BMU_IDLE_BD_PDU_STATUS_ADDR A:0xfb080240
y.create.l HWIO_WCSS_A_BMU_BTQM_STAID_11_TO_8_MEM_STATUS_ADDR A:0xfb080244
y.create.l HWIO_WCSS_A_BMU_BTQM_STAID_15_TO_12_MEM_STATUS_ADDR A:0xfb080248
y.create.l HWIO_WCSS_A_BMU_BTQM_STAID_9_TO_8_MEM_THRESHOLD_ADDR A:0xfb08024c
y.create.l HWIO_WCSS_A_BMU_BTQM_STAID_11_TO_10_MEM_THRESHOLD_ADDR A:0xfb080250
y.create.l HWIO_WCSS_A_BMU_BTQM_STAID_13_TO_12_MEM_THRESHOLD_ADDR A:0xfb080254
y.create.l HWIO_WCSS_A_BMU_BTQM_STAID_15_TO_14_MEM_THRESHOLD_ADDR A:0xfb080258
y.create.l HWIO_WCSS_A_BMU_BMU_PKT_MEMORY_CONFIG_MODE_ADDR A:0xfb08025c
y.create.l HWIO_WCSS_A_BMU_AVAILABLE_BD_PDU_AFTER_RSV_IN_LOCAL_MEM_ADDR A:0xfb080260
y.create.l HWIO_WCSS_A_BMU_BLOCK_DPU_RX_THRESHOLD_ADDR A:0xfb080264
y.create.l HWIO_WCSS_A_BMU_ADU_RX_LOW_THRESHOLD_ADDR A:0xfb080268
y.create.l HWIO_WCSS_A_BMU_DXE_TX_LOW_THRESHOLD_ADDR A:0xfb08026c
y.create.l HWIO_WCSS_A_BMU_DXE_RX_DA_SELECTION_ADDR A:0xfb080270
y.create.l HWIO_WCSS_A_BTCF_BTCF_CONFIG_ADDR A:0xfb014800
y.create.l HWIO_WCSS_A_BTCF_BTCF_DET_RATIO_ADDR A:0xfb014804
y.create.l HWIO_WCSS_A_BTCF_BTCF_DET_DSHIFT_ADDR A:0xfb014808
y.create.l HWIO_WCSS_A_BTCF_BTCFMIN_ADDR A:0xfb01480c
y.create.l HWIO_WCSS_A_BTCF_PWRMIN_ADDR A:0xfb014810
y.create.l HWIO_WCSS_A_BTCF_OFFSETMIN_ADDR A:0xfb014814
y.create.l HWIO_WCSS_A_CAHB_CAHB_RXP_PL_ADDR A:0xfb082c00
y.create.l HWIO_WCSS_A_CAHB_CAHB_TPE_PL_ADDR A:0xfb082c04
y.create.l HWIO_WCSS_A_CAHB_CAHB_RPE_PL_ADDR A:0xfb082c08
y.create.l HWIO_WCSS_A_CAHB_CAHB_RPEM_PL_ADDR A:0xfb082c0c
y.create.l HWIO_WCSS_A_CAHB_CAHB_DPU_PL_ADDR A:0xfb082c10
y.create.l HWIO_WCSS_A_CAHB_CAHB_ADU_PL_ADDR A:0xfb082c14
y.create.l HWIO_WCSS_A_CAHB_CAHB_CBR_PL_ADDR A:0xfb082c18
y.create.l HWIO_WCSS_A_CAHB_CAHB_CSU_PL_ADDR A:0xfb082c1c
y.create.l HWIO_WCSS_A_CAHB_CAHB_DFLT_MST_ADDR A:0xfb082c48
y.create.l HWIO_WCSS_A_CAHB_CAHB_VERSION_ADDR A:0xfb082c90
y.create.l HWIO_WCSS_A_CAL_CALMODE_ADDR A:0xfb008000
y.create.l HWIO_WCSS_A_CAL_MEASURE_ADDR A:0xfb008004
y.create.l HWIO_WCSS_A_CAL_CHAIN_SEL_ADDR A:0xfb008008
y.create.l HWIO_WCSS_A_CAL_LENGTH_INIT_ADDR A:0xfb00800c
y.create.l HWIO_WCSS_A_CAL_LENGTH_RSA_ADDR A:0xfb008010
y.create.l HWIO_WCSS_A_CAL_LENGTH_RSB_ADDR A:0xfb008014
y.create.l HWIO_WCSS_A_CAL_PIE_FFT_ADDR A:0xfb008018
y.create.l HWIO_WCSS_A_CAL_DCO_THRESHOLD_ADDR A:0xfb00801c
y.create.l HWIO_WCSS_A_CAL_DCTIMER1_ADDR A:0xfb008020
y.create.l HWIO_WCSS_A_CAL_DCTIMER2_ADDR A:0xfb008024
y.create.l HWIO_WCSS_A_CAL_DCOFFSET_ADDR A:0xfb008028
y.create.l HWIO_WCSS_A_CAL_PWRDCOFFSET_ADDR A:0xfb00802c
y.create.l HWIO_WCSS_A_CAL_CLR_DCOFFSET_ADDR A:0xfb008030
y.create.l HWIO_WCSS_A_CAL_CHN0_DCO_OVR_ADDR A:0xfb008034
y.create.l HWIO_WCSS_A_CAL_STATUS_ADDR A:0xfb008038
y.create.l HWIO_WCSS_A_CAL_OVERRIDE_ADDR A:0xfb00803c
y.create.l HWIO_WCSS_A_CAL_CORR_ENABLE_ADDR A:0xfb008040
y.create.l HWIO_WCSS_A_CAL_AIEST_ADDR A:0xfb008044
y.create.l HWIO_WCSS_A_CAL_IQ_CORR_MODE_ADDR A:0xfb008048
y.create.l HWIO_WCSS_A_CAL_DEBUG_OUTPUT_EN_MASK_ADDR A:0xfb00804c
y.create.l HWIO_WCSS_A_CAL_FORCE_TR_SWITCH_ADDR A:0xfb008050
y.create.l HWIO_WCSS_A_CAL_AIEST_DISABLE_ADDR A:0xfb008054
y.create.l HWIO_WCSS_A_CAL_BARAM_ACCESS_ADDR A:0xfb008058
y.create.l HWIO_WCSS_A_CAL_BARAM0_0_ADDR A:0xfb008800
y.create.l HWIO_WCSS_A_CAL_BARAM1_0_ADDR A:0xfb008808
y.create.l HWIO_WCSS_A_CAL_BARAM2_0_ADDR A:0xfb008810
y.create.l HWIO_WCSS_A_CAL_BARAM3_0_ADDR A:0xfb008818
y.create.l HWIO_WCSS_A_CAL_BARAM4_0_ADDR A:0xfb008820
y.create.l HWIO_WCSS_A_CAL_BARAM5_0_ADDR A:0xfb008828
y.create.l HWIO_WCSS_A_CAL_BARAM6_0_ADDR A:0xfb008830
y.create.l HWIO_WCSS_A_CAL_BARAM7_0_ADDR A:0xfb008838
y.create.l HWIO_WCSS_A_CAL_BARAM8_0_ADDR A:0xfb008840
y.create.l HWIO_WCSS_A_CAL_BARAM9_0_ADDR A:0xfb008848
y.create.l HWIO_WCSS_A_CAL_BARAM0_1_ADDR A:0xfb008804
y.create.l HWIO_WCSS_A_CAL_BARAM1_1_ADDR A:0xfb00880c
y.create.l HWIO_WCSS_A_CAL_BARAM2_1_ADDR A:0xfb008814
y.create.l HWIO_WCSS_A_CAL_BARAM3_1_ADDR A:0xfb00881c
y.create.l HWIO_WCSS_A_CAL_BARAM4_1_ADDR A:0xfb008824
y.create.l HWIO_WCSS_A_CAL_BARAM5_1_ADDR A:0xfb00882c
y.create.l HWIO_WCSS_A_CAL_BARAM6_1_ADDR A:0xfb008834
y.create.l HWIO_WCSS_A_CAL_BARAM7_1_ADDR A:0xfb00883c
y.create.l HWIO_WCSS_A_CAL_BARAM8_1_ADDR A:0xfb008844
y.create.l HWIO_WCSS_A_CAL_BARAM9_1_ADDR A:0xfb00884c
y.create.l HWIO_WCSS_A_CAL_IQ_CORR_COEFF_MEM0_0_ADDR A:0xfb009000
y.create.l HWIO_WCSS_A_CAL_IQ_CORR_COEFF_MEM1_0_ADDR A:0xfb009020
y.create.l HWIO_WCSS_A_CAL_IQ_CORR_COEFF_MEM2_0_ADDR A:0xfb009040
y.create.l HWIO_WCSS_A_CAL_IQ_CORR_COEFF_MEM3_0_ADDR A:0xfb009060
y.create.l HWIO_WCSS_A_CAL_IQ_CORR_COEFF_MEM4_0_ADDR A:0xfb009080
y.create.l HWIO_WCSS_A_CAL_IQ_CORR_COEFF_MEM5_0_ADDR A:0xfb0090a0
y.create.l HWIO_WCSS_A_CAL_IQ_CORR_COEFF_MEM6_0_ADDR A:0xfb0090c0
y.create.l HWIO_WCSS_A_CAL_IQ_CORR_COEFF_MEM7_0_ADDR A:0xfb0090e0
y.create.l HWIO_WCSS_A_CAL_IQ_CORR_COEFF_MEM8_0_ADDR A:0xfb009100
y.create.l HWIO_WCSS_A_CAL_IQ_CORR_COEFF_MEM9_0_ADDR A:0xfb009120
y.create.l HWIO_WCSS_A_CAL_IQ_CORR_COEFF_MEM0_1_ADDR A:0xfb009004
y.create.l HWIO_WCSS_A_CAL_IQ_CORR_COEFF_MEM1_1_ADDR A:0xfb009024
y.create.l HWIO_WCSS_A_CAL_IQ_CORR_COEFF_MEM2_1_ADDR A:0xfb009044
y.create.l HWIO_WCSS_A_CAL_IQ_CORR_COEFF_MEM3_1_ADDR A:0xfb009064
y.create.l HWIO_WCSS_A_CAL_IQ_CORR_COEFF_MEM4_1_ADDR A:0xfb009084
y.create.l HWIO_WCSS_A_CAL_IQ_CORR_COEFF_MEM5_1_ADDR A:0xfb0090a4
y.create.l HWIO_WCSS_A_CAL_IQ_CORR_COEFF_MEM6_1_ADDR A:0xfb0090c4
y.create.l HWIO_WCSS_A_CAL_IQ_CORR_COEFF_MEM7_1_ADDR A:0xfb0090e4
y.create.l HWIO_WCSS_A_CAL_IQ_CORR_COEFF_MEM8_1_ADDR A:0xfb009104
y.create.l HWIO_WCSS_A_CAL_IQ_CORR_COEFF_MEM9_1_ADDR A:0xfb009124
y.create.l HWIO_WCSS_A_CAL_IQ_CORR_COEFF_MEM0_2_ADDR A:0xfb009008
y.create.l HWIO_WCSS_A_CAL_IQ_CORR_COEFF_MEM1_2_ADDR A:0xfb009028
y.create.l HWIO_WCSS_A_CAL_IQ_CORR_COEFF_MEM2_2_ADDR A:0xfb009048
y.create.l HWIO_WCSS_A_CAL_IQ_CORR_COEFF_MEM3_2_ADDR A:0xfb009068
y.create.l HWIO_WCSS_A_CAL_IQ_CORR_COEFF_MEM4_2_ADDR A:0xfb009088
y.create.l HWIO_WCSS_A_CAL_IQ_CORR_COEFF_MEM5_2_ADDR A:0xfb0090a8
y.create.l HWIO_WCSS_A_CAL_IQ_CORR_COEFF_MEM6_2_ADDR A:0xfb0090c8
y.create.l HWIO_WCSS_A_CAL_IQ_CORR_COEFF_MEM7_2_ADDR A:0xfb0090e8
y.create.l HWIO_WCSS_A_CAL_IQ_CORR_COEFF_MEM8_2_ADDR A:0xfb009108
y.create.l HWIO_WCSS_A_CAL_IQ_CORR_COEFF_MEM9_2_ADDR A:0xfb009128
y.create.l HWIO_WCSS_A_CAL_IQ_CORR_COEFF_MEM0_3_ADDR A:0xfb00900c
y.create.l HWIO_WCSS_A_CAL_IQ_CORR_COEFF_MEM1_3_ADDR A:0xfb00902c
y.create.l HWIO_WCSS_A_CAL_IQ_CORR_COEFF_MEM2_3_ADDR A:0xfb00904c
y.create.l HWIO_WCSS_A_CAL_IQ_CORR_COEFF_MEM3_3_ADDR A:0xfb00906c
y.create.l HWIO_WCSS_A_CAL_IQ_CORR_COEFF_MEM4_3_ADDR A:0xfb00908c
y.create.l HWIO_WCSS_A_CAL_IQ_CORR_COEFF_MEM5_3_ADDR A:0xfb0090ac
y.create.l HWIO_WCSS_A_CAL_IQ_CORR_COEFF_MEM6_3_ADDR A:0xfb0090cc
y.create.l HWIO_WCSS_A_CAL_IQ_CORR_COEFF_MEM7_3_ADDR A:0xfb0090ec
y.create.l HWIO_WCSS_A_CAL_IQ_CORR_COEFF_MEM8_3_ADDR A:0xfb00910c
y.create.l HWIO_WCSS_A_CAL_IQ_CORR_COEFF_MEM9_3_ADDR A:0xfb00912c
y.create.l HWIO_WCSS_A_CAL_IQ_CORR_COEFF_MEM0_4_ADDR A:0xfb009010
y.create.l HWIO_WCSS_A_CAL_IQ_CORR_COEFF_MEM1_4_ADDR A:0xfb009030
y.create.l HWIO_WCSS_A_CAL_IQ_CORR_COEFF_MEM2_4_ADDR A:0xfb009050
y.create.l HWIO_WCSS_A_CAL_IQ_CORR_COEFF_MEM3_4_ADDR A:0xfb009070
y.create.l HWIO_WCSS_A_CAL_IQ_CORR_COEFF_MEM4_4_ADDR A:0xfb009090
y.create.l HWIO_WCSS_A_CAL_IQ_CORR_COEFF_MEM5_4_ADDR A:0xfb0090b0
y.create.l HWIO_WCSS_A_CAL_IQ_CORR_COEFF_MEM6_4_ADDR A:0xfb0090d0
y.create.l HWIO_WCSS_A_CAL_IQ_CORR_COEFF_MEM7_4_ADDR A:0xfb0090f0
y.create.l HWIO_WCSS_A_CAL_IQ_CORR_COEFF_MEM8_4_ADDR A:0xfb009110
y.create.l HWIO_WCSS_A_CAL_IQ_CORR_COEFF_MEM9_4_ADDR A:0xfb009130
y.create.l HWIO_WCSS_A_CAL_IQ_CORR_COEFF_MEM0_5_ADDR A:0xfb009014
y.create.l HWIO_WCSS_A_CAL_IQ_CORR_COEFF_MEM1_5_ADDR A:0xfb009034
y.create.l HWIO_WCSS_A_CAL_IQ_CORR_COEFF_MEM2_5_ADDR A:0xfb009054
y.create.l HWIO_WCSS_A_CAL_IQ_CORR_COEFF_MEM3_5_ADDR A:0xfb009074
y.create.l HWIO_WCSS_A_CAL_IQ_CORR_COEFF_MEM4_5_ADDR A:0xfb009094
y.create.l HWIO_WCSS_A_CAL_IQ_CORR_COEFF_MEM5_5_ADDR A:0xfb0090b4
y.create.l HWIO_WCSS_A_CAL_IQ_CORR_COEFF_MEM6_5_ADDR A:0xfb0090d4
y.create.l HWIO_WCSS_A_CAL_IQ_CORR_COEFF_MEM7_5_ADDR A:0xfb0090f4
y.create.l HWIO_WCSS_A_CAL_IQ_CORR_COEFF_MEM8_5_ADDR A:0xfb009114
y.create.l HWIO_WCSS_A_CAL_IQ_CORR_COEFF_MEM9_5_ADDR A:0xfb009134
y.create.l HWIO_WCSS_A_CCU_CCU_ENABLE_CLK_ADDR A:0xfb204000
y.create.l HWIO_WCSS_A_CCU_CCU_DISABLE_CLK_GATING_ADDR A:0xfb204004
y.create.l HWIO_WCSS_A_CCU_CCU_GCU_DISABLE_CLK_GATING_ADDR A:0xfb204008
y.create.l HWIO_WCSS_A_CCU_CCU_CRCM_CONTROL_ADDR A:0xfb20400c
y.create.l HWIO_WCSS_A_CCU_CCU_SOFT_RESET_ADDR A:0xfb204010
y.create.l HWIO_WCSS_A_CCU_CCU_SPARE_TEST_CTL_ADDR A:0xfb2050f4
y.create.l HWIO_WCSS_A_CCU_CCU_SPARE_INT_CTL_ADDR A:0xfb2050f8
y.create.l HWIO_WCSS_A_CCU_CCU_ROM_BASE_ADDR1_ADDR A:0xfb205000
y.create.l HWIO_WCSS_A_CCU_CCU_ROM_BASE_ADDR2_ADDR A:0xfb205004
y.create.l HWIO_WCSS_A_CCU_CCU_ROM_START_ADDR1_ADDR A:0xfb205008
y.create.l HWIO_WCSS_A_CCU_CCU_ROM_START_ADDR2_ADDR A:0xfb20500c
y.create.l HWIO_WCSS_A_CCU_CCU_ROM_START_ADDR3_ADDR A:0xfb205010
y.create.l HWIO_WCSS_A_CCU_CCU_ROM_START_ADDR4_ADDR A:0xfb205014
y.create.l HWIO_WCSS_A_CCU_CCU_ROM_END_ADDR1_ADDR A:0xfb205018
y.create.l HWIO_WCSS_A_CCU_CCU_ROM_END_ADDR2_ADDR A:0xfb20501c
y.create.l HWIO_WCSS_A_CCU_CCU_ROM_END_ADDR3_ADDR A:0xfb205020
y.create.l HWIO_WCSS_A_CCU_CCU_ROM_END_ADDR4_ADDR A:0xfb205024
y.create.l HWIO_WCSS_A_CCU_CCU_TESTBUS_CONTROL_ADDR A:0xfb20502c
y.create.l HWIO_WCSS_A_CCU_CCU_TESTBUS_LOWER_ADDR A:0xfb205030
y.create.l HWIO_WCSS_A_CCU_CCU_TESTBUS_UPPER_ADDR A:0xfb205034
y.create.l HWIO_WCSS_A_CCU_CCU_RRI_SW_REG_REINIT_ADDR A:0xfb205038
y.create.l HWIO_WCSS_A_CCU_CCU_RRI_SW_REG_REINIT_ADDR_ADDR A:0xfb20503c
y.create.l HWIO_WCSS_A_CCU_CCU_RRI_POLL_CMD_ERR_ADDR_ADDR A:0xfb205040
y.create.l HWIO_WCSS_A_CCU_CCU_RRI_MISC_CFG_ADDR A:0xfb205044
y.create.l HWIO_WCSS_A_CCU_CCU_MISC_CTL_ADDR A:0xfb20504c
y.create.l HWIO_WCSS_A_CCU_CCU_CCPU_STALL_COUNT_ADDR A:0xfb205050
y.create.l HWIO_WCSS_A_CCU_CCU_CCPU_ACTIVE_COUNT_ADDR A:0xfb205054
y.create.l HWIO_WCSS_A_CCU_CCU_CCPU_INVALID_ADDR_ADDR A:0xfb205058
y.create.l HWIO_WCSS_A_CCU_CCU_CCPU_LAST_ADDR0_ADDR A:0xfb20505c
y.create.l HWIO_WCSS_A_CCU_CCU_CCPU_LAST_ADDR1_ADDR A:0xfb205060
y.create.l HWIO_WCSS_A_CCU_CCU_CCPU_LAST_ADDR2_ADDR A:0xfb205064
y.create.l HWIO_WCSS_A_CCU_CCU_A2AB_ERR_ADDR_ADDR A:0xfb205068
y.create.l HWIO_WCSS_A_CCU_CCU_A2AB_CTL_ADDR A:0xfb20506c
y.create.l HWIO_WCSS_A_CCU_CCU_A2AB_CFG_ADDR A:0xfb205070
y.create.l HWIO_WCSS_A_CCU_CCU_WRAP_ADDR_ADDR A:0xfb205074
y.create.l HWIO_WCSS_A_CCU_CCU_AOWBR_ERR_ADDR_ADDR A:0xfb205078
y.create.l HWIO_WCSS_A_CCU_CCU_CCPU_TO_MSM_MB_INT_STAT_ADDR A:0xfb206000
y.create.l HWIO_WCSS_A_CCU_CCU_MSM_TO_CCPU_MB_INT_STAT_ADDR A:0xfb206004
y.create.l HWIO_WCSS_A_CCU_CCU_MB0_CONTROL_ADDR A:0xfb206008
y.create.l HWIO_WCSS_A_CCU_CCU_MB0_CONTROL_COUNTERS_ADDR A:0xfb20600c
y.create.l HWIO_WCSS_A_CCU_CCU_MB1_CONTROL_ADDR A:0xfb206010
y.create.l HWIO_WCSS_A_CCU_CCU_MB1_CONTROL_COUNTERS_ADDR A:0xfb206014
y.create.l HWIO_WCSS_A_CCU_CCU_MB2_CONTROL_ADDR A:0xfb206018
y.create.l HWIO_WCSS_A_CCU_CCU_MB2_CONTROL_COUNTERS_ADDR A:0xfb20601c
y.create.l HWIO_WCSS_A_CCU_CCU_MB3_CONTROL_ADDR A:0xfb206020
y.create.l HWIO_WCSS_A_CCU_CCU_MB3_CONTROL_COUNTERS_ADDR A:0xfb206024
y.create.l HWIO_WCSS_A_CCU_CCU_MB4_CONTROL_ADDR A:0xfb206028
y.create.l HWIO_WCSS_A_CCU_CCU_MB4_CONTROL_COUNTERS_ADDR A:0xfb20602c
y.create.l HWIO_WCSS_A_CCU_CCU_MB5_CONTROL_ADDR A:0xfb206030
y.create.l HWIO_WCSS_A_CCU_CCU_MB5_CONTROL_COUNTERS_ADDR A:0xfb206034
y.create.l HWIO_WCSS_A_CCU_CCU_MB6_CONTROL_ADDR A:0xfb206038
y.create.l HWIO_WCSS_A_CCU_CCU_MB6_CONTROL_COUNTERS_ADDR A:0xfb20603c
y.create.l HWIO_WCSS_A_CCU_CCU_MB7_CONTROL_ADDR A:0xfb206040
y.create.l HWIO_WCSS_A_CCU_CCU_MB7_CONTROL_COUNTERS_ADDR A:0xfb206044
y.create.l HWIO_WCSS_A_CCU_CCU_MUTEX0_ADDR A:0xfb2060b0
y.create.l HWIO_WCSS_A_CCU_CCU_MUTEX1_ADDR A:0xfb2060b4
y.create.l HWIO_WCSS_A_CCU_CCU_MUTEX2_ADDR A:0xfb2060b8
y.create.l HWIO_WCSS_A_CCU_CCU_MUTEX3_ADDR A:0xfb2060bc
y.create.l HWIO_WCSS_A_CCU_CCU_MUTEX4_ADDR A:0xfb2060c0
y.create.l HWIO_WCSS_A_CCU_CCU_MUTEX5_ADDR A:0xfb2060c4
y.create.l HWIO_WCSS_A_CCU_CCU_MUTEX6_ADDR A:0xfb2060c8
y.create.l HWIO_WCSS_A_CCU_CCU_MUTEX7_ADDR A:0xfb2060cc
y.create.l HWIO_WCSS_A_CCU_CCU_TRACE_CONTROL1_ADDR A:0xfb20507c
y.create.l HWIO_WCSS_A_CCU_CCU_TRACE_CONTROL2_ADDR A:0xfb205080
y.create.l HWIO_WCSS_A_CCU_CCU_TRC_WFT_CAPTURE_CTRL_ADDR A:0xfb205084
y.create.l HWIO_WCSS_A_CCU_CCU_TRC_WFT_STATE_CTRL_ADDR A:0xfb205088
y.create.l HWIO_WCSS_A_CCU_CCU_TRC_TS1_CAPTURE_CTRL_ADDR A:0xfb20508c
y.create.l HWIO_WCSS_A_CCU_CCU_TRC_TS1_STATE_CTRL_ADDR A:0xfb205090
y.create.l HWIO_WCSS_A_CCU_CCU_TRC_TS1_TRIGGER_MASK_ADDR A:0xfb205094
y.create.l HWIO_WCSS_A_CCU_CCU_TRC_TS1_TRIGGER_VALUE_ADDR A:0xfb205098
y.create.l HWIO_WCSS_A_CCU_CCU_TRC_TS2_CAPTURE_CTRL_ADDR A:0xfb20509c
y.create.l HWIO_WCSS_A_CCU_CCU_TRC_TS2_STATE_CTRL_ADDR A:0xfb2050a0
y.create.l HWIO_WCSS_A_CCU_CCU_TRC_TS2_TRIGGER_MASK_ADDR A:0xfb2050a4
y.create.l HWIO_WCSS_A_CCU_CCU_TRC_TS2_TRIGGER_VALUE_ADDR A:0xfb2050a8
y.create.l HWIO_WCSS_A_CCU_CCU_TRC_TS3_CAPTURE_CTRL_ADDR A:0xfb2050ac
y.create.l HWIO_WCSS_A_CCU_CCU_TRC_TS3_STATE_CTRL_ADDR A:0xfb2050b0
y.create.l HWIO_WCSS_A_CCU_CCU_TRC_TS3_TRIGGER_MASK_ADDR A:0xfb2050b4
y.create.l HWIO_WCSS_A_CCU_CCU_TRC_TS3_TRIGGER_VALUE_ADDR A:0xfb2050b8
y.create.l HWIO_WCSS_A_CCU_CCU_TRC_TS4_CAPTURE_CTRL_ADDR A:0xfb2050bc
y.create.l HWIO_WCSS_A_CCU_CCU_TRC_TS4_STATE_CTRL_ADDR A:0xfb2050c0
y.create.l HWIO_WCSS_A_CCU_CCU_TRC_TS4_TRIGGER_MASK_ADDR A:0xfb2050c4
y.create.l HWIO_WCSS_A_CCU_CCU_TRC_TS4_TRIGGER_VALUE_ADDR A:0xfb2050c8
y.create.l HWIO_WCSS_A_CCU_CCU_TRC_TS5_CAPTURE_CTRL_ADDR A:0xfb2050cc
y.create.l HWIO_WCSS_A_CCU_CCU_TRC_TS5_STATE_CTRL_ADDR A:0xfb2050d0
y.create.l HWIO_WCSS_A_CCU_CCU_TRC_TS5_TRIGGER_MASK_ADDR A:0xfb2050d4
y.create.l HWIO_WCSS_A_CCU_CCU_TRC_TS5_TRIGGER_VALUE_ADDR A:0xfb2050d8
y.create.l HWIO_WCSS_A_CCU_CCU_DXE_INT_SELECT_ADDR A:0xfb2050dc
y.create.l HWIO_WCSS_A_CCU_CCU_DXE_INT_SELECT_STATUS_ADDR A:0xfb2050e0
y.create.l HWIO_WCSS_A_CCU_CCU_ASIC_INT_ENABLE_ADDR A:0xfb2050e4
y.create.l HWIO_WCSS_A_CCU_CCU_ASIC_INT_STATUS_ADDR A:0xfb2050e8
y.create.l HWIO_WCSS_A_CCU_TESTMUX_CONTROL1_ADDR A:0xfb2050ec
y.create.l HWIO_WCSS_A_CCU_TESTMUX_CONTROL2_ADDR A:0xfb2050f0
y.create.l HWIO_WCSS_A_CCU_CCU_CCPU_DBG_STATUS_ADDR A:0xfb2050fc
y.create.l HWIO_WCSS_A_CCU_CCU_TRC_STATUS_ADDR A:0xfb205100
y.create.l HWIO_WCSS_A_CCU_CCU_TRC_TRIG_SAMPLE_ADDR A:0xfb205104
y.create.l HWIO_WCSS_A_CCU_CCU_TRC_RD_ADDR_ADDR A:0xfb205108
y.create.l HWIO_WCSS_A_CCU_SLP_CALIB_CYCLES_REG_ADDR A:0xfb20510c
y.create.l HWIO_WCSS_A_CCU_SLP_CALIB_CTL_REG_ADDR A:0xfb205110
y.create.l HWIO_WCSS_A_CCU_SLP_CALIB_DONE_REG_ADDR A:0xfb205114
y.create.l HWIO_WCSS_A_CCU_SLP_CALIB_CNT_AHB_PER_SLP_REG_ADDR A:0xfb205118
y.create.l HWIO_WCSS_A_CCU_AOWBR_TIMEOUT_ADDR_REG_ADDR A:0xfb20511c
y.create.l HWIO_WCSS_A_CCU_AOWBR_ERR_TIMEOUT_FLAGS_REG_ADDR A:0xfb205120
y.create.l HWIO_WCSS_A_CCU_UART_UART_RBR_ADDR A:0xfb207000
y.create.l HWIO_WCSS_A_CCU_UART_UART_DLH_ADDR A:0xfb207004
y.create.l HWIO_WCSS_A_CCU_UART_UART_IIR_ADDR A:0xfb207008
y.create.l HWIO_WCSS_A_CCU_UART_UART_LCR_ADDR A:0xfb20700c
y.create.l HWIO_WCSS_A_CCU_UART_UART_MCR_ADDR A:0xfb207010
y.create.l HWIO_WCSS_A_CCU_UART_UART_LSR_ADDR A:0xfb207014
y.create.l HWIO_WCSS_A_CCU_UART_UART_MSR_ADDR A:0xfb207018
y.create.l HWIO_WCSS_A_CCU_UART_UART_SCRATCH_ADDR A:0xfb20701c
y.create.l HWIO_WCSS_A_CCU_UART_UART_FAR_ADDR A:0xfb207070
y.create.l HWIO_WCSS_A_CCU_UART_UART_USR_ADDR A:0xfb20707c
y.create.l HWIO_WCSS_A_CCU_UART_UART_HTX_ADDR A:0xfb2070a4
y.create.l HWIO_WCSS_A_CCU_UART_UART_DMASA_ADDR A:0xfb2070a8
y.create.l HWIO_WCSS_A_CDAHB_CDAHB_RRI_PL_ADDR A:0xfb100000
y.create.l HWIO_WCSS_A_CDAHB_CDAHB_FDBR_PL_ADDR A:0xfb100004
y.create.l HWIO_WCSS_A_CDAHB_CDAHB_CCPU_PL_ADDR A:0xfb100008
y.create.l HWIO_WCSS_A_CDAHB_CDAHB_DBR_PL_ADDR A:0xfb10000c
y.create.l HWIO_WCSS_A_CDAHB_CDAHB_A2AB_PL_ADDR A:0xfb100010
y.create.l HWIO_WCSS_A_CDAHB_CDAHB_DXE_PL_ADDR A:0xfb100014
y.create.l HWIO_WCSS_A_CDAHB_CDAHB_DFLT_MST_ADDR A:0xfb100048
y.create.l HWIO_WCSS_A_CDAHB_CDAHB_VERSION_ADDR A:0xfb100090
y.create.l HWIO_WCSS_A_CFG_CSI_TEMPLATE_DW0_ADDR A:0xfb141000
y.create.l HWIO_WCSS_A_CFG_CSI_TEMPLATE_MEM_ADDR A:0xfb141004
y.create.l HWIO_WCSS_A_CFG_CFG_STALL_TIMEOUT_ADDR A:0xfb141844
y.create.l HWIO_WCSS_A_CFG_CFG_CONFIG_ADDR A:0xfb141848
y.create.l HWIO_WCSS_A_CFG_STALL_TIMEOUT_PHY_ABORT_CNT_ADDR A:0xfb14184c
y.create.l HWIO_WCSS_A_CFG_CFG_TESTBUS_LOWER_ADDR A:0xfb141850
y.create.l HWIO_WCSS_A_CFG_CFG_TESTBUS_UPPER_ADDR A:0xfb141854
y.create.l HWIO_WCSS_A_CFG_CFG_SM_STATE_ADDR A:0xfb141858
y.create.l HWIO_WCSS_A_CFG_CFG_TPE_INFO_CNT_ADDR A:0xfb14185c
y.create.l HWIO_WCSS_A_DAHB_DAHB_DPUW_PL_ADDR A:0xfb120000
y.create.l HWIO_WCSS_A_DAHB_DAHB_DPUR_PL_ADDR A:0xfb120004
y.create.l HWIO_WCSS_A_DAHB_DAHB_BMUW_PL_ADDR A:0xfb120008
y.create.l HWIO_WCSS_A_DAHB_DAHB_BMUR_PL_ADDR A:0xfb12000c
y.create.l HWIO_WCSS_A_DAHB_DAHB_ADU_PL_ADDR A:0xfb120010
y.create.l HWIO_WCSS_A_DAHB_DAHB_DBR_PL_ADDR A:0xfb120014
y.create.l HWIO_WCSS_A_DAHB_DAHB_CSU_PL_ADDR A:0xfb120018
y.create.l HWIO_WCSS_A_DAHB_DAHB_DFLT_MST_ADDR A:0xfb120048
y.create.l HWIO_WCSS_A_DAHB_DAHB_VERSION_ADDR A:0xfb120090
y.create.l HWIO_WCSS_A_DPU_DPU_TXPKTCOUNT_ADDR A:0xfb081800
y.create.l HWIO_WCSS_A_DPU_DPU_RXPKTCOUNT_ADDR A:0xfb081804
y.create.l HWIO_WCSS_A_DPU_DPU_BASE_ADDR_ADDR A:0xfb08180c
y.create.l HWIO_WCSS_A_DPU_DPU_KEYBASE_ADDR_ADDR A:0xfb081810
y.create.l HWIO_WCSS_A_DPU_DPU_MICKEYBASE_ADDR_ADDR A:0xfb081814
y.create.l HWIO_WCSS_A_DPU_DPU_RCBASE_ADDR_ADDR A:0xfb081818
y.create.l HWIO_WCSS_A_DPU_DPU_CONTROL_ADDR A:0xfb08181c
y.create.l HWIO_WCSS_A_DPU_DPU_INTERRUPT_MASK_ADDR A:0xfb081820
y.create.l HWIO_WCSS_A_DPU_DPU_INTERRUPT_STATUS_ADDR A:0xfb081824
y.create.l HWIO_WCSS_A_DPU_DPU_BIP_MMIE_ADDR A:0xfb081828
y.create.l HWIO_WCSS_A_DPU_DPU_WATCHDOG_ADDR A:0xfb081848
y.create.l HWIO_WCSS_A_DPU_DPU_BD_IN_COUNTS_ADDR A:0xfb08184c
y.create.l HWIO_WCSS_A_DPU_DPU_BD_OUT_COUNTS_ADDR A:0xfb081850
y.create.l HWIO_WCSS_A_DPU_DPU_WQ_3_RESERVE_ADDR A:0xfb081854
y.create.l HWIO_WCSS_A_DPU_DPU_WQ_5_RESERVE_ADDR A:0xfb08185c
y.create.l HWIO_WCSS_A_DPU_DPU_WQ_6_RESERVE_ADDR A:0xfb081860
y.create.l HWIO_WCSS_A_DPU_DPU_WQ_7_RESERVE_ADDR A:0xfb081864
y.create.l HWIO_WCSS_A_DPU_DPU_ERROR_WQ_ADDR A:0xfb081874
y.create.l HWIO_WCSS_A_DPU_DPU_ERROR_WQ_SELECT_ADDR A:0xfb081878
y.create.l HWIO_WCSS_A_DPU_DPU_ERROR_WQ_COUNT_ADDR A:0xfb08187c
y.create.l HWIO_WCSS_A_DPU_DPU_FRAG_COUNT_ADDR A:0xfb081880
y.create.l HWIO_WCSS_A_DPU_DPU_DBG_TESTBUS_HI_ADDR A:0xfb081884
y.create.l HWIO_WCSS_A_DPU_DPU_DBG_TESTBUS_LO_ADDR A:0xfb081888
y.create.l HWIO_WCSS_A_DPU_DPU_DBG_WQ_AVAIL_ADDR A:0xfb08188c
y.create.l HWIO_WCSS_A_DPU_DPU_DBG_WQ_ALLOW_ADDR A:0xfb081890
y.create.l HWIO_WCSS_A_DPU_DPU_DBG_SM_STATE_ADDR A:0xfb081894
y.create.l HWIO_WCSS_A_DPU_DPU_DBG_BUF_FILL_ADDR A:0xfb081898
y.create.l HWIO_WCSS_A_DPU_DPU_DBG_BD_DPU_WORD0_ADDR A:0xfb08189c
y.create.l HWIO_WCSS_A_DPU_DPU_DBG_BD_DPU_WORD2_ADDR A:0xfb0818a0
y.create.l HWIO_WCSS_A_DPU_DPU_DBG_BD_DPU_WORD3_ADDR A:0xfb0818a4
y.create.l HWIO_WCSS_A_DPU_DPU_DBG_BD_DPU_WORD4_ADDR A:0xfb0818a8
y.create.l HWIO_WCSS_A_DPU_DPU_DBG_BD_DPU_WORD5_ADDR A:0xfb0818ac
y.create.l HWIO_WCSS_A_DPU_DPU_DBG_DD_WORD_0_ADDR A:0xfb0818d0
y.create.l HWIO_WCSS_A_DPU_DPU_DBG_DD_WORD_1_ADDR A:0xfb0818d4
y.create.l HWIO_WCSS_A_DPU_DPU_DBG_DD_WORD_2_ADDR A:0xfb0818d8
y.create.l HWIO_WCSS_A_DPU_DPU_DBG_DD_WORD_3_ADDR A:0xfb0818dc
y.create.l HWIO_WCSS_A_DPU_DPU_DBG_DD_WORD_4_ADDR A:0xfb0818e0
y.create.l HWIO_WCSS_A_DPU_DPU_WAPIMICKEYBASE_ADDR_ADDR A:0xfb0818e4
y.create.l HWIO_WCSS_A_DPU_DPU_BUG_FIX_ADDR A:0xfb0818e8
y.create.l HWIO_WCSS_A_DPU_DPU_AES_MASK_ADDR A:0xfb0818ec
y.create.l HWIO_WCSS_A_DPU_DPU_TKIP_MASK_ADDR A:0xfb0818f0
y.create.l HWIO_WCSS_A_DPU_DPU_SEQUENCE_NO_ADDR A:0xfb0818f4
y.create.l HWIO_WCSS_A_DPU_DPU_ROUTING_FLAG_ADDR A:0xfb0818f8
y.create.l HWIO_WCSS_A_DPU_DPU_HOST_WAKEUP_STATUS_MAGICBD_ADDR A:0xfb0818fc
y.create.l HWIO_WCSS_A_DPU_DPU_WOW_CONFIG_ADDR A:0xfb081900
y.create.l HWIO_WCSS_A_DPU_DPU_WOW_TIMERS_ADDR A:0xfb081904
y.create.l HWIO_WCSS_A_DPU_DPU_WOW_MAGIC_PACKET_HI_ADDR A:0xfb081908
y.create.l HWIO_WCSS_A_DPU_DPU_WOW_MAGIC_PACKET_LO_ADDR A:0xfb08190c
y.create.l HWIO_WCSS_A_DPU_WOW_FOUND_MAGIC_COUNTER_ADDR A:0xfb081910
y.create.l HWIO_WCSS_A_DPU_WOW_WAITING4MAGIC_COUNTER_ADDR A:0xfb081914
y.create.l HWIO_WCSS_A_DPU_WAPI_STA_KEY_INDEX_VALUES_ADDR A:0xfb081918
y.create.l HWIO_WCSS_A_DPU_WAPI_STA0_KEY_INDEXES_ADDR A:0xfb081920
y.create.l HWIO_WCSS_A_DPU_WAPI_STA1_KEY_INDEXES_ADDR A:0xfb081924
y.create.l HWIO_WCSS_A_DPU_WAPI_STA2_KEY_INDEXES_ADDR A:0xfb081928
y.create.l HWIO_WCSS_A_DPU_WAPI_STA3_KEY_INDEXES_ADDR A:0xfb08192c
y.create.l HWIO_WCSS_A_DPU_WAPI_STA4_KEY_INDEXES_ADDR A:0xfb081930
y.create.l HWIO_WCSS_A_DPU_WAPI_STA5_KEY_INDEXES_ADDR A:0xfb081934
y.create.l HWIO_WCSS_A_DPU_WAPI_STA6_KEY_INDEXES_ADDR A:0xfb081938
y.create.l HWIO_WCSS_A_DPU_WAPI_STA7_KEY_INDEXES_ADDR A:0xfb08193c
y.create.l HWIO_WCSS_A_DPU_WAPI_STA8_KEY_INDEXES_ADDR A:0xfb081940
y.create.l HWIO_WCSS_A_DPU_WAPI_STA9_KEY_INDEXES_ADDR A:0xfb081944
y.create.l HWIO_WCSS_A_DPU_WAPI_STA10_KEY_INDEXES_ADDR A:0xfb081948
y.create.l HWIO_WCSS_A_DPU_WAPI_STA11_KEY_INDEXES_ADDR A:0xfb08194c
y.create.l HWIO_WCSS_A_DPU_WAPI_STA12_KEY_INDEXES_ADDR A:0xfb081950
y.create.l HWIO_WCSS_A_DPU_WAPI_STA13_KEY_INDEXES_ADDR A:0xfb081954
y.create.l HWIO_WCSS_A_DPU_WAPI_STA14_KEY_INDEXES_ADDR A:0xfb081958
y.create.l HWIO_WCSS_A_DPU_WAPI_STA15_KEY_INDEXES_ADDR A:0xfb08195c
y.create.l HWIO_WCSS_A_DPU_WAPI_PN_CONFIG_ADDR A:0xfb081964
y.create.l HWIO_WCSS_A_FDAHB_FDAHB_RXP_PL_ADDR A:0xfb140000
y.create.l HWIO_WCSS_A_FDAHB_FDAHB_TXP_PL_ADDR A:0xfb140004
y.create.l HWIO_WCSS_A_FDAHB_FDAHB_TPE_PL_ADDR A:0xfb140008
y.create.l HWIO_WCSS_A_FDAHB_FDAHB_FDBR_PL_ADDR A:0xfb14000c
y.create.l HWIO_WCSS_A_FDAHB_FDAHB_RPE_PL_ADDR A:0xfb140010
y.create.l HWIO_WCSS_A_FDAHB_FDAHB_DFLT_MST_ADDR A:0xfb140048
y.create.l HWIO_WCSS_A_FDAHB_FDAHB_VERSION_ADDR A:0xfb140090
y.create.l HWIO_WCSS_A_FFT_FFT_RAM_00_0_ADDR A:0xfb00c000
y.create.l HWIO_WCSS_A_FFT_FFT_RAM_01_0_ADDR A:0xfb00c008
y.create.l HWIO_WCSS_A_FFT_FFT_RAM_02_0_ADDR A:0xfb00c010
y.create.l HWIO_WCSS_A_FFT_FFT_RAM_03_0_ADDR A:0xfb00c018
y.create.l HWIO_WCSS_A_FFT_FFT_RAM_04_0_ADDR A:0xfb00c020
y.create.l HWIO_WCSS_A_FFT_FFT_RAM_05_0_ADDR A:0xfb00c028
y.create.l HWIO_WCSS_A_FFT_FFT_RAM_06_0_ADDR A:0xfb00c030
y.create.l HWIO_WCSS_A_FFT_FFT_RAM_07_0_ADDR A:0xfb00c038
y.create.l HWIO_WCSS_A_FFT_FFT_RAM_08_0_ADDR A:0xfb00c040
y.create.l HWIO_WCSS_A_FFT_FFT_RAM_09_0_ADDR A:0xfb00c048
y.create.l HWIO_WCSS_A_FFT_FFT_RAM_00_1_ADDR A:0xfb00c004
y.create.l HWIO_WCSS_A_FFT_FFT_RAM_01_1_ADDR A:0xfb00c00c
y.create.l HWIO_WCSS_A_FFT_FFT_RAM_02_1_ADDR A:0xfb00c014
y.create.l HWIO_WCSS_A_FFT_FFT_RAM_03_1_ADDR A:0xfb00c01c
y.create.l HWIO_WCSS_A_FFT_FFT_RAM_04_1_ADDR A:0xfb00c024
y.create.l HWIO_WCSS_A_FFT_FFT_RAM_05_1_ADDR A:0xfb00c02c
y.create.l HWIO_WCSS_A_FFT_FFT_RAM_06_1_ADDR A:0xfb00c034
y.create.l HWIO_WCSS_A_FFT_FFT_RAM_07_1_ADDR A:0xfb00c03c
y.create.l HWIO_WCSS_A_FFT_FFT_RAM_08_1_ADDR A:0xfb00c044
y.create.l HWIO_WCSS_A_FFT_FFT_RAM_09_1_ADDR A:0xfb00c04c
y.create.l HWIO_WCSS_A_FFT_FFT_RAM_10_0_ADDR A:0xfb00c800
y.create.l HWIO_WCSS_A_FFT_FFT_RAM_11_0_ADDR A:0xfb00c808
y.create.l HWIO_WCSS_A_FFT_FFT_RAM_12_0_ADDR A:0xfb00c810
y.create.l HWIO_WCSS_A_FFT_FFT_RAM_13_0_ADDR A:0xfb00c818
y.create.l HWIO_WCSS_A_FFT_FFT_RAM_14_0_ADDR A:0xfb00c820
y.create.l HWIO_WCSS_A_FFT_FFT_RAM_15_0_ADDR A:0xfb00c828
y.create.l HWIO_WCSS_A_FFT_FFT_RAM_16_0_ADDR A:0xfb00c830
y.create.l HWIO_WCSS_A_FFT_FFT_RAM_17_0_ADDR A:0xfb00c838
y.create.l HWIO_WCSS_A_FFT_FFT_RAM_18_0_ADDR A:0xfb00c840
y.create.l HWIO_WCSS_A_FFT_FFT_RAM_19_0_ADDR A:0xfb00c848
y.create.l HWIO_WCSS_A_FFT_FFT_RAM_10_1_ADDR A:0xfb00c804
y.create.l HWIO_WCSS_A_FFT_FFT_RAM_11_1_ADDR A:0xfb00c80c
y.create.l HWIO_WCSS_A_FFT_FFT_RAM_12_1_ADDR A:0xfb00c814
y.create.l HWIO_WCSS_A_FFT_FFT_RAM_13_1_ADDR A:0xfb00c81c
y.create.l HWIO_WCSS_A_FFT_FFT_RAM_14_1_ADDR A:0xfb00c824
y.create.l HWIO_WCSS_A_FFT_FFT_RAM_15_1_ADDR A:0xfb00c82c
y.create.l HWIO_WCSS_A_FFT_FFT_RAM_16_1_ADDR A:0xfb00c834
y.create.l HWIO_WCSS_A_FFT_FFT_RAM_17_1_ADDR A:0xfb00c83c
y.create.l HWIO_WCSS_A_FFT_FFT_RAM_18_1_ADDR A:0xfb00c844
y.create.l HWIO_WCSS_A_FFT_FFT_RAM_19_1_ADDR A:0xfb00c84c
y.create.l HWIO_WCSS_A_FFT_APB_ACCESS_ADDR A:0xfb00d000
y.create.l HWIO_WCSS_A_FFT_FFT_TOGGLE_ADDR A:0xfb00d004
y.create.l HWIO_WCSS_A_MCU_BD_PDU_BASE_ADDR_ADDR A:0xfb080c00
y.create.l HWIO_WCSS_A_MCU_MLC_CONTROL_ADDR A:0xfb080c04
y.create.l HWIO_WCSS_A_MCU_DBR_STATUS_ADDR A:0xfb080c0c
y.create.l HWIO_WCSS_A_MCU_MCPU_TO_HOST_MB_INT_STAT_ADDR A:0xfb080c10
y.create.l HWIO_WCSS_A_MCU_HOST_TO_MCPU_MB_INT_STAT_ADDR A:0xfb080c14
y.create.l HWIO_WCSS_A_MCU_MB0_CONTROL_ADDR A:0xfb080c18
y.create.l HWIO_WCSS_A_MCU_MB0_CONTROL_COUNTERS_ADDR A:0xfb080c1c
y.create.l HWIO_WCSS_A_MCU_MB1_CONTROL_ADDR A:0xfb080c20
y.create.l HWIO_WCSS_A_MCU_MB1_CONTROL_COUNTERS_ADDR A:0xfb080c24
y.create.l HWIO_WCSS_A_MCU_MB2_CONTROL_ADDR A:0xfb080c28
y.create.l HWIO_WCSS_A_MCU_MB2_CONTROL_COUNTERS_ADDR A:0xfb080c2c
y.create.l HWIO_WCSS_A_MCU_MB3_CONTROL_ADDR A:0xfb080c30
y.create.l HWIO_WCSS_A_MCU_MB3_CONTROL_COUNTERS_ADDR A:0xfb080c34
y.create.l HWIO_WCSS_A_MCU_MUTEX0_ADDR A:0xfb080c98
y.create.l HWIO_WCSS_A_MCU_MUTEX1_ADDR A:0xfb080c9c
y.create.l HWIO_WCSS_A_MCU_MUTEX2_ADDR A:0xfb080ca0
y.create.l HWIO_WCSS_A_MCU_MUTEX3_ADDR A:0xfb080ca4
y.create.l HWIO_WCSS_A_MCU_SOFT_RESET_ADDR A:0xfb080cb8
y.create.l HWIO_WCSS_A_MCU_MAC_CLK_GATING_ENABLE_ADDR A:0xfb080cbc
y.create.l HWIO_WCSS_A_MCU_MAC_TESTBUS_CONTROL_ADDR A:0xfb080cc0
y.create.l HWIO_WCSS_A_MCU_MAC_FPGA_VERSION_ADDR A:0xfb080cc4
y.create.l HWIO_WCSS_A_MCU_MAC_MODULES_ROOT_CLK_ENABLES_ADDR A:0xfb080cd4
y.create.l HWIO_WCSS_A_MCU_MAC_MODULES_GOTO_IDLE_CONTROL_ADDR A:0xfb080cd8
y.create.l HWIO_WCSS_A_MCU_MAC_TESTBUS_LOW_ADDR A:0xfb080cdc
y.create.l HWIO_WCSS_A_MCU_MAC_TESTBUS_HIGH_ADDR A:0xfb080ce0
y.create.l HWIO_WCSS_A_MCU_APB2PHY_STATUS_ADDR A:0xfb080cec
y.create.l HWIO_WCSS_A_MCU_MLC_STATUS_ADDR A:0xfb080cf0
y.create.l HWIO_WCSS_A_MCU_RF_WARMUP_CONTROL_ADDR A:0xfb080d00
y.create.l HWIO_WCSS_A_MCU_BTC_ADDR A:0xfb080d04
y.create.l HWIO_WCSS_A_MCU_RF_ON_OFF_CONTROL_ADDR A:0xfb080d08
y.create.l HWIO_WCSS_A_MCU_DEBUGC_CONTROL_ADDR A:0xfb080d94
y.create.l HWIO_WCSS_A_MCU_DABH_MIF_PRIORITY_GENERATION_CONTROL_ADDR A:0xfb080e10
y.create.l HWIO_WCSS_A_MCU_BTC_CTRL_ADDR A:0xfb080e14
y.create.l HWIO_WCSS_A_MCU_BTC_CTRL2_ADDR A:0xfb080e18
y.create.l HWIO_WCSS_A_MCU_BTC_CTRL3_ADDR A:0xfb080e1c
y.create.l HWIO_WCSS_A_MCU_BTC_STATUS_ADDR A:0xfb080e20
y.create.l HWIO_WCSS_A_MCU_BTC_STATUS2_ADDR A:0xfb080e24
y.create.l HWIO_WCSS_A_MCU_BTC_FRAME1_STATUS_ADDR A:0xfb080e2c
y.create.l HWIO_WCSS_A_MCU_BTC_FRAME2_STATUS_ADDR A:0xfb080e30
y.create.l HWIO_WCSS_A_MCU_FIQ_EN_ADDR A:0xfb080e38
y.create.l HWIO_WCSS_A_MCU_FIQ_STATUS_ADDR A:0xfb080e3c
y.create.l HWIO_WCSS_A_MCU_FIQ_MASKED_STATUS_ADDR A:0xfb080e40
y.create.l HWIO_WCSS_A_MCU_FIQ_CLEAR_ADDR A:0xfb080e44
y.create.l HWIO_WCSS_A_MCU_IRQ_EN_ADDR A:0xfb080e48
y.create.l HWIO_WCSS_A_MCU_IRQ_STATUS_ADDR A:0xfb080e4c
y.create.l HWIO_WCSS_A_MCU_IRQ_MASKED_STATUS_ADDR A:0xfb080e50
y.create.l HWIO_WCSS_A_MCU_IRQ_CLEAR_ADDR A:0xfb080e54
y.create.l HWIO_WCSS_A_MCU_MTU_INT_EN_ADDR A:0xfb080e58
y.create.l HWIO_WCSS_A_MCU_MTU_INT_STATUS_ADDR A:0xfb080e5c
y.create.l HWIO_WCSS_A_MCU_MTU_INT_MASKED_STATUS_ADDR A:0xfb080e60
y.create.l HWIO_WCSS_A_MCU_MTU_INT_CLEAR_ADDR A:0xfb080e64
y.create.l HWIO_WCSS_A_MCU_COMBINED_INT_EN_ADDR A:0xfb080e68
y.create.l HWIO_WCSS_A_MCU_COMBINED_INT_STATUS_ADDR A:0xfb080e6c
y.create.l HWIO_WCSS_A_MCU_COMBINED_INT_MASKED_STATUS_ADDR A:0xfb080e70
y.create.l HWIO_WCSS_A_MCU_COMBINED_INT_CLEAR_ADDR A:0xfb080e74
y.create.l HWIO_WCSS_A_MCU_BMU_WQ_INT_EN_ADDR A:0xfb080e78
y.create.l HWIO_WCSS_A_MCU_BMU_WQ_INT_STATUS_ADDR A:0xfb080e7c
y.create.l HWIO_WCSS_A_MCU_BMU_WQ_INT_MASKED_STATUS_ADDR A:0xfb080e80
y.create.l HWIO_WCSS_A_MCU_BMU_WQ_INT_CLEAR_ADDR A:0xfb080e84
y.create.l HWIO_WCSS_A_MCU_SW_INT_0_ADDR A:0xfb080e98
y.create.l HWIO_WCSS_A_MCU_SW_INT_1_ADDR A:0xfb080e9c
y.create.l HWIO_WCSS_A_MCU_MCU_HOST_INT_EN_ADDR A:0xfb080ea0
y.create.l HWIO_WCSS_A_MCU_MCU_HOST_INT_STATUS_ADDR A:0xfb080ea4
y.create.l HWIO_WCSS_A_MCU_MCU_HOST_INT_MASKED_STATUS_ADDR A:0xfb080ea8
y.create.l HWIO_WCSS_A_MCU_MCU_HOST_INT_CLEAR_ADDR A:0xfb080eac
y.create.l HWIO_WCSS_A_MCU_MCU_PMU_INFO_ADDR A:0xfb080eb0
y.create.l HWIO_WCSS_A_MCU_MCU_WMAC_STATUS_ADDR A:0xfb080eb4
y.create.l HWIO_WCSS_A_MCU_MAC_HOST_INT_EN_ADDR A:0xfb080eb8
y.create.l HWIO_WCSS_A_MCU_MAC_HOST_INT_STATUS_ADDR A:0xfb080ebc
y.create.l HWIO_WCSS_A_MCU_MAC_HOST_INT_MASKED_STATUS_ADDR A:0xfb080ec0
y.create.l HWIO_WCSS_A_MCU_MAC_HOST_INT_CLEAR_ADDR A:0xfb080ec4
y.create.l HWIO_WCSS_A_MCU_MTU_HOST_INT_EN_ADDR A:0xfb080ec8
y.create.l HWIO_WCSS_A_MCU_MTU_HOST_INT_MASKED_STATUS_ADDR A:0xfb080ecc
y.create.l HWIO_WCSS_A_MCU_COMBINED_HOST_INT_EN_ADDR A:0xfb080ed0
y.create.l HWIO_WCSS_A_MCU_COMBINED_HOST_INT_MASKED_STATUS_ADDR A:0xfb080ed4
y.create.l HWIO_WCSS_A_MCU_BMU_WQ_HOST_INT_EN_ADDR A:0xfb080ed8
y.create.l HWIO_WCSS_A_MCU_BMU_WQ_HOST_INT_MASKED_STATUS_ADDR A:0xfb080edc
y.create.l HWIO_WCSS_A_MCU_MTU_TIMER_INTERRUPT_SOURCE_ADDR A:0xfb080ee0
y.create.l HWIO_WCSS_A_MCU_BTC_CTRL4_ADDR A:0xfb080f00
y.create.l HWIO_WCSS_A_MCU_BTC_PATTERN_DET1_ADDR A:0xfb080f04
y.create.l HWIO_WCSS_A_MCU_BTC_PATTERN_DET2_ADDR A:0xfb080f08
y.create.l HWIO_WCSS_A_MCU_BTC_PATTERN_HISTORY_ADDR A:0xfb080f0c
y.create.l HWIO_WCSS_A_MCU_BTC_HI_GRANT_ADDR A:0xfb080f10
y.create.l HWIO_WCSS_A_MCU_BTC_LOW_GRANT_ADDR A:0xfb080f14
y.create.l HWIO_WCSS_A_MCU_BTC_REQ_CNT_ADDR A:0xfb080f18
y.create.l HWIO_WCSS_A_MCU_MRCM_CLK_GATE_DISABLE_ADDR A:0xfb080f1c
y.create.l HWIO_WCSS_A_MCU_TXP_BUSY_CNT_ADDR A:0xfb080f20
y.create.l HWIO_WCSS_A_MCU_WLAN_BRIDGE_CTRL_ADDR A:0xfb080f24
y.create.l HWIO_WCSS_A_MCU_BD_PDU_BASE_ADDR_LOCAL_ADDR A:0xfb080f30
y.create.l HWIO_WCSS_A_MCU_CMEM_BDINDEX_THRESHOLD_ADDR A:0xfb080f34
y.create.l HWIO_WCSS_A_MCU_CSU_CONFIGURATION_ADDR A:0xfb080f38
y.create.l HWIO_WCSS_A_MCU_MCU_CSU_NEXTHDR_BITMAP_0_ADDR A:0xfb080f3c
y.create.l HWIO_WCSS_A_MCU_MCU_CSU_NEXTHDR_BITMAP_1_ADDR A:0xfb080f40
y.create.l HWIO_WCSS_A_MCU_MCU_CSU_NEXTHDR_BITMAP_2_ADDR A:0xfb080f44
y.create.l HWIO_WCSS_A_MCU_MCU_CSU_NEXTHDR_BITMAP_3_ADDR A:0xfb080f48
y.create.l HWIO_WCSS_A_MCU_MCU_CSU_NEXTHDR_BITMAP_4_ADDR A:0xfb080f4c
y.create.l HWIO_WCSS_A_MCU_MCU_CSU_NEXTHDR_BITMAP_5_ADDR A:0xfb080f50
y.create.l HWIO_WCSS_A_MCU_MCU_CSU_NEXTHDR_BITMAP_6_ADDR A:0xfb080f54
y.create.l HWIO_WCSS_A_MCU_MCU_CSU_NEXTHDR_BITMAP_7_ADDR A:0xfb080f58
y.create.l HWIO_WCSS_A_MCU_MCU_CSU_TX_WORK_QUEUES_ADDR A:0xfb080f5c
y.create.l HWIO_WCSS_A_MCU_MCU_CSU_TX_DEBUG_COUNTERS1_ADDR A:0xfb080f60
y.create.l HWIO_WCSS_A_MCU_MCU_CSU_TX_DEBUG_COUNTERS2_ADDR A:0xfb080f64
y.create.l HWIO_WCSS_A_MCU_MCU_CSU_TX_DEBUG_COUNTERS3_ADDR A:0xfb080f68
y.create.l HWIO_WCSS_A_MCU_MCU_CSU_RX_WORK_QUEUES_ADDR A:0xfb080f6c
y.create.l HWIO_WCSS_A_MCU_MCU_CSU_RX_DEBUG_COUNTERS1_ADDR A:0xfb080f70
y.create.l HWIO_WCSS_A_MCU_MCU_CSU_RX_DEBUG_COUNTERS2_ADDR A:0xfb080f74
y.create.l HWIO_WCSS_A_MCU_MCU_CSU_RX_DEBUG_COUNTERS3_ADDR A:0xfb080f78
y.create.l HWIO_WCSS_A_MCU_MCU_CSU_INTERRUPT_ADDR A:0xfb080f7c
y.create.l HWIO_WCSS_A_MCU_MCU_CBR_CCAHB_ERR_ADDR_ADDR A:0xfb080f80
y.create.l HWIO_WCSS_A_MCU_MCU_CBR_CAHB_ERR_ADDR_ADDR A:0xfb080f84
y.create.l HWIO_WCSS_A_MCU_MCU_CBR_CCAHB_TIMEOUT_ADDR_ADDR A:0xfb080f88
y.create.l HWIO_WCSS_A_MCU_MCU_CBR_CAHB_TIMEOUT_ADDR_ADDR A:0xfb080f8c
y.create.l HWIO_WCSS_A_MCU_MCU_DBR_CDAHB_ERR_ADDR_ADDR A:0xfb080f90
y.create.l HWIO_WCSS_A_MCU_MCU_DBR_DAHB_ERR_ADDR_ADDR A:0xfb080f94
y.create.l HWIO_WCSS_A_MCU_MCU_DBR_CDAHB_TIMEOUT_ADDR_ADDR A:0xfb080f98
y.create.l HWIO_WCSS_A_MCU_MCU_DBR_DAHB_TIMEOUT_ADDR_ADDR A:0xfb080f9c
y.create.l HWIO_WCSS_A_MCU_MCU_FDBR_CDAHB_ERR_ADDR_ADDR A:0xfb080fa0
y.create.l HWIO_WCSS_A_MCU_MCU_FDBR_FDAHB_ERR_ADDR_ADDR A:0xfb080fa4
y.create.l HWIO_WCSS_A_MCU_MCU_FDBR_CDAHB_TIMEOUT_ADDR_ADDR A:0xfb080fa8
y.create.l HWIO_WCSS_A_MCU_MCU_FDBR_FDAHB_TIMEOUT_ADDR_ADDR A:0xfb080fac
y.create.l HWIO_WCSS_A_MCU_MCU_WLAN_BRIDGE_ERR_TIMEOUT_SRC_ADDR A:0xfb080fb0
y.create.l HWIO_WCSS_A_MPI_WATCHDOG_MAX_COMMAND1_ADDR A:0xfb013400
y.create.l HWIO_WCSS_A_MPI_WATCHDOG_MAX_COMMAND2_ADDR A:0xfb013404
y.create.l HWIO_WCSS_A_MPI_WATCHDOG_MAX_WAIT_ADDR A:0xfb013408
y.create.l HWIO_WCSS_A_MPI_WATCHDOG_MAX_TRANSFER_ADDR A:0xfb01340c
y.create.l HWIO_WCSS_A_MPI_MAX_REQAORB_ADDR A:0xfb013410
y.create.l HWIO_WCSS_A_MPI_COMMAND2_DELAY_ADDR A:0xfb013414
y.create.l HWIO_WCSS_A_MPI_MPI_ENABLE_ADDR A:0xfb013418
y.create.l HWIO_WCSS_A_MPI_TXP_MPI_START_ADDR A:0xfb01341c
y.create.l HWIO_WCSS_A_MPI_MPI_TXP_REQ_ADDR A:0xfb013420
y.create.l HWIO_WCSS_A_MPI_TXA_MPI_DATA_REQ_ADDR A:0xfb013424
y.create.l HWIO_WCSS_A_MPI_TXB_MPI_DATA_REQ_ADDR A:0xfb013428
y.create.l HWIO_WCSS_A_MPI_TXP_MPI_DATA_VAL_ADDR A:0xfb01342c
y.create.l HWIO_WCSS_A_MPI_MPI_TXA_DATA_VAL_ADDR A:0xfb013430
y.create.l HWIO_WCSS_A_MPI_MPI_TXB_DATA_VAL_ADDR A:0xfb013434
y.create.l HWIO_WCSS_A_MPI_MPI_TXA_LASTBYTE_ADDR A:0xfb013438
y.create.l HWIO_WCSS_A_MPI_MPI_TXA_CW_LASTBYTE_ADDR A:0xfb01343c
y.create.l HWIO_WCSS_A_MPI_MPI_TXA_CW_MAX_PARITY_ADDR A:0xfb013440
y.create.l HWIO_WCSS_A_MPI_MPI_STATE_ADDR A:0xfb013444
y.create.l HWIO_WCSS_A_MPI_STATUS_FLAGS_ADDR A:0xfb013448
y.create.l HWIO_WCSS_A_MPI_REQ_ALARM_ADDR A:0xfb01344c
y.create.l HWIO_WCSS_A_MPI_WATCHDOG_ALARM_ADDR A:0xfb013450
y.create.l HWIO_WCSS_A_MPI_COMMAND_ALARM_ADDR A:0xfb013454
y.create.l HWIO_WCSS_A_MPI_TXP_ABORT_ADDR A:0xfb013458
y.create.l HWIO_WCSS_A_MPI_TXCTL_ABORT_ADDR A:0xfb01345c
y.create.l HWIO_WCSS_A_MTU_DIFS_LIMIT_0TO3_ADDR A:0xfb081400
y.create.l HWIO_WCSS_A_MTU_DIFS_LIMIT_4TO7_ADDR A:0xfb081404
y.create.l HWIO_WCSS_A_MTU_EIFS_PIFS_SLOT_LIMIT_ADDR A:0xfb081408
y.create.l HWIO_WCSS_A_MTU_SW_MTU_BCN_SLOT_USEC_SIFS_LIMIT_ADDR A:0xfb08140c
y.create.l HWIO_WCSS_A_MTU_SW_MTU_MISC_LIMITS_ADDR A:0xfb081410
y.create.l HWIO_WCSS_A_MTU_NAV_CNT_ADDR A:0xfb081414
y.create.l HWIO_WCSS_A_MTU_TSF_TIMER_LO_ADDR A:0xfb081418
y.create.l HWIO_WCSS_A_MTU_TSF_TIMER_HI_ADDR A:0xfb08141c
y.create.l HWIO_WCSS_A_MTU_TIMER_0_ADDR A:0xfb081420
y.create.l HWIO_WCSS_A_MTU_TIMER_1_ADDR A:0xfb081424
y.create.l HWIO_WCSS_A_MTU_TIMER_2_ADDR A:0xfb081428
y.create.l HWIO_WCSS_A_MTU_TIMER_3_ADDR A:0xfb08142c
y.create.l HWIO_WCSS_A_MTU_TIMER_4_ADDR A:0xfb081430
y.create.l HWIO_WCSS_A_MTU_TIMER_5_ADDR A:0xfb081434
y.create.l HWIO_WCSS_A_MTU_TIMER_6_ADDR A:0xfb081438
y.create.l HWIO_WCSS_A_MTU_TIMER_7_ADDR A:0xfb08143c
y.create.l HWIO_WCSS_A_MTU_TIMER_CONTROL_ADDR A:0xfb081440
y.create.l HWIO_WCSS_A_MTU_BKOF_CNT_0_ADDR A:0xfb081444
y.create.l HWIO_WCSS_A_MTU_BKOF_CNT_1_ADDR A:0xfb081448
y.create.l HWIO_WCSS_A_MTU_BKOF_CNT_2_ADDR A:0xfb08144c
y.create.l HWIO_WCSS_A_MTU_BKOF_CNT_3_ADDR A:0xfb081450
y.create.l HWIO_WCSS_A_MTU_BKOF_CNT_4_ADDR A:0xfb081454
y.create.l HWIO_WCSS_A_MTU_BKOF_CNT_5_ADDR A:0xfb081458
y.create.l HWIO_WCSS_A_MTU_BKOF_CNT_6_ADDR A:0xfb08145c
y.create.l HWIO_WCSS_A_MTU_BKOF_CNT_7_ADDR A:0xfb081460
y.create.l HWIO_WCSS_A_MTU_BKOF_CONTROL_ADDR A:0xfb081464
y.create.l HWIO_WCSS_A_MTU_CW_REG_CONTROL_FOR_BACKOFF_0_ADDR A:0xfb081468
y.create.l HWIO_WCSS_A_MTU_CW_REG_CONTROL_FOR_BACKOFF_1_ADDR A:0xfb08146c
y.create.l HWIO_WCSS_A_MTU_CW_REG_CONTROL_FOR_BACKOFF_2_ADDR A:0xfb081470
y.create.l HWIO_WCSS_A_MTU_CW_REG_CONTROL_FOR_BACKOFF_3_ADDR A:0xfb081474
y.create.l HWIO_WCSS_A_MTU_CW_REG_CONTROL_FOR_BACKOFF_4_ADDR A:0xfb081478
y.create.l HWIO_WCSS_A_MTU_CW_REG_CONTROL_FOR_BACKOFF_5_ADDR A:0xfb08147c
y.create.l HWIO_WCSS_A_MTU_CW_REG_CONTROL_FOR_BACKOFF_6_ADDR A:0xfb081480
y.create.l HWIO_WCSS_A_MTU_CW_REG_CONTROL_FOR_BACKOFF_7_ADDR A:0xfb081484
y.create.l HWIO_WCSS_A_MTU_MTU_INTERRUPT_STATUS_ADDR A:0xfb081488
y.create.l HWIO_WCSS_A_MTU_SW_MATCH_REGISTER_0_ADDR A:0xfb08148c
y.create.l HWIO_WCSS_A_MTU_SW_MATCH_REGISTER_1_ADDR A:0xfb081490
y.create.l HWIO_WCSS_A_MTU_SW_MATCH_REGISTER_2_ADDR A:0xfb081494
y.create.l HWIO_WCSS_A_MTU_SW_MATCH_REGISTER_3_ADDR A:0xfb081498
y.create.l HWIO_WCSS_A_MTU_SW_MATCH_REGISTER_4_ADDR A:0xfb08149c
y.create.l HWIO_WCSS_A_MTU_SW_MATCH_REGISTER_5_ADDR A:0xfb0814a0
y.create.l HWIO_WCSS_A_MTU_SW_MATCH_REGISTER_6_ADDR A:0xfb0814a4
y.create.l HWIO_WCSS_A_MTU_SW_MATCH_REGISTER_7_ADDR A:0xfb0814a8
y.create.l HWIO_WCSS_A_MTU_SW_CW_MIN_CW_MAX_0_ADDR A:0xfb0814ac
y.create.l HWIO_WCSS_A_MTU_SW_CW_MIN_CW_MAX_1_ADDR A:0xfb0814b0
y.create.l HWIO_WCSS_A_MTU_SW_CW_MIN_CW_MAX_2_ADDR A:0xfb0814b4
y.create.l HWIO_WCSS_A_MTU_SW_CW_MIN_CW_MAX_3_ADDR A:0xfb0814b8
y.create.l HWIO_WCSS_A_MTU_SW_CW_MIN_CW_MAX_4_ADDR A:0xfb0814bc
y.create.l HWIO_WCSS_A_MTU_SW_CW_MIN_CW_MAX_5_ADDR A:0xfb0814c0
y.create.l HWIO_WCSS_A_MTU_SW_CW_MIN_CW_MAX_6_ADDR A:0xfb0814c4
y.create.l HWIO_WCSS_A_MTU_SW_CW_MIN_CW_MAX_7_ADDR A:0xfb0814c8
y.create.l HWIO_WCSS_A_MTU_CCA_COUNTER0_ADDR A:0xfb0814cc
y.create.l HWIO_WCSS_A_MTU_CCA_COUNTER1_ADDR A:0xfb0814d0
y.create.l HWIO_WCSS_A_MTU_CCA_COUNTER2_ADDR A:0xfb0814d4
y.create.l HWIO_WCSS_A_MTU_WATCH_DOG_TIMER_ADDR A:0xfb0814d8
y.create.l HWIO_WCSS_A_MTU_WATCH_DOG_THR0_ADDR A:0xfb0814dc
y.create.l HWIO_WCSS_A_MTU_WATCH_DOG_THR1_ADDR A:0xfb0814e0
y.create.l HWIO_WCSS_A_MTU_WATCH_DOG_THR2_ADDR A:0xfb0814e4
y.create.l HWIO_WCSS_A_MTU_BKOF_SW_INT_TYPE_ADDR A:0xfb0814e8
y.create.l HWIO_WCSS_A_MTU_CCA_CONTROL_REG_ADDR A:0xfb0814ec
y.create.l HWIO_WCSS_A_MTU_TIMER_8_ADDR A:0xfb0814f0
y.create.l HWIO_WCSS_A_MTU_TIMER_9_ADDR A:0xfb0814f4
y.create.l HWIO_WCSS_A_MTU_TIMER_10_ADDR A:0xfb0814f8
y.create.l HWIO_WCSS_A_MTU_TIMER_11_ADDR A:0xfb0814fc
y.create.l HWIO_WCSS_A_MTU_SW_MATCH_REGISTER_8_ADDR A:0xfb081510
y.create.l HWIO_WCSS_A_MTU_SW_MATCH_REGISTER_9_ADDR A:0xfb081514
y.create.l HWIO_WCSS_A_MTU_SW_MATCH_REGISTER_10_ADDR A:0xfb081518
y.create.l HWIO_WCSS_A_MTU_SW_MATCH_REGISTER_11_ADDR A:0xfb08151c
y.create.l HWIO_WCSS_A_MTU_BKOF_CONTROL2_ADDR A:0xfb081534
y.create.l HWIO_WCSS_A_MTU_CCA_CONTROL_REG2_ADDR A:0xfb081538
y.create.l HWIO_WCSS_A_MTU_TIMER_CONTROL11TO8_ADDR A:0xfb08154c
y.create.l HWIO_WCSS_A_MTU_MTU_GLOBAL_CONTROL_ADDR A:0xfb081550
y.create.l HWIO_WCSS_A_MTU_MTU_INTERRUPT_STATUS11TO8_ADDR A:0xfb081554
y.create.l HWIO_WCSS_A_MTU_MTU_GLOBAL_CONTROL2_ADDR A:0xfb081558
y.create.l HWIO_WCSS_A_MTU_SW_MTU_SHADOW_NAV_CNT_ADDR A:0xfb08155c
y.create.l HWIO_WCSS_A_MTU_PRIMARY_CCA_HISTOGRAM_LO_ADDR A:0xfb081560
y.create.l HWIO_WCSS_A_MTU_PRIMARY_CCA_HISTOGRAM_HI_ADDR A:0xfb081564
y.create.l HWIO_WCSS_A_MTU_SECONDARY_CCA_HISTOGRAM_LO_ADDR A:0xfb081568
y.create.l HWIO_WCSS_A_MTU_SECONDARY_CCA_HISTOGRAM_HI_ADDR A:0xfb08156c
y.create.l HWIO_WCSS_A_MTU_TIMEOUT_LIMIT_ADDR A:0xfb081570
y.create.l HWIO_WCSS_A_MTU_CCA_FINAL_CONTROL_REG_ADDR A:0xfb081574
y.create.l HWIO_WCSS_A_MTU_EARLY_INTERRUPT_LIMITS_ADDR A:0xfb08157c
y.create.l HWIO_WCSS_A_MTU_BTC_CONFIG_REGISTERS_ADDR A:0xfb081580
y.create.l HWIO_WCSS_A_MTU_MTU_TESTBUS_LOW_ADDR A:0xfb081584
y.create.l HWIO_WCSS_A_MTU_MTU_TESTBUS_HIGH_ADDR A:0xfb081588
y.create.l HWIO_WCSS_A_MTU_MTU_FOR_HMAC_CONTROLS_ADDR A:0xfb08158c
y.create.l HWIO_WCSS_A_MTU_MTU_DTIM_CNT_AND_PERIOD_ADDR A:0xfb081590
y.create.l HWIO_WCSS_A_MTU_DTIM_THRSH_CNT_AND_LIMIT_ADDR A:0xfb081594
y.create.l HWIO_WCSS_A_MTU_TBTT_L_ADDR A:0xfb081598
y.create.l HWIO_WCSS_A_MTU_TBTT_H_ADDR A:0xfb08159c
y.create.l HWIO_WCSS_A_MTU_M_TBTT_L_ADDR A:0xfb0815a0
y.create.l HWIO_WCSS_A_MTU_M_TBTT_H_ADDR A:0xfb0815a4
y.create.l HWIO_WCSS_A_MTU_BCN_BSSID_INTV_ADDR A:0xfb0815a8
y.create.l HWIO_WCSS_A_MTU_VALID_BSSID_BITMAP_ADDR A:0xfb0815ac
y.create.l HWIO_WCSS_A_MTU_IBSS_BKOF_CNT_ADDR A:0xfb0815b0
y.create.l HWIO_WCSS_A_MTU_LFSR_DATA_1_0_ADDR A:0xfb0815b4
y.create.l HWIO_WCSS_A_MTU_LFSR_DATA_3_2_ADDR A:0xfb0815b8
y.create.l HWIO_WCSS_A_MTU_LFSR_DATA_5_4_ADDR A:0xfb0815bc
y.create.l HWIO_WCSS_A_MTU_LFSR_DATA_7_6_ADDR A:0xfb0815c0
y.create.l HWIO_WCSS_A_MTU_LONG_SHORT_XMIT_LIMIT_BKOF_3_TO_0_ADDR A:0xfb0815c4
y.create.l HWIO_WCSS_A_MTU_LONG_SHORT_XMIT_LIMIT_BKOF_7_TO_4_ADDR A:0xfb0815c8
y.create.l HWIO_WCSS_A_MTU_WARMUP_LIMIT_ADDR A:0xfb0815cc
y.create.l HWIO_WCSS_A_MTU_ONE_SEC_LIMIT_ADDR A:0xfb0815d0
y.create.l HWIO_WCSS_A_MTU_MTU_GLOBAL_TIMER_ADDR A:0xfb0815d4
y.create.l HWIO_WCSS_A_MTU_TSF_TIMER_FOR_SIM_BSS_LO_ADDR A:0xfb0815d8
y.create.l HWIO_WCSS_A_MTU_TSF_TIMER_FOR_SIM_BSS_HI_ADDR A:0xfb0815dc
y.create.l HWIO_WCSS_A_MTU_SW_MTU_SIFS_LIMIT_FORINNAV_ADDR A:0xfb0815e0
y.create.l HWIO_WCSS_A_MTU_SW_MTU_P2P_GO_TSF_TIMER_LO_ADDR A:0xfb0815e4
y.create.l HWIO_WCSS_A_MTU_SW_MTU_P2P_GO_TSF_TIMER_HI_ADDR A:0xfb0815e8
y.create.l HWIO_WCSS_A_MTU_SW_MTU_P2P_CLIENT_TSF_TIMER_LO_ADDR A:0xfb0815ec
y.create.l HWIO_WCSS_A_MTU_SW_MTU_P2P_CLIENT_TSF_TIMER_HI_ADDR A:0xfb0815f0
y.create.l HWIO_WCSS_A_MTU_SW_MTU_P2P_CTRL_ADDR A:0xfb0815f4
y.create.l HWIO_WCSS_A_MTU_SW_MTU_P2P_TRANSMIT_BOUNDARY_ADDR A:0xfb0815f8
y.create.l HWIO_WCSS_A_MTU_SW_MTU_P2P_WAIT_FOR_BEACON_ADDR A:0xfb0815fc
y.create.l HWIO_WCSS_A_MTU_TERTIARY_CCA_HISTOGRAM_LO_ADDR A:0xfb081600
y.create.l HWIO_WCSS_A_MTU_TERTIARY_CCA_HISTOGRAM_HI_ADDR A:0xfb081604
y.create.l HWIO_WCSS_A_MTU_QUATERNARY_CCA_HISTOGRAM_LO_ADDR A:0xfb081608
y.create.l HWIO_WCSS_A_MTU_QUATERNARY_CCA_HISTOGRAM_HI_ADDR A:0xfb08160c
y.create.l HWIO_WCSS_A_MTU_MTU_CCA_CONTROL_ADDR A:0xfb081610
y.create.l HWIO_WCSS_A_MTU_MTU_CCA_STATUS_ADDR A:0xfb081614
y.create.l HWIO_WCSS_A_MTU_ADD_TSF_TIMER_LO_ADDR A:0xfb081618
y.create.l HWIO_WCSS_A_MTU_ADD_TSF_TIMER_HI_ADDR A:0xfb08161c
y.create.l HWIO_WCSS_A_MTU_TSF_TIMER_CTRL_ADDR A:0xfb081620
y.create.l HWIO_WCSS_A_MTU_MTU_LTE_CXM_TSF_LOW_ADDR A:0xfb081624
y.create.l HWIO_WCSS_A_MTU_MTU_LTE_CXM_TSF_HIGH_ADDR A:0xfb081628
y.create.l HWIO_WCSS_A_MTU_SW_SECONDARY_CCA_HISTOGRAM_MASK_ADDR A:0xfb08162c
y.create.l HWIO_WCSS_A_MTU_SW_TERTIARY_CCA_HISTOGRAM_MASK_ADDR A:0xfb081630
y.create.l HWIO_WCSS_A_MTU_SW_QUATERNARY_CCA_HISTOGRAM_MASK_ADDR A:0xfb081634
y.create.l HWIO_WCSS_A_MTU_SW_CCA_HISTOGRAM_MASK_MISC_ADDR A:0xfb081638
y.create.l HWIO_WCSS_A_MTU_CCA_SECONDARY_HISTOGRAM_ADDR A:0xfb08163c
y.create.l HWIO_WCSS_A_MTU_CCA_TERTIARY_HISTOGRAM_ADDR A:0xfb081640
y.create.l HWIO_WCSS_A_MTU_CCA_QUATERNARY_HISTOGRAM_ADDR A:0xfb081644
y.create.l HWIO_WCSS_A_MTU_MTU_MISC_FOR_TVWS_1_ADDR A:0xfb081648
y.create.l HWIO_WCSS_A_MTU_CCA_COUNTER3_ADDR A:0xfb08164c
y.create.l HWIO_WCSS_A_MTU_CCA_COUNTER4_ADDR A:0xfb081650
y.create.l HWIO_WCSS_A_MTU_CCA_COUNTER5_ADDR A:0xfb081654
y.create.l HWIO_WCSS_A_MTU_BSS2_CLIENT_TSF_TIMER_LO_ADDR A:0xfb081658
y.create.l HWIO_WCSS_A_MTU_BSS2_CLIENT_TSF_TIMER_HI_ADDR A:0xfb08165c
y.create.l HWIO_WCSS_A_MTU_QBOOST_CONTROL_ADDR A:0xfb081660
y.create.l HWIO_WCSS_A_PHYDBG_CFGMODE_ADDR A:0xfb004000
y.create.l HWIO_WCSS_A_PHYDBG_SELTRIG_ADDR A:0xfb004004
y.create.l HWIO_WCSS_A_PHYDBG_RST0_ADDR A:0xfb004008
y.create.l HWIO_WCSS_A_PHYDBG_RST1_ADDR A:0xfb00400c
y.create.l HWIO_WCSS_A_PHYDBG_START0_ADDR A:0xfb004010
y.create.l HWIO_WCSS_A_PHYDBG_START1_ADDR A:0xfb004014
y.create.l HWIO_WCSS_A_PHYDBG_STATUS_ADDR A:0xfb004018
y.create.l HWIO_WCSS_A_PHYDBG_DELAY0_ADDR A:0xfb00401c
y.create.l HWIO_WCSS_A_PHYDBG_TRIGPTR0_ADDR A:0xfb004020
y.create.l HWIO_WCSS_A_PHYDBG_TMUX_STRBQUAL_ADDR A:0xfb004024
y.create.l HWIO_WCSS_A_PHYDBG_CAPT_CFG_ADDR A:0xfb004028
y.create.l HWIO_WCSS_A_PHYDBG_CAPT_CFG2_ADDR A:0xfb00402c
y.create.l HWIO_WCSS_A_PHYDBG_START_TRIGWD0_ADDR A:0xfb004030
y.create.l HWIO_WCSS_A_PHYDBG_END_TRIGWD0_ADDR A:0xfb004034
y.create.l HWIO_WCSS_A_PHYDBG_STOP_TRIGWD0_ADDR A:0xfb004038
y.create.l HWIO_WCSS_A_PHYDBG_START_ADDR0_ADDR A:0xfb00403c
y.create.l HWIO_WCSS_A_PHYDBG_MAX_ADDR0_ADDR A:0xfb004040
y.create.l HWIO_WCSS_A_PHYDBG_START_ADDR1_ADDR A:0xfb004044
y.create.l HWIO_WCSS_A_PHYDBG_MAX_ADDR1_ADDR A:0xfb004048
y.create.l HWIO_WCSS_A_PHYDBG_AGCRST_ADDR A:0xfb00404c
y.create.l HWIO_WCSS_A_PHYDBG_TMUX_STRIG_ADDR A:0xfb004050
y.create.l HWIO_WCSS_A_PHYDBG_TMUX_ETRIG_ADDR A:0xfb004054
y.create.l HWIO_WCSS_A_PHYDBG_PLYBCK_CFG_ADDR A:0xfb004058
y.create.l HWIO_WCSS_A_PHYDBG_PLYBCK_CFG2_ADDR A:0xfb00405c
y.create.l HWIO_WCSS_A_PHYDBG_PRBS_ADDR A:0xfb004060
y.create.l HWIO_WCSS_A_PHYDBG_PRBS_MS_ADDR A:0xfb004064
y.create.l HWIO_WCSS_A_PHYDBG_PRBS_LOAD_ADDR A:0xfb004068
y.create.l HWIO_WCSS_A_PHYDBG_TXPKT_CNT_ADDR A:0xfb00406c
y.create.l HWIO_WCSS_A_PHYDBG_RXPKT_CNT_ADDR A:0xfb004070
y.create.l HWIO_WCSS_A_PHYDBG_CAPTCNT_ADDR A:0xfb004074
y.create.l HWIO_WCSS_A_PHYDBG_POSTTRIGCNT_ADDR A:0xfb004078
y.create.l HWIO_WCSS_A_PHYDBG_WARMUP_DLY_ADDR A:0xfb00407c
y.create.l HWIO_WCSS_A_PHYDBG_RXPKT_FILTER_10_ADDR A:0xfb004080
y.create.l HWIO_WCSS_A_PHYDBG_RXPKT_FILTER_32_ADDR A:0xfb004084
y.create.l HWIO_WCSS_A_PHYDBG_PLYBKCNT_ADDR A:0xfb004088
y.create.l HWIO_WCSS_A_PHYDBG_AMPDU_RXPKT_CNT_ADDR A:0xfb00408c
y.create.l HWIO_WCSS_A_PHYDBG_AUTO_TRIG_PLAYBACK1_ADDR A:0xfb004090
y.create.l HWIO_WCSS_A_PHYDBG_AUTO_TRIG_PLAYBACK_DELAY1_ADDR A:0xfb004094
y.create.l HWIO_WCSS_A_PHYDBG_AUTO_TRIG_PLAYBACK_TIMEOUT_DELAY1_ADDR A:0xfb004098
y.create.l HWIO_WCSS_A_PHYDBG_GPIO_OUT_TRIG_ADDR A:0xfb00409c
y.create.l HWIO_WCSS_A_PHYDBG_AUTO_CAPT_CNT_ADDR A:0xfb0040a0
y.create.l HWIO_WCSS_A_PHYDBG_DBGMEM0_0_ADDR A:0xfb006000
y.create.l HWIO_WCSS_A_PHYDBG_DBGMEM1_0_ADDR A:0xfb006008
y.create.l HWIO_WCSS_A_PHYDBG_DBGMEM2_0_ADDR A:0xfb006010
y.create.l HWIO_WCSS_A_PHYDBG_DBGMEM3_0_ADDR A:0xfb006018
y.create.l HWIO_WCSS_A_PHYDBG_DBGMEM4_0_ADDR A:0xfb006020
y.create.l HWIO_WCSS_A_PHYDBG_DBGMEM5_0_ADDR A:0xfb006028
y.create.l HWIO_WCSS_A_PHYDBG_DBGMEM6_0_ADDR A:0xfb006030
y.create.l HWIO_WCSS_A_PHYDBG_DBGMEM7_0_ADDR A:0xfb006038
y.create.l HWIO_WCSS_A_PHYDBG_DBGMEM8_0_ADDR A:0xfb006040
y.create.l HWIO_WCSS_A_PHYDBG_DBGMEM9_0_ADDR A:0xfb006048
y.create.l HWIO_WCSS_A_PHYDBG_DBGMEM0_1_ADDR A:0xfb006004
y.create.l HWIO_WCSS_A_PHYDBG_DBGMEM1_1_ADDR A:0xfb00600c
y.create.l HWIO_WCSS_A_PHYDBG_DBGMEM2_1_ADDR A:0xfb006014
y.create.l HWIO_WCSS_A_PHYDBG_DBGMEM3_1_ADDR A:0xfb00601c
y.create.l HWIO_WCSS_A_PHYDBG_DBGMEM4_1_ADDR A:0xfb006024
y.create.l HWIO_WCSS_A_PHYDBG_DBGMEM5_1_ADDR A:0xfb00602c
y.create.l HWIO_WCSS_A_PHYDBG_DBGMEM6_1_ADDR A:0xfb006034
y.create.l HWIO_WCSS_A_PHYDBG_DBGMEM7_1_ADDR A:0xfb00603c
y.create.l HWIO_WCSS_A_PHYDBG_DBGMEM8_1_ADDR A:0xfb006044
y.create.l HWIO_WCSS_A_PHYDBG_DBGMEM9_1_ADDR A:0xfb00604c
y.create.l HWIO_WCSS_A_PHYINT_STATUS_ADDR A:0xfb015c00
y.create.l HWIO_WCSS_A_PHYINT_FAST_MASK_ADDR A:0xfb015c04
y.create.l HWIO_WCSS_A_PHYINT_SLOW_MASK_ADDR A:0xfb015c08
y.create.l HWIO_WCSS_A_PHYINT_HOST_MASK_ADDR A:0xfb015c0c
y.create.l HWIO_WCSS_A_PMI_PMI_STATE_ADDR A:0xfb013800
y.create.l HWIO_WCSS_A_PMI_RXA_PKTS_ADDR A:0xfb013804
y.create.l HWIO_WCSS_A_PMI_RXB_PACKETS_ADDR A:0xfb01380c
y.create.l HWIO_WCSS_A_PMI_RXA_DATA_VALID_ADDR A:0xfb013810
y.create.l HWIO_WCSS_A_PMI_RXB_DATA_VALID_ADDR A:0xfb013814
y.create.l HWIO_WCSS_A_PMI_RXP_SHUTOFF_ADDR A:0xfb013818
y.create.l HWIO_WCSS_A_PMI_RXP_MU_EOP_ADDR A:0xfb01381c
y.create.l HWIO_WCSS_A_PMI_PHY_STARTS_ADDR A:0xfb013820
y.create.l HWIO_WCSS_A_PMI_PHY_DATA_VAL_ADDR A:0xfb013824
y.create.l HWIO_WCSS_A_PMI_PHY_ABORT_ADDR A:0xfb013828
y.create.l HWIO_WCSS_A_PMI_PHY_INT_ADDR A:0xfb01382c
y.create.l HWIO_WCSS_A_PMI_WATCHDOG_TIMEOUT_GENERAL_ADDR A:0xfb013830
y.create.l HWIO_WCSS_A_PMI_WATCHDOG_TIMEOUT_11A_ADDR A:0xfb013834
y.create.l HWIO_WCSS_A_PMI_WATCHDOG_TIMEOUT_11B_ADDR A:0xfb013838
y.create.l HWIO_WCSS_A_PMI_DISABLE_FLAGS_ADDR A:0xfb01383c
y.create.l HWIO_WCSS_A_PMI_CRC_FSM_RESET_ADDR A:0xfb013840
y.create.l HWIO_WCSS_A_PMI_RXPKT_FILTER_LSW_ADDR A:0xfb013844
y.create.l HWIO_WCSS_A_PMI_RXPKT_FILTER_MSW_ADDR A:0xfb013848
y.create.l HWIO_WCSS_A_PMI_CRC_DONE_ADDR A:0xfb01384c
y.create.l HWIO_WCSS_A_PMI_CRC_PASS_ADDR A:0xfb013850
y.create.l HWIO_WCSS_A_PMI_AMPDU_BAD_ADDR A:0xfb013854
y.create.l HWIO_WCSS_A_PMI_AMPDU_GOOD_ADDR A:0xfb013858
y.create.l HWIO_WCSS_A_PMI_AMPDU_DONE_ADDR A:0xfb01385c
y.create.l HWIO_WCSS_A_PMI_LAST_STATS0_ADDR A:0xfb013860
y.create.l HWIO_WCSS_A_PMI_LAST_STATS1_ADDR A:0xfb013864
y.create.l HWIO_WCSS_A_PMI_LAST_STATS2_ADDR A:0xfb013868
y.create.l HWIO_WCSS_A_PMI_LAST_STATS3_ADDR A:0xfb01386c
y.create.l HWIO_WCSS_A_QTA_INTR_ADDR A:0xfb080fc0
y.create.l HWIO_WCSS_A_QTA_INTR_EN_ADDR A:0xfb080fc4
y.create.l HWIO_WCSS_A_QTA_UART_CTRL_ADDR A:0xfb080fc8
y.create.l HWIO_WCSS_A_QTA_HW_CTRL_ADDR A:0xfb080fcc
y.create.l HWIO_WCSS_A_QTA_HW_TX_BUFFER_MODIFY_ADDR A:0xfb080fd0
y.create.l HWIO_WCSS_A_QTA_SW_CTRL_ADDR A:0xfb080fd4
y.create.l HWIO_WCSS_A_QTA_SW_TX_FIFO_IN_ADDR A:0xfb080fd8
y.create.l HWIO_WCSS_A_QTA_SW_RX_FIFO_OUT_ADDR A:0xfb080fdc
y.create.l HWIO_WCSS_A_QTA_TESTBUS_ADDR A:0xfb080fe0
y.create.l HWIO_WCSS_A_RACTL_PTC_LOOP_EN_ADDR A:0xfb00f000
y.create.l HWIO_WCSS_A_RACTL_PTC_LOOP_GAIN_ADDR A:0xfb00f004
y.create.l HWIO_WCSS_A_RACTL_PTC_CHAN_FREQ_ADDR A:0xfb00f008
y.create.l HWIO_WCSS_A_RACTL_RACTL_CFG_ADDR A:0xfb00f00c
y.create.l HWIO_WCSS_A_RACTL_RXA_ABORT_ADDR A:0xfb00f010
y.create.l HWIO_WCSS_A_RACTL_RACTL_TOFFSET_ADDR A:0xfb00f014
y.create.l HWIO_WCSS_A_RACTL_RACTL_DELTAT_IN_ADDR A:0xfb00f018
y.create.l HWIO_WCSS_A_RACTL_RACTL_DELTAT_OUT_ADDR A:0xfb00f01c
y.create.l HWIO_WCSS_A_RACTL_RACTL_DELTAF_IN_ADDR A:0xfb00f020
y.create.l HWIO_WCSS_A_RACTL_RACTL_DELTAF_OUT_ADDR A:0xfb00f024
y.create.l HWIO_WCSS_A_RACTL_PTC_DELTAAMP_TIMINGOFFSET_OUT_ADDR A:0xfb00f028
y.create.l HWIO_WCSS_A_RACTL_RACTL_TEST_SIG_LEN_ADDR A:0xfb00f02c
y.create.l HWIO_WCSS_A_RACTL_RACTL_TEST_CFG_ADDR A:0xfb00f030
y.create.l HWIO_WCSS_A_RACTL_TESTMUX_SEL_ADDR A:0xfb00f034
y.create.l HWIO_WCSS_A_RACTL_RACTL_PKTCOUNT_ADDR A:0xfb00f038
y.create.l HWIO_WCSS_A_RACTL_RACTL_SYMCOUNT_ADDR A:0xfb00f03c
y.create.l HWIO_WCSS_A_RACTL_RACTL_PKTCOUNT_AC20_ADDR A:0xfb00f040
y.create.l HWIO_WCSS_A_RACTL_RACTL_PKTCOUNT_AC40_ADDR A:0xfb00f044
y.create.l HWIO_WCSS_A_RACTL_RACTL_PKTCOUNT_AC80_ADDR A:0xfb00f048
y.create.l HWIO_WCSS_A_RACTL_RACTL_PKTCOUNT_AC_SU_ADDR A:0xfb00f04c
y.create.l HWIO_WCSS_A_RACTL_RACTL_PKTCOUNT_AC_MU_ADDR A:0xfb00f050
y.create.l HWIO_WCSS_A_RACTL_CHE_PKTCOUNT_ADDR A:0xfb00f054
y.create.l HWIO_WCSS_A_RACTL_PTC_PKTCOUNT_ADDR A:0xfb00f058
y.create.l HWIO_WCSS_A_RACTL_PTC_SYMCOUNT_ADDR A:0xfb00f05c
y.create.l HWIO_WCSS_A_RACTL_PTC_PKTCOUNT_20M_ADDR A:0xfb00f060
y.create.l HWIO_WCSS_A_RACTL_PTC_PKTCOUNT_40M_ADDR A:0xfb00f064
y.create.l HWIO_WCSS_A_RACTL_PTC_PKTCOUNT_SIMO_ADDR A:0xfb00f068
y.create.l HWIO_WCSS_A_RACTL_PTC_PKTCOUNT_STBC_ADDR A:0xfb00f06c
y.create.l HWIO_WCSS_A_RACTL_PTC_PKTCOUNT_GF_ADDR A:0xfb00f070
y.create.l HWIO_WCSS_A_RACTL_PTC_PKTCOUNT_MM_ADDR A:0xfb00f074
y.create.l HWIO_WCSS_A_RACTL_FFT_OPSCALE_ADDR A:0xfb00f078
y.create.l HWIO_WCSS_A_RACTL_RACTL_STATE_ADDR A:0xfb00f07c
y.create.l HWIO_WCSS_A_RACTL_AGC_ABORT_COUNT_ADDR A:0xfb00f080
y.create.l HWIO_WCSS_A_RACTL_SIGNAL_INVALID_COUNT_LSIG_ADDR A:0xfb00f084
y.create.l HWIO_WCSS_A_RACTL_SERV_INVALID_COUNT_ADDR A:0xfb00f088
y.create.l HWIO_WCSS_A_RACTL_INTERRUPT_COUNT_ADDR A:0xfb00f08c
y.create.l HWIO_WCSS_A_RACTL_LAST_LS_SIGNAL_ADDR A:0xfb00f090
y.create.l HWIO_WCSS_A_RACTL_LAST_MS_SIGNAL_ADDR A:0xfb00f094
y.create.l HWIO_WCSS_A_RACTL_LAST_MCS_ADDR A:0xfb00f098
y.create.l HWIO_WCSS_A_RACTL_STROBE_UNSUPPHTSIG_ADDR A:0xfb00f09c
y.create.l HWIO_WCSS_A_RACTL_LAST_UNSUPHTSIGNAL0_ADDR A:0xfb00f0a0
y.create.l HWIO_WCSS_A_RACTL_LAST_UNSUPHTSIGNAL1_ADDR A:0xfb00f0a4
y.create.l HWIO_WCSS_A_RACTL_LAST_UNSUPHTSIGNAL2_ADDR A:0xfb00f0a8
y.create.l HWIO_WCSS_A_RACTL_LAST_MXED_SIG0_ADDR A:0xfb00f0ac
y.create.l HWIO_WCSS_A_RACTL_LAST_MXED_SIG1_ADDR A:0xfb00f0b0
y.create.l HWIO_WCSS_A_RACTL_LAST_MXED_SIG2_ADDR A:0xfb00f0b4
y.create.l HWIO_WCSS_A_RACTL_STATISTICS_SELECT_ADDR A:0xfb00f0b8
y.create.l HWIO_WCSS_A_RACTL_DAGC_TGTBO_ADDR A:0xfb00f0bc
y.create.l HWIO_WCSS_A_RACTL_CMDWDFILL_ADDR A:0xfb00f0c0
y.create.l HWIO_WCSS_A_RACTL_RACTL_STATUS_ADDR A:0xfb00f0c4
y.create.l HWIO_WCSS_A_RACTL_NES2_MCSBOUND0_ADDR A:0xfb00f0c8
y.create.l HWIO_WCSS_A_RACTL_NES2_MCSBOUND1_ADDR A:0xfb00f0cc
y.create.l HWIO_WCSS_A_RACTL_NES2_MCSBOUND2_ADDR A:0xfb00f0d0
y.create.l HWIO_WCSS_A_RACTL_NES2_MCSBOUND3_ADDR A:0xfb00f0d4
y.create.l HWIO_WCSS_A_RACTL_LSIGLEN_LOWERBOUND_ADDR A:0xfb00f0d8
y.create.l HWIO_WCSS_A_RACTL_RACTL_INTR_EN_ADDR A:0xfb00f0dc
y.create.l HWIO_WCSS_A_RACTL_RACTL_SUPP_BWMISMCOUNT_ADDR A:0xfb00f0e0
y.create.l HWIO_WCSS_A_RACTL_PTC_TH_ADDR A:0xfb00f0e4
y.create.l HWIO_WCSS_A_RACTL_BWMISMCNTRST_ADDR A:0xfb00f0e8
y.create.l HWIO_WCSS_A_RACTL_LMAP_OPSCALE1_SISO_ADDR A:0xfb00f0f0
y.create.l HWIO_WCSS_A_RACTL_LMAP_OPSCALE2_SISO_ADDR A:0xfb00f0f4
y.create.l HWIO_WCSS_A_RACTL_LMAP_OPSCALE1_STBC_ADDR A:0xfb00f0f8
y.create.l HWIO_WCSS_A_RACTL_LMAP_OPSCALE2_STBC_ADDR A:0xfb00f0fc
y.create.l HWIO_WCSS_A_RACTL_LMAP_OPSCALE3_ADDR A:0xfb00f100
y.create.l HWIO_WCSS_A_RACTL_LMAP_TRK_CTRL_ADDR A:0xfb00f104
y.create.l HWIO_WCSS_A_RACTL_LMAP_DUPCOMB_ADDR A:0xfb00f108
y.create.l HWIO_WCSS_A_RACTL_LMAP_SNR_SEL_ADDR A:0xfb00f10c
y.create.l HWIO_WCSS_A_RACTL_RACTL_SPL_ADDR A:0xfb00f110
y.create.l HWIO_WCSS_A_RACTL_WATCHDOG1_ADDR A:0xfb00f114
y.create.l HWIO_WCSS_A_RACTL_WATCHDOG2_ADDR A:0xfb00f118
y.create.l HWIO_WCSS_A_RACTL_WATCHDOG3_ADDR A:0xfb00f11c
y.create.l HWIO_WCSS_A_RACTL_RACTL_UNSUPP_BWMISMCOUNT_ADDR A:0xfb00f120
y.create.l HWIO_WCSS_A_RACTL_RACTL_LAST_BW_ADDR A:0xfb00f124
y.create.l HWIO_WCSS_A_RACTL_RACTL_MINSNRSTATS_ADDR A:0xfb00f130
y.create.l HWIO_WCSS_A_RACTL_SIGNAL_INVALID_COUNT_HTSIG_ADDR A:0xfb00f140
y.create.l HWIO_WCSS_A_RACTL_RXFIR_SCALING_COEFF_ADDR A:0xfb00f144
y.create.l HWIO_WCSS_A_RACTL_CSI_CODEBOOK_SNR_TH_ADDR A:0xfb00f148
y.create.l HWIO_WCSS_A_RACTL_CSI_CONFIG_ADDR A:0xfb00f14c
y.create.l HWIO_WCSS_A_RACTL_BF_GAIN_DENOM_ADDR A:0xfb00f150
y.create.l HWIO_WCSS_A_RACTL_CSI_STATS1_ADDR A:0xfb00f154
y.create.l HWIO_WCSS_A_RACTL_CSI_STATS2_ADDR A:0xfb00f158
y.create.l HWIO_WCSS_A_RACTL_CHE_SMOOTHING_ADDR A:0xfb00f15c
y.create.l HWIO_WCSS_A_RACTL_PKTCNT_SMOOTHED_ADDR A:0xfb00f160
y.create.l HWIO_WCSS_A_RACTL_RACTL_CRCCHKCFG_ADDR A:0xfb00f164
y.create.l HWIO_WCSS_A_RACTL_RACTL_DBG_ADDR A:0xfb00f168
y.create.l HWIO_WCSS_A_RACTL_FORCE_DBGPKTTYPE_ADDR A:0xfb00f16c
y.create.l HWIO_WCSS_A_RACTL_RACTL_MU_ADDR A:0xfb00f170
y.create.l HWIO_WCSS_A_RACTL_VIT_LSIG_ADDR A:0xfb00f174
y.create.l HWIO_WCSS_A_RACTL_MCSFBSNRTH1_ADDR A:0xfb00f180
y.create.l HWIO_WCSS_A_RACTL_MCSFBSNRTH2_ADDR A:0xfb00f184
y.create.l HWIO_WCSS_A_RACTL_MCSFBSNRTH3_ADDR A:0xfb00f188
y.create.l HWIO_WCSS_A_RACTL_MCSFBSNRTH4_ADDR A:0xfb00f18c
y.create.l HWIO_WCSS_A_RACTL_MCSFBSNRTH5_ADDR A:0xfb00f190
y.create.l HWIO_WCSS_A_RACTL_MCSFBSNRTH6_ADDR A:0xfb00f194
y.create.l HWIO_WCSS_A_RACTL_MCSFBSNRTH7_ADDR A:0xfb00f198
y.create.l HWIO_WCSS_A_RACTL_MCSFBSNRTH8_ADDR A:0xfb00f19c
y.create.l HWIO_WCSS_A_RACTL_MCSFBSNRTH9_ADDR A:0xfb00f1a0
y.create.l HWIO_WCSS_A_RACTL_MSA_REG0_ADDR A:0xfb00f1a4
y.create.l HWIO_WCSS_A_RACTL_MSA_REG1_ADDR A:0xfb00f1a8
y.create.l HWIO_WCSS_A_RACTL_MSA_REG2_ADDR A:0xfb00f1ac
y.create.l HWIO_WCSS_A_RACTL_MSA_REG3_ADDR A:0xfb00f1b0
y.create.l HWIO_WCSS_A_RACTL_UPA_REG0_ADDR A:0xfb00f1b4
y.create.l HWIO_WCSS_A_RACTL_UPA_REG1_ADDR A:0xfb00f1b8
y.create.l HWIO_WCSS_A_RACTL_UPA_REG2_ADDR A:0xfb00f1bc
y.create.l HWIO_WCSS_A_RACTL_UPA_REG3_ADDR A:0xfb00f1c0
y.create.l HWIO_WCSS_A_RACTL_UPA_REG4_ADDR A:0xfb00f1c4
y.create.l HWIO_WCSS_A_RACTL_UPA_REG5_ADDR A:0xfb00f1c8
y.create.l HWIO_WCSS_A_RACTL_UPA_REG6_ADDR A:0xfb00f1cc
y.create.l HWIO_WCSS_A_RACTL_UPA_REG7_ADDR A:0xfb00f1d0
y.create.l HWIO_WCSS_A_RBAPB_CONTROL_RXB_DSCR_ADDR A:0xfb014400
y.create.l HWIO_WCSS_A_RBAPB_COUNT_SSFD_ADDR A:0xfb014404
y.create.l HWIO_WCSS_A_RBAPB_COUNT_LSFD_ADDR A:0xfb014408
y.create.l HWIO_WCSS_A_RBAPB_IGN_ILL_PLCP_ADDR A:0xfb01440c
y.create.l HWIO_WCSS_A_RBAPB_COUNT_PLCP_CRC_ERRORS_ADDR A:0xfb014410
y.create.l HWIO_WCSS_A_RBAPB_COUNT_PLCP_SIG_ERRORS_ADDR A:0xfb014414
y.create.l HWIO_WCSS_A_RBAPB_COUNT_PLCP_SVC_ERRORS_ADDR A:0xfb014418
y.create.l HWIO_WCSS_A_RBAPB_COUNT_RX_BYTES_ADDR A:0xfb01441c
y.create.l HWIO_WCSS_A_RBAPB_COUNT_MPI_SOF_ADDR A:0xfb014420
y.create.l HWIO_WCSS_A_RBAPB_COUNT_MPI_EOF_ADDR A:0xfb014424
y.create.l HWIO_WCSS_A_RBAPB_SFD_DET_TMO_ADDR A:0xfb014428
y.create.l HWIO_WCSS_A_RBAPB_SLR_SFD_DET_TMO_ADDR A:0xfb01442c
y.create.l HWIO_WCSS_A_RBAPB_COUNT_RXB_START_ADDR A:0xfb014430
y.create.l HWIO_WCSS_A_RBAPB_COUNT_RXB_ABORT_ADDR A:0xfb014438
y.create.l HWIO_WCSS_A_RBAPB_RXB_RESET_ADDR A:0xfb01443c
y.create.l HWIO_WCSS_A_RBAPB_CONTROL_BARKER_TIMING_TRACKING_ADDR A:0xfb014440
y.create.l HWIO_WCSS_A_RBAPB_CMF_PLL_COEFF_A_ADDR A:0xfb014448
y.create.l HWIO_WCSS_A_RBAPB_CMF_PLL_COEFF_B_ADDR A:0xfb01444c
y.create.l HWIO_WCSS_A_RBAPB_CMF_PLL_COEFF_A_SLR_TRACK_ADDR A:0xfb014450
y.create.l HWIO_WCSS_A_RBAPB_CMF_PLL_COEFF_B_SLR_TRACK_ADDR A:0xfb014454
y.create.l HWIO_WCSS_A_RBAPB_ANTENNA_DIVERSITY_MODE_ADDR A:0xfb014458
y.create.l HWIO_WCSS_A_RBAPB_SNR_THRESHOLD_ADDR A:0xfb01445c
y.create.l HWIO_WCSS_A_RBAPB_SNR_AVERAGER_GAIN_ADDR A:0xfb014460
y.create.l HWIO_WCSS_A_RBAPB_LMS_AVERAGER_SHIFT_ADDR A:0xfb014464
y.create.l HWIO_WCSS_A_RBAPB_COUNT_DYNSEL_ANT0_ADDR A:0xfb014468
y.create.l HWIO_WCSS_A_RBAPB_COUNT_DYNSEL_ANT1_ADDR A:0xfb01446c
y.create.l HWIO_WCSS_A_RBAPB_COUNT_DYNSEL_2ANT_ADDR A:0xfb014470
y.create.l HWIO_WCSS_A_RFIF_RF_BUS_CONTROL_ADDR A:0xfb015000
y.create.l HWIO_WCSS_A_RFIF_RF_BUS_STATUS_ADDR A:0xfb015004
y.create.l HWIO_WCSS_A_RFIF_ARB_CONTROL_ADDR A:0xfb015008
y.create.l HWIO_WCSS_A_RFIF_ARB_COMMAND_ADDR A:0xfb01500c
y.create.l HWIO_WCSS_A_RFIF_ARB_STATUS_ADDR A:0xfb015010
y.create.l HWIO_WCSS_A_RFIF_BT_CTRL_CFG_ADDR A:0xfb015014
y.create.l HWIO_WCSS_A_RFIF_TX_EN_CFG_ADDR A:0xfb015018
y.create.l HWIO_WCSS_A_RFIF_RESET_CTRL_ADDR A:0xfb01501c
y.create.l HWIO_WCSS_A_RFIF_PHY_HW_STATUS_ADDR A:0xfb015020
y.create.l HWIO_WCSS_A_RFIF_RFAPB_STATUS_ADDR A:0xfb015024
y.create.l HWIO_WCSS_A_RFIF_ERROR_CONDS_ADDR A:0xfb015028
y.create.l HWIO_WCSS_A_RFIF_HKADC_RD_ADDR_ADDR A:0xfb01502c
y.create.l HWIO_WCSS_A_RFIF_HKADC_WR_ADDR_ADDR A:0xfb015030
y.create.l HWIO_WCSS_A_RFIF_HKADC_CONV_TIMER_ADDR A:0xfb015034
y.create.l HWIO_WCSS_A_RFIF_RX_GAIN0_0_ADDR A:0xfb015400
y.create.l HWIO_WCSS_A_RFIF_RX_GAIN1_0_ADDR A:0xfb015410
y.create.l HWIO_WCSS_A_RFIF_RX_GAIN2_0_ADDR A:0xfb015420
y.create.l HWIO_WCSS_A_RFIF_RX_GAIN3_0_ADDR A:0xfb015430
y.create.l HWIO_WCSS_A_RFIF_RX_GAIN4_0_ADDR A:0xfb015440
y.create.l HWIO_WCSS_A_RFIF_RX_GAIN5_0_ADDR A:0xfb015450
y.create.l HWIO_WCSS_A_RFIF_RX_GAIN6_0_ADDR A:0xfb015460
y.create.l HWIO_WCSS_A_RFIF_RX_GAIN7_0_ADDR A:0xfb015470
y.create.l HWIO_WCSS_A_RFIF_RX_GAIN8_0_ADDR A:0xfb015480
y.create.l HWIO_WCSS_A_RFIF_RX_GAIN9_0_ADDR A:0xfb015490
y.create.l HWIO_WCSS_A_RFIF_RX_GAIN0_1_ADDR A:0xfb015404
y.create.l HWIO_WCSS_A_RFIF_RX_GAIN1_1_ADDR A:0xfb015414
y.create.l HWIO_WCSS_A_RFIF_RX_GAIN2_1_ADDR A:0xfb015424
y.create.l HWIO_WCSS_A_RFIF_RX_GAIN3_1_ADDR A:0xfb015434
y.create.l HWIO_WCSS_A_RFIF_RX_GAIN4_1_ADDR A:0xfb015444
y.create.l HWIO_WCSS_A_RFIF_RX_GAIN5_1_ADDR A:0xfb015454
y.create.l HWIO_WCSS_A_RFIF_RX_GAIN6_1_ADDR A:0xfb015464
y.create.l HWIO_WCSS_A_RFIF_RX_GAIN7_1_ADDR A:0xfb015474
y.create.l HWIO_WCSS_A_RFIF_RX_GAIN8_1_ADDR A:0xfb015484
y.create.l HWIO_WCSS_A_RFIF_RX_GAIN9_1_ADDR A:0xfb015494
y.create.l HWIO_WCSS_A_RFIF_RX_GAIN0_2_ADDR A:0xfb015408
y.create.l HWIO_WCSS_A_RFIF_RX_GAIN1_2_ADDR A:0xfb015418
y.create.l HWIO_WCSS_A_RFIF_RX_GAIN2_2_ADDR A:0xfb015428
y.create.l HWIO_WCSS_A_RFIF_RX_GAIN3_2_ADDR A:0xfb015438
y.create.l HWIO_WCSS_A_RFIF_RX_GAIN4_2_ADDR A:0xfb015448
y.create.l HWIO_WCSS_A_RFIF_RX_GAIN5_2_ADDR A:0xfb015458
y.create.l HWIO_WCSS_A_RFIF_RX_GAIN6_2_ADDR A:0xfb015468
y.create.l HWIO_WCSS_A_RFIF_RX_GAIN7_2_ADDR A:0xfb015478
y.create.l HWIO_WCSS_A_RFIF_RX_GAIN8_2_ADDR A:0xfb015488
y.create.l HWIO_WCSS_A_RFIF_RX_GAIN9_2_ADDR A:0xfb015498
y.create.l HWIO_WCSS_A_RFIF_TX_GAIN0_0_ADDR A:0xfb015800
y.create.l HWIO_WCSS_A_RFIF_TX_GAIN1_0_ADDR A:0xfb015820
y.create.l HWIO_WCSS_A_RFIF_TX_GAIN2_0_ADDR A:0xfb015840
y.create.l HWIO_WCSS_A_RFIF_TX_GAIN3_0_ADDR A:0xfb015860
y.create.l HWIO_WCSS_A_RFIF_TX_GAIN4_0_ADDR A:0xfb015880
y.create.l HWIO_WCSS_A_RFIF_TX_GAIN5_0_ADDR A:0xfb0158a0
y.create.l HWIO_WCSS_A_RFIF_TX_GAIN6_0_ADDR A:0xfb0158c0
y.create.l HWIO_WCSS_A_RFIF_TX_GAIN7_0_ADDR A:0xfb0158e0
y.create.l HWIO_WCSS_A_RFIF_TX_GAIN8_0_ADDR A:0xfb015900
y.create.l HWIO_WCSS_A_RFIF_TX_GAIN9_0_ADDR A:0xfb015920
y.create.l HWIO_WCSS_A_RFIF_TX_GAIN0_1_ADDR A:0xfb015804
y.create.l HWIO_WCSS_A_RFIF_TX_GAIN1_1_ADDR A:0xfb015824
y.create.l HWIO_WCSS_A_RFIF_TX_GAIN2_1_ADDR A:0xfb015844
y.create.l HWIO_WCSS_A_RFIF_TX_GAIN3_1_ADDR A:0xfb015864
y.create.l HWIO_WCSS_A_RFIF_TX_GAIN4_1_ADDR A:0xfb015884
y.create.l HWIO_WCSS_A_RFIF_TX_GAIN5_1_ADDR A:0xfb0158a4
y.create.l HWIO_WCSS_A_RFIF_TX_GAIN6_1_ADDR A:0xfb0158c4
y.create.l HWIO_WCSS_A_RFIF_TX_GAIN7_1_ADDR A:0xfb0158e4
y.create.l HWIO_WCSS_A_RFIF_TX_GAIN8_1_ADDR A:0xfb015904
y.create.l HWIO_WCSS_A_RFIF_TX_GAIN9_1_ADDR A:0xfb015924
y.create.l HWIO_WCSS_A_RFIF_TX_GAIN0_2_ADDR A:0xfb015808
y.create.l HWIO_WCSS_A_RFIF_TX_GAIN1_2_ADDR A:0xfb015828
y.create.l HWIO_WCSS_A_RFIF_TX_GAIN2_2_ADDR A:0xfb015848
y.create.l HWIO_WCSS_A_RFIF_TX_GAIN3_2_ADDR A:0xfb015868
y.create.l HWIO_WCSS_A_RFIF_TX_GAIN4_2_ADDR A:0xfb015888
y.create.l HWIO_WCSS_A_RFIF_TX_GAIN5_2_ADDR A:0xfb0158a8
y.create.l HWIO_WCSS_A_RFIF_TX_GAIN6_2_ADDR A:0xfb0158c8
y.create.l HWIO_WCSS_A_RFIF_TX_GAIN7_2_ADDR A:0xfb0158e8
y.create.l HWIO_WCSS_A_RFIF_TX_GAIN8_2_ADDR A:0xfb015908
y.create.l HWIO_WCSS_A_RFIF_TX_GAIN9_2_ADDR A:0xfb015928
y.create.l HWIO_WCSS_A_RFIF_TX_GAIN0_3_ADDR A:0xfb01580c
y.create.l HWIO_WCSS_A_RFIF_TX_GAIN1_3_ADDR A:0xfb01582c
y.create.l HWIO_WCSS_A_RFIF_TX_GAIN2_3_ADDR A:0xfb01584c
y.create.l HWIO_WCSS_A_RFIF_TX_GAIN3_3_ADDR A:0xfb01586c
y.create.l HWIO_WCSS_A_RFIF_TX_GAIN4_3_ADDR A:0xfb01588c
y.create.l HWIO_WCSS_A_RFIF_TX_GAIN5_3_ADDR A:0xfb0158ac
y.create.l HWIO_WCSS_A_RFIF_TX_GAIN6_3_ADDR A:0xfb0158cc
y.create.l HWIO_WCSS_A_RFIF_TX_GAIN7_3_ADDR A:0xfb0158ec
y.create.l HWIO_WCSS_A_RFIF_TX_GAIN8_3_ADDR A:0xfb01590c
y.create.l HWIO_WCSS_A_RFIF_TX_GAIN9_3_ADDR A:0xfb01592c
y.create.l HWIO_WCSS_A_RFIF_TX_GAIN0_4_ADDR A:0xfb015810
y.create.l HWIO_WCSS_A_RFIF_TX_GAIN1_4_ADDR A:0xfb015830
y.create.l HWIO_WCSS_A_RFIF_TX_GAIN2_4_ADDR A:0xfb015850
y.create.l HWIO_WCSS_A_RFIF_TX_GAIN3_4_ADDR A:0xfb015870
y.create.l HWIO_WCSS_A_RFIF_TX_GAIN4_4_ADDR A:0xfb015890
y.create.l HWIO_WCSS_A_RFIF_TX_GAIN5_4_ADDR A:0xfb0158b0
y.create.l HWIO_WCSS_A_RFIF_TX_GAIN6_4_ADDR A:0xfb0158d0
y.create.l HWIO_WCSS_A_RFIF_TX_GAIN7_4_ADDR A:0xfb0158f0
y.create.l HWIO_WCSS_A_RFIF_TX_GAIN8_4_ADDR A:0xfb015910
y.create.l HWIO_WCSS_A_RFIF_TX_GAIN9_4_ADDR A:0xfb015930
y.create.l HWIO_WCSS_A_RFIF_TX_GAIN0_5_ADDR A:0xfb015814
y.create.l HWIO_WCSS_A_RFIF_TX_GAIN1_5_ADDR A:0xfb015834
y.create.l HWIO_WCSS_A_RFIF_TX_GAIN2_5_ADDR A:0xfb015854
y.create.l HWIO_WCSS_A_RFIF_TX_GAIN3_5_ADDR A:0xfb015874
y.create.l HWIO_WCSS_A_RFIF_TX_GAIN4_5_ADDR A:0xfb015894
y.create.l HWIO_WCSS_A_RFIF_TX_GAIN5_5_ADDR A:0xfb0158b4
y.create.l HWIO_WCSS_A_RFIF_TX_GAIN6_5_ADDR A:0xfb0158d4
y.create.l HWIO_WCSS_A_RFIF_TX_GAIN7_5_ADDR A:0xfb0158f4
y.create.l HWIO_WCSS_A_RFIF_TX_GAIN8_5_ADDR A:0xfb015914
y.create.l HWIO_WCSS_A_RFIF_TX_GAIN9_5_ADDR A:0xfb015934
y.create.l HWIO_WCSS_A_RPE_MEM_BASE_ADDR_ADDR A:0xfb082400
y.create.l HWIO_WCSS_A_RPE_FULLSTATE_STATIONS_QUEUES_ADDR A:0xfb082404
y.create.l HWIO_WCSS_A_RPE_SM_STUCK_CNT_VALUE_ADDR A:0xfb082408
y.create.l HWIO_WCSS_A_RPE_RPE_CONFIG_ADDR A:0xfb08240c
y.create.l HWIO_WCSS_A_RPE_ROUTING_FLAG_ADDR A:0xfb082410
y.create.l HWIO_WCSS_A_RPE_SW_FLUSH_BITMAP_CACHE_ADDR A:0xfb082414
y.create.l HWIO_WCSS_A_RPE_FULLSTATE_BITMAP_CACHE_DW1_ADDR A:0xfb082418
y.create.l HWIO_WCSS_A_RPE_FULLSTATE_BITMAP_CACHE_DW2_ADDR A:0xfb08241c
y.create.l HWIO_WCSS_A_RPE_FULLSTATE_BITMAP_CACHE_DW3_ADDR A:0xfb082420
y.create.l HWIO_WCSS_A_RPE_STATIONID_QID_4_FULLSTATE_BITMAP_ADDR A:0xfb082424
y.create.l HWIO_WCSS_A_RPE_PARTIALSTATE_BITMAP_CACHE_DW1_ADDR A:0xfb082428
y.create.l HWIO_WCSS_A_RPE_PARTIALSTATE_BITMAP_CACHE_DW2_ADDR A:0xfb08242c
y.create.l HWIO_WCSS_A_RPE_PARTIALSTATE_BITMAP_CACHE_DW3_ADDR A:0xfb082430
y.create.l HWIO_WCSS_A_RPE_STATIONID_QID_4_PARTIALSTATE_BITMAP_ADDR A:0xfb082434
y.create.l HWIO_WCSS_A_RPE_FRAGMENT_RESRC_ENTRY1_DW1_ADDR A:0xfb082438
y.create.l HWIO_WCSS_A_RPE_FRAGMENT_RESRC_ENTRY1_DW2_ADDR A:0xfb08243c
y.create.l HWIO_WCSS_A_RPE_FRAGMENT_RESRC_ENTRY2_DW1_ADDR A:0xfb082440
y.create.l HWIO_WCSS_A_RPE_FRAGMENT_RESRC_ENTRY2_DW2_ADDR A:0xfb082444
y.create.l HWIO_WCSS_A_RPE_ERR_INT_ENABLE_ADDR A:0xfb082478
y.create.l HWIO_WCSS_A_RPE_ERR_INT_STATUS_ADDR A:0xfb08247c
y.create.l HWIO_WCSS_A_RPE_CUR_STATE_BU_DD_ADDR A:0xfb082480
y.create.l HWIO_WCSS_A_RPE_CUR_STATE_RA_RR_ADDR A:0xfb082484
y.create.l HWIO_WCSS_A_RPE_CUR_STATE_DMA_ADDR A:0xfb082488
y.create.l HWIO_WCSS_A_RPE_SEND_PKT_STATS_ADDR A:0xfb08248c
y.create.l HWIO_WCSS_A_RPE_DROP_PKT_STATS_ADDR A:0xfb082490
y.create.l HWIO_WCSS_A_RPE_GET_BMU_FAIL_STATS_ADDR A:0xfb082494
y.create.l HWIO_WCSS_A_RPE_RPE_TESTBUS_LOWER_ADDR A:0xfb082498
y.create.l HWIO_WCSS_A_RPE_RPE_TESTBUS_UPPER_ADDR A:0xfb08249c
y.create.l HWIO_WCSS_A_RPE_RPE_BITMAP_DUPLICATE_CNTR_ADDR A:0xfb082500
y.create.l HWIO_WCSS_A_RPE_RPE_SW_FLUSH_RSRC_ENTRY_ADDR A:0xfb082504
y.create.l HWIO_WCSS_A_RPE_RPE_SW_BLOCK_PKTS_ADDR A:0xfb082508
y.create.l HWIO_WCSS_A_RPE_REORDER_BITMAP_CACHE_DW1_ADDR A:0xfb08250c
y.create.l HWIO_WCSS_A_RPE_REORDER_BITMAP_CACHE_DW2_ADDR A:0xfb082510
y.create.l HWIO_WCSS_A_RPE_REORDER_BITMAP_CACHE_DW3_ADDR A:0xfb082514
y.create.l HWIO_WCSS_A_RPE_SPARE_AND_CLK_GATE_DISABLE_ADDR A:0xfb082550
y.create.l HWIO_WCSS_A_RXACLKCTRL_ROOT_CLK_EN_ADDR A:0xfb016000
y.create.l HWIO_WCSS_A_RXACLKCTRL_APB_BLOCK_CLK_EN_ADDR A:0xfb016004
y.create.l HWIO_WCSS_A_RXACLKCTRL_APB_BLOCK_DYN_CLKG_DISABLE_ADDR A:0xfb016008
y.create.l HWIO_WCSS_A_RXACLKCTRL_DYN_ANTSW_CLK_CTRL_DISABLE_ADDR A:0xfb01600c
y.create.l HWIO_WCSS_A_RXACLKCTRL_MAIN1_FAST_CLK_CTRL_ADDR A:0xfb016010
y.create.l HWIO_WCSS_A_RXCLKCTRL_ROOT_CLK_EN_ADDR A:0xfb016400
y.create.l HWIO_WCSS_A_RXCLKCTRL_APB_BLOCK_CLK_EN_ADDR A:0xfb016404
y.create.l HWIO_WCSS_A_RXCLKCTRL_APB_BLOCK_DYN_CLKG_DISABLE_ADDR A:0xfb016408
y.create.l HWIO_WCSS_A_RXCLKCTRL_APB_BLOCK_DYN_CLKG_DISABLE_AGC_ADDR A:0xfb01640c
y.create.l HWIO_WCSS_A_RXCLKCTRL_APB_SYNC_RESET_ADDR A:0xfb016410
y.create.l HWIO_WCSS_A_RXCLKCTRL_CLK_PHY_MAIN2_3BY4_DIV_BYPASS_ADDR A:0xfb016414
y.create.l HWIO_WCSS_A_RXCLKCTRL_BW_CONFIG_ADDR A:0xfb016418
y.create.l HWIO_WCSS_A_RXCLKCTRL_PHY_VERSION_ADDR A:0xfb016420
y.create.l HWIO_WCSS_A_RXCLKCTRL_FAST_CH_SW_PAGE_SEL_ADDR A:0xfb016424
y.create.l HWIO_WCSS_A_RXCLKCTRL_ADC_FIFO_SYNC_RST_ADDR A:0xfb016428
y.create.l HWIO_WCSS_A_RXP_CONFIG_ADDR A:0xfb080800
y.create.l HWIO_WCSS_A_RXP_MAX_PKTLEN_ADDR A:0xfb080808
y.create.l HWIO_WCSS_A_RXP_SW_BD_REG_ADDR A:0xfb08080c
y.create.l HWIO_WCSS_A_RXP_MPDU_HEADER_START_OFFSET_ADDR A:0xfb080810
y.create.l HWIO_WCSS_A_RXP_SEARCH_ADDR1_PTR_ADDR A:0xfb08082c
y.create.l HWIO_WCSS_A_RXP_SEARCH_ADDR2_PTR_ADDR A:0xfb080830
y.create.l HWIO_WCSS_A_RXP_SEARCH_ADDR3_PTR_ADDR A:0xfb080834
y.create.l HWIO_WCSS_A_RXP_SEARCH_TABLE_CMD_ADDR A:0xfb080838
y.create.l HWIO_WCSS_A_RXP_SEARCH_TABLE_DATA0_ADDR A:0xfb08083c
y.create.l HWIO_WCSS_A_RXP_SEARCH_TABLE_DATA1_ADDR A:0xfb080840
y.create.l HWIO_WCSS_A_RXP_MAX_LEN_AMPDU_ADDR A:0xfb080844
y.create.l HWIO_WCSS_A_RXP_MAX_LEN_MPDU_IN_AMPDU_ADDR A:0xfb080848
y.create.l HWIO_WCSS_A_RXP_DMA_MAX_RSV_PDU_ADDR A:0xfb08084c
y.create.l HWIO_WCSS_A_RXP_DMA_BURST_THRESHOLD_ADDR A:0xfb080850
y.create.l HWIO_WCSS_A_RXP_CLEAR_STATS_ADDR A:0xfb080854
y.create.l HWIO_WCSS_A_RXP_PHY_MPDU_CNT_ADDR A:0xfb080858
y.create.l HWIO_WCSS_A_RXP_PHY_AMPDU_CNT_ADDR A:0xfb08085c
y.create.l HWIO_WCSS_A_RXP_PHY_ABORT_CNT_ADDR A:0xfb080864
y.create.l HWIO_WCSS_A_RXP_PHY_SHUTOFF_CNT_ADDR A:0xfb080868
y.create.l HWIO_WCSS_A_RXP_DLM_FIFO_FULL_CNT_ADDR A:0xfb08086c
y.create.l HWIO_WCSS_A_RXP_DLM_ERR_CNT_ADDR A:0xfb080870
y.create.l HWIO_WCSS_A_RXP_FAIL_FILTER_CNT_ADDR A:0xfb080874
y.create.l HWIO_WCSS_A_RXP_FAIL_MAX_PKTLEN_CNT_ADDR A:0xfb080878
y.create.l HWIO_WCSS_A_RXP_FCS_ERR_CNT_ADDR A:0xfb08087c
y.create.l HWIO_WCSS_A_RXP_DMA_SEND_CNT_ADDR A:0xfb080880
y.create.l HWIO_WCSS_A_RXP_DMA_DROP_CNT_ADDR A:0xfb080884
y.create.l HWIO_WCSS_A_RXP_DMA_GET_BMU_FAIL_CNT_ADDR A:0xfb080888
y.create.l HWIO_WCSS_A_RXP_PROTOCOL_VERSION_FILTER_CNT_ADDR A:0xfb08088c
y.create.l HWIO_WCSS_A_RXP_TYPE_SUBTYPE_FILTER_CNT_ADDR A:0xfb080890
y.create.l HWIO_WCSS_A_RXP_INCORRECT_LENGTH_FILTER_CNT_ADDR A:0xfb080894
y.create.l HWIO_WCSS_A_RXP_ADDR1_BLOCK_FILTER_CNT_ADDR A:0xfb080898
y.create.l HWIO_WCSS_A_RXP_ADDR1_HIT_NO_PASS_CNT_ADDR A:0xfb08089c
y.create.l HWIO_WCSS_A_RXP_ADDR1_DROP_CNT_ADDR A:0xfb0808a0
y.create.l HWIO_WCSS_A_RXP_ADDR2_HIT_NO_PASS_CNT_ADDR A:0xfb0808a4
y.create.l HWIO_WCSS_A_RXP_ADDR2_DROP_CNT_ADDR A:0xfb0808a8
y.create.l HWIO_WCSS_A_RXP_ADDR3_HIT_NO_PASS_CNT_ADDR A:0xfb0808ac
y.create.l HWIO_WCSS_A_RXP_ADDR3_DROP_CNT_ADDR A:0xfb0808b0
y.create.l HWIO_WCSS_A_RXP_MPDU_IN_AMPDU_CNT_ADDR A:0xfb0808b4
y.create.l HWIO_WCSS_A_RXP_PHY_ERR_DROP_CNT_ADDR A:0xfb0808b8
y.create.l HWIO_WCSS_A_RXP_RADAR_DETECT_STATUS_ADDR A:0xfb0808bc
y.create.l HWIO_WCSS_A_RXP_RADAR_DETECT_CONTROL_ADDR A:0xfb0808c0
y.create.l HWIO_WCSS_A_RXP_RADAR_DETECT_LLOGS_ADDR A:0xfb0808c4
y.create.l HWIO_WCSS_A_RXP_RADAR_DETECT_ULOGS_ADDR A:0xfb0808c8
y.create.l HWIO_WCSS_A_RXP_RADAR_DETECT_LOGS_ADDR A:0xfb0808cc
y.create.l HWIO_WCSS_A_RXP_SOFT_PMI_ABORT_ADDR A:0xfb0808d0
y.create.l HWIO_WCSS_A_RXP_START_ERR_CNT_ADDR A:0xfb0808d4
y.create.l HWIO_WCSS_A_RXP_CCA_AND_EXT_TIMEOUT_ADDR A:0xfb0808d8
y.create.l HWIO_WCSS_A_RXP_TIMEOUT_ERROR_CNT_ADDR A:0xfb0808dc
y.create.l HWIO_WCSS_A_RXP_STALL_TIMEOUT_CNT_ADDR A:0xfb0808e0
y.create.l HWIO_WCSS_A_RXP_CFG_FLT_NAV_CONTROL_RESPONSE_REQ_ADDR A:0xfb0808ec
y.create.l HWIO_WCSS_A_RXP_CFG_FLT_TYPE_SUBTYPE_RX_DISABLE0_ADDR A:0xfb0808f0
y.create.l HWIO_WCSS_A_RXP_CFG_FLT_TYPE_SUBTYPE_RX_DISABLE1_ADDR A:0xfb0808f4
y.create.l HWIO_WCSS_A_RXP_DIAG_STATUS_ADDR A:0xfb0808f8
y.create.l HWIO_WCSS_A_RXP_DIAG_TESTBUS_SEL_ADDR A:0xfb0808fc
y.create.l HWIO_WCSS_A_RXP_FRAME_FILTER_CONFIG_ADDR A:0xfb080900
y.create.l HWIO_WCSS_A_RXP_STALL_TIMEOUT_ADDR A:0xfb080a04
y.create.l HWIO_WCSS_A_RXP_CONFIG2_ADDR A:0xfb080a50
y.create.l HWIO_WCSS_A_RXP_CONFIG3_ADDR A:0xfb080a54
y.create.l HWIO_WCSS_A_RXP_SEARCH_TABLE_DATA2_ADDR A:0xfb080a58
y.create.l HWIO_WCSS_A_RXP_BEACON_TSF_TIM_EXTRACT_CTRL_ADDR A:0xfb080a5c
y.create.l HWIO_WCSS_A_RXP_TSF_COMPENSATION1_VALUE_ADDR A:0xfb080a60
y.create.l HWIO_WCSS_A_RXP_TSF_COMPENSATION2_VALUE_ADDR A:0xfb080a64
y.create.l HWIO_WCSS_A_RXP_SSID_VALUES_B0_B3_ADDR A:0xfb080a68
y.create.l HWIO_WCSS_A_RXP_SSID_VALUES_B4_B7_ADDR A:0xfb080a6c
y.create.l HWIO_WCSS_A_RXP_SSID_VALUES_B8_B11_ADDR A:0xfb080a70
y.create.l HWIO_WCSS_A_RXP_SSID_VALUES_B12_B15_ADDR A:0xfb080a74
y.create.l HWIO_WCSS_A_RXP_SSID_VALUES_B16_B19_ADDR A:0xfb080a78
y.create.l HWIO_WCSS_A_RXP_SSID_VALUES_B20_B23_ADDR A:0xfb080a7c
y.create.l HWIO_WCSS_A_RXP_SSID_VALUES_B24_B27_ADDR A:0xfb080a80
y.create.l HWIO_WCSS_A_RXP_SSID_VALUES_B28_B31_ADDR A:0xfb080a84
y.create.l HWIO_WCSS_A_RXP_BEACON_ADDR2_LOW_FIELD_ADDR A:0xfb080a88
y.create.l HWIO_WCSS_A_RXP_BEACON_ADDR2_HIGH_FIELD_ADDR A:0xfb080a8c
y.create.l HWIO_WCSS_A_RXP_BEACON_ADDR3_LOW_FIELD_ADDR A:0xfb080a90
y.create.l HWIO_WCSS_A_RXP_BEACON_ADDR3_HIGH_FIELD_ADDR A:0xfb080a94
y.create.l HWIO_WCSS_A_RXP_FLT_DUPL_CNT_ADDR A:0xfb080a98
y.create.l HWIO_WCSS_A_RXP_FLT_RPE_HANDSHAKE_TIMEOUT_CNT_ADDR A:0xfb080a9c
y.create.l HWIO_WCSS_A_RXP_QID_MAPPING0_ADDR A:0xfb080b00
y.create.l HWIO_WCSS_A_RXP_QID_MAPPING1_ADDR A:0xfb080b04
y.create.l HWIO_WCSS_A_RXP_QID_MAPPING2_ADDR A:0xfb080b08
y.create.l HWIO_WCSS_A_RXP_QID_MAPPING3_ADDR A:0xfb080b0c
y.create.l HWIO_WCSS_A_RXP_QID_MAPPING4_ADDR A:0xfb080b10
y.create.l HWIO_WCSS_A_RXP_PUSH_WQ_CTRL_ADDR A:0xfb080b14
y.create.l HWIO_WCSS_A_RXP_PUSH_WQ_CTRL2_ADDR A:0xfb080b18
y.create.l HWIO_WCSS_A_RXP_EXTRA_FRAME_FILTER_CONTROL_ADDR A:0xfb080b1c
y.create.l HWIO_WCSS_A_RXP_RXP_GROUPED_INTERRUPT_ENABLE_ADDR A:0xfb080b20
y.create.l HWIO_WCSS_A_RXP_RXP_GROUPED_INTERRUPT_STATUS_ADDR A:0xfb080b24
y.create.l HWIO_WCSS_A_RXP_DEFAULT_HW_INSERT_DPU_PARAM_ADDR A:0xfb080b28
y.create.l HWIO_WCSS_A_RXP_PSPOLL_NAV_VALUE_ADDR A:0xfb080b44
y.create.l HWIO_WCSS_A_RXP_PMU_INTERFACE_CONTROL_ADDR A:0xfb080b48
y.create.l HWIO_WCSS_A_RXP_RATE_INDEX_HISTORY_ADDR A:0xfb080b50
y.create.l HWIO_WCSS_A_RXP_ADDR2_MISS_INFO_ADDR A:0xfb080b58
y.create.l HWIO_WCSS_A_RXP_ADDR2_MISS_CTRL_ADDR A:0xfb080b5c
y.create.l HWIO_WCSS_A_RXP_EOSP_INT_CONTROL_ADDR A:0xfb080b60
y.create.l HWIO_WCSS_A_RXP_MORE_DATA_CLEAR_INT_CONTROL_ADDR A:0xfb080b64
y.create.l HWIO_WCSS_A_RXP_CONFIG4_ADDR A:0xfb080b6c
y.create.l HWIO_WCSS_A_RXP_BEACON_P2P_CLIENT_ADDR_LOW_FIELD_ADDR A:0xfb080b74
y.create.l HWIO_WCSS_A_RXP_BEACON_P2P_CLIENT_ADDR_HIGH_FIELD_ADDR A:0xfb080b78
y.create.l HWIO_WCSS_A_RXP_P2P_BEACON_PARSE_CONTROL_ADDR A:0xfb080b7c
y.create.l HWIO_WCSS_A_RXP_MORE_DATA_SET_INT_CONTROL_ADDR A:0xfb080b80
y.create.l HWIO_WCSS_A_RXP_RULE1_CNTR_CTRL_ADDR A:0xfb080b84
y.create.l HWIO_WCSS_A_RXP_RULE2_CNTR_CTRL_ADDR A:0xfb080b88
y.create.l HWIO_WCSS_A_RXP_RULE1_CNTR_ADDR A:0xfb080b8c
y.create.l HWIO_WCSS_A_RXP_RULE2_CNTR_ADDR A:0xfb080b90
y.create.l HWIO_WCSS_A_RXP_DROP_DUE_TO_DROP_AT_DMA_CNT_ADDR A:0xfb080b94
y.create.l HWIO_WCSS_A_RXP_RX_TIME_CNTR_ADDR A:0xfb080b98
y.create.l HWIO_WCSS_A_RXP_SPARE_AND_CLKGATE_DIS_ADDR A:0xfb080b9c
y.create.l HWIO_WCSS_A_RXP_NDP_PKT_CNTR_ADDR A:0xfb080ba0
y.create.l HWIO_WCSS_A_RXP_P2P_BEACON_PARSE_CONTROL2_ADDR A:0xfb080ba4
y.create.l HWIO_WCSS_A_RXP_BSS2_BEACON_PARSE_CONTROL_ADDR A:0xfb080ba8
y.create.l HWIO_WCSS_A_RXP_BEACON_BSS2_ADDR_LOW_FIELD_ADDR A:0xfb080bac
y.create.l HWIO_WCSS_A_RXP_BEACON_BSS2_CLIENT_ADDR_HIGH_FIELD_ADDR A:0xfb080bb0
y.create.l HWIO_WCSS_A_RXP_RXP_GROUPED2_INTERRUPT_ENABLE_ADDR A:0xfb080bb4
y.create.l HWIO_WCSS_A_RXP_RXP_GROUPED2_INTERRUPT_STATUS_ADDR A:0xfb080bb8
y.create.l HWIO_WCSS_A_RXP_RXP_QBOOST_CONTROL_ADDR A:0xfb080bbc
y.create.l HWIO_WCSS_A_RXP_RXP_P2P_CHANNELSWITCH_BODY_ADDR A:0xfb080bc0
y.create.l HWIO_WCSS_A_RXP_RXP_BSS_CHANNELSWITCH_BODY_ADDR A:0xfb080bc4
y.create.l HWIO_WCSS_A_RXP_RXP_BSS2_CHANNELSWITCH_BODY_ADDR A:0xfb080bc8
y.create.l HWIO_WCSS_A_RXP_RXP_P2P_QUIETIE_LSBYTES_ADDR A:0xfb080bcc
y.create.l HWIO_WCSS_A_RXP_RXP_BSS_QUIETIE_LSBYTES_ADDR A:0xfb080bd0
y.create.l HWIO_WCSS_A_RXP_RXP_BSS2_QUIETIE_LSBYTES_ADDR A:0xfb080bd4
y.create.l HWIO_WCSS_A_RXP_RXP_P2P_QUIETIE_MSBYTES_ADDR A:0xfb080bd8
y.create.l HWIO_WCSS_A_RXP_RXP_BSS_QUIETIE_MSBYTES_ADDR A:0xfb080bdc
y.create.l HWIO_WCSS_A_RXP_RXP_BSS2_QUIETIE_MSBYTES_ADDR A:0xfb080be0
y.create.l HWIO_WCSS_A_TACTL_CFG_ADDR A:0xfb012400
y.create.l HWIO_WCSS_A_TACTL_SCR_CONFIG_ADDR A:0xfb012404
y.create.l HWIO_WCSS_A_TACTL_TATMUX_CONFIG_ADDR A:0xfb012408
y.create.l HWIO_WCSS_A_TACTL_SCALE_20_ADDR A:0xfb01240c
y.create.l HWIO_WCSS_A_TACTL_SCALE_40_ADDR A:0xfb012410
y.create.l HWIO_WCSS_A_TACTL_SCALE_80_ADDR A:0xfb012414
y.create.l HWIO_WCSS_A_TACTL_CYC_DELAY_11AC_ADDR A:0xfb012418
y.create.l HWIO_WCSS_A_TACTL_DOT11AC_SERVICE_OVERRIDE_ADDR A:0xfb01241c
y.create.l HWIO_WCSS_A_TACTL_DOT11AC_APB_SERVICE_ADDR A:0xfb012420
y.create.l HWIO_WCSS_A_TACTL_DOT11AC_MU_MIMO_NSTS_OVERRIDE_ADDR A:0xfb012424
y.create.l HWIO_WCSS_A_TACTL_CTRL_STATE_ADDR A:0xfb012428
y.create.l HWIO_WCSS_A_TACTL_PKT_REQ_COUNT_ADDR A:0xfb01242c
y.create.l HWIO_WCSS_A_TACTL_TAHDR_SYM_COUNT_ADDR A:0xfb012430
y.create.l HWIO_WCSS_A_TACTL_TAQAM_SYM_COUNT_ADDR A:0xfb012434
y.create.l HWIO_WCSS_A_TACTL_LAST_SYM_PARAMS_ADDR A:0xfb012438
y.create.l HWIO_WCSS_A_TACTL_QAM_NSYMS_ADDR A:0xfb01243c
y.create.l HWIO_WCSS_A_TACTL_NPKTS_ADDR A:0xfb012440
y.create.l HWIO_WCSS_A_TACTL_SCR_LFSR_ADDR A:0xfb012444
y.create.l HWIO_WCSS_A_TACTL_ALARMS_ADDR A:0xfb012448
y.create.l HWIO_WCSS_A_TACTL_RESET_ALARMS_ADDR A:0xfb01244c
y.create.l HWIO_WCSS_A_TACTL_LAST_MU_PARAMS_ADDR A:0xfb012450
y.create.l HWIO_WCSS_A_TACTL_MU_PKT_ADDR A:0xfb012454
y.create.l HWIO_WCSS_A_TACTL_DISABLE_MAC_LSIG_ADDR A:0xfb012458
y.create.l HWIO_WCSS_A_TAQAM_SCALE_BPSK_ADDR A:0xfb012c00
y.create.l HWIO_WCSS_A_TAQAM_SCALE_QPSK_ADDR A:0xfb012c08
y.create.l HWIO_WCSS_A_TAQAM_SCALE_QAM16_ADDR A:0xfb012c0c
y.create.l HWIO_WCSS_A_TAQAM_SCALE_QAM64_ADDR A:0xfb012c10
y.create.l HWIO_WCSS_A_TAQAM_SCALE_QAM256_ADDR A:0xfb012c14
y.create.l HWIO_WCSS_A_TAQAM_SCALE_LEGACY20_ADDR A:0xfb012c18
y.create.l HWIO_WCSS_A_TAQAM_SCALE_LEGACY40_ADDR A:0xfb012c1c
y.create.l HWIO_WCSS_A_TAQAM_SCALE_LEGACY80_ADDR A:0xfb012c20
y.create.l HWIO_WCSS_A_TAQAM_SCALE_HT20_ADDR A:0xfb012c24
y.create.l HWIO_WCSS_A_TAQAM_SCALE_HT40_ADDR A:0xfb012c28
y.create.l HWIO_WCSS_A_TAQAM_SCALE_HT80_ADDR A:0xfb012c2c
y.create.l HWIO_WCSS_A_TAQAM_AC_ADDR A:0xfb012c30
y.create.l HWIO_WCSS_A_TBAPB_CRC16_CTRL_ADDR A:0xfb012800
y.create.l HWIO_WCSS_A_TBAPB_SCRAMBLE_CTRL_ADDR A:0xfb012804
y.create.l HWIO_WCSS_A_TBAPB_TXB_DEBUG_ADDR A:0xfb012808
y.create.l HWIO_WCSS_A_TBAPB_LINEAR_DELAY_ANT1_ADDR A:0xfb01280c
y.create.l HWIO_WCSS_A_TBAPB_LINEAR_DELAY_ANT2_ADDR A:0xfb012810
y.create.l HWIO_WCSS_A_TBAPB_LINEAR_DELAY_ANT3_ADDR A:0xfb012814
y.create.l HWIO_WCSS_A_TDC_TDCSYM_IN_ADDR A:0xfb014c00
y.create.l HWIO_WCSS_A_TDC_TDCSYM_OUT_ADDR A:0xfb014c04
y.create.l HWIO_WCSS_A_TDC_TDCPKT_IN_ADDR A:0xfb014c08
y.create.l HWIO_WCSS_A_TDC_CWDET_COUNT_ADDR A:0xfb014c0c
y.create.l HWIO_WCSS_A_TDC_CWDET_STATUS_ADDR A:0xfb014c10
y.create.l HWIO_WCSS_A_TDC_CWDET_OVERRIDE_ADDR A:0xfb014c14
y.create.l HWIO_WCSS_A_TDC_CWDET_TRIGGER_ADDR A:0xfb014c18
y.create.l HWIO_WCSS_A_TDC_APB_GAIN_THRESH_LLP64_1RX_ADDR A:0xfb014c1c
y.create.l HWIO_WCSS_A_TDC_APB_GAIN_THRESH_LLP128_1RX_ADDR A:0xfb014c20
y.create.l HWIO_WCSS_A_TDC_APB_GAIN_THRESH_HTLTF64_1RX_ADDR A:0xfb014c24
y.create.l HWIO_WCSS_A_TDC_APB_GAIN_THRESH_HTLTF128_1RX_ADDR A:0xfb014c28
y.create.l HWIO_WCSS_A_TDC_APB_GAIN_THRESH_LLP256_1RX_ADDR A:0xfb014c2c
y.create.l HWIO_WCSS_A_TDC_APB_GAIN_THRESH_VHTLTF256_1RX_ADDR A:0xfb014c30
y.create.l HWIO_WCSS_A_TDC_RAM_OVERFLOW_ADDR A:0xfb014c34
y.create.l HWIO_WCSS_A_TPC_TXPWR_OVERRIDE_11A0_ADDR A:0xfb010000
y.create.l HWIO_WCSS_A_TPC_TXPWR_OVERRIDE_11B0_ADDR A:0xfb010004
y.create.l HWIO_WCSS_A_TPC_TXPWR_ENABLE_ADDR A:0xfb010008
y.create.l HWIO_WCSS_A_TPC_ADC_CTRL_GET_ADC_ADDR A:0xfb01000c
y.create.l HWIO_WCSS_A_TPC_ADC_STATUS_ADDR A:0xfb010010
y.create.l HWIO_WCSS_A_TPC_MAN_TXPWR_ADDR A:0xfb010014
y.create.l HWIO_WCSS_A_TPC_MAX_RF_GAIN_ADDR A:0xfb010018
y.create.l HWIO_WCSS_A_TPC_MIN_RF_GAIN_ADDR A:0xfb01001c
y.create.l HWIO_WCSS_A_TPC_MAX_DIGITAL_GAIN_ADDR A:0xfb010020
y.create.l HWIO_WCSS_A_TPC_MID_DIGITAL_GAIN_ADDR A:0xfb010024
y.create.l HWIO_WCSS_A_TPC_MIN_DIGITAL_GAIN_ADDR A:0xfb010028
y.create.l HWIO_WCSS_A_TPC_RC_DELAY_ADDR A:0xfb010030
y.create.l HWIO_WCSS_A_TPC_SENSED_PWR0_ADDR A:0xfb010034
y.create.l HWIO_WCSS_A_TPC_ADCTIMEOUT_ADDR A:0xfb010038
y.create.l HWIO_WCSS_A_TPC_APBACCESS_ADDR A:0xfb01003c
y.create.l HWIO_WCSS_A_TPC_PTADC_FSM_RST_ADDR A:0xfb010040
y.create.l HWIO_WCSS_A_TPC_PDADC_RANGE_ADDR A:0xfb010048
y.create.l HWIO_WCSS_A_TPC_PDADC_OFFSET_ADDR A:0xfb01004c
y.create.l HWIO_WCSS_A_TPC_GAIN_OFFSET1_ADDR A:0xfb010050
y.create.l HWIO_WCSS_A_TPC_GAIN_OFFSET2_ADDR A:0xfb010054
y.create.l HWIO_WCSS_A_TPC_DEMANDED_PWR_RANGE_ADDR A:0xfb010058
y.create.l HWIO_WCSS_A_TPC_LAST_DEMANDED_PWR_ADDR A:0xfb01005c
y.create.l HWIO_WCSS_A_TPC_POWERDET0_RAM0_ADDR A:0xfb010800
y.create.l HWIO_WCSS_A_TPC_POWERDET0_RAM1_ADDR A:0xfb010804
y.create.l HWIO_WCSS_A_TPC_POWERDET0_RAM2_ADDR A:0xfb010808
y.create.l HWIO_WCSS_A_TPC_POWERDET0_RAM3_ADDR A:0xfb01080c
y.create.l HWIO_WCSS_A_TPC_POWERDET0_RAM4_ADDR A:0xfb010810
y.create.l HWIO_WCSS_A_TPC_POWERDET0_RAM5_ADDR A:0xfb010814
y.create.l HWIO_WCSS_A_TPC_POWERDET0_RAM6_ADDR A:0xfb010818
y.create.l HWIO_WCSS_A_TPC_POWERDET0_RAM7_ADDR A:0xfb01081c
y.create.l HWIO_WCSS_A_TPC_POWERDET0_RAM8_ADDR A:0xfb010820
y.create.l HWIO_WCSS_A_TPC_POWERDET0_RAM9_ADDR A:0xfb010824
y.create.l HWIO_WCSS_A_TPC_RF_GAIN_LUT00_ADDR A:0xfb010c00
y.create.l HWIO_WCSS_A_TPC_RF_GAIN_LUT01_ADDR A:0xfb010c04
y.create.l HWIO_WCSS_A_TPC_RF_GAIN_LUT02_ADDR A:0xfb010c08
y.create.l HWIO_WCSS_A_TPC_RF_GAIN_LUT03_ADDR A:0xfb010c0c
y.create.l HWIO_WCSS_A_TPC_RF_GAIN_LUT04_ADDR A:0xfb010c10
y.create.l HWIO_WCSS_A_TPC_RF_GAIN_LUT05_ADDR A:0xfb010c14
y.create.l HWIO_WCSS_A_TPC_RF_GAIN_LUT06_ADDR A:0xfb010c18
y.create.l HWIO_WCSS_A_TPC_RF_GAIN_LUT07_ADDR A:0xfb010c1c
y.create.l HWIO_WCSS_A_TPC_RF_GAIN_LUT08_ADDR A:0xfb010c20
y.create.l HWIO_WCSS_A_TPC_RF_GAIN_LUT09_ADDR A:0xfb010c24
y.create.l HWIO_WCSS_A_TPC_DIGITAL_GAIN_LUT00_ADDR A:0xfb010c80
y.create.l HWIO_WCSS_A_TPC_DIGITAL_GAIN_LUT01_ADDR A:0xfb010c84
y.create.l HWIO_WCSS_A_TPC_DIGITAL_GAIN_LUT02_ADDR A:0xfb010c88
y.create.l HWIO_WCSS_A_TPC_DIGITAL_GAIN_LUT03_ADDR A:0xfb010c8c
y.create.l HWIO_WCSS_A_TPC_DIGITAL_GAIN_LUT04_ADDR A:0xfb010c90
y.create.l HWIO_WCSS_A_TPC_DIGITAL_GAIN_LUT05_ADDR A:0xfb010c94
y.create.l HWIO_WCSS_A_TPC_DIGITAL_GAIN_LUT06_ADDR A:0xfb010c98
y.create.l HWIO_WCSS_A_TPC_DIGITAL_GAIN_LUT07_ADDR A:0xfb010c9c
y.create.l HWIO_WCSS_A_TPC_DIGITAL_GAIN_LUT08_ADDR A:0xfb010ca0
y.create.l HWIO_WCSS_A_TPC_DIGITAL_GAIN_LUT09_ADDR A:0xfb010ca4
y.create.l HWIO_WCSS_A_TPE_EDCF_TXOP_0_1_ADDR A:0xfb082000
y.create.l HWIO_WCSS_A_TPE_EDCF_TXOP_2_3_ADDR A:0xfb082004
y.create.l HWIO_WCSS_A_TPE_EDCF_TXOP_4_5_ADDR A:0xfb082008
y.create.l HWIO_WCSS_A_TPE_EDCF_TXOP_6_7_ADDR A:0xfb08200c
y.create.l HWIO_WCSS_A_TPE_SW_TEMPLATE_BASE_ADDR_ADDR A:0xfb082010
y.create.l HWIO_WCSS_A_TPE_SW_TPE_HW_CONTROL_REG_ADDR A:0xfb082014
y.create.l HWIO_WCSS_A_TPE_SW_SOFTWARE_TX_CONTROL_REG1_ADDR A:0xfb082018
y.create.l HWIO_WCSS_A_TPE_SW_SOFTWARE_TX_ADDRESS_ADDR A:0xfb08201c
y.create.l HWIO_WCSS_A_TPE_SW_MAX_BYTES_AND_TX_TIME_IN_AMPDU_ADDR A:0xfb082020
y.create.l HWIO_WCSS_A_TPE_SW_MAX_MPDUS_IN_AMPDU_AND_MISC_ADDR A:0xfb082024
y.create.l HWIO_WCSS_A_TPE_SW_STA_DESCR_ADDR_ADDR A:0xfb082028
y.create.l HWIO_WCSS_A_TPE_SW_TPE_TEST_AND_MISC_ADDR A:0xfb082030
y.create.l HWIO_WCSS_A_TPE_SW_PM_ADDR A:0xfb082034
y.create.l HWIO_WCSS_A_TPE_SW_TPE_TEST_BUS_LOWER_ADDR A:0xfb082038
y.create.l HWIO_WCSS_A_TPE_SW_11G_CTRL_INDEX_OFFSET_ADDR A:0xfb08203c
y.create.l HWIO_WCSS_A_TPE_RATE_TABLE_SRAM_CONTROL_ADDR A:0xfb082040
y.create.l HWIO_WCSS_A_TPE_RATE_TABLE_SRAM_CONTROL2_ADDR A:0xfb082044
y.create.l HWIO_WCSS_A_TPE_SW_BEACON_BASE_ADDR_ADDR A:0xfb082050
y.create.l HWIO_WCSS_A_TPE_SW_BEACON_MAX_SIZE_MISC_ADDR A:0xfb082054
y.create.l HWIO_WCSS_A_TPE_SW_GLOBAL_CF_END_DATA_POWER_TEMPLATE_ADDR A:0xfb082058
y.create.l HWIO_WCSS_A_TPE_TPE_BMU_INTERFACE_CNTS_ADDR A:0xfb082080
y.create.l HWIO_WCSS_A_TPE_RXP_TPE_INTERFACE_CNTS_ADDR A:0xfb082084
y.create.l HWIO_WCSS_A_TPE_MTU_TPE_INTERFACE_CNTS_ADDR A:0xfb082088
y.create.l HWIO_WCSS_A_TPE_RPE_TPE_INTERFACE_CNTS_ADDR A:0xfb08208c
y.create.l HWIO_WCSS_A_TPE_ERROR_INT_CNTS_ADDR A:0xfb082090
y.create.l HWIO_WCSS_A_TPE_UNICAST_BYTES_LOWER_ADDR A:0xfb0820c0
y.create.l HWIO_WCSS_A_TPE_UNICAST_BYTES_UPPER_ADDR A:0xfb0820c4
y.create.l HWIO_WCSS_A_TPE_MULTICAST_BYTES_LOWER_ADDR A:0xfb0820c8
y.create.l HWIO_WCSS_A_TPE_MULTICAST_BYTES_UPPER_ADDR A:0xfb0820cc
y.create.l HWIO_WCSS_A_TPE_BROADCAST_BYTES_LOWER_ADDR A:0xfb0820d0
y.create.l HWIO_WCSS_A_TPE_BROADCAST_BYTES_UPPER_ADDR A:0xfb0820d4
y.create.l HWIO_WCSS_A_TPE_STATISTIC_COUNTERS_CNTL_ADDR A:0xfb082100
y.create.l HWIO_WCSS_A_TPE_TPE_STATUS_REG_LOWER_ADDR A:0xfb082104
y.create.l HWIO_WCSS_A_TPE_TPE_STATUS_REG_UPPER_ADDR A:0xfb082108
y.create.l HWIO_WCSS_A_TPE_GOT_ACK_FOR_BACK_INFO_REG_ADDR A:0xfb082110
y.create.l HWIO_WCSS_A_TPE_SW_DELAY_WAIT_CMD_CNT_REG_ADDR A:0xfb082118
y.create.l HWIO_WCSS_A_TPE_SW_MEDIUM_TIME_USED_AC0_ADDR A:0xfb08211c
y.create.l HWIO_WCSS_A_TPE_SW_MEDIUM_TIME_USED_AC1_ADDR A:0xfb082120
y.create.l HWIO_WCSS_A_TPE_SW_MEDIUM_TIME_USED_AC2_ADDR A:0xfb082124
y.create.l HWIO_WCSS_A_TPE_SW_MEDIUM_TIME_USED_AC3_ADDR A:0xfb082128
y.create.l HWIO_WCSS_A_TPE_SW_MEDIUM_TIME_THR_AC0_AC1_ADDR A:0xfb08212c
y.create.l HWIO_WCSS_A_TPE_SW_MEDIUM_TIME_THR_AC2_AC3_ADDR A:0xfb082130
y.create.l HWIO_WCSS_A_TPE_SW_ADMISSION_CONTROL_CONTROL_REG_ADDR A:0xfb082134
y.create.l HWIO_WCSS_A_TPE_SW_LIFE_TIME_DROP_CNT_ADDR A:0xfb08213c
y.create.l HWIO_WCSS_A_TPE_TPE_MCU_BD_BASED_TX_INT_FEEDBACK_ADDR A:0xfb082140
y.create.l HWIO_WCSS_A_TPE_TPE_MCU_BD_BASED_TX_INT_FEEDBACK_1_ADDR A:0xfb082144
y.create.l HWIO_WCSS_A_TPE_WRONG_BA_SSN_TID_FEEDBACK_ADDR A:0xfb082148
y.create.l HWIO_WCSS_A_TPE_SW_CAPPED_POWER_CONTROL_ADDR A:0xfb08214c
y.create.l HWIO_WCSS_A_TPE_SW_ACK_TO_DUE_TO_BTC_COUNT_ADDR A:0xfb082150
y.create.l HWIO_WCSS_A_TPE_SW_LOW_PRIORITY_BT_REJECTED_COUNT_ADDR A:0xfb082154
y.create.l HWIO_WCSS_A_TPE_SW_TERMINATE_CURRENT_TX_VALID_ADDR A:0xfb082158
y.create.l HWIO_WCSS_A_TPE_RTT_REGISTER_ADDR A:0xfb08215c
y.create.l HWIO_WCSS_A_TPE_BEAMFORM_CTRL_ADDR A:0xfb082160
y.create.l HWIO_WCSS_A_TPE_CFG_CSI_ADDR_ADDR A:0xfb082164
y.create.l HWIO_WCSS_A_TPE_INTERRUPT_ENABLE_ADDR A:0xfb082168
y.create.l HWIO_WCSS_A_TPE_INTERRUPT_STATUS_ADDR A:0xfb08216c
y.create.l HWIO_WCSS_A_TPE_BEAMFORM_STATUS_ADDR A:0xfb082170
y.create.l HWIO_WCSS_A_TPE_CALIBRATION_CNT_ADDR A:0xfb082174
y.create.l HWIO_WCSS_A_TPE_BEAMFORM_CNT_ADDR A:0xfb082178
y.create.l HWIO_WCSS_A_TPE_SW_PM_2_ADDR A:0xfb08217c
y.create.l HWIO_WCSS_A_TPE_SW_11AC_PADDING_ADDR A:0xfb082198
y.create.l HWIO_WCSS_A_TPE_NDP_BEAMFORM_CTRL_ADDR A:0xfb0821b0
y.create.l HWIO_WCSS_A_TPE_BEAMFORM_QOSNULL_NDP_CNT_ADDR A:0xfb0821b4
y.create.l HWIO_WCSS_A_TPE_CXM_CTRL_ADDR A:0xfb0821b8
y.create.l HWIO_WCSS_A_TPE_SW_11AC_CTRL_ADDR A:0xfb0821bc
y.create.l HWIO_WCSS_A_TPE_SW_NONHT_BW_CTRL_ADDR A:0xfb0821e4
y.create.l HWIO_WCSS_A_TPE_SW_GLOBAL_CF_END_DATA_POWER_TEMPLATE_40MHZ_ADDR A:0xfb0821e8
y.create.l HWIO_WCSS_A_TPE_SW_GLOBAL_CF_END_DATA_POWER_TEMPLATE_80MHZ_ADDR A:0xfb0821ec
y.create.l HWIO_WCSS_A_TPE_SW_WARMUP_DELAY_ADDR A:0xfb0821f0
y.create.l HWIO_WCSS_A_TPE_MAIN_MPROC_REQ_CNT_ADDR A:0xfb0821f4
y.create.l HWIO_WCSS_A_TPE_SW_11AC_BEAMFORM_CTRL_ADDR A:0xfb0821f8
y.create.l HWIO_WCSS_A_TPE_SW_11AC_CNT1_ADDR A:0xfb0821fc
y.create.l HWIO_WCSS_A_TPE_SW_11AC_CNT2_ADDR A:0xfb0821ac
y.create.l HWIO_WCSS_A_TPE_SW_11AC_VHTCB_RATE_ADDR A:0xfb0821a8
y.create.l HWIO_WCSS_A_TPE_SW_VHTCB_ADDR2_0_LO_ADDR A:0xfb0821a0
y.create.l HWIO_WCSS_A_TPE_SW_VHTCB_ADDR2_0_HI_ADDR A:0xfb0821a4
y.create.l HWIO_WCSS_A_TPE_SW_VHTCB_ADDR2_1_LO_ADDR A:0xfb0821c0
y.create.l HWIO_WCSS_A_TPE_SW_VHTCB_ADDR2_1_HI_ADDR A:0xfb0821c4
y.create.l HWIO_WCSS_A_TPE_SW_VHTCB_ADDR2_LOOKUP_ADDR A:0xfb0821c8
y.create.l HWIO_WCSS_A_TPE_SW_RTT3_ABSOLUTE_ADDR A:0xfb0821cc
y.create.l HWIO_WCSS_A_TPE_SW_RTT3_DELTA_ADDR A:0xfb0821d0
y.create.l HWIO_WCSS_A_TPE_SW_RTT3_CTRL_ADDR A:0xfb0821d4
y.create.l HWIO_WCSS_A_TPE_SW_RTT3_CTRL2_ADDR A:0xfb0821d8
y.create.l HWIO_WCSS_A_TPE_SW_11AF_CTRL_ADDR A:0xfb0821dc
y.create.l HWIO_WCSS_A_TPE_SW_QBOOST_CTRL_ADDR A:0xfb0821e0
y.create.l HWIO_WCSS_A_TXCLKCTRL_ROOT_CLK_EN_ADDR A:0xfb013000
y.create.l HWIO_WCSS_A_TXCLKCTRL_APB_BLOCK_CLK_EN_ADDR A:0xfb013004
y.create.l HWIO_WCSS_A_TXCLKCTRL_APB_BLOCK_DYN_CLKG_DISABLE_ADDR A:0xfb013008
y.create.l HWIO_WCSS_A_TXCTL_FIR_MODE_ADDR A:0xfb012000
y.create.l HWIO_WCSS_A_TXCTL_PA_GUARD_ADDR A:0xfb012004
y.create.l HWIO_WCSS_A_TXCTL_RAMP_UP_11A_ADDR A:0xfb012008
y.create.l HWIO_WCSS_A_TXCTL_RAMP_UP_11B_ADDR A:0xfb01200c
y.create.l HWIO_WCSS_A_TXCTL_RAMP_DOWN_ADDR A:0xfb012010
y.create.l HWIO_WCSS_A_TXCTL_TESTMUX_SELECT_ADDR A:0xfb012014
y.create.l HWIO_WCSS_A_TXCTL_DAC_CONTROL_ADDR A:0xfb012018
y.create.l HWIO_WCSS_A_TXCTL_DAC_STDBY_ADDR A:0xfb01201c
y.create.l HWIO_WCSS_A_TXCTL_PLCP_OVERRIDE_ADDR A:0xfb012020
y.create.l HWIO_WCSS_A_TXCTL_FSHIFT_ADDR A:0xfb012024
y.create.l HWIO_WCSS_A_TXCTL_SOFTRESET_ADDR A:0xfb012028
y.create.l HWIO_WCSS_A_TXCTL_WATCHDOG_START_ADDR A:0xfb01202c
y.create.l HWIO_WCSS_A_TXCTL_WATCHDOG_RFWARM_ADDR A:0xfb012030
y.create.l HWIO_WCSS_A_TXCTL_WATCHDOG_PAGUARD_ADDR A:0xfb012034
y.create.l HWIO_WCSS_A_TXCTL_WATCHDOG_RAMPUP_ADDR A:0xfb012038
y.create.l HWIO_WCSS_A_TXCTL_WATCHDOG_TX_ADDR A:0xfb01203c
y.create.l HWIO_WCSS_A_TXCTL_WATCHDOG_SHUTOFF_ADDR A:0xfb012040
y.create.l HWIO_WCSS_A_TXCTL_WATCHDOG_TPC_ADDR A:0xfb012044
y.create.l HWIO_WCSS_A_TXCTL_MAX_TXBUSY_ADDR A:0xfb012048
y.create.l HWIO_WCSS_A_TXCTL_MAX_TXENB_ADDR A:0xfb01204c
y.create.l HWIO_WCSS_A_TXCTL_TXBUSY_ALARM_ADDR A:0xfb012050
y.create.l HWIO_WCSS_A_TXCTL_TXEN_ALARM_ADDR A:0xfb012054
y.create.l HWIO_WCSS_A_TXCTL_TXCTL_STATE_ADDR A:0xfb012058
y.create.l HWIO_WCSS_A_TXCTL_LAST_PKT_PARAMS1_ADDR A:0xfb01205c
y.create.l HWIO_WCSS_A_TXCTL_LAST_PKT_PACKET_LENGTH_ADDR A:0xfb012060
y.create.l HWIO_WCSS_A_TXCTL_LAST_PKT_LSIG_LENGTH_ADDR A:0xfb012064
y.create.l HWIO_WCSS_A_TXCTL_LAST_TX_POWER_ADDR A:0xfb012068
y.create.l HWIO_WCSS_A_TXCTL_WATCHDOG_ALARM_ADDR A:0xfb01206c
y.create.l HWIO_WCSS_A_TXCTL_PKT_INVALID_ALARM_ADDR A:0xfb012070
y.create.l HWIO_WCSS_A_TXCTL_TXA_ABORT_ALARM_ADDR A:0xfb012074
y.create.l HWIO_WCSS_A_TXCTL_LEGACY_PKTS_ADDR A:0xfb012078
y.create.l HWIO_WCSS_A_TXCTL_GF_SIMO_20_PKTS_ADDR A:0xfb01207c
y.create.l HWIO_WCSS_A_TXCTL_GF_SIMO_40_PKTS_ADDR A:0xfb012080
y.create.l HWIO_WCSS_A_TXCTL_MM_SIMO_20_PKTS_ADDR A:0xfb012084
y.create.l HWIO_WCSS_A_TXCTL_MM_SIMO_40_PKTS_ADDR A:0xfb012088
y.create.l HWIO_WCSS_A_TXCTL_AC_SIMO_20_PKTS_ADDR A:0xfb01208c
y.create.l HWIO_WCSS_A_TXCTL_AC_SIMO_40_PKTS_ADDR A:0xfb012090
y.create.l HWIO_WCSS_A_TXCTL_AC_SIMO_80_PKTS_ADDR A:0xfb012094
y.create.l HWIO_WCSS_A_TXCTL_TXB_SHORT_PKTS_ADDR A:0xfb012098
y.create.l HWIO_WCSS_A_TXCTL_TXB_LONG_PKTS_ADDR A:0xfb01209c
y.create.l HWIO_WCSS_A_TXCTL_TXFIR_DONE_ADDR A:0xfb0120a0
y.create.l HWIO_WCSS_A_TXCTL_MISSING_WARMUP_ADDR A:0xfb0120a4
y.create.l HWIO_WCSS_A_TXCTL_ALARMS_ADDR A:0xfb0120a8
y.create.l HWIO_WCSS_A_TXCTL_RESET_ALARMS_ADDR A:0xfb0120ac
y.create.l HWIO_WCSS_A_TXFIR_CFG_ADDR A:0xfb018000
y.create.l HWIO_WCSS_A_TXFIR_LOLEAKAGE_SHIFT_ADDR A:0xfb018004
y.create.l HWIO_WCSS_A_TXFIR_COEFF_QUARTER_0_ADDR A:0xfb01800c
y.create.l HWIO_WCSS_A_TXFIR_COEFF_QUARTER_1_ADDR A:0xfb018010
y.create.l HWIO_WCSS_A_TXFIR_COEFF_QUARTER_2_ADDR A:0xfb018014
y.create.l HWIO_WCSS_A_TXFIR_COEFF_QUARTER_3_ADDR A:0xfb018018
y.create.l HWIO_WCSS_A_TXFIR_COEFF_QUARTER_4_ADDR A:0xfb01801c
y.create.l HWIO_WCSS_A_TXFIR_COEFF_QUARTER_5_ADDR A:0xfb018020
y.create.l HWIO_WCSS_A_TXFIR_COEFF_QUARTER_6_ADDR A:0xfb018024
y.create.l HWIO_WCSS_A_TXFIR_COEFF_QUARTER_7_ADDR A:0xfb018028
y.create.l HWIO_WCSS_A_TXFIR_COEFF_QUARTER_8_ADDR A:0xfb01802c
y.create.l HWIO_WCSS_A_TXFIR_COEFF_QUARTER_9_ADDR A:0xfb018030
y.create.l HWIO_WCSS_A_TXFIR_COEFF_QUARTER_10_ADDR A:0xfb018034
y.create.l HWIO_WCSS_A_TXFIR_COEFF_QUARTER_11_ADDR A:0xfb018038
y.create.l HWIO_WCSS_A_TXFIR_COEFF_QUARTER_12_ADDR A:0xfb01803c
y.create.l HWIO_WCSS_A_TXFIR_COEFF_QUARTER_13_ADDR A:0xfb018040
y.create.l HWIO_WCSS_A_TXFIR_COEFF_QUARTER_14_ADDR A:0xfb018044
y.create.l HWIO_WCSS_A_TXFIR_COEFF_QUARTER_15_ADDR A:0xfb018048
y.create.l HWIO_WCSS_A_TXFIR_COEFF_QUARTER_16_ADDR A:0xfb01804c
y.create.l HWIO_WCSS_A_TXFIR_COEFF_QUARTER_17_ADDR A:0xfb018050
y.create.l HWIO_WCSS_A_TXFIR_COEFF_QUARTER_18_ADDR A:0xfb018054
y.create.l HWIO_WCSS_A_TXFIR_COEFF_QUARTER_19_ADDR A:0xfb018058
y.create.l HWIO_WCSS_A_TXFIR_COEFF_QUARTER_20_ADDR A:0xfb01805c
y.create.l HWIO_WCSS_A_TXFIR_COEFF_QUARTER_21_ADDR A:0xfb018060
y.create.l HWIO_WCSS_A_TXFIR_COEFF_QUARTER_22_ADDR A:0xfb018064
y.create.l HWIO_WCSS_A_TXFIR_COEFF_QUARTER_23_ADDR A:0xfb018068
y.create.l HWIO_WCSS_A_TXFIR_COEFF_QUARTER_24_ADDR A:0xfb01806c
y.create.l HWIO_WCSS_A_TXFIR_COEFF_QUARTER_25_ADDR A:0xfb018070
y.create.l HWIO_WCSS_A_TXFIR_COEFF_QUARTER_26_ADDR A:0xfb018074
y.create.l HWIO_WCSS_A_TXFIR_COEFF_QUARTER_27_ADDR A:0xfb018078
y.create.l HWIO_WCSS_A_TXFIR_COEFF_QUARTER_28_ADDR A:0xfb01807c
y.create.l HWIO_WCSS_A_TXFIR_COEFF_QUARTER_29_ADDR A:0xfb018080
y.create.l HWIO_WCSS_A_TXFIR_COEFF_QUARTER_30_ADDR A:0xfb018084
y.create.l HWIO_WCSS_A_TXFIR_COEFF_QUARTER_31_ADDR A:0xfb018088
y.create.l HWIO_WCSS_A_TXFIR_COEFF_QUARTER_32_ADDR A:0xfb01808c
y.create.l HWIO_WCSS_A_TXFIR_COEFF_QUARTER_33_ADDR A:0xfb018090
y.create.l HWIO_WCSS_A_TXFIR_COEFF_QUARTER_34_ADDR A:0xfb018094
y.create.l HWIO_WCSS_A_TXFIR_COEFF_QUARTER_35_ADDR A:0xfb018098
y.create.l HWIO_WCSS_A_TXFIR_COEFF_QUARTER_36_ADDR A:0xfb01809c
y.create.l HWIO_WCSS_A_TXFIR_COEFF_QUARTER_37_ADDR A:0xfb0180a0
y.create.l HWIO_WCSS_A_TXFIR_COEFF_QUARTER_38_ADDR A:0xfb0180a4
y.create.l HWIO_WCSS_A_TXFIR_COEFF_QUARTER_39_ADDR A:0xfb0180a8
y.create.l HWIO_WCSS_A_TXFIR_COEFF_QUARTER_40_ADDR A:0xfb0180ac
y.create.l HWIO_WCSS_A_TXFIR_COEFF_QUARTER_41_ADDR A:0xfb0180b0
y.create.l HWIO_WCSS_A_TXFIR_COEFF_HALF_0_ADDR A:0xfb0180b4
y.create.l HWIO_WCSS_A_TXFIR_COEFF_HALF_1_ADDR A:0xfb0180b8
y.create.l HWIO_WCSS_A_TXFIR_COEFF_HALF_2_ADDR A:0xfb0180bc
y.create.l HWIO_WCSS_A_TXFIR_COEFF_HALF_3_ADDR A:0xfb0180c0
y.create.l HWIO_WCSS_A_TXFIR_COEFF_HALF_4_ADDR A:0xfb0180c4
y.create.l HWIO_WCSS_A_TXFIR_COEFF_HALF_5_ADDR A:0xfb0180c8
y.create.l HWIO_WCSS_A_TXFIR_COEFF_HALF_6_ADDR A:0xfb0180cc
y.create.l HWIO_WCSS_A_TXFIR_COEFF_HALF_7_ADDR A:0xfb0180d0
y.create.l HWIO_WCSS_A_TXFIR_COEFF_HALF_8_ADDR A:0xfb0180d4
y.create.l HWIO_WCSS_A_TXFIR_COEFF_HALF_9_ADDR A:0xfb0180d8
y.create.l HWIO_WCSS_A_TXFIR_COEFF_HALF_10_ADDR A:0xfb0180dc
y.create.l HWIO_WCSS_A_TXFIR_COEFF_HALF_11_ADDR A:0xfb0180e0
y.create.l HWIO_WCSS_A_TXFIR_COEFF_HALF_12_ADDR A:0xfb0180e4
y.create.l HWIO_WCSS_A_TXFIR_COEFF_HALF_13_ADDR A:0xfb0180e8
y.create.l HWIO_WCSS_A_TXFIR_COEFF_HALF_14_ADDR A:0xfb0180ec
y.create.l HWIO_WCSS_A_TXFIR_COEFF_HALF_15_ADDR A:0xfb0180f0
y.create.l HWIO_WCSS_A_TXFIR_COEFF_HALF_16_ADDR A:0xfb0180f4
y.create.l HWIO_WCSS_A_TXFIR_COEFF_HALF_17_ADDR A:0xfb0180f8
y.create.l HWIO_WCSS_A_TXFIR_COEFF_HALF_18_ADDR A:0xfb0180fc
y.create.l HWIO_WCSS_A_TXFIR_COEFF_HALF_19_ADDR A:0xfb018100
y.create.l HWIO_WCSS_A_TXFIR_COEFF_HALF_20_ADDR A:0xfb018104
y.create.l HWIO_WCSS_A_TXFIR_COEFF_HALF_21_ADDR A:0xfb018108
y.create.l HWIO_WCSS_A_TXFIR_COEFF_HALF_22_ADDR A:0xfb01810c
y.create.l HWIO_WCSS_A_TXFIR_COEFF_HALF_23_ADDR A:0xfb018110
y.create.l HWIO_WCSS_A_TXFIR_COEFF_HALF_24_ADDR A:0xfb018114
y.create.l HWIO_WCSS_A_TXFIR_COEFF_HALF_25_ADDR A:0xfb018118
y.create.l HWIO_WCSS_A_TXFIR_COEFF_HALF_26_ADDR A:0xfb01811c
y.create.l HWIO_WCSS_A_TXFIR_COEFF_HALF_27_ADDR A:0xfb018120
y.create.l HWIO_WCSS_A_TXFIR_COEFF_HALF_28_ADDR A:0xfb018124
y.create.l HWIO_WCSS_A_TXFIR_COEFF_HALF_29_ADDR A:0xfb018128
y.create.l HWIO_WCSS_A_TXFIR_COEFF_HALF_30_ADDR A:0xfb01812c
y.create.l HWIO_WCSS_A_TXFIR_COEFF_HALF_31_ADDR A:0xfb018130
y.create.l HWIO_WCSS_A_TXFIR_COEFF_HALF_32_ADDR A:0xfb018134
y.create.l HWIO_WCSS_A_TXFIR_COEFF_HALF_33_ADDR A:0xfb018138
y.create.l HWIO_WCSS_A_TXFIR_COEFF_HALF_34_ADDR A:0xfb01813c
y.create.l HWIO_WCSS_A_TXFIR_COEFF_HALF_35_ADDR A:0xfb018140
y.create.l HWIO_WCSS_A_TXFIR_COEFF_HALF_36_ADDR A:0xfb018144
y.create.l HWIO_WCSS_A_TXFIR_COEFF_HALF_37_ADDR A:0xfb018148
y.create.l HWIO_WCSS_A_TXFIR_COEFF_HALF_38_ADDR A:0xfb01814c
y.create.l HWIO_WCSS_A_TXFIR_COEFF_HALF_39_ADDR A:0xfb018150
y.create.l HWIO_WCSS_A_TXFIR_COEFF_HALF_40_ADDR A:0xfb018154
y.create.l HWIO_WCSS_A_TXFIR_COEFF_HALF_41_ADDR A:0xfb018158
y.create.l HWIO_WCSS_A_TXFIR_COEFF_FULL_0_ADDR A:0xfb01815c
y.create.l HWIO_WCSS_A_TXFIR_COEFF_FULL_1_ADDR A:0xfb018160
y.create.l HWIO_WCSS_A_TXFIR_COEFF_FULL_2_ADDR A:0xfb018164
y.create.l HWIO_WCSS_A_TXFIR_COEFF_FULL_3_ADDR A:0xfb018168
y.create.l HWIO_WCSS_A_TXFIR_COEFF_FULL_4_ADDR A:0xfb01816c
y.create.l HWIO_WCSS_A_TXFIR_COEFF_FULL_5_ADDR A:0xfb018170
y.create.l HWIO_WCSS_A_TXFIR_COEFF_FULL_6_ADDR A:0xfb018174
y.create.l HWIO_WCSS_A_TXFIR_COEFF_FULL_7_ADDR A:0xfb018178
y.create.l HWIO_WCSS_A_TXFIR_COEFF_FULL_8_ADDR A:0xfb01817c
y.create.l HWIO_WCSS_A_TXFIR_COEFF_FULL_9_ADDR A:0xfb018180
y.create.l HWIO_WCSS_A_TXFIR_COEFF_FULL_10_ADDR A:0xfb018184
y.create.l HWIO_WCSS_A_TXFIR_COEFF_FULL_11_ADDR A:0xfb018188
y.create.l HWIO_WCSS_A_TXFIR_COEFF_FULL_12_ADDR A:0xfb01818c
y.create.l HWIO_WCSS_A_TXFIR_COEFF_FULL_13_ADDR A:0xfb018190
y.create.l HWIO_WCSS_A_TXFIR_COEFF_FULL_14_ADDR A:0xfb018194
y.create.l HWIO_WCSS_A_TXFIR_COEFF_FULL_15_ADDR A:0xfb018198
y.create.l HWIO_WCSS_A_TXFIR_COEFF_FULL_16_ADDR A:0xfb01819c
y.create.l HWIO_WCSS_A_TXFIR_COEFF_FULL_17_ADDR A:0xfb0181a0
y.create.l HWIO_WCSS_A_TXFIR_COEFF_FULL_18_ADDR A:0xfb0181a4
y.create.l HWIO_WCSS_A_TXFIR_COEFF_FULL_19_ADDR A:0xfb0181a8
y.create.l HWIO_WCSS_A_TXFIR_COEFF_FULL_20_ADDR A:0xfb0181ac
y.create.l HWIO_WCSS_A_TXFIR_COEFF_FULL_21_ADDR A:0xfb0181b0
y.create.l HWIO_WCSS_A_TXFIR_COEFF_FULL_22_ADDR A:0xfb0181b4
y.create.l HWIO_WCSS_A_TXFIR_COEFF_FULL_23_ADDR A:0xfb0181b8
y.create.l HWIO_WCSS_A_TXFIR_COEFF_FULL_24_ADDR A:0xfb0181bc
y.create.l HWIO_WCSS_A_TXFIR_COEFF_FULL_25_ADDR A:0xfb0181c0
y.create.l HWIO_WCSS_A_TXFIR_COEFF_FULL_26_ADDR A:0xfb0181c4
y.create.l HWIO_WCSS_A_TXFIR_COEFF_FULL_27_ADDR A:0xfb0181c8
y.create.l HWIO_WCSS_A_TXFIR_COEFF_FULL_28_ADDR A:0xfb0181cc
y.create.l HWIO_WCSS_A_TXFIR_COEFF_FULL_29_ADDR A:0xfb0181d0
y.create.l HWIO_WCSS_A_TXFIR_COEFF_FULL_30_ADDR A:0xfb0181d4
y.create.l HWIO_WCSS_A_TXFIR_COEFF_FULL_31_ADDR A:0xfb0181d8
y.create.l HWIO_WCSS_A_TXFIR_COEFF_FULL_32_ADDR A:0xfb0181dc
y.create.l HWIO_WCSS_A_TXFIR_COEFF_FULL_33_ADDR A:0xfb0181e0
y.create.l HWIO_WCSS_A_TXFIR_COEFF_FULL_34_ADDR A:0xfb0181e4
y.create.l HWIO_WCSS_A_TXFIR_COEFF_FULL_35_ADDR A:0xfb0181e8
y.create.l HWIO_WCSS_A_TXFIR_COEFF_FULL_36_ADDR A:0xfb0181ec
y.create.l HWIO_WCSS_A_TXFIR_COEFF_FULL_37_ADDR A:0xfb0181f0
y.create.l HWIO_WCSS_A_TXFIR_COEFF_FULL_38_ADDR A:0xfb0181f4
y.create.l HWIO_WCSS_A_TXFIR_COEFF_FULL_39_ADDR A:0xfb0181f8
y.create.l HWIO_WCSS_A_TXFIR_COEFF_FULL_40_ADDR A:0xfb0181fc
y.create.l HWIO_WCSS_A_TXFIR_COEFF_FULL_41_ADDR A:0xfb018200
y.create.l HWIO_WCSS_A_TXFIR_COEFF_TXB_20_0_ADDR A:0xfb018204
y.create.l HWIO_WCSS_A_TXFIR_COEFF_TXB_20_1_ADDR A:0xfb018208
y.create.l HWIO_WCSS_A_TXFIR_COEFF_TXB_20_2_ADDR A:0xfb01820c
y.create.l HWIO_WCSS_A_TXFIR_COEFF_TXB_20_3_ADDR A:0xfb018210
y.create.l HWIO_WCSS_A_TXFIR_COEFF_TXB_20_4_ADDR A:0xfb018214
y.create.l HWIO_WCSS_A_TXFIR_COEFF_TXB_20_5_ADDR A:0xfb018218
y.create.l HWIO_WCSS_A_TXFIR_COEFF_TXB_20_6_ADDR A:0xfb01821c
y.create.l HWIO_WCSS_A_TXFIR_COEFF_TXB_20_7_ADDR A:0xfb018220
y.create.l HWIO_WCSS_A_TXFIR_COEFF_TXB_20_8_ADDR A:0xfb018224
y.create.l HWIO_WCSS_A_TXFIR_COEFF_TXB_20_9_ADDR A:0xfb018228
y.create.l HWIO_WCSS_A_TXFIR_COEFF_TXB_20_10_ADDR A:0xfb01822c
y.create.l HWIO_WCSS_A_TXFIR_COEFF_TXB_20_11_ADDR A:0xfb018230
y.create.l HWIO_WCSS_A_TXFIR_COEFF_TXB_20_12_ADDR A:0xfb018234
y.create.l HWIO_WCSS_A_TXFIR_COEFF_TXB_20_13_ADDR A:0xfb018238
y.create.l HWIO_WCSS_A_TXFIR_COEFF_TXB_20_14_ADDR A:0xfb01823c
y.create.l HWIO_WCSS_A_TXFIR_COEFF_TXB_20_15_ADDR A:0xfb018240
y.create.l HWIO_WCSS_A_TXFIR_COEFF_TXB_40_0_ADDR A:0xfb018244
y.create.l HWIO_WCSS_A_TXFIR_COEFF_TXB_40_1_ADDR A:0xfb018248
y.create.l HWIO_WCSS_A_TXFIR_COEFF_TXB_40_2_ADDR A:0xfb01824c
y.create.l HWIO_WCSS_A_TXFIR_COEFF_TXB_40_3_ADDR A:0xfb018250
y.create.l HWIO_WCSS_A_TXFIR_COEFF_TXB_40_4_ADDR A:0xfb018254
y.create.l HWIO_WCSS_A_TXFIR_COEFF_TXB_40_5_ADDR A:0xfb018258
y.create.l HWIO_WCSS_A_TXFIR_COEFF_TXB_40_6_ADDR A:0xfb01825c
y.create.l HWIO_WCSS_A_TXFIR_COEFF_TXB_40_7_ADDR A:0xfb018260
y.create.l HWIO_WCSS_A_TXFIR_COEFF_TXB_40_8_ADDR A:0xfb018264
y.create.l HWIO_WCSS_A_TXFIR_COEFF_TXB_40_9_ADDR A:0xfb018268
y.create.l HWIO_WCSS_A_TXFIR_COEFF_TXB_40_10_ADDR A:0xfb01826c
y.create.l HWIO_WCSS_A_TXFIR_COEFF_TXB_40_11_ADDR A:0xfb018270
y.create.l HWIO_WCSS_A_TXFIR_COEFF_TXB_40_12_ADDR A:0xfb018274
y.create.l HWIO_WCSS_A_TXFIR_COEFF_TXB_40_13_ADDR A:0xfb018278
y.create.l HWIO_WCSS_A_TXFIR_COEFF_TXB_40_14_ADDR A:0xfb01827c
y.create.l HWIO_WCSS_A_TXFIR_COEFF_TXB_40_15_ADDR A:0xfb018280
y.create.l HWIO_WCSS_A_TXFIR_COEFF_TXB_40_16_ADDR A:0xfb018284
y.create.l HWIO_WCSS_A_TXFIR_COEFF_TXB_40_17_ADDR A:0xfb018288
y.create.l HWIO_WCSS_A_TXFIR_COEFF_TXB_40_18_ADDR A:0xfb01828c
y.create.l HWIO_WCSS_A_TXFIR_COEFF_TXB_40_19_ADDR A:0xfb018290
y.create.l HWIO_WCSS_A_TXFIR_COEFF_TXB_40_20_ADDR A:0xfb018294
y.create.l HWIO_WCSS_A_TXFIR_COEFF_TXB_40_21_ADDR A:0xfb018298
y.create.l HWIO_WCSS_A_TXFIR_COEFF_TXB_40_22_ADDR A:0xfb01829c
y.create.l HWIO_WCSS_A_TXFIR_COEFF_TXB_40_23_ADDR A:0xfb0182a0
y.create.l HWIO_WCSS_A_TXFIR_COEFF_TXB_40_24_ADDR A:0xfb0182a4
y.create.l HWIO_WCSS_A_TXFIR_COEFF_TXB_40_25_ADDR A:0xfb0182a8
y.create.l HWIO_WCSS_A_TXFIR_COEFF_TXB_40_26_ADDR A:0xfb0182ac
y.create.l HWIO_WCSS_A_TXFIR_COEFF_TXB_40_27_ADDR A:0xfb0182b0
y.create.l HWIO_WCSS_A_TXFIR_COEFF_TXB_40_28_ADDR A:0xfb0182b4
y.create.l HWIO_WCSS_A_TXFIR_COEFF_TXB_40_29_ADDR A:0xfb0182b8
y.create.l HWIO_WCSS_A_TXFIR_COEFF_TXB_40_30_ADDR A:0xfb0182bc
y.create.l HWIO_WCSS_A_TXFIR_COEFF_TXB_40_31_ADDR A:0xfb0182c0
y.create.l HWIO_WCSS_A_TXFIR_COEFF_TXB_80_0_ADDR A:0xfb0182c4
y.create.l HWIO_WCSS_A_TXFIR_COEFF_TXB_80_1_ADDR A:0xfb0182c8
y.create.l HWIO_WCSS_A_TXFIR_COEFF_TXB_80_2_ADDR A:0xfb0182cc
y.create.l HWIO_WCSS_A_TXFIR_COEFF_TXB_80_3_ADDR A:0xfb0182d0
y.create.l HWIO_WCSS_A_TXFIR_COEFF_TXB_80_4_ADDR A:0xfb0182d4
y.create.l HWIO_WCSS_A_TXFIR_COEFF_TXB_80_5_ADDR A:0xfb0182d8
y.create.l HWIO_WCSS_A_TXFIR_COEFF_TXB_80_6_ADDR A:0xfb0182dc
y.create.l HWIO_WCSS_A_TXFIR_COEFF_TXB_80_7_ADDR A:0xfb0182e0
y.create.l HWIO_WCSS_A_TXFIR_COEFF_TXB_80_8_ADDR A:0xfb0182e4
y.create.l HWIO_WCSS_A_TXFIR_COEFF_TXB_80_9_ADDR A:0xfb0182e8
y.create.l HWIO_WCSS_A_TXFIR_COEFF_TXB_80_10_ADDR A:0xfb0182ec
y.create.l HWIO_WCSS_A_TXFIR_COEFF_TXB_80_11_ADDR A:0xfb0182f0
y.create.l HWIO_WCSS_A_TXFIR_COEFF_TXB_80_12_ADDR A:0xfb0182f4
y.create.l HWIO_WCSS_A_TXFIR_COEFF_TXB_80_13_ADDR A:0xfb0182f8
y.create.l HWIO_WCSS_A_TXFIR_COEFF_TXB_80_14_ADDR A:0xfb0182fc
y.create.l HWIO_WCSS_A_TXFIR_COEFF_TXB_80_15_ADDR A:0xfb018300
y.create.l HWIO_WCSS_A_TXFIR_COEFF_TXB_80_16_ADDR A:0xfb018304
y.create.l HWIO_WCSS_A_TXFIR_COEFF_TXB_80_17_ADDR A:0xfb018308
y.create.l HWIO_WCSS_A_TXFIR_COEFF_TXB_80_18_ADDR A:0xfb01830c
y.create.l HWIO_WCSS_A_TXFIR_COEFF_TXB_80_19_ADDR A:0xfb018310
y.create.l HWIO_WCSS_A_TXFIR_COEFF_TXB_80_20_ADDR A:0xfb018314
y.create.l HWIO_WCSS_A_TXFIR_COEFF_TXB_80_21_ADDR A:0xfb018318
y.create.l HWIO_WCSS_A_TXFIR_COEFF_TXB_80_22_ADDR A:0xfb01831c
y.create.l HWIO_WCSS_A_TXFIR_COEFF_TXB_80_23_ADDR A:0xfb018320
y.create.l HWIO_WCSS_A_TXFIR_COEFF_TXB_80_24_ADDR A:0xfb018324
y.create.l HWIO_WCSS_A_TXFIR_COEFF_TXB_80_25_ADDR A:0xfb018328
y.create.l HWIO_WCSS_A_TXFIR_COEFF_TXB_80_26_ADDR A:0xfb01832c
y.create.l HWIO_WCSS_A_TXFIR_COEFF_TXB_80_27_ADDR A:0xfb018330
y.create.l HWIO_WCSS_A_TXFIR_COEFF_TXB_80_28_ADDR A:0xfb018334
y.create.l HWIO_WCSS_A_TXFIR_COEFF_TXB_80_29_ADDR A:0xfb018338
y.create.l HWIO_WCSS_A_TXFIR_COEFF_TXB_80_30_ADDR A:0xfb01833c
y.create.l HWIO_WCSS_A_TXFIR_COEFF_TXB_80_31_ADDR A:0xfb018340
y.create.l HWIO_WCSS_A_TXFIR_COEFF_TXB_80_32_ADDR A:0xfb018344
y.create.l HWIO_WCSS_A_TXFIR_COEFF_TXB_80_33_ADDR A:0xfb018348
y.create.l HWIO_WCSS_A_TXFIR_COEFF_TXB_80_34_ADDR A:0xfb01834c
y.create.l HWIO_WCSS_A_TXFIR_COEFF_TXB_80_35_ADDR A:0xfb018350
y.create.l HWIO_WCSS_A_TXFIR_COEFF_TXB_80_36_ADDR A:0xfb018354
y.create.l HWIO_WCSS_A_TXFIR_COEFF_TXB_80_37_ADDR A:0xfb018358
y.create.l HWIO_WCSS_A_TXFIR_COEFF_TXB_80_38_ADDR A:0xfb01835c
y.create.l HWIO_WCSS_A_TXFIR_COEFF_TXB_80_39_ADDR A:0xfb018360
y.create.l HWIO_WCSS_A_TXFIR_COEFF_TXB_80_40_ADDR A:0xfb018364
y.create.l HWIO_WCSS_A_TXFIR_COEFF_TXB_80_41_ADDR A:0xfb018368
y.create.l HWIO_WCSS_A_TXFIR_COEFF_TXB_80_42_ADDR A:0xfb01836c
y.create.l HWIO_WCSS_A_TXFIR_COEFF_TXB_80_43_ADDR A:0xfb018370
y.create.l HWIO_WCSS_A_TXFIR_COEFF_TXB_80_44_ADDR A:0xfb018374
y.create.l HWIO_WCSS_A_TXFIR_COEFF_TXB_80_45_ADDR A:0xfb018378
y.create.l HWIO_WCSS_A_TXFIR_COEFF_TXB_80_46_ADDR A:0xfb01837c
y.create.l HWIO_WCSS_A_TXFIR_COEFF_TXB_80_47_ADDR A:0xfb018380
y.create.l HWIO_WCSS_A_TXFIR_COEFF_TXB_80_48_ADDR A:0xfb018384
y.create.l HWIO_WCSS_A_TXFIR_COEFF_TXB_80_49_ADDR A:0xfb018388
y.create.l HWIO_WCSS_A_TXFIR_COEFF_TXB_80_50_ADDR A:0xfb01838c
y.create.l HWIO_WCSS_A_TXFIR_COEFF_TXB_80_51_ADDR A:0xfb018390
y.create.l HWIO_WCSS_A_TXFIR_COEFF_TXB_80_52_ADDR A:0xfb018394
y.create.l HWIO_WCSS_A_TXFIR_COEFF_TXB_80_53_ADDR A:0xfb018398
y.create.l HWIO_WCSS_A_TXFIR_COEFF_TXB_80_54_ADDR A:0xfb01839c
y.create.l HWIO_WCSS_A_TXFIR_COEFF_TXB_80_55_ADDR A:0xfb0183a0
y.create.l HWIO_WCSS_A_TXFIR_COEFF_TXB_80_56_ADDR A:0xfb0183a4
y.create.l HWIO_WCSS_A_TXFIR_COEFF_TXB_80_57_ADDR A:0xfb0183a8
y.create.l HWIO_WCSS_A_TXFIR_COEFF_TXB_80_58_ADDR A:0xfb0183ac
y.create.l HWIO_WCSS_A_TXFIR_COEFF_TXB_80_59_ADDR A:0xfb0183b0
y.create.l HWIO_WCSS_A_TXFIR_COEFF_TXB_80_60_ADDR A:0xfb0183b4
y.create.l HWIO_WCSS_A_TXFIR_COEFF_TXB_80_61_ADDR A:0xfb0183b8
y.create.l HWIO_WCSS_A_TXFIR_COEFF_TXB_80_62_ADDR A:0xfb0183bc
y.create.l HWIO_WCSS_A_TXFIR_COEFF_TXB_80_63_ADDR A:0xfb0183c0
y.create.l HWIO_WCSS_A_TXFIR_COEFF_PEAKW_0_ADDR A:0xfb0183c4
y.create.l HWIO_WCSS_A_TXFIR_COEFF_PEAKW_1_ADDR A:0xfb0183c8
y.create.l HWIO_WCSS_A_TXFIR_COEFF_PEAKW_2_ADDR A:0xfb0183cc
y.create.l HWIO_WCSS_A_TXFIR_COEFF_PEAKW_3_ADDR A:0xfb0183d0
y.create.l HWIO_WCSS_A_TXFIR_COEFF_PEAKW_4_ADDR A:0xfb0183d4
y.create.l HWIO_WCSS_A_TXFIR_COEFF_PEAKW_5_ADDR A:0xfb0183d8
y.create.l HWIO_WCSS_A_TXFIR_COEFF_PEAKW_6_ADDR A:0xfb0183dc
y.create.l HWIO_WCSS_A_TXFIR_COEFF_PEAKW_7_ADDR A:0xfb0183e0
y.create.l HWIO_WCSS_A_TXFIR_COEFF_PEAKW_8_ADDR A:0xfb0183e4
y.create.l HWIO_WCSS_A_TXFIR_COEFF_PEAKW_9_ADDR A:0xfb0183e8
y.create.l HWIO_WCSS_A_TXFIR_COEFF_PEAKW_10_ADDR A:0xfb0183ec
y.create.l HWIO_WCSS_A_TXFIR_PEAKW_CLIP_THRESHOLD_0_ADDR A:0xfb0183f0
y.create.l HWIO_WCSS_A_TXFIR_PEAKW_CLIP_THRESHOLD_1_ADDR A:0xfb0183f4
y.create.l HWIO_WCSS_A_TXFIR_PEAKW_CLIP_THRESHOLD_2_ADDR A:0xfb0183f8
y.create.l HWIO_WCSS_A_TXFIR_PEAKW_CLIP_THRESHOLD_3_ADDR A:0xfb0183fc
y.create.l HWIO_WCSS_A_TXFIR_PEAKW_CLIP_THRESHOLD_4_ADDR A:0xfb018400
y.create.l HWIO_WCSS_A_TXFIR_PEAKW_CLIP_THRESHOLD_5_ADDR A:0xfb018404
y.create.l HWIO_WCSS_A_TXFIR_PEAKW_CLIP_THRESHOLD_6_ADDR A:0xfb018408
y.create.l HWIO_WCSS_A_TXFIR_PEAKW_CLIP_THRESHOLD_7_ADDR A:0xfb01840c
y.create.l HWIO_WCSS_A_TXFIR_PEAKW_CLIP_THRESHOLD_8_ADDR A:0xfb018410
y.create.l HWIO_WCSS_A_TXFIR_PEAKW_CLIP_THRESHOLD_9_ADDR A:0xfb018414
y.create.l HWIO_WCSS_A_TXFIR_PEAKW_CLIP_THRESHOLD_10_ADDR A:0xfb018418
y.create.l HWIO_WCSS_A_TXFIR_PEAKW_CLIP_THRESHOLD_11_ADDR A:0xfb01841c
y.create.l HWIO_WCSS_A_TXFIR_PEAKW_CLIP_THRESHOLD_12_ADDR A:0xfb018420
y.create.l HWIO_WCSS_A_TXFIR_PEAKW_CLIP_THRESHOLD_13_ADDR A:0xfb018424
y.create.l HWIO_WCSS_A_TXFIR_PEAKW_CLIP_THRESHOLD_14_ADDR A:0xfb018428
y.create.l HWIO_WCSS_A_TXFIR_PEAKW_CLIP_THRESHOLD_15_ADDR A:0xfb01842c
y.create.l HWIO_WCSS_A_TXFIR_PEAKW_CLIP_THRESHOLD_16_ADDR A:0xfb018430
y.create.l HWIO_WCSS_A_TXFIR_PEAKW_CLIP_THRESHOLD_17_ADDR A:0xfb018434
y.create.l HWIO_WCSS_A_TXFIR_PEAKW_CLIP_THRESHOLD_18_ADDR A:0xfb018438
y.create.l HWIO_WCSS_A_TXFIR_PEAKW_CLIP_THRESHOLD_19_ADDR A:0xfb01843c
y.create.l HWIO_WCSS_A_TXFIR_PEAKW_CLIP_THRESHOLD_20_ADDR A:0xfb018440
y.create.l HWIO_WCSS_A_TXFIR_PEAKW_CLIP_THRESHOLD_21_ADDR A:0xfb018444
y.create.l HWIO_WCSS_A_TXFIR_PEAKW_CLIP_THRESHOLD_22_ADDR A:0xfb018448
y.create.l HWIO_WCSS_A_TXFIR_PEAKW_CLIP_THRESHOLD_23_ADDR A:0xfb01844c
y.create.l HWIO_WCSS_A_TXFIR_PEAKW_CLIP_THRESHOLD_24_ADDR A:0xfb018450
y.create.l HWIO_WCSS_A_TXFIR_PEAKW_CLIP_THRESHOLD_25_ADDR A:0xfb018454
y.create.l HWIO_WCSS_A_TXFIR_PEAKW_CLIP_THRESHOLD_26_ADDR A:0xfb018458
y.create.l HWIO_WCSS_A_TXFIR_PEAKW_CLIP_THRESHOLD_27_ADDR A:0xfb01845c
y.create.l HWIO_WCSS_A_TXFIR_PEAKW_CLIP_THRESHOLD_28_ADDR A:0xfb018460
y.create.l HWIO_WCSS_A_TXFIR_PEAKW_CLIP_THRESHOLD_29_ADDR A:0xfb018464
y.create.l HWIO_WCSS_A_TXFIR_PEAKW_CLIP_THRESHOLD_30_ADDR A:0xfb018468
y.create.l HWIO_WCSS_A_TXFIR_PEAKW_CLIP_THRESHOLD_31_ADDR A:0xfb01846c
y.create.l HWIO_WCSS_A_TXFIR_Q_INVERT_ADDR A:0xfb018470
y.create.l HWIO_WCSS_A_TXFIR_INTERP_X2_ADDR A:0xfb018474
y.create.l HWIO_WCSS_A_TXFIR_IQCORR_CENTRE_TAP_ADDR A:0xfb018478
y.create.l HWIO_WCSS_A_TXFIR_GAIN_OFFSET_OFDM_ADDR A:0xfb01847c
y.create.l HWIO_WCSS_A_TXFIR_FINEGAIN_OFFSET_ADDR A:0xfb018480
y.create.l HWIO_WCSS_A_TXFIR_GAIN_OFFSET_11B_ADDR A:0xfb018484
y.create.l HWIO_WCSS_A_TXFIR_TXFIR_FIFO_RESET_ADDR A:0xfb018488
y.create.l HWIO_WCSS_A_TXFIR_TXCAL_MEM00_0_ADDR A:0xfb018800
y.create.l HWIO_WCSS_A_TXFIR_TXCAL_MEM01_0_ADDR A:0xfb018820
y.create.l HWIO_WCSS_A_TXFIR_TXCAL_MEM02_0_ADDR A:0xfb018840
y.create.l HWIO_WCSS_A_TXFIR_TXCAL_MEM03_0_ADDR A:0xfb018860
y.create.l HWIO_WCSS_A_TXFIR_TXCAL_MEM04_0_ADDR A:0xfb018880
y.create.l HWIO_WCSS_A_TXFIR_TXCAL_MEM05_0_ADDR A:0xfb0188a0
y.create.l HWIO_WCSS_A_TXFIR_TXCAL_MEM06_0_ADDR A:0xfb0188c0
y.create.l HWIO_WCSS_A_TXFIR_TXCAL_MEM07_0_ADDR A:0xfb0188e0
y.create.l HWIO_WCSS_A_TXFIR_TXCAL_MEM08_0_ADDR A:0xfb018900
y.create.l HWIO_WCSS_A_TXFIR_TXCAL_MEM09_0_ADDR A:0xfb018920
y.create.l HWIO_WCSS_A_TXFIR_TXCAL_MEM00_1_ADDR A:0xfb018804
y.create.l HWIO_WCSS_A_TXFIR_TXCAL_MEM01_1_ADDR A:0xfb018824
y.create.l HWIO_WCSS_A_TXFIR_TXCAL_MEM02_1_ADDR A:0xfb018844
y.create.l HWIO_WCSS_A_TXFIR_TXCAL_MEM03_1_ADDR A:0xfb018864
y.create.l HWIO_WCSS_A_TXFIR_TXCAL_MEM04_1_ADDR A:0xfb018884
y.create.l HWIO_WCSS_A_TXFIR_TXCAL_MEM05_1_ADDR A:0xfb0188a4
y.create.l HWIO_WCSS_A_TXFIR_TXCAL_MEM06_1_ADDR A:0xfb0188c4
y.create.l HWIO_WCSS_A_TXFIR_TXCAL_MEM07_1_ADDR A:0xfb0188e4
y.create.l HWIO_WCSS_A_TXFIR_TXCAL_MEM08_1_ADDR A:0xfb018904
y.create.l HWIO_WCSS_A_TXFIR_TXCAL_MEM09_1_ADDR A:0xfb018924
y.create.l HWIO_WCSS_A_TXFIR_TXCAL_MEM00_2_ADDR A:0xfb018808
y.create.l HWIO_WCSS_A_TXFIR_TXCAL_MEM01_2_ADDR A:0xfb018828
y.create.l HWIO_WCSS_A_TXFIR_TXCAL_MEM02_2_ADDR A:0xfb018848
y.create.l HWIO_WCSS_A_TXFIR_TXCAL_MEM03_2_ADDR A:0xfb018868
y.create.l HWIO_WCSS_A_TXFIR_TXCAL_MEM04_2_ADDR A:0xfb018888
y.create.l HWIO_WCSS_A_TXFIR_TXCAL_MEM05_2_ADDR A:0xfb0188a8
y.create.l HWIO_WCSS_A_TXFIR_TXCAL_MEM06_2_ADDR A:0xfb0188c8
y.create.l HWIO_WCSS_A_TXFIR_TXCAL_MEM07_2_ADDR A:0xfb0188e8
y.create.l HWIO_WCSS_A_TXFIR_TXCAL_MEM08_2_ADDR A:0xfb018908
y.create.l HWIO_WCSS_A_TXFIR_TXCAL_MEM09_2_ADDR A:0xfb018928
y.create.l HWIO_WCSS_A_TXFIR_TXCAL_MEM00_3_ADDR A:0xfb01880c
y.create.l HWIO_WCSS_A_TXFIR_TXCAL_MEM01_3_ADDR A:0xfb01882c
y.create.l HWIO_WCSS_A_TXFIR_TXCAL_MEM02_3_ADDR A:0xfb01884c
y.create.l HWIO_WCSS_A_TXFIR_TXCAL_MEM03_3_ADDR A:0xfb01886c
y.create.l HWIO_WCSS_A_TXFIR_TXCAL_MEM04_3_ADDR A:0xfb01888c
y.create.l HWIO_WCSS_A_TXFIR_TXCAL_MEM05_3_ADDR A:0xfb0188ac
y.create.l HWIO_WCSS_A_TXFIR_TXCAL_MEM06_3_ADDR A:0xfb0188cc
y.create.l HWIO_WCSS_A_TXFIR_TXCAL_MEM07_3_ADDR A:0xfb0188ec
y.create.l HWIO_WCSS_A_TXFIR_TXCAL_MEM08_3_ADDR A:0xfb01890c
y.create.l HWIO_WCSS_A_TXFIR_TXCAL_MEM09_3_ADDR A:0xfb01892c
y.create.l HWIO_WCSS_A_TXFIR_TXCAL_MEM00_4_ADDR A:0xfb018810
y.create.l HWIO_WCSS_A_TXFIR_TXCAL_MEM01_4_ADDR A:0xfb018830
y.create.l HWIO_WCSS_A_TXFIR_TXCAL_MEM02_4_ADDR A:0xfb018850
y.create.l HWIO_WCSS_A_TXFIR_TXCAL_MEM03_4_ADDR A:0xfb018870
y.create.l HWIO_WCSS_A_TXFIR_TXCAL_MEM04_4_ADDR A:0xfb018890
y.create.l HWIO_WCSS_A_TXFIR_TXCAL_MEM05_4_ADDR A:0xfb0188b0
y.create.l HWIO_WCSS_A_TXFIR_TXCAL_MEM06_4_ADDR A:0xfb0188d0
y.create.l HWIO_WCSS_A_TXFIR_TXCAL_MEM07_4_ADDR A:0xfb0188f0
y.create.l HWIO_WCSS_A_TXFIR_TXCAL_MEM08_4_ADDR A:0xfb018910
y.create.l HWIO_WCSS_A_TXFIR_TXCAL_MEM09_4_ADDR A:0xfb018930
y.create.l HWIO_WCSS_A_TXFIR_TXCAL_MEM00_5_ADDR A:0xfb018814
y.create.l HWIO_WCSS_A_TXFIR_TXCAL_MEM01_5_ADDR A:0xfb018834
y.create.l HWIO_WCSS_A_TXFIR_TXCAL_MEM02_5_ADDR A:0xfb018854
y.create.l HWIO_WCSS_A_TXFIR_TXCAL_MEM03_5_ADDR A:0xfb018874
y.create.l HWIO_WCSS_A_TXFIR_TXCAL_MEM04_5_ADDR A:0xfb018894
y.create.l HWIO_WCSS_A_TXFIR_TXCAL_MEM05_5_ADDR A:0xfb0188b4
y.create.l HWIO_WCSS_A_TXFIR_TXCAL_MEM06_5_ADDR A:0xfb0188d4
y.create.l HWIO_WCSS_A_TXFIR_TXCAL_MEM07_5_ADDR A:0xfb0188f4
y.create.l HWIO_WCSS_A_TXFIR_TXCAL_MEM08_5_ADDR A:0xfb018914
y.create.l HWIO_WCSS_A_TXFIR_TXCAL_MEM09_5_ADDR A:0xfb018934
y.create.l HWIO_WCSS_A_TXFIR_TXCAL_MEM00_6_ADDR A:0xfb018818
y.create.l HWIO_WCSS_A_TXFIR_TXCAL_MEM01_6_ADDR A:0xfb018838
y.create.l HWIO_WCSS_A_TXFIR_TXCAL_MEM02_6_ADDR A:0xfb018858
y.create.l HWIO_WCSS_A_TXFIR_TXCAL_MEM03_6_ADDR A:0xfb018878
y.create.l HWIO_WCSS_A_TXFIR_TXCAL_MEM04_6_ADDR A:0xfb018898
y.create.l HWIO_WCSS_A_TXFIR_TXCAL_MEM05_6_ADDR A:0xfb0188b8
y.create.l HWIO_WCSS_A_TXFIR_TXCAL_MEM06_6_ADDR A:0xfb0188d8
y.create.l HWIO_WCSS_A_TXFIR_TXCAL_MEM07_6_ADDR A:0xfb0188f8
y.create.l HWIO_WCSS_A_TXFIR_TXCAL_MEM08_6_ADDR A:0xfb018918
y.create.l HWIO_WCSS_A_TXFIR_TXCAL_MEM09_6_ADDR A:0xfb018938
y.create.l HWIO_WCSS_A_TXFIR_DPD_MEM00_0_ADDR A:0xfb019000
y.create.l HWIO_WCSS_A_TXFIR_DPD_MEM01_0_ADDR A:0xfb019010
y.create.l HWIO_WCSS_A_TXFIR_DPD_MEM02_0_ADDR A:0xfb019020
y.create.l HWIO_WCSS_A_TXFIR_DPD_MEM03_0_ADDR A:0xfb019030
y.create.l HWIO_WCSS_A_TXFIR_DPD_MEM04_0_ADDR A:0xfb019040
y.create.l HWIO_WCSS_A_TXFIR_DPD_MEM05_0_ADDR A:0xfb019050
y.create.l HWIO_WCSS_A_TXFIR_DPD_MEM06_0_ADDR A:0xfb019060
y.create.l HWIO_WCSS_A_TXFIR_DPD_MEM07_0_ADDR A:0xfb019070
y.create.l HWIO_WCSS_A_TXFIR_DPD_MEM08_0_ADDR A:0xfb019080
y.create.l HWIO_WCSS_A_TXFIR_DPD_MEM09_0_ADDR A:0xfb019090
y.create.l HWIO_WCSS_A_TXFIR_DPD_MEM00_1_ADDR A:0xfb019004
y.create.l HWIO_WCSS_A_TXFIR_DPD_MEM01_1_ADDR A:0xfb019014
y.create.l HWIO_WCSS_A_TXFIR_DPD_MEM02_1_ADDR A:0xfb019024
y.create.l HWIO_WCSS_A_TXFIR_DPD_MEM03_1_ADDR A:0xfb019034
y.create.l HWIO_WCSS_A_TXFIR_DPD_MEM04_1_ADDR A:0xfb019044
y.create.l HWIO_WCSS_A_TXFIR_DPD_MEM05_1_ADDR A:0xfb019054
y.create.l HWIO_WCSS_A_TXFIR_DPD_MEM06_1_ADDR A:0xfb019064
y.create.l HWIO_WCSS_A_TXFIR_DPD_MEM07_1_ADDR A:0xfb019074
y.create.l HWIO_WCSS_A_TXFIR_DPD_MEM08_1_ADDR A:0xfb019084
y.create.l HWIO_WCSS_A_TXFIR_DPD_MEM09_1_ADDR A:0xfb019094
y.create.l HWIO_WCSS_A_TXFIR_DPD_MEM00_2_ADDR A:0xfb019008
y.create.l HWIO_WCSS_A_TXFIR_DPD_MEM01_2_ADDR A:0xfb019018
y.create.l HWIO_WCSS_A_TXFIR_DPD_MEM02_2_ADDR A:0xfb019028
y.create.l HWIO_WCSS_A_TXFIR_DPD_MEM03_2_ADDR A:0xfb019038
y.create.l HWIO_WCSS_A_TXFIR_DPD_MEM04_2_ADDR A:0xfb019048
y.create.l HWIO_WCSS_A_TXFIR_DPD_MEM05_2_ADDR A:0xfb019058
y.create.l HWIO_WCSS_A_TXFIR_DPD_MEM06_2_ADDR A:0xfb019068
y.create.l HWIO_WCSS_A_TXFIR_DPD_MEM07_2_ADDR A:0xfb019078
y.create.l HWIO_WCSS_A_TXFIR_DPD_MEM08_2_ADDR A:0xfb019088
y.create.l HWIO_WCSS_A_TXFIR_DPD_MEM09_2_ADDR A:0xfb019098
y.create.l HWIO_WCSS_A_TXFIR_DPD_MEM00_3_ADDR A:0xfb01900c
y.create.l HWIO_WCSS_A_TXFIR_DPD_MEM01_3_ADDR A:0xfb01901c
y.create.l HWIO_WCSS_A_TXFIR_DPD_MEM02_3_ADDR A:0xfb01902c
y.create.l HWIO_WCSS_A_TXFIR_DPD_MEM03_3_ADDR A:0xfb01903c
y.create.l HWIO_WCSS_A_TXFIR_DPD_MEM04_3_ADDR A:0xfb01904c
y.create.l HWIO_WCSS_A_TXFIR_DPD_MEM05_3_ADDR A:0xfb01905c
y.create.l HWIO_WCSS_A_TXFIR_DPD_MEM06_3_ADDR A:0xfb01906c
y.create.l HWIO_WCSS_A_TXFIR_DPD_MEM07_3_ADDR A:0xfb01907c
y.create.l HWIO_WCSS_A_TXFIR_DPD_MEM08_3_ADDR A:0xfb01908c
y.create.l HWIO_WCSS_A_TXFIR_DPD_MEM09_3_ADDR A:0xfb01909c
y.create.l HWIO_WCSS_A_TXP_TXP_CMDF_DIN_ADDR A:0xfb080400
y.create.l HWIO_WCSS_A_TXP_TXP_CMDF_CONTROL_ADDR A:0xfb080404
y.create.l HWIO_WCSS_A_TXP_TXP_TIMEOUT_TIMER_ADDR A:0xfb080408
y.create.l HWIO_WCSS_A_TXP_TXP_STATUS_ADDR A:0xfb08040c
y.create.l HWIO_WCSS_A_TXP_TXP_BTC_ACTIVE_ABORT_ENABLE_ADDR A:0xfb080410
y.create.l HWIO_WCSS_A_TXP_TXP_TESTBUS_ADDR A:0xfb080414
y.create.l HWIO_WCSS_A_TXP_TXP_WARMUP_CNTL_ADDR A:0xfb080418
y.create.l HWIO_WCSS_A_TXP_TXP_DEBUG_CLEAR_ADDR A:0xfb080480
y.create.l HWIO_WCSS_A_TXP_TXP_NR_FRAMES_XMIT_ADDR A:0xfb080484
y.create.l HWIO_WCSS_A_TXP_TXP_PHY_ABORTS_ADDR A:0xfb080488
y.create.l HWIO_WCSS_A_TXP_TXP_NR_END_INTERRUPTS_ADDR A:0xfb08048c
y.create.l HWIO_WCSS_A_TXP_TXP_NR_CMDS_ADDR A:0xfb080490
y.create.l HWIO_WCSS_A_TXP_TXP_FSM_STATUS_ADDR A:0xfb080494
y.create.l HWIO_WCSS_A_TXP_TXP_DBG_STATUS_ADDR A:0xfb080498
y.create.l HWIO_WCSS_A_TXP_TXP_NR_MPI_ADDR A:0xfb08049c
y.create.l HWIO_XPU_CFG_DDR_PHY_CFG_XPU_SCR_ADDR A:0xfc501000
y.create.l HWIO_XPU_CFG_DDR_PHY_CFG_XPU_SWDR_ADDR A:0xfc501004
y.create.l HWIO_XPU_CFG_DDR_PHY_CFG_XPU_SEAR0_ADDR A:0xfc501040
y.create.l HWIO_XPU_CFG_DDR_PHY_CFG_XPU_SESR_ADDR A:0xfc501048
y.create.l HWIO_XPU_CFG_DDR_PHY_CFG_XPU_SESRRESTORE_ADDR A:0xfc50104c
y.create.l HWIO_XPU_CFG_DDR_PHY_CFG_XPU_SESYNR0_ADDR A:0xfc501050
y.create.l HWIO_XPU_CFG_DDR_PHY_CFG_XPU_SESYNR1_ADDR A:0xfc501054
y.create.l HWIO_XPU_CFG_DDR_PHY_CFG_XPU_SESYNR2_ADDR A:0xfc501058
y.create.l HWIO_XPU_CFG_DDR_PHY_CFG_XPU_MCR_ADDR A:0xfc501100
y.create.l HWIO_XPU_CFG_DDR_PHY_CFG_XPU_MEAR0_ADDR A:0xfc501140
y.create.l HWIO_XPU_CFG_DDR_PHY_CFG_XPU_MESR_ADDR A:0xfc501148
y.create.l HWIO_XPU_CFG_DDR_PHY_CFG_XPU_MESRRESTORE_ADDR A:0xfc50114c
y.create.l HWIO_XPU_CFG_DDR_PHY_CFG_XPU_MESYNR0_ADDR A:0xfc501150
y.create.l HWIO_XPU_CFG_DDR_PHY_CFG_XPU_MESYNR1_ADDR A:0xfc501154
y.create.l HWIO_XPU_CFG_DDR_PHY_CFG_XPU_MESYNR2_ADDR A:0xfc501158
y.create.l HWIO_XPU_CFG_DDR_PHY_CFG_XPU_CR_ADDR A:0xfc501080
y.create.l HWIO_XPU_CFG_DDR_PHY_CFG_XPU_RPU_ACR0_ADDR A:0xfc5010a0
y.create.l HWIO_XPU_CFG_DDR_PHY_CFG_XPU_EAR0_ADDR A:0xfc5010c0
y.create.l HWIO_XPU_CFG_DDR_PHY_CFG_XPU_ESR_ADDR A:0xfc5010c8
y.create.l HWIO_XPU_CFG_DDR_PHY_CFG_XPU_ESRRESTORE_ADDR A:0xfc5010cc
y.create.l HWIO_XPU_CFG_DDR_PHY_CFG_XPU_ESYNR0_ADDR A:0xfc5010d0
y.create.l HWIO_XPU_CFG_DDR_PHY_CFG_XPU_ESYNR1_ADDR A:0xfc5010d4
y.create.l HWIO_XPU_CFG_DDR_PHY_CFG_XPU_ESYNR2_ADDR A:0xfc5010d8
y.create.l HWIO_XPU_CFG_DDR_PHY_CFG_XPU_IDR0_ADDR A:0xfc501074
y.create.l HWIO_XPU_CFG_DDR_PHY_CFG_XPU_IDR1_ADDR A:0xfc501078
y.create.l HWIO_XPU_CFG_DDR_PHY_CFG_XPU_REV_ADDR A:0xfc50107c
y.create.l HWIO_XPU_CFG_DDR_PHY_CFG_XPU_RG0_RACR0_ADDR A:0xfc501200
y.create.l HWIO_XPU_CFG_DDR_PHY_CFG_XPU_RG0_WACR0_ADDR A:0xfc501220
y.create.l HWIO_XPU_CFG_DDR_PHY_CFG_XPU_RG0_SCR_ADDR A:0xfc501250
y.create.l HWIO_XPU_CFG_DDR_PHY_CFG_XPU_RG0_MCR_ADDR A:0xfc501254
y.create.l HWIO_XPU_CFG_QDSS_XPU_SCR_ADDR A:0xfc48d000
y.create.l HWIO_XPU_CFG_QDSS_XPU_SWDR_ADDR A:0xfc48d004
y.create.l HWIO_XPU_CFG_QDSS_XPU_SEAR0_ADDR A:0xfc48d040
y.create.l HWIO_XPU_CFG_QDSS_XPU_SESR_ADDR A:0xfc48d048
y.create.l HWIO_XPU_CFG_QDSS_XPU_SESRRESTORE_ADDR A:0xfc48d04c
y.create.l HWIO_XPU_CFG_QDSS_XPU_SESYNR0_ADDR A:0xfc48d050
y.create.l HWIO_XPU_CFG_QDSS_XPU_SESYNR1_ADDR A:0xfc48d054
y.create.l HWIO_XPU_CFG_QDSS_XPU_SESYNR2_ADDR A:0xfc48d058
y.create.l HWIO_XPU_CFG_QDSS_XPU_MCR_ADDR A:0xfc48d100
y.create.l HWIO_XPU_CFG_QDSS_XPU_MEAR0_ADDR A:0xfc48d140
y.create.l HWIO_XPU_CFG_QDSS_XPU_MESR_ADDR A:0xfc48d148
y.create.l HWIO_XPU_CFG_QDSS_XPU_MESRRESTORE_ADDR A:0xfc48d14c
y.create.l HWIO_XPU_CFG_QDSS_XPU_MESYNR0_ADDR A:0xfc48d150
y.create.l HWIO_XPU_CFG_QDSS_XPU_MESYNR1_ADDR A:0xfc48d154
y.create.l HWIO_XPU_CFG_QDSS_XPU_MESYNR2_ADDR A:0xfc48d158
y.create.l HWIO_XPU_CFG_QDSS_XPU_CR_ADDR A:0xfc48d080
y.create.l HWIO_XPU_CFG_QDSS_XPU_RPU_ACR0_ADDR A:0xfc48d0a0
y.create.l HWIO_XPU_CFG_QDSS_XPU_EAR0_ADDR A:0xfc48d0c0
y.create.l HWIO_XPU_CFG_QDSS_XPU_ESR_ADDR A:0xfc48d0c8
y.create.l HWIO_XPU_CFG_QDSS_XPU_ESRRESTORE_ADDR A:0xfc48d0cc
y.create.l HWIO_XPU_CFG_QDSS_XPU_ESYNR0_ADDR A:0xfc48d0d0
y.create.l HWIO_XPU_CFG_QDSS_XPU_ESYNR1_ADDR A:0xfc48d0d4
y.create.l HWIO_XPU_CFG_QDSS_XPU_ESYNR2_ADDR A:0xfc48d0d8
y.create.l HWIO_XPU_CFG_QDSS_XPU_IDR0_ADDR A:0xfc48d074
y.create.l HWIO_XPU_CFG_QDSS_XPU_IDR1_ADDR A:0xfc48d078
y.create.l HWIO_XPU_CFG_QDSS_XPU_REV_ADDR A:0xfc48d07c
y.create.l HWIO_XPU_CFG_QDSS_XPU_RG0_RACR0_ADDR A:0xfc48d200
y.create.l HWIO_XPU_CFG_QDSS_XPU_RG1_RACR0_ADDR A:0xfc48d280
y.create.l HWIO_XPU_CFG_QDSS_XPU_RG0_WACR0_ADDR A:0xfc48d220
y.create.l HWIO_XPU_CFG_QDSS_XPU_RG1_WACR0_ADDR A:0xfc48d2a0
y.create.l HWIO_XPU_CFG_QDSS_XPU_RG0_SCR_ADDR A:0xfc48d250
y.create.l HWIO_XPU_CFG_QDSS_XPU_RG1_SCR_ADDR A:0xfc48d2d0
y.create.l HWIO_XPU_CFG_QDSS_XPU_RG0_MCR_ADDR A:0xfc48d254
y.create.l HWIO_XPU_CFG_QDSS_XPU_RG1_MCR_ADDR A:0xfc48d2d4
y.create.l HWIO_XPU_CFG_SNOC_CFG_XPU_SCR_ADDR A:0xfc48c000
y.create.l HWIO_XPU_CFG_SNOC_CFG_XPU_SWDR_ADDR A:0xfc48c004
y.create.l HWIO_XPU_CFG_SNOC_CFG_XPU_PRTN_RACR_SSHADOW_ADDR A:0xfc48c008
y.create.l HWIO_XPU_CFG_SNOC_CFG_XPU_PRTN_WACR_SSHADOW_ADDR A:0xfc48c00c
y.create.l HWIO_XPU_CFG_SNOC_CFG_XPU_PRTN_START_SSHADOW0_ADDR A:0xfc48c010
y.create.l HWIO_XPU_CFG_SNOC_CFG_XPU_PRTN_END_SSHADOW0_ADDR A:0xfc48c018
y.create.l HWIO_XPU_CFG_SNOC_CFG_XPU_SEAR0_ADDR A:0xfc48c040
y.create.l HWIO_XPU_CFG_SNOC_CFG_XPU_SESR_ADDR A:0xfc48c048
y.create.l HWIO_XPU_CFG_SNOC_CFG_XPU_SESRRESTORE_ADDR A:0xfc48c04c
y.create.l HWIO_XPU_CFG_SNOC_CFG_XPU_SESYNR0_ADDR A:0xfc48c050
y.create.l HWIO_XPU_CFG_SNOC_CFG_XPU_SESYNR1_ADDR A:0xfc48c054
y.create.l HWIO_XPU_CFG_SNOC_CFG_XPU_SESYNR2_ADDR A:0xfc48c058
y.create.l HWIO_XPU_CFG_SNOC_CFG_XPU_MCR_ADDR A:0xfc48c100
y.create.l HWIO_XPU_CFG_SNOC_CFG_XPU_MEAR0_ADDR A:0xfc48c140
y.create.l HWIO_XPU_CFG_SNOC_CFG_XPU_MESR_ADDR A:0xfc48c148
y.create.l HWIO_XPU_CFG_SNOC_CFG_XPU_MESRRESTORE_ADDR A:0xfc48c14c
y.create.l HWIO_XPU_CFG_SNOC_CFG_XPU_MESYNR0_ADDR A:0xfc48c150
y.create.l HWIO_XPU_CFG_SNOC_CFG_XPU_MESYNR1_ADDR A:0xfc48c154
y.create.l HWIO_XPU_CFG_SNOC_CFG_XPU_MESYNR2_ADDR A:0xfc48c158
y.create.l HWIO_XPU_CFG_SNOC_CFG_XPU_CR_ADDR A:0xfc48c080
y.create.l HWIO_XPU_CFG_SNOC_CFG_XPU_PRTN_RACR_SHADOW_ADDR A:0xfc48c088
y.create.l HWIO_XPU_CFG_SNOC_CFG_XPU_PRTN_WACR_SHADOW_ADDR A:0xfc48c08c
y.create.l HWIO_XPU_CFG_SNOC_CFG_XPU_PRTN_START_SHADOW0_ADDR A:0xfc48c090
y.create.l HWIO_XPU_CFG_SNOC_CFG_XPU_PRTN_END_SHADOW0_ADDR A:0xfc48c098
y.create.l HWIO_XPU_CFG_SNOC_CFG_XPU_RPU_ACR0_ADDR A:0xfc48c0a0
y.create.l HWIO_XPU_CFG_SNOC_CFG_XPU_EAR0_ADDR A:0xfc48c0c0
y.create.l HWIO_XPU_CFG_SNOC_CFG_XPU_ESR_ADDR A:0xfc48c0c8
y.create.l HWIO_XPU_CFG_SNOC_CFG_XPU_ESRRESTORE_ADDR A:0xfc48c0cc
y.create.l HWIO_XPU_CFG_SNOC_CFG_XPU_ESYNR0_ADDR A:0xfc48c0d0
y.create.l HWIO_XPU_CFG_SNOC_CFG_XPU_ESYNR1_ADDR A:0xfc48c0d4
y.create.l HWIO_XPU_CFG_SNOC_CFG_XPU_ESYNR2_ADDR A:0xfc48c0d8
y.create.l HWIO_XPU_CFG_SNOC_CFG_XPU_UMR_RACR_ADDR A:0xfc48c0e0
y.create.l HWIO_XPU_CFG_SNOC_CFG_XPU_UMR_WACR_ADDR A:0xfc48c0e4
y.create.l HWIO_XPU_CFG_SNOC_CFG_XPU_IDR0_ADDR A:0xfc48c074
y.create.l HWIO_XPU_CFG_SNOC_CFG_XPU_IDR1_ADDR A:0xfc48c078
y.create.l HWIO_XPU_CFG_SNOC_CFG_XPU_REV_ADDR A:0xfc48c07c
y.create.l HWIO_XPU_CFG_SNOC_CFG_XPU_PRT0_RACR0_ADDR A:0xfc48c200
y.create.l HWIO_XPU_CFG_SNOC_CFG_XPU_PRT1_RACR0_ADDR A:0xfc48c280
y.create.l HWIO_XPU_CFG_SNOC_CFG_XPU_PRT2_RACR0_ADDR A:0xfc48c300
y.create.l HWIO_XPU_CFG_SNOC_CFG_XPU_PRT3_RACR0_ADDR A:0xfc48c380
y.create.l HWIO_XPU_CFG_SNOC_CFG_XPU_PRT4_RACR0_ADDR A:0xfc48c400
y.create.l HWIO_XPU_CFG_SNOC_CFG_XPU_PRT5_RACR0_ADDR A:0xfc48c480
y.create.l HWIO_XPU_CFG_SNOC_CFG_XPU_PRT6_RACR0_ADDR A:0xfc48c500
y.create.l HWIO_XPU_CFG_SNOC_CFG_XPU_PRT7_RACR0_ADDR A:0xfc48c580
y.create.l HWIO_XPU_CFG_SNOC_CFG_XPU_PRT8_RACR0_ADDR A:0xfc48c600
y.create.l HWIO_XPU_CFG_SNOC_CFG_XPU_PRT9_RACR0_ADDR A:0xfc48c680
y.create.l HWIO_XPU_CFG_SNOC_CFG_XPU_PRT0_WACR0_ADDR A:0xfc48c220
y.create.l HWIO_XPU_CFG_SNOC_CFG_XPU_PRT1_WACR0_ADDR A:0xfc48c2a0
y.create.l HWIO_XPU_CFG_SNOC_CFG_XPU_PRT2_WACR0_ADDR A:0xfc48c320
y.create.l HWIO_XPU_CFG_SNOC_CFG_XPU_PRT3_WACR0_ADDR A:0xfc48c3a0
y.create.l HWIO_XPU_CFG_SNOC_CFG_XPU_PRT4_WACR0_ADDR A:0xfc48c420
y.create.l HWIO_XPU_CFG_SNOC_CFG_XPU_PRT5_WACR0_ADDR A:0xfc48c4a0
y.create.l HWIO_XPU_CFG_SNOC_CFG_XPU_PRT6_WACR0_ADDR A:0xfc48c520
y.create.l HWIO_XPU_CFG_SNOC_CFG_XPU_PRT7_WACR0_ADDR A:0xfc48c5a0
y.create.l HWIO_XPU_CFG_SNOC_CFG_XPU_PRT8_WACR0_ADDR A:0xfc48c620
y.create.l HWIO_XPU_CFG_SNOC_CFG_XPU_PRT9_WACR0_ADDR A:0xfc48c6a0
y.create.l HWIO_XPU_CFG_SNOC_CFG_XPU_PRT0_START0_ADDR A:0xfc48c240
y.create.l HWIO_XPU_CFG_SNOC_CFG_XPU_PRT1_START0_ADDR A:0xfc48c2c0
y.create.l HWIO_XPU_CFG_SNOC_CFG_XPU_PRT2_START0_ADDR A:0xfc48c340
y.create.l HWIO_XPU_CFG_SNOC_CFG_XPU_PRT3_START0_ADDR A:0xfc48c3c0
y.create.l HWIO_XPU_CFG_SNOC_CFG_XPU_PRT4_START0_ADDR A:0xfc48c440
y.create.l HWIO_XPU_CFG_SNOC_CFG_XPU_PRT5_START0_ADDR A:0xfc48c4c0
y.create.l HWIO_XPU_CFG_SNOC_CFG_XPU_PRT6_START0_ADDR A:0xfc48c540
y.create.l HWIO_XPU_CFG_SNOC_CFG_XPU_PRT7_START0_ADDR A:0xfc48c5c0
y.create.l HWIO_XPU_CFG_SNOC_CFG_XPU_PRT8_START0_ADDR A:0xfc48c640
y.create.l HWIO_XPU_CFG_SNOC_CFG_XPU_PRT9_START0_ADDR A:0xfc48c6c0
y.create.l HWIO_XPU_CFG_SNOC_CFG_XPU_PRT0_END0_ADDR A:0xfc48c248
y.create.l HWIO_XPU_CFG_SNOC_CFG_XPU_PRT1_END0_ADDR A:0xfc48c2c8
y.create.l HWIO_XPU_CFG_SNOC_CFG_XPU_PRT2_END0_ADDR A:0xfc48c348
y.create.l HWIO_XPU_CFG_SNOC_CFG_XPU_PRT3_END0_ADDR A:0xfc48c3c8
y.create.l HWIO_XPU_CFG_SNOC_CFG_XPU_PRT4_END0_ADDR A:0xfc48c448
y.create.l HWIO_XPU_CFG_SNOC_CFG_XPU_PRT5_END0_ADDR A:0xfc48c4c8
y.create.l HWIO_XPU_CFG_SNOC_CFG_XPU_PRT6_END0_ADDR A:0xfc48c548
y.create.l HWIO_XPU_CFG_SNOC_CFG_XPU_PRT7_END0_ADDR A:0xfc48c5c8
y.create.l HWIO_XPU_CFG_SNOC_CFG_XPU_PRT8_END0_ADDR A:0xfc48c648
y.create.l HWIO_XPU_CFG_SNOC_CFG_XPU_PRT9_END0_ADDR A:0xfc48c6c8
y.create.l HWIO_XPU_CFG_SNOC_CFG_XPU_PRT0_SCR_ADDR A:0xfc48c250
y.create.l HWIO_XPU_CFG_SNOC_CFG_XPU_PRT1_SCR_ADDR A:0xfc48c2d0
y.create.l HWIO_XPU_CFG_SNOC_CFG_XPU_PRT2_SCR_ADDR A:0xfc48c350
y.create.l HWIO_XPU_CFG_SNOC_CFG_XPU_PRT3_SCR_ADDR A:0xfc48c3d0
y.create.l HWIO_XPU_CFG_SNOC_CFG_XPU_PRT4_SCR_ADDR A:0xfc48c450
y.create.l HWIO_XPU_CFG_SNOC_CFG_XPU_PRT5_SCR_ADDR A:0xfc48c4d0
y.create.l HWIO_XPU_CFG_SNOC_CFG_XPU_PRT6_SCR_ADDR A:0xfc48c550
y.create.l HWIO_XPU_CFG_SNOC_CFG_XPU_PRT7_SCR_ADDR A:0xfc48c5d0
y.create.l HWIO_XPU_CFG_SNOC_CFG_XPU_PRT8_SCR_ADDR A:0xfc48c650
y.create.l HWIO_XPU_CFG_SNOC_CFG_XPU_PRT9_SCR_ADDR A:0xfc48c6d0
y.create.l HWIO_XPU_CFG_SNOC_CFG_XPU_PRT0_MCR_ADDR A:0xfc48c254
y.create.l HWIO_XPU_CFG_SNOC_CFG_XPU_PRT1_MCR_ADDR A:0xfc48c2d4
y.create.l HWIO_XPU_CFG_SNOC_CFG_XPU_PRT2_MCR_ADDR A:0xfc48c354
y.create.l HWIO_XPU_CFG_SNOC_CFG_XPU_PRT3_MCR_ADDR A:0xfc48c3d4
y.create.l HWIO_XPU_CFG_SNOC_CFG_XPU_PRT4_MCR_ADDR A:0xfc48c454
y.create.l HWIO_XPU_CFG_SNOC_CFG_XPU_PRT5_MCR_ADDR A:0xfc48c4d4
y.create.l HWIO_XPU_CFG_SNOC_CFG_XPU_PRT6_MCR_ADDR A:0xfc48c554
y.create.l HWIO_XPU_CFG_SNOC_CFG_XPU_PRT7_MCR_ADDR A:0xfc48c5d4
y.create.l HWIO_XPU_CFG_SNOC_CFG_XPU_PRT8_MCR_ADDR A:0xfc48c654
y.create.l HWIO_XPU_CFG_SNOC_CFG_XPU_PRT9_MCR_ADDR A:0xfc48c6d4
y.create.l HWIO_XPU_CFG_SNOC_CFG_XPU_PRT0_CNTL0_ADDR A:0xfc48c258
y.create.l HWIO_XPU_CFG_SNOC_CFG_XPU_PRT1_CNTL0_ADDR A:0xfc48c2d8
y.create.l HWIO_XPU_CFG_SNOC_CFG_XPU_PRT2_CNTL0_ADDR A:0xfc48c358
y.create.l HWIO_XPU_CFG_SNOC_CFG_XPU_PRT3_CNTL0_ADDR A:0xfc48c3d8
y.create.l HWIO_XPU_CFG_SNOC_CFG_XPU_PRT4_CNTL0_ADDR A:0xfc48c458
y.create.l HWIO_XPU_CFG_SNOC_CFG_XPU_PRT5_CNTL0_ADDR A:0xfc48c4d8
y.create.l HWIO_XPU_CFG_SNOC_CFG_XPU_PRT6_CNTL0_ADDR A:0xfc48c558
y.create.l HWIO_XPU_CFG_SNOC_CFG_XPU_PRT7_CNTL0_ADDR A:0xfc48c5d8
y.create.l HWIO_XPU_CFG_SNOC_CFG_XPU_PRT8_CNTL0_ADDR A:0xfc48c658
y.create.l HWIO_XPU_CFG_SNOC_CFG_XPU_PRT9_CNTL0_ADDR A:0xfc48c6d8
y.create.l HWIO_XPU_CFG_SNOC_CFG_XPU_PRT0_CNTL1_ADDR A:0xfc48c25c
y.create.l HWIO_XPU_CFG_SNOC_CFG_XPU_PRT1_CNTL1_ADDR A:0xfc48c2dc
y.create.l HWIO_XPU_CFG_SNOC_CFG_XPU_PRT2_CNTL1_ADDR A:0xfc48c35c
y.create.l HWIO_XPU_CFG_SNOC_CFG_XPU_PRT3_CNTL1_ADDR A:0xfc48c3dc
y.create.l HWIO_XPU_CFG_SNOC_CFG_XPU_PRT4_CNTL1_ADDR A:0xfc48c45c
y.create.l HWIO_XPU_CFG_SNOC_CFG_XPU_PRT5_CNTL1_ADDR A:0xfc48c4dc
y.create.l HWIO_XPU_CFG_SNOC_CFG_XPU_PRT6_CNTL1_ADDR A:0xfc48c55c
y.create.l HWIO_XPU_CFG_SNOC_CFG_XPU_PRT7_CNTL1_ADDR A:0xfc48c5dc
y.create.l HWIO_XPU_CFG_SNOC_CFG_XPU_PRT8_CNTL1_ADDR A:0xfc48c65c
y.create.l HWIO_XPU_CFG_SNOC_CFG_XPU_PRT9_CNTL1_ADDR A:0xfc48c6dc
y.create.done
