y.create.l HWIO_APCS_GICD_CTLR_ADDR A:0xf9000000
y.create.l HWIO_APCS_GICD_TYPER_ADDR A:0xf9000004
y.create.l HWIO_APCS_GICD_IIDR_ADDR A:0xf9000008
y.create.l HWIO_APCS_GICD_ANSACR_ADDR A:0xf9000020
y.create.l HWIO_APCS_GICD_CGCR_ADDR A:0xf9000024
y.create.l HWIO_APCS_GICD_HW_VERSION_ADDR A:0xf9000030
y.create.l HWIO_APCS_GICD_ISR0_ADDR A:0xf9000080
y.create.l HWIO_APCS_GICD_ISR1_ADDR A:0xf9000084
y.create.l HWIO_APCS_GICD_ISR2_ADDR A:0xf9000088
y.create.l HWIO_APCS_GICD_ISR3_ADDR A:0xf900008c
y.create.l HWIO_APCS_GICD_ISR4_ADDR A:0xf9000090
y.create.l HWIO_APCS_GICD_ISR5_ADDR A:0xf9000094
y.create.l HWIO_APCS_GICD_ISR6_ADDR A:0xf9000098
y.create.l HWIO_APCS_GICD_ISR7_ADDR A:0xf900009c
y.create.l HWIO_APCS_GICD_ISR8_ADDR A:0xf90000a0
y.create.l HWIO_APCS_GICD_ISENABLER0_ADDR A:0xf9000100
y.create.l HWIO_APCS_GICD_ISENABLER1_ADDR A:0xf9000104
y.create.l HWIO_APCS_GICD_ISENABLER2_ADDR A:0xf9000108
y.create.l HWIO_APCS_GICD_ISENABLER3_ADDR A:0xf900010c
y.create.l HWIO_APCS_GICD_ISENABLER4_ADDR A:0xf9000110
y.create.l HWIO_APCS_GICD_ISENABLER5_ADDR A:0xf9000114
y.create.l HWIO_APCS_GICD_ISENABLER6_ADDR A:0xf9000118
y.create.l HWIO_APCS_GICD_ISENABLER7_ADDR A:0xf900011c
y.create.l HWIO_APCS_GICD_ISENABLER8_ADDR A:0xf9000120
y.create.l HWIO_APCS_GICD_ICENABLER0_ADDR A:0xf9000180
y.create.l HWIO_APCS_GICD_ICENABLER1_ADDR A:0xf9000184
y.create.l HWIO_APCS_GICD_ICENABLER2_ADDR A:0xf9000188
y.create.l HWIO_APCS_GICD_ICENABLER3_ADDR A:0xf900018c
y.create.l HWIO_APCS_GICD_ICENABLER4_ADDR A:0xf9000190
y.create.l HWIO_APCS_GICD_ICENABLER5_ADDR A:0xf9000194
y.create.l HWIO_APCS_GICD_ICENABLER6_ADDR A:0xf9000198
y.create.l HWIO_APCS_GICD_ICENABLER7_ADDR A:0xf900019c
y.create.l HWIO_APCS_GICD_ICENABLER8_ADDR A:0xf90001a0
y.create.l HWIO_APCS_GICD_ISPENDR0_ADDR A:0xf9000200
y.create.l HWIO_APCS_GICD_ISPENDR1_ADDR A:0xf9000204
y.create.l HWIO_APCS_GICD_ISPENDR2_ADDR A:0xf9000208
y.create.l HWIO_APCS_GICD_ISPENDR3_ADDR A:0xf900020c
y.create.l HWIO_APCS_GICD_ISPENDR4_ADDR A:0xf9000210
y.create.l HWIO_APCS_GICD_ISPENDR5_ADDR A:0xf9000214
y.create.l HWIO_APCS_GICD_ISPENDR6_ADDR A:0xf9000218
y.create.l HWIO_APCS_GICD_ISPENDR7_ADDR A:0xf900021c
y.create.l HWIO_APCS_GICD_ISPENDR8_ADDR A:0xf9000220
y.create.l HWIO_APCS_GICD_ICPENDR0_ADDR A:0xf9000280
y.create.l HWIO_APCS_GICD_ICPENDR1_ADDR A:0xf9000284
y.create.l HWIO_APCS_GICD_ICPENDR2_ADDR A:0xf9000288
y.create.l HWIO_APCS_GICD_ICPENDR3_ADDR A:0xf900028c
y.create.l HWIO_APCS_GICD_ICPENDR4_ADDR A:0xf9000290
y.create.l HWIO_APCS_GICD_ICPENDR5_ADDR A:0xf9000294
y.create.l HWIO_APCS_GICD_ICPENDR6_ADDR A:0xf9000298
y.create.l HWIO_APCS_GICD_ICPENDR7_ADDR A:0xf900029c
y.create.l HWIO_APCS_GICD_ICPENDR8_ADDR A:0xf90002a0
y.create.l HWIO_APCS_GICD_ISACTIVER0_ADDR A:0xf9000300
y.create.l HWIO_APCS_GICD_ISACTIVER1_ADDR A:0xf9000304
y.create.l HWIO_APCS_GICD_ISACTIVER2_ADDR A:0xf9000308
y.create.l HWIO_APCS_GICD_ISACTIVER3_ADDR A:0xf900030c
y.create.l HWIO_APCS_GICD_ISACTIVER4_ADDR A:0xf9000310
y.create.l HWIO_APCS_GICD_ISACTIVER5_ADDR A:0xf9000314
y.create.l HWIO_APCS_GICD_ISACTIVER6_ADDR A:0xf9000318
y.create.l HWIO_APCS_GICD_ISACTIVER7_ADDR A:0xf900031c
y.create.l HWIO_APCS_GICD_ISACTIVER8_ADDR A:0xf9000320
y.create.l HWIO_APCS_GICD_ICACTIVER0_ADDR A:0xf9000380
y.create.l HWIO_APCS_GICD_ICACTIVER1_ADDR A:0xf9000384
y.create.l HWIO_APCS_GICD_ICACTIVER2_ADDR A:0xf9000388
y.create.l HWIO_APCS_GICD_ICACTIVER3_ADDR A:0xf900038c
y.create.l HWIO_APCS_GICD_ICACTIVER4_ADDR A:0xf9000390
y.create.l HWIO_APCS_GICD_ICACTIVER5_ADDR A:0xf9000394
y.create.l HWIO_APCS_GICD_ICACTIVER6_ADDR A:0xf9000398
y.create.l HWIO_APCS_GICD_ICACTIVER7_ADDR A:0xf900039c
y.create.l HWIO_APCS_GICD_ICACTIVER8_ADDR A:0xf90003a0
y.create.l HWIO_APCS_GICD_IPRIORITYR0_ADDR A:0xf9000400
y.create.l HWIO_APCS_GICD_IPRIORITYR1_ADDR A:0xf9000404
y.create.l HWIO_APCS_GICD_IPRIORITYR2_ADDR A:0xf9000408
y.create.l HWIO_APCS_GICD_IPRIORITYR3_ADDR A:0xf900040c
y.create.l HWIO_APCS_GICD_IPRIORITYR4_ADDR A:0xf9000410
y.create.l HWIO_APCS_GICD_IPRIORITYR5_ADDR A:0xf9000414
y.create.l HWIO_APCS_GICD_IPRIORITYR6_ADDR A:0xf9000418
y.create.l HWIO_APCS_GICD_IPRIORITYR7_ADDR A:0xf900041c
y.create.l HWIO_APCS_GICD_IPRIORITYR8_ADDR A:0xf9000420
y.create.l HWIO_APCS_GICD_IPRIORITYR9_ADDR A:0xf9000424
y.create.l HWIO_APCS_GICD_ITARGETSR0_ADDR A:0xf9000800
y.create.l HWIO_APCS_GICD_ITARGETSR1_ADDR A:0xf9000804
y.create.l HWIO_APCS_GICD_ITARGETSR2_ADDR A:0xf9000808
y.create.l HWIO_APCS_GICD_ITARGETSR3_ADDR A:0xf900080c
y.create.l HWIO_APCS_GICD_ITARGETSR4_ADDR A:0xf9000810
y.create.l HWIO_APCS_GICD_ITARGETSR5_ADDR A:0xf9000814
y.create.l HWIO_APCS_GICD_ITARGETSR6_ADDR A:0xf9000818
y.create.l HWIO_APCS_GICD_ITARGETSR7_ADDR A:0xf900081c
y.create.l HWIO_APCS_GICD_ITARGETSR8_ADDR A:0xf9000820
y.create.l HWIO_APCS_GICD_ITARGETSR9_ADDR A:0xf9000824
y.create.l HWIO_APCS_GICD_ICFGR0_ADDR A:0xf9000c00
y.create.l HWIO_APCS_GICD_ICFGR1_ADDR A:0xf9000c04
y.create.l HWIO_APCS_GICD_ICFGR2_ADDR A:0xf9000c08
y.create.l HWIO_APCS_GICD_ICFGR3_ADDR A:0xf9000c0c
y.create.l HWIO_APCS_GICD_ICFGR4_ADDR A:0xf9000c10
y.create.l HWIO_APCS_GICD_ICFGR5_ADDR A:0xf9000c14
y.create.l HWIO_APCS_GICD_ICFGR6_ADDR A:0xf9000c18
y.create.l HWIO_APCS_GICD_ICFGR7_ADDR A:0xf9000c1c
y.create.l HWIO_APCS_GICD_ICFGR8_ADDR A:0xf9000c20
y.create.l HWIO_APCS_GICD_ICFGR9_ADDR A:0xf9000c24
y.create.l HWIO_APCS_GICD_SGIR_ADDR A:0xf9000f00
y.create.l HWIO_APCS_GICD_CPENDSGIR0_ADDR A:0xf9000f10
y.create.l HWIO_APCS_GICD_CPENDSGIR1_ADDR A:0xf9000f14
y.create.l HWIO_APCS_GICD_CPENDSGIR2_ADDR A:0xf9000f18
y.create.l HWIO_APCS_GICD_CPENDSGIR3_ADDR A:0xf9000f1c
y.create.l HWIO_APCS_GICD_SPENDSGIR0_ADDR A:0xf9000f20
y.create.l HWIO_APCS_GICD_SPENDSGIR1_ADDR A:0xf9000f24
y.create.l HWIO_APCS_GICD_SPENDSGIR2_ADDR A:0xf9000f28
y.create.l HWIO_APCS_GICD_SPENDSGIR3_ADDR A:0xf9000f2c
y.create.l HWIO_APCS_GICD_PIDR0_ADDR A:0xf9000fd0
y.create.l HWIO_APCS_GICD_PIDR1_ADDR A:0xf9000fd4
y.create.l HWIO_APCS_GICD_PIDR2_ADDR A:0xf9000fd8
y.create.l HWIO_APCS_GICD_PIDR3_ADDR A:0xf9000fdc
y.create.l HWIO_APCS_GICD_PIDR4_ADDR A:0xf9000fe0
y.create.l HWIO_APCS_GICD_PIDR5_ADDR A:0xf9000fe4
y.create.l HWIO_APCS_GICD_PIDR6_ADDR A:0xf9000fe8
y.create.l HWIO_APCS_GICD_PIDR7_ADDR A:0xf9000fec
y.create.l HWIO_APCS_GICD_CIDR0_ADDR A:0xf9000ff0
y.create.l HWIO_APCS_GICD_CIDR1_ADDR A:0xf9000ff4
y.create.l HWIO_APCS_GICD_CIDR2_ADDR A:0xf9000ff8
y.create.l HWIO_APCS_GICD_CIDR3_ADDR A:0xf9000ffc
y.create.l HWIO_APCS_GICH_HCR_ADDR A:0xf9001000
y.create.l HWIO_APCS_GICH_VTR_ADDR A:0xf9001004
y.create.l HWIO_APCS_GICH_VMCR_ADDR A:0xf9001008
y.create.l HWIO_APCS_GICH_MISR_ADDR A:0xf9001010
y.create.l HWIO_APCS_GICH_EISR_ADDR A:0xf9001020
y.create.l HWIO_APCS_GICH_ELRSR_ADDR A:0xf9001030
y.create.l HWIO_APCS_GICH_APR_ADDR A:0xf90010f0
y.create.l HWIO_APCS_GICH_LR0_ADDR A:0xf9001100
y.create.l HWIO_APCS_GICH_LR1_ADDR A:0xf9001104
y.create.l HWIO_APCS_GICH_LR2_ADDR A:0xf9001108
y.create.l HWIO_APCS_GICH_LR3_ADDR A:0xf900110c
y.create.l HWIO_APCS_GICH_SW_LR_ADDR A:0xf9001120
y.create.l HWIO_APCS_GICC_CTLR_ADDR A:0xf9002000
y.create.l HWIO_APCS_GICC_PMR_ADDR A:0xf9002004
y.create.l HWIO_APCS_GICC_BPR_ADDR A:0xf9002008
y.create.l HWIO_APCS_GICC_IAR_ADDR A:0xf900200c
y.create.l HWIO_APCS_GICC_EOIR_ADDR A:0xf9002010
y.create.l HWIO_APCS_GICC_RPR_ADDR A:0xf9002014
y.create.l HWIO_APCS_GICC_HPPIR_ADDR A:0xf9002018
y.create.l HWIO_APCS_GICC_ABPR_ADDR A:0xf900201c
y.create.l HWIO_APCS_GICC_AIAR_ADDR A:0xf9002020
y.create.l HWIO_APCS_GICC_AEOIR_ADDR A:0xf9002024
y.create.l HWIO_APCS_GICC_AHPPIR_ADDR A:0xf9002028
y.create.l HWIO_APCS_GICC_APR_ADDR A:0xf90020d0
y.create.l HWIO_APCS_GICC_NSAPR_ADDR A:0xf90020e0
y.create.l HWIO_APCS_GICC_IIDR_ADDR A:0xf90020fc
y.create.l HWIO_APCS_GICC_DIR_ADDR A:0xf9003000
y.create.l HWIO_APCS_GICV_CTLR_ADDR A:0xf9004000
y.create.l HWIO_APCS_GICV_PMR_ADDR A:0xf9004004
y.create.l HWIO_APCS_GICV_BPR_ADDR A:0xf9004008
y.create.l HWIO_APCS_GICV_IAR_ADDR A:0xf900400c
y.create.l HWIO_APCS_GICV_EOIR_ADDR A:0xf9004010
y.create.l HWIO_APCS_GICV_RPR_ADDR A:0xf9004014
y.create.l HWIO_APCS_GICV_HPPIR_ADDR A:0xf9004018
y.create.l HWIO_APCS_GICV_ABPR_ADDR A:0xf900401c
y.create.l HWIO_APCS_GICV_AIAR_ADDR A:0xf9004020
y.create.l HWIO_APCS_GICV_AEOIR_ADDR A:0xf9004024
y.create.l HWIO_APCS_GICV_AHPPIR_ADDR A:0xf9004028
y.create.l HWIO_APCS_GICV_APR_ADDR A:0xf90040d0
y.create.l HWIO_APCS_GICV_IIDR_ADDR A:0xf90040fc
y.create.l HWIO_APCS_GICV_DIR_ADDR A:0xf9005000
y.create.l HWIO_APCS_ACCSECURE_ADDR A:0xf9008000
y.create.l HWIO_APCS_CPU_PWR_CTL_ADDR A:0xf9008004
y.create.l HWIO_APCS_ACC_STS_ADDR A:0xf9008008
y.create.l HWIO_APCS_ATSTBUS_SEL_ADDR A:0xf900800c
y.create.l HWIO_APCS_CPU_TRGTD_DBG_RST_ADDR A:0xf9008010
y.create.l HWIO_APCS_CPU_AUX_CLK_SEL_ADDR A:0xf9008014
y.create.l HWIO_APCS_CPU_PLL_MODE_ADDR A:0xf9008018
y.create.l HWIO_APCS_CPU_PLL_L_VAL_ADDR A:0xf900801c
y.create.l HWIO_APCS_CPU_PLL_ALPHA_VAL_ADDR A:0xf9008020
y.create.l HWIO_APCS_CPU_PLL_ALPHA_VAL_U_ADDR A:0xf9008024
y.create.l HWIO_APCS_CPU_PLL_USER_CTL_ADDR A:0xf9008028
y.create.l HWIO_APCS_CPU_PLL_USER_CTL_U_ADDR A:0xf900802c
y.create.l HWIO_APCS_CPU_PLL_CONFIG_CTL_ADDR A:0xf9008030
y.create.l HWIO_APCS_CPU_PLL_TEST_CTL_ADDR A:0xf9008034
y.create.l HWIO_APCS_CPU_PLL_TEST_CTL_U_ADDR A:0xf9008038
y.create.l HWIO_APCS_CPU_PLL_STATUS_ADDR A:0xf900803c
y.create.l HWIO_APCS_CPU_PLL_FREQ_CTL_ADDR A:0xf9008040
y.create.l HWIO_APCS_TZIPC_INTERRUPT_ADDR A:0xf9008044
y.create.l HWIO_APCS_A7_CFG_ADDR A:0xf9008048
y.create.l HWIO_APCS_SAW2_SECURE_ADDR A:0xf9009000
y.create.l HWIO_APCS_SAW2_ID_ADDR A:0xf9009004
y.create.l HWIO_APCS_SAW2_CFG_ADDR A:0xf9009008
y.create.l HWIO_APCS_SAW2_SPM_STS_ADDR A:0xf900900c
y.create.l HWIO_APCS_SAW2_AVS_STS_ADDR A:0xf9009010
y.create.l HWIO_APCS_SAW2_PMIC_STS_ADDR A:0xf9009014
y.create.l HWIO_APCS_SAW2_RST_ADDR A:0xf9009018
y.create.l HWIO_APCS_SAW2_SPM_CTL_ADDR A:0xf9009030
y.create.l HWIO_APCS_SAW2_SPM_DLY_ADDR A:0xf9009034
y.create.l HWIO_APCS_SAW2_SPM_STS2_ADDR A:0xf9009038
y.create.l HWIO_APCS_SAW2_SPM_SLP_SEQ_ENTRY_0_ADDR A:0xf9009400
y.create.l HWIO_APCS_SAW2_SPM_SLP_SEQ_ENTRY_1_ADDR A:0xf9009404
y.create.l HWIO_APCS_SAW2_SPM_SLP_SEQ_ENTRY_2_ADDR A:0xf9009408
y.create.l HWIO_APCS_SAW2_SPM_SLP_SEQ_ENTRY_3_ADDR A:0xf900940c
y.create.l HWIO_APCS_SAW2_SPM_SLP_SEQ_ENTRY_4_ADDR A:0xf9009410
y.create.l HWIO_APCS_SAW2_SPM_SLP_SEQ_ENTRY_5_ADDR A:0xf9009414
y.create.l HWIO_APCS_SAW2_SPM_SLP_SEQ_ENTRY_6_ADDR A:0xf9009418
y.create.l HWIO_APCS_SAW2_SPM_SLP_SEQ_ENTRY_7_ADDR A:0xf900941c
y.create.l HWIO_APCS_SAW2_SPM_SLP_SEQ_ENTRY_8_ADDR A:0xf9009420
y.create.l HWIO_APCS_SAW2_SPM_SLP_SEQ_ENTRY_9_ADDR A:0xf9009424
y.create.l HWIO_APCS_SAW2_VERSION_ADDR A:0xf9009fd0
y.create.l HWIO_QTMR_AC_CNTFRQ_ADDR A:0xf9020000
y.create.l HWIO_QTMR_AC_CNTSR_ADDR A:0xf9020004
y.create.l HWIO_QTMR_AC_CNTTID_ADDR A:0xf9020008
y.create.l HWIO_QTMR_AC_CNTACR_0_ADDR A:0xf9020040
y.create.l HWIO_QTMR_AC_CNTACR_1_ADDR A:0xf9020044
y.create.l HWIO_QTMR_AC_CNTACR_2_ADDR A:0xf9020048
y.create.l HWIO_QTMR_AC_CNTACR_3_ADDR A:0xf902004c
y.create.l HWIO_QTMR_AC_CNTACR_4_ADDR A:0xf9020050
y.create.l HWIO_QTMR_AC_CNTACR_5_ADDR A:0xf9020054
y.create.l HWIO_QTMR_AC_CNTACR_6_ADDR A:0xf9020058
y.create.l HWIO_QTMR_AC_CNTACR_7_ADDR A:0xf902005c
y.create.l HWIO_QTMR_AC_CNTVOFF_LO_0_ADDR A:0xf9020080
y.create.l HWIO_QTMR_AC_CNTVOFF_LO_1_ADDR A:0xf9020088
y.create.l HWIO_QTMR_AC_CNTVOFF_LO_2_ADDR A:0xf9020090
y.create.l HWIO_QTMR_AC_CNTVOFF_LO_3_ADDR A:0xf9020098
y.create.l HWIO_QTMR_AC_CNTVOFF_LO_4_ADDR A:0xf90200a0
y.create.l HWIO_QTMR_AC_CNTVOFF_LO_5_ADDR A:0xf90200a8
y.create.l HWIO_QTMR_AC_CNTVOFF_LO_6_ADDR A:0xf90200b0
y.create.l HWIO_QTMR_AC_CNTVOFF_LO_7_ADDR A:0xf90200b8
y.create.l HWIO_QTMR_AC_CNTVOFF_HI_0_ADDR A:0xf9020084
y.create.l HWIO_QTMR_AC_CNTVOFF_HI_1_ADDR A:0xf902008c
y.create.l HWIO_QTMR_AC_CNTVOFF_HI_2_ADDR A:0xf9020094
y.create.l HWIO_QTMR_AC_CNTVOFF_HI_3_ADDR A:0xf902009c
y.create.l HWIO_QTMR_AC_CNTVOFF_HI_4_ADDR A:0xf90200a4
y.create.l HWIO_QTMR_AC_CNTVOFF_HI_5_ADDR A:0xf90200ac
y.create.l HWIO_QTMR_AC_CNTVOFF_HI_6_ADDR A:0xf90200b4
y.create.l HWIO_QTMR_AC_CNTVOFF_HI_7_ADDR A:0xf90200bc
y.create.l HWIO_QTMR_AC_CFG_ADDR A:0xf9020fc0
y.create.l HWIO_QTMR_AC_VERSION_ADDR A:0xf9020fd0
y.create.l HWIO_APCS_F0_QTMR_V1_CNTPCT_LO_ADDR A:0xf9021000
y.create.l HWIO_APCS_F0_QTMR_V1_CNTPCT_HI_ADDR A:0xf9021004
y.create.l HWIO_APCS_F0_QTMR_V1_CNTVCT_LO_ADDR A:0xf9021008
y.create.l HWIO_APCS_F0_QTMR_V1_CNTVCT_HI_ADDR A:0xf902100c
y.create.l HWIO_APCS_F0_QTMR_V1_CNTFRQ_ADDR A:0xf9021010
y.create.l HWIO_APCS_F0_QTMR_V1_CNTPL0ACR_ADDR A:0xf9021014
y.create.l HWIO_APCS_F0_QTMR_V1_CNTVOFF_LO_ADDR A:0xf9021018
y.create.l HWIO_APCS_F0_QTMR_V1_CNTVOFF_HI_ADDR A:0xf902101c
y.create.l HWIO_APCS_F0_QTMR_V1_CNTP_CVAL_LO_ADDR A:0xf9021020
y.create.l HWIO_APCS_F0_QTMR_V1_CNTP_CVAL_HI_ADDR A:0xf9021024
y.create.l HWIO_APCS_F0_QTMR_V1_CNTP_TVAL_ADDR A:0xf9021028
y.create.l HWIO_APCS_F0_QTMR_V1_CNTP_CTL_ADDR A:0xf902102c
y.create.l HWIO_APCS_F0_QTMR_V1_CNTV_CVAL_LO_ADDR A:0xf9021030
y.create.l HWIO_APCS_F0_QTMR_V1_CNTV_CVAL_HI_ADDR A:0xf9021034
y.create.l HWIO_APCS_F0_QTMR_V1_CNTV_TVAL_ADDR A:0xf9021038
y.create.l HWIO_APCS_F0_QTMR_V1_CNTV_CTL_ADDR A:0xf902103c
y.create.l HWIO_APCS_F0_QTMR_V1_VERSION_ADDR A:0xf9021fd0
y.create.l HWIO_APCS_F0_QTMR_V2_CNTPCT_LO_ADDR A:0xf9022000
y.create.l HWIO_APCS_F0_QTMR_V2_CNTPCT_HI_ADDR A:0xf9022004
y.create.l HWIO_APCS_F0_QTMR_V2_CNTVCT_LO_ADDR A:0xf9022008
y.create.l HWIO_APCS_F0_QTMR_V2_CNTVCT_HI_ADDR A:0xf902200c
y.create.l HWIO_APCS_F0_QTMR_V2_CNTFRQ_ADDR A:0xf9022010
y.create.l HWIO_APCS_F0_QTMR_V2_CNTP_CVAL_LO_ADDR A:0xf9022020
y.create.l HWIO_APCS_F0_QTMR_V2_CNTP_CVAL_HI_ADDR A:0xf9022024
y.create.l HWIO_APCS_F0_QTMR_V2_CNTP_TVAL_ADDR A:0xf9022028
y.create.l HWIO_APCS_F0_QTMR_V2_CNTP_CTL_ADDR A:0xf902202c
y.create.l HWIO_APCS_F0_QTMR_V2_CNTV_CVAL_LO_ADDR A:0xf9022030
y.create.l HWIO_APCS_F0_QTMR_V2_CNTV_CVAL_HI_ADDR A:0xf9022034
y.create.l HWIO_APCS_F0_QTMR_V2_CNTV_TVAL_ADDR A:0xf9022038
y.create.l HWIO_APCS_F0_QTMR_V2_CNTV_CTL_ADDR A:0xf902203c
y.create.l HWIO_APCS_F0_QTMR_V2_VERSION_ADDR A:0xf9022fd0
y.create.l HWIO_APCS_F1_QTMR_V1_CNTPCT_LO_ADDR A:0xf9023000
y.create.l HWIO_APCS_F1_QTMR_V1_CNTPCT_HI_ADDR A:0xf9023004
y.create.l HWIO_APCS_F1_QTMR_V1_CNTVCT_LO_ADDR A:0xf9023008
y.create.l HWIO_APCS_F1_QTMR_V1_CNTVCT_HI_ADDR A:0xf902300c
y.create.l HWIO_APCS_F1_QTMR_V1_CNTFRQ_ADDR A:0xf9023010
y.create.l HWIO_APCS_F1_QTMR_V1_CNTPL0ACR_ADDR A:0xf9023014
y.create.l HWIO_APCS_F1_QTMR_V1_CNTVOFF_LO_ADDR A:0xf9023018
y.create.l HWIO_APCS_F1_QTMR_V1_CNTVOFF_HI_ADDR A:0xf902301c
y.create.l HWIO_APCS_F1_QTMR_V1_CNTP_CVAL_LO_ADDR A:0xf9023020
y.create.l HWIO_APCS_F1_QTMR_V1_CNTP_CVAL_HI_ADDR A:0xf9023024
y.create.l HWIO_APCS_F1_QTMR_V1_CNTP_TVAL_ADDR A:0xf9023028
y.create.l HWIO_APCS_F1_QTMR_V1_CNTP_CTL_ADDR A:0xf902302c
y.create.l HWIO_APCS_F1_QTMR_V1_CNTV_CVAL_LO_ADDR A:0xf9023030
y.create.l HWIO_APCS_F1_QTMR_V1_CNTV_CVAL_HI_ADDR A:0xf9023034
y.create.l HWIO_APCS_F1_QTMR_V1_CNTV_TVAL_ADDR A:0xf9023038
y.create.l HWIO_APCS_F1_QTMR_V1_CNTV_CTL_ADDR A:0xf902303c
y.create.l HWIO_APCS_F1_QTMR_V1_VERSION_ADDR A:0xf9023fd0
y.create.l HWIO_APCS_F2_QTMR_V1_CNTPCT_LO_ADDR A:0xf9024000
y.create.l HWIO_APCS_F2_QTMR_V1_CNTPCT_HI_ADDR A:0xf9024004
y.create.l HWIO_APCS_F2_QTMR_V1_CNTVCT_LO_ADDR A:0xf9024008
y.create.l HWIO_APCS_F2_QTMR_V1_CNTVCT_HI_ADDR A:0xf902400c
y.create.l HWIO_APCS_F2_QTMR_V1_CNTFRQ_ADDR A:0xf9024010
y.create.l HWIO_APCS_F2_QTMR_V1_CNTPL0ACR_ADDR A:0xf9024014
y.create.l HWIO_APCS_F2_QTMR_V1_CNTVOFF_LO_ADDR A:0xf9024018
y.create.l HWIO_APCS_F2_QTMR_V1_CNTVOFF_HI_ADDR A:0xf902401c
y.create.l HWIO_APCS_F2_QTMR_V1_CNTP_CVAL_LO_ADDR A:0xf9024020
y.create.l HWIO_APCS_F2_QTMR_V1_CNTP_CVAL_HI_ADDR A:0xf9024024
y.create.l HWIO_APCS_F2_QTMR_V1_CNTP_TVAL_ADDR A:0xf9024028
y.create.l HWIO_APCS_F2_QTMR_V1_CNTP_CTL_ADDR A:0xf902402c
y.create.l HWIO_APCS_F2_QTMR_V1_CNTV_CVAL_LO_ADDR A:0xf9024030
y.create.l HWIO_APCS_F2_QTMR_V1_CNTV_CVAL_HI_ADDR A:0xf9024034
y.create.l HWIO_APCS_F2_QTMR_V1_CNTV_TVAL_ADDR A:0xf9024038
y.create.l HWIO_APCS_F2_QTMR_V1_CNTV_CTL_ADDR A:0xf902403c
y.create.l HWIO_APCS_F2_QTMR_V1_VERSION_ADDR A:0xf9024fd0
y.create.l HWIO_APCS_F3_QTMR_V1_CNTPCT_LO_ADDR A:0xf9025000
y.create.l HWIO_APCS_F3_QTMR_V1_CNTPCT_HI_ADDR A:0xf9025004
y.create.l HWIO_APCS_F3_QTMR_V1_CNTVCT_LO_ADDR A:0xf9025008
y.create.l HWIO_APCS_F3_QTMR_V1_CNTVCT_HI_ADDR A:0xf902500c
y.create.l HWIO_APCS_F3_QTMR_V1_CNTFRQ_ADDR A:0xf9025010
y.create.l HWIO_APCS_F3_QTMR_V1_CNTPL0ACR_ADDR A:0xf9025014
y.create.l HWIO_APCS_F3_QTMR_V1_CNTVOFF_LO_ADDR A:0xf9025018
y.create.l HWIO_APCS_F3_QTMR_V1_CNTVOFF_HI_ADDR A:0xf902501c
y.create.l HWIO_APCS_F3_QTMR_V1_CNTP_CVAL_LO_ADDR A:0xf9025020
y.create.l HWIO_APCS_F3_QTMR_V1_CNTP_CVAL_HI_ADDR A:0xf9025024
y.create.l HWIO_APCS_F3_QTMR_V1_CNTP_TVAL_ADDR A:0xf9025028
y.create.l HWIO_APCS_F3_QTMR_V1_CNTP_CTL_ADDR A:0xf902502c
y.create.l HWIO_APCS_F3_QTMR_V1_CNTV_CVAL_LO_ADDR A:0xf9025030
y.create.l HWIO_APCS_F3_QTMR_V1_CNTV_CVAL_HI_ADDR A:0xf9025034
y.create.l HWIO_APCS_F3_QTMR_V1_CNTV_TVAL_ADDR A:0xf9025038
y.create.l HWIO_APCS_F3_QTMR_V1_CNTV_CTL_ADDR A:0xf902503c
y.create.l HWIO_APCS_F3_QTMR_V1_VERSION_ADDR A:0xf9025fd0
y.create.l HWIO_APCS_F4_QTMR_V1_CNTPCT_LO_ADDR A:0xf9026000
y.create.l HWIO_APCS_F4_QTMR_V1_CNTPCT_HI_ADDR A:0xf9026004
y.create.l HWIO_APCS_F4_QTMR_V1_CNTVCT_LO_ADDR A:0xf9026008
y.create.l HWIO_APCS_F4_QTMR_V1_CNTVCT_HI_ADDR A:0xf902600c
y.create.l HWIO_APCS_F4_QTMR_V1_CNTFRQ_ADDR A:0xf9026010
y.create.l HWIO_APCS_F4_QTMR_V1_CNTPL0ACR_ADDR A:0xf9026014
y.create.l HWIO_APCS_F4_QTMR_V1_CNTVOFF_LO_ADDR A:0xf9026018
y.create.l HWIO_APCS_F4_QTMR_V1_CNTVOFF_HI_ADDR A:0xf902601c
y.create.l HWIO_APCS_F4_QTMR_V1_CNTP_CVAL_LO_ADDR A:0xf9026020
y.create.l HWIO_APCS_F4_QTMR_V1_CNTP_CVAL_HI_ADDR A:0xf9026024
y.create.l HWIO_APCS_F4_QTMR_V1_CNTP_TVAL_ADDR A:0xf9026028
y.create.l HWIO_APCS_F4_QTMR_V1_CNTP_CTL_ADDR A:0xf902602c
y.create.l HWIO_APCS_F4_QTMR_V1_CNTV_CVAL_LO_ADDR A:0xf9026030
y.create.l HWIO_APCS_F4_QTMR_V1_CNTV_CVAL_HI_ADDR A:0xf9026034
y.create.l HWIO_APCS_F4_QTMR_V1_CNTV_TVAL_ADDR A:0xf9026038
y.create.l HWIO_APCS_F4_QTMR_V1_CNTV_CTL_ADDR A:0xf902603c
y.create.l HWIO_APCS_F4_QTMR_V1_VERSION_ADDR A:0xf9026fd0
y.create.l HWIO_APCS_F5_QTMR_V1_CNTPCT_LO_ADDR A:0xf9027000
y.create.l HWIO_APCS_F5_QTMR_V1_CNTPCT_HI_ADDR A:0xf9027004
y.create.l HWIO_APCS_F5_QTMR_V1_CNTVCT_LO_ADDR A:0xf9027008
y.create.l HWIO_APCS_F5_QTMR_V1_CNTVCT_HI_ADDR A:0xf902700c
y.create.l HWIO_APCS_F5_QTMR_V1_CNTFRQ_ADDR A:0xf9027010
y.create.l HWIO_APCS_F5_QTMR_V1_CNTPL0ACR_ADDR A:0xf9027014
y.create.l HWIO_APCS_F5_QTMR_V1_CNTVOFF_LO_ADDR A:0xf9027018
y.create.l HWIO_APCS_F5_QTMR_V1_CNTVOFF_HI_ADDR A:0xf902701c
y.create.l HWIO_APCS_F5_QTMR_V1_CNTP_CVAL_LO_ADDR A:0xf9027020
y.create.l HWIO_APCS_F5_QTMR_V1_CNTP_CVAL_HI_ADDR A:0xf9027024
y.create.l HWIO_APCS_F5_QTMR_V1_CNTP_TVAL_ADDR A:0xf9027028
y.create.l HWIO_APCS_F5_QTMR_V1_CNTP_CTL_ADDR A:0xf902702c
y.create.l HWIO_APCS_F5_QTMR_V1_CNTV_CVAL_LO_ADDR A:0xf9027030
y.create.l HWIO_APCS_F5_QTMR_V1_CNTV_CVAL_HI_ADDR A:0xf9027034
y.create.l HWIO_APCS_F5_QTMR_V1_CNTV_TVAL_ADDR A:0xf9027038
y.create.l HWIO_APCS_F5_QTMR_V1_CNTV_CTL_ADDR A:0xf902703c
y.create.l HWIO_APCS_F5_QTMR_V1_VERSION_ADDR A:0xf9027fd0
y.create.l HWIO_APCS_F6_QTMR_V1_CNTPCT_LO_ADDR A:0xf9028000
y.create.l HWIO_APCS_F6_QTMR_V1_CNTPCT_HI_ADDR A:0xf9028004
y.create.l HWIO_APCS_F6_QTMR_V1_CNTVCT_LO_ADDR A:0xf9028008
y.create.l HWIO_APCS_F6_QTMR_V1_CNTVCT_HI_ADDR A:0xf902800c
y.create.l HWIO_APCS_F6_QTMR_V1_CNTFRQ_ADDR A:0xf9028010
y.create.l HWIO_APCS_F6_QTMR_V1_CNTPL0ACR_ADDR A:0xf9028014
y.create.l HWIO_APCS_F6_QTMR_V1_CNTVOFF_LO_ADDR A:0xf9028018
y.create.l HWIO_APCS_F6_QTMR_V1_CNTVOFF_HI_ADDR A:0xf902801c
y.create.l HWIO_APCS_F6_QTMR_V1_CNTP_CVAL_LO_ADDR A:0xf9028020
y.create.l HWIO_APCS_F6_QTMR_V1_CNTP_CVAL_HI_ADDR A:0xf9028024
y.create.l HWIO_APCS_F6_QTMR_V1_CNTP_TVAL_ADDR A:0xf9028028
y.create.l HWIO_APCS_F6_QTMR_V1_CNTP_CTL_ADDR A:0xf902802c
y.create.l HWIO_APCS_F6_QTMR_V1_CNTV_CVAL_LO_ADDR A:0xf9028030
y.create.l HWIO_APCS_F6_QTMR_V1_CNTV_CVAL_HI_ADDR A:0xf9028034
y.create.l HWIO_APCS_F6_QTMR_V1_CNTV_TVAL_ADDR A:0xf9028038
y.create.l HWIO_APCS_F6_QTMR_V1_CNTV_CTL_ADDR A:0xf902803c
y.create.l HWIO_APCS_F6_QTMR_V1_VERSION_ADDR A:0xf9028fd0
y.create.l HWIO_APCS_F7_QTMR_V1_CNTPCT_LO_ADDR A:0xf9029000
y.create.l HWIO_APCS_F7_QTMR_V1_CNTPCT_HI_ADDR A:0xf9029004
y.create.l HWIO_APCS_F7_QTMR_V1_CNTVCT_LO_ADDR A:0xf9029008
y.create.l HWIO_APCS_F7_QTMR_V1_CNTVCT_HI_ADDR A:0xf902900c
y.create.l HWIO_APCS_F7_QTMR_V1_CNTFRQ_ADDR A:0xf9029010
y.create.l HWIO_APCS_F7_QTMR_V1_CNTPL0ACR_ADDR A:0xf9029014
y.create.l HWIO_APCS_F7_QTMR_V1_CNTVOFF_LO_ADDR A:0xf9029018
y.create.l HWIO_APCS_F7_QTMR_V1_CNTVOFF_HI_ADDR A:0xf902901c
y.create.l HWIO_APCS_F7_QTMR_V1_CNTP_CVAL_LO_ADDR A:0xf9029020
y.create.l HWIO_APCS_F7_QTMR_V1_CNTP_CVAL_HI_ADDR A:0xf9029024
y.create.l HWIO_APCS_F7_QTMR_V1_CNTP_TVAL_ADDR A:0xf9029028
y.create.l HWIO_APCS_F7_QTMR_V1_CNTP_CTL_ADDR A:0xf902902c
y.create.l HWIO_APCS_F7_QTMR_V1_CNTV_CVAL_LO_ADDR A:0xf9029030
y.create.l HWIO_APCS_F7_QTMR_V1_CNTV_CVAL_HI_ADDR A:0xf9029034
y.create.l HWIO_APCS_F7_QTMR_V1_CNTV_TVAL_ADDR A:0xf9029038
y.create.l HWIO_APCS_F7_QTMR_V1_CNTV_CTL_ADDR A:0xf902903c
y.create.l HWIO_APCS_F7_QTMR_V1_VERSION_ADDR A:0xf9029fd0
y.create.l HWIO_WDOG_SECURE_ADDR A:0xf9017000
y.create.l HWIO_WDOG_RESET_ADDR A:0xf9017004
y.create.l HWIO_WDOG_CTL_ADDR A:0xf9017008
y.create.l HWIO_WDOG_STATUS_ADDR A:0xf901700c
y.create.l HWIO_WDOG_BARK_TIME_ADDR A:0xf9017010
y.create.l HWIO_WDOG_BITE_TIME_ADDR A:0xf9017014
y.create.l HWIO_WDOG_TEST_LOAD_STATUS_ADDR A:0xf9017018
y.create.l HWIO_WDOG_TEST_LOAD_ADDR A:0xf901701c
y.create.l HWIO_WDOG_TEST_ADDR A:0xf9017020
y.create.l HWIO_APCS_GLBSECURE_ADDR A:0xf9010000
y.create.l HWIO_APCS_START_ADDR_ADDR A:0xf9010004
y.create.l HWIO_APCS_CMD_RCGR_ADDR A:0xf9010008
y.create.l HWIO_APCS_CFG_RCGR_ADDR A:0xf901000c
y.create.l HWIO_APCS_CBCR_ADDR A:0xf9010010
y.create.l HWIO_APCS_GLB_CFG_ADDR A:0xf9010014
y.create.l HWIO_APCS_GLB_BOOT_REMAP_ADDR A:0xf9010018
y.create.l HWIO_APCS_GLB_TEST_BUSSEL_ADDR A:0xf901001c
y.create.l HWIO_APCS_GLB_EN_PWR_ST_ADDR A:0xf9010020
y.create.l HWIO_APCS_GLB_QSB_LP_ADDR A:0xf9010024
y.create.l HWIO_APCS_GLB_AHB_CLKON_ADDR A:0xf9010028
y.create.l HWIO_APCS_GLB_QGIC_CFG_ADDR A:0xf901002c
y.create.l HWIO_APCS_GLB_GHDS_CNTR_ADDR A:0xf9010030
y.create.l HWIO_APCS_TCM_REDIRECT_ADDR_ADDR A:0xf9010034
y.create.l HWIO_APCS_A7_GLB_CFG_ADDR A:0xf9010038
y.create.l HWIO_APCS_GCCSECURE_ADDR A:0xf9011000
y.create.l HWIO_APCS_IPC_SECURITY_ADDR A:0xf9011004
y.create.l HWIO_APCS_IPC_ADDR A:0xf9011008
y.create.l HWIO_APCS_PWR_CTL_OVERRIDE_ADDR A:0xf901100c
y.create.l HWIO_APCS_GCLK_STS_ADDR A:0xf9011010
y.create.l HWIO_APCS_L2_PWR_CTL_ADDR A:0xf9011014
y.create.l HWIO_APCS_PWR_STS_ADDR A:0xf9011018
y.create.l HWIO_APCS_CLK_DIAG_ADDR A:0xf901101c
y.create.l HWIO_APCS_ALL_TSTBUS_SEL_ADDR A:0xf9011020
y.create.l HWIO_APCS_DBG_PWR_CTL_ADDR A:0xf9011024
y.create.l HWIO_APCS_L2_AUX_CLK_SEL_ADDR A:0xf9011028
y.create.l HWIO_APCS_SPARE_ADDR A:0xf901102c
y.create.l HWIO_APCS_SPARE_STS_ADDR A:0xf9011030
y.create.l HWIO_XPU_STATUS_ADDR A:0xf9011034
y.create.l HWIO_APCS_HW_EVENT_SEL_0_ADDR A:0xf9011038
y.create.l HWIO_APCS_HW_EVENT_SEL_1_ADDR A:0xf901103c
y.create.l HWIO_APCS_HW_EVENT_SEL_2_ADDR A:0xf9011040
y.create.l HWIO_APCS_HW_EVENT_SEL_3_ADDR A:0xf9011044
y.create.l HWIO_APCS_HW_EVENT_SEL_4_ADDR A:0xf9011048
y.create.l HWIO_APCS_HW_EVENT_SEL_5_ADDR A:0xf901104c
y.create.l HWIO_APCS_HW_EVENT_SEL_6_ADDR A:0xf9011050
y.create.l HWIO_APCS_HW_EVENT_SEL_7_ADDR A:0xf9011054
y.create.l HWIO_APCS_HW_EVENT_SEL_8_ADDR A:0xf9011058
y.create.l HWIO_APCS_HW_EVENT_SEL_9_ADDR A:0xf901105c
y.create.l HWIO_APCS_XPU_SCR_ADDR A:0xf9013000
y.create.l HWIO_APCS_XPU_SWDR_ADDR A:0xf9013004
y.create.l HWIO_APCS_XPU_PRTN_RACR_SSHADOW_ADDR A:0xf9013008
y.create.l HWIO_APCS_XPU_PRTN_WACR_SSHADOW_ADDR A:0xf901300c
y.create.l HWIO_APCS_XPU_PRTN_START_SSHADOW0_ADDR A:0xf9013010
y.create.l HWIO_APCS_XPU_PRTN_END_SSHADOW0_ADDR A:0xf9013018
y.create.l HWIO_APCS_XPU_SEAR0_ADDR A:0xf9013040
y.create.l HWIO_APCS_XPU_SESR_ADDR A:0xf9013048
y.create.l HWIO_APCS_XPU_SESRRESTORE_ADDR A:0xf901304c
y.create.l HWIO_APCS_XPU_SESYNR0_ADDR A:0xf9013050
y.create.l HWIO_APCS_XPU_SESYNR1_ADDR A:0xf9013054
y.create.l HWIO_APCS_XPU_SESYNR2_ADDR A:0xf9013058
y.create.l HWIO_APCS_XPU_MCR_ADDR A:0xf9013100
y.create.l HWIO_APCS_XPU_MEAR0_ADDR A:0xf9013140
y.create.l HWIO_APCS_XPU_MESR_ADDR A:0xf9013148
y.create.l HWIO_APCS_XPU_MESRRESTORE_ADDR A:0xf901314c
y.create.l HWIO_APCS_XPU_MESYNR0_ADDR A:0xf9013150
y.create.l HWIO_APCS_XPU_MESYNR1_ADDR A:0xf9013154
y.create.l HWIO_APCS_XPU_MESYNR2_ADDR A:0xf9013158
y.create.l HWIO_APCS_XPU_CR_ADDR A:0xf9013080
y.create.l HWIO_APCS_XPU_PRTN_RACR_SHADOW_ADDR A:0xf9013088
y.create.l HWIO_APCS_XPU_PRTN_WACR_SHADOW_ADDR A:0xf901308c
y.create.l HWIO_APCS_XPU_PRTN_START_SHADOW0_ADDR A:0xf9013090
y.create.l HWIO_APCS_XPU_PRTN_END_SHADOW0_ADDR A:0xf9013098
y.create.l HWIO_APCS_XPU_RPU_ACR0_ADDR A:0xf90130a0
y.create.l HWIO_APCS_XPU_EAR0_ADDR A:0xf90130c0
y.create.l HWIO_APCS_XPU_ESR_ADDR A:0xf90130c8
y.create.l HWIO_APCS_XPU_ESRRESTORE_ADDR A:0xf90130cc
y.create.l HWIO_APCS_XPU_ESYNR0_ADDR A:0xf90130d0
y.create.l HWIO_APCS_XPU_ESYNR1_ADDR A:0xf90130d4
y.create.l HWIO_APCS_XPU_ESYNR2_ADDR A:0xf90130d8
y.create.l HWIO_APCS_XPU_UMR_RACR_ADDR A:0xf90130e0
y.create.l HWIO_APCS_XPU_UMR_WACR_ADDR A:0xf90130e4
y.create.l HWIO_APCS_XPU_IDR0_ADDR A:0xf9013074
y.create.l HWIO_APCS_XPU_IDR1_ADDR A:0xf9013078
y.create.l HWIO_APCS_XPU_REV_ADDR A:0xf901307c
y.create.l HWIO_APCS_XPU_PRT0_RACR0_ADDR A:0xf9013200
y.create.l HWIO_APCS_XPU_PRT1_RACR0_ADDR A:0xf9013280
y.create.l HWIO_APCS_XPU_PRT2_RACR0_ADDR A:0xf9013300
y.create.l HWIO_APCS_XPU_PRT3_RACR0_ADDR A:0xf9013380
y.create.l HWIO_APCS_XPU_PRT4_RACR0_ADDR A:0xf9013400
y.create.l HWIO_APCS_XPU_PRT5_RACR0_ADDR A:0xf9013480
y.create.l HWIO_APCS_XPU_PRT6_RACR0_ADDR A:0xf9013500
y.create.l HWIO_APCS_XPU_PRT7_RACR0_ADDR A:0xf9013580
y.create.l HWIO_APCS_XPU_PRT8_RACR0_ADDR A:0xf9013600
y.create.l HWIO_APCS_XPU_PRT9_RACR0_ADDR A:0xf9013680
y.create.l HWIO_APCS_XPU_PRT0_WACR0_ADDR A:0xf9013220
y.create.l HWIO_APCS_XPU_PRT1_WACR0_ADDR A:0xf90132a0
y.create.l HWIO_APCS_XPU_PRT2_WACR0_ADDR A:0xf9013320
y.create.l HWIO_APCS_XPU_PRT3_WACR0_ADDR A:0xf90133a0
y.create.l HWIO_APCS_XPU_PRT4_WACR0_ADDR A:0xf9013420
y.create.l HWIO_APCS_XPU_PRT5_WACR0_ADDR A:0xf90134a0
y.create.l HWIO_APCS_XPU_PRT6_WACR0_ADDR A:0xf9013520
y.create.l HWIO_APCS_XPU_PRT7_WACR0_ADDR A:0xf90135a0
y.create.l HWIO_APCS_XPU_PRT8_WACR0_ADDR A:0xf9013620
y.create.l HWIO_APCS_XPU_PRT9_WACR0_ADDR A:0xf90136a0
y.create.l HWIO_APCS_XPU_PRT0_START0_ADDR A:0xf9013240
y.create.l HWIO_APCS_XPU_PRT1_START0_ADDR A:0xf90132c0
y.create.l HWIO_APCS_XPU_PRT2_START0_ADDR A:0xf9013340
y.create.l HWIO_APCS_XPU_PRT3_START0_ADDR A:0xf90133c0
y.create.l HWIO_APCS_XPU_PRT4_START0_ADDR A:0xf9013440
y.create.l HWIO_APCS_XPU_PRT5_START0_ADDR A:0xf90134c0
y.create.l HWIO_APCS_XPU_PRT6_START0_ADDR A:0xf9013540
y.create.l HWIO_APCS_XPU_PRT7_START0_ADDR A:0xf90135c0
y.create.l HWIO_APCS_XPU_PRT8_START0_ADDR A:0xf9013640
y.create.l HWIO_APCS_XPU_PRT9_START0_ADDR A:0xf90136c0
y.create.l HWIO_APCS_XPU_PRT0_END0_ADDR A:0xf9013248
y.create.l HWIO_APCS_XPU_PRT1_END0_ADDR A:0xf90132c8
y.create.l HWIO_APCS_XPU_PRT2_END0_ADDR A:0xf9013348
y.create.l HWIO_APCS_XPU_PRT3_END0_ADDR A:0xf90133c8
y.create.l HWIO_APCS_XPU_PRT4_END0_ADDR A:0xf9013448
y.create.l HWIO_APCS_XPU_PRT5_END0_ADDR A:0xf90134c8
y.create.l HWIO_APCS_XPU_PRT6_END0_ADDR A:0xf9013548
y.create.l HWIO_APCS_XPU_PRT7_END0_ADDR A:0xf90135c8
y.create.l HWIO_APCS_XPU_PRT8_END0_ADDR A:0xf9013648
y.create.l HWIO_APCS_XPU_PRT9_END0_ADDR A:0xf90136c8
y.create.l HWIO_APCS_XPU_PRT0_SCR_ADDR A:0xf9013250
y.create.l HWIO_APCS_XPU_PRT1_SCR_ADDR A:0xf90132d0
y.create.l HWIO_APCS_XPU_PRT2_SCR_ADDR A:0xf9013350
y.create.l HWIO_APCS_XPU_PRT3_SCR_ADDR A:0xf90133d0
y.create.l HWIO_APCS_XPU_PRT4_SCR_ADDR A:0xf9013450
y.create.l HWIO_APCS_XPU_PRT5_SCR_ADDR A:0xf90134d0
y.create.l HWIO_APCS_XPU_PRT6_SCR_ADDR A:0xf9013550
y.create.l HWIO_APCS_XPU_PRT7_SCR_ADDR A:0xf90135d0
y.create.l HWIO_APCS_XPU_PRT8_SCR_ADDR A:0xf9013650
y.create.l HWIO_APCS_XPU_PRT9_SCR_ADDR A:0xf90136d0
y.create.l HWIO_APCS_XPU_PRT0_MCR_ADDR A:0xf9013254
y.create.l HWIO_APCS_XPU_PRT1_MCR_ADDR A:0xf90132d4
y.create.l HWIO_APCS_XPU_PRT2_MCR_ADDR A:0xf9013354
y.create.l HWIO_APCS_XPU_PRT3_MCR_ADDR A:0xf90133d4
y.create.l HWIO_APCS_XPU_PRT4_MCR_ADDR A:0xf9013454
y.create.l HWIO_APCS_XPU_PRT5_MCR_ADDR A:0xf90134d4
y.create.l HWIO_APCS_XPU_PRT6_MCR_ADDR A:0xf9013554
y.create.l HWIO_APCS_XPU_PRT7_MCR_ADDR A:0xf90135d4
y.create.l HWIO_APCS_XPU_PRT8_MCR_ADDR A:0xf9013654
y.create.l HWIO_APCS_XPU_PRT9_MCR_ADDR A:0xf90136d4
y.create.l HWIO_APCS_XPU_PRT0_CNTL0_ADDR A:0xf9013258
y.create.l HWIO_APCS_XPU_PRT1_CNTL0_ADDR A:0xf90132d8
y.create.l HWIO_APCS_XPU_PRT2_CNTL0_ADDR A:0xf9013358
y.create.l HWIO_APCS_XPU_PRT3_CNTL0_ADDR A:0xf90133d8
y.create.l HWIO_APCS_XPU_PRT4_CNTL0_ADDR A:0xf9013458
y.create.l HWIO_APCS_XPU_PRT5_CNTL0_ADDR A:0xf90134d8
y.create.l HWIO_APCS_XPU_PRT6_CNTL0_ADDR A:0xf9013558
y.create.l HWIO_APCS_XPU_PRT7_CNTL0_ADDR A:0xf90135d8
y.create.l HWIO_APCS_XPU_PRT8_CNTL0_ADDR A:0xf9013658
y.create.l HWIO_APCS_XPU_PRT9_CNTL0_ADDR A:0xf90136d8
y.create.l HWIO_APCS_XPU_PRT0_CNTL1_ADDR A:0xf901325c
y.create.l HWIO_APCS_XPU_PRT1_CNTL1_ADDR A:0xf90132dc
y.create.l HWIO_APCS_XPU_PRT2_CNTL1_ADDR A:0xf901335c
y.create.l HWIO_APCS_XPU_PRT3_CNTL1_ADDR A:0xf90133dc
y.create.l HWIO_APCS_XPU_PRT4_CNTL1_ADDR A:0xf901345c
y.create.l HWIO_APCS_XPU_PRT5_CNTL1_ADDR A:0xf90134dc
y.create.l HWIO_APCS_XPU_PRT6_CNTL1_ADDR A:0xf901355c
y.create.l HWIO_APCS_XPU_PRT7_CNTL1_ADDR A:0xf90135dc
y.create.l HWIO_APCS_XPU_PRT8_CNTL1_ADDR A:0xf901365c
y.create.l HWIO_APCS_XPU_PRT9_CNTL1_ADDR A:0xf90136dc
y.create.l HWIO_APCS_VMIDMT_SCR0_ADDR A:0xf902a000
y.create.l HWIO_APCS_VMIDMT_SCR1_ADDR A:0xf902a004
y.create.l HWIO_APCS_VMIDMT_SCR2_ADDR A:0xf902a008
y.create.l HWIO_APCS_VMIDMT_SACR_ADDR A:0xf902a010
y.create.l HWIO_APCS_VMIDMT_SIDR0_ADDR A:0xf902a020
y.create.l HWIO_APCS_VMIDMT_SIDR1_ADDR A:0xf902a024
y.create.l HWIO_APCS_VMIDMT_SIDR2_ADDR A:0xf902a028
y.create.l HWIO_APCS_VMIDMT_SIDR4_ADDR A:0xf902a030
y.create.l HWIO_APCS_VMIDMT_SIDR5_ADDR A:0xf902a034
y.create.l HWIO_APCS_VMIDMT_SIDR7_ADDR A:0xf902a03c
y.create.l HWIO_APCS_VMIDMT_SGFAR0_ADDR A:0xf902a040
y.create.l HWIO_APCS_VMIDMT_SGFSR_ADDR A:0xf902a048
y.create.l HWIO_APCS_VMIDMT_SGFSRRESTORE_ADDR A:0xf902a04c
y.create.l HWIO_APCS_VMIDMT_SGFSYNDR0_ADDR A:0xf902a050
y.create.l HWIO_APCS_VMIDMT_SGFSYNDR1_ADDR A:0xf902a054
y.create.l HWIO_APCS_VMIDMT_SGFSYNDR2_ADDR A:0xf902a058
y.create.l HWIO_APCS_VMIDMT_VMIDMTSCR0_ADDR A:0xf902a090
y.create.l HWIO_APCS_VMIDMT_CR0_ADDR A:0xf902a000
y.create.l HWIO_APCS_VMIDMT_CR2_ADDR A:0xf902a008
y.create.l HWIO_APCS_VMIDMT_ACR_ADDR A:0xf902a010
y.create.l HWIO_APCS_VMIDMT_IDR0_ADDR A:0xf902a020
y.create.l HWIO_APCS_VMIDMT_IDR1_ADDR A:0xf902a024
y.create.l HWIO_APCS_VMIDMT_IDR2_ADDR A:0xf902a028
y.create.l HWIO_APCS_VMIDMT_IDR4_ADDR A:0xf902a030
y.create.l HWIO_APCS_VMIDMT_IDR5_ADDR A:0xf902a034
y.create.l HWIO_APCS_VMIDMT_IDR7_ADDR A:0xf902a03c
y.create.l HWIO_APCS_VMIDMT_GFAR0_ADDR A:0xf902a040
y.create.l HWIO_APCS_VMIDMT_GFSR_ADDR A:0xf902a048
y.create.l HWIO_APCS_VMIDMT_GFSRRESTORE_ADDR A:0xf902a04c
y.create.l HWIO_APCS_VMIDMT_GFSYNDR0_ADDR A:0xf902a050
y.create.l HWIO_APCS_VMIDMT_GFSYNDR1_ADDR A:0xf902a054
y.create.l HWIO_APCS_VMIDMT_GFSYNDR2_ADDR A:0xf902a058
y.create.l HWIO_APCS_VMIDMT_VMIDMTCR0_ADDR A:0xf902a090
y.create.l HWIO_APCS_VMIDMT_VMIDMTACR_ADDR A:0xf902a09c
y.create.l HWIO_APCS_VMIDMT_NSCR0_ADDR A:0xf902a400
y.create.l HWIO_APCS_VMIDMT_NSCR2_ADDR A:0xf902a408
y.create.l HWIO_APCS_VMIDMT_NSACR_ADDR A:0xf902a410
y.create.l HWIO_APCS_VMIDMT_NSGFAR0_ADDR A:0xf902a440
y.create.l HWIO_APCS_VMIDMT_NSGFSR_ADDR A:0xf902a448
y.create.l HWIO_APCS_VMIDMT_NSGFSRRESTORE_ADDR A:0xf902a44c
y.create.l HWIO_APCS_VMIDMT_NSGFSYNDR0_ADDR A:0xf902a450
y.create.l HWIO_APCS_VMIDMT_NSGFSYNDR1_ADDR A:0xf902a454
y.create.l HWIO_APCS_VMIDMT_NSGFSYNDR2_ADDR A:0xf902a458
y.create.l HWIO_APCS_VMIDMT_NSVMIDMTCR0_ADDR A:0xf902a490
y.create.l HWIO_APCS_VMIDMT_SSDR0_ADDR A:0xf902a080
y.create.l HWIO_APCS_VMIDMT_S2VR0_ADDR A:0xf902ac00
y.create.l HWIO_APCS_VMIDMT_S2VR1_ADDR A:0xf902ac04
y.create.l HWIO_APCS_VMIDMT_AS2VR0_ADDR A:0xf902ae00
y.create.l HWIO_APCS_VMIDMT_AS2VR1_ADDR A:0xf902ae04
y.create.l HWIO_BIMC_HW_VERSION_ADDR A:0xfc380000
y.create.l HWIO_BIMC_CORE_INFO_ADDR A:0xfc380004
y.create.l HWIO_BIMC_HW_INFO_ADDR A:0xfc380008
y.create.l HWIO_BIMC_CORE_CLK_SEL_ADDR A:0xfc380020
y.create.l HWIO_BIMC_CORE_CLK_PERIOD_ADDR A:0xfc380024
y.create.l HWIO_BIMC_SCMO0_LOCAL_CGC_THRESHOLD_ADDR A:0xfc380100
y.create.l HWIO_BIMC_DPE0_LOCAL_CGC_THRESHOLD_ADDR A:0xfc380140
y.create.l HWIO_BIMC_MPORT_CORE_DOMAIN_LOCAL_CGC_THRESHOLD_ADDR A:0xfc380180
y.create.l HWIO_BIMC_MPORT0_CLK_LOCAL_CGC_THRESHOLD_ADDR A:0xfc3801c0
y.create.l HWIO_BIMC_MPORT1_CLK_LOCAL_CGC_THRESHOLD_ADDR A:0xfc3801c4
y.create.l HWIO_BIMC_MPORT2_CLK_LOCAL_CGC_THRESHOLD_ADDR A:0xfc3801c8
y.create.l HWIO_BIMC_SWAY_LOCAL_CGC_THRESHOLD_ADDR A:0xfc380200
y.create.l HWIO_BIMC_SCMO0_CGC_CFG_ADDR A:0xfc380240
y.create.l HWIO_BIMC_DPE0_CGC_CFG_ADDR A:0xfc380280
y.create.l HWIO_BIMC_CALIBRATION_CFG_ADDR A:0xfc380400
y.create.l HWIO_BIMC_DFI0_LP_CFG_ADDR A:0xfc380600
y.create.l HWIO_BIMC_HFSC_CFG_ADDR A:0xfc380800
y.create.l HWIO_BIMC_HFSC_STATUS_ADDR A:0xfc38080c
y.create.l HWIO_BIMC_HFSC_STAGE1_CTRL_ADDR A:0xfc380840
y.create.l HWIO_BIMC_HFSC_STAGE2_CTRL_ADDR A:0xfc380860
y.create.l HWIO_BIMC_BRIC_GLOBAL1_COMPONENT_INFO_ADDR A:0xfc381000
y.create.l HWIO_BIMC_BRIC_HW_INFO_ADDR A:0xfc381010
y.create.l HWIO_BIMC_BRIC_CONFIGURATION_INFO_0_ADDR A:0xfc381020
y.create.l HWIO_BIMC_BRIC_CONFIGURATION_INFO_1_ADDR A:0xfc381030
y.create.l HWIO_BIMC_BRIC_INTERRUPT_STATUS_0_ADDR A:0xfc381100
y.create.l HWIO_BIMC_BRIC_INTERRUPT_CLEAR_0_ADDR A:0xfc381108
y.create.l HWIO_BIMC_BRIC_INTERRUPT_ENABLE_0_ADDR A:0xfc38110c
y.create.l HWIO_BIMC_BRIC_INTERRUPT_STATUS_1_ADDR A:0xfc381110
y.create.l HWIO_BIMC_BRIC_INTERRUPT_CLEAR_1_ADDR A:0xfc381118
y.create.l HWIO_BIMC_BRIC_INTERRUPT_ENABLE_1_ADDR A:0xfc38111c
y.create.l HWIO_BIMC_BRIC_INTERRUPT_STATUS_2_ADDR A:0xfc381120
y.create.l HWIO_BIMC_BRIC_INTERRUPT_CLEAR_2_ADDR A:0xfc381128
y.create.l HWIO_BIMC_BRIC_INTERRUPT_ENABLE_2_ADDR A:0xfc38112c
y.create.l HWIO_BIMC_BRIC_INTERRUPT_STATUS_3_ADDR A:0xfc381130
y.create.l HWIO_BIMC_BRIC_INTERRUPT_CLEAR_3_ADDR A:0xfc381138
y.create.l HWIO_BIMC_BRIC_INTERRUPT_ENABLE_3_ADDR A:0xfc38113c
y.create.l HWIO_BIMC_BRIC_REF_TIMER_INTERVAL_ADDR A:0xfc381200
y.create.l HWIO_BIMC_BRIC_DEBUG_SELECT_ADDR A:0xfc381210
y.create.l HWIO_BIMC_BRIC_GLOBAL2_COMPONENT_INFO_ADDR A:0xfc382000
y.create.l HWIO_BIMC_BRIC_DEFAULT_SEGMENT_ADDR A:0xfc3821f0
y.create.l HWIO_BIMC_BRIC_SEGMENT0_ADDR_BASE_A_LOWER_ADDR A:0xfc382200
y.create.l HWIO_BIMC_BRIC_SEGMENT1_ADDR_BASE_A_LOWER_ADDR A:0xfc382280
y.create.l HWIO_BIMC_BRIC_SEGMENT2_ADDR_BASE_A_LOWER_ADDR A:0xfc382300
y.create.l HWIO_BIMC_BRIC_SEGMENT0_ADDR_BASE_A_UPPER_ADDR A:0xfc382204
y.create.l HWIO_BIMC_BRIC_SEGMENT1_ADDR_BASE_A_UPPER_ADDR A:0xfc382284
y.create.l HWIO_BIMC_BRIC_SEGMENT2_ADDR_BASE_A_UPPER_ADDR A:0xfc382304
y.create.l HWIO_BIMC_BRIC_SEGMENT0_ADDR_MASK_A_LOWER_ADDR A:0xfc382208
y.create.l HWIO_BIMC_BRIC_SEGMENT1_ADDR_MASK_A_LOWER_ADDR A:0xfc382288
y.create.l HWIO_BIMC_BRIC_SEGMENT2_ADDR_MASK_A_LOWER_ADDR A:0xfc382308
y.create.l HWIO_BIMC_BRIC_SEGMENT0_ADDR_MASK_A_UPPER_ADDR A:0xfc38220c
y.create.l HWIO_BIMC_BRIC_SEGMENT1_ADDR_MASK_A_UPPER_ADDR A:0xfc38228c
y.create.l HWIO_BIMC_BRIC_SEGMENT2_ADDR_MASK_A_UPPER_ADDR A:0xfc38230c
y.create.l HWIO_BIMC_BRIC_SEGMENT0_ADDR_BASE_B_LOWER_ADDR A:0xfc382210
y.create.l HWIO_BIMC_BRIC_SEGMENT1_ADDR_BASE_B_LOWER_ADDR A:0xfc382290
y.create.l HWIO_BIMC_BRIC_SEGMENT2_ADDR_BASE_B_LOWER_ADDR A:0xfc382310
y.create.l HWIO_BIMC_BRIC_SEGMENT0_ADDR_BASE_B_UPPER_ADDR A:0xfc382214
y.create.l HWIO_BIMC_BRIC_SEGMENT1_ADDR_BASE_B_UPPER_ADDR A:0xfc382294
y.create.l HWIO_BIMC_BRIC_SEGMENT2_ADDR_BASE_B_UPPER_ADDR A:0xfc382314
y.create.l HWIO_BIMC_BRIC_SEGMENT0_ADDR_MASK_B_LOWER_ADDR A:0xfc382218
y.create.l HWIO_BIMC_BRIC_SEGMENT1_ADDR_MASK_B_LOWER_ADDR A:0xfc382298
y.create.l HWIO_BIMC_BRIC_SEGMENT2_ADDR_MASK_B_LOWER_ADDR A:0xfc382318
y.create.l HWIO_BIMC_BRIC_SEGMENT0_ADDR_MASK_B_UPPER_ADDR A:0xfc38221c
y.create.l HWIO_BIMC_BRIC_SEGMENT1_ADDR_MASK_B_UPPER_ADDR A:0xfc38229c
y.create.l HWIO_BIMC_BRIC_SEGMENT2_ADDR_MASK_B_UPPER_ADDR A:0xfc38231c
y.create.l HWIO_BIMC_BRIC_SEGMENT0_ADDR_BASE_C_LOWER_ADDR A:0xfc382220
y.create.l HWIO_BIMC_BRIC_SEGMENT1_ADDR_BASE_C_LOWER_ADDR A:0xfc3822a0
y.create.l HWIO_BIMC_BRIC_SEGMENT2_ADDR_BASE_C_LOWER_ADDR A:0xfc382320
y.create.l HWIO_BIMC_BRIC_SEGMENT0_ADDR_BASE_C_UPPER_ADDR A:0xfc382224
y.create.l HWIO_BIMC_BRIC_SEGMENT1_ADDR_BASE_C_UPPER_ADDR A:0xfc3822a4
y.create.l HWIO_BIMC_BRIC_SEGMENT2_ADDR_BASE_C_UPPER_ADDR A:0xfc382324
y.create.l HWIO_BIMC_BRIC_SEGMENT0_ADDR_MASK_C_LOWER_ADDR A:0xfc382228
y.create.l HWIO_BIMC_BRIC_SEGMENT1_ADDR_MASK_C_LOWER_ADDR A:0xfc3822a8
y.create.l HWIO_BIMC_BRIC_SEGMENT2_ADDR_MASK_C_LOWER_ADDR A:0xfc382328
y.create.l HWIO_BIMC_BRIC_SEGMENT0_ADDR_MASK_C_UPPER_ADDR A:0xfc38222c
y.create.l HWIO_BIMC_BRIC_SEGMENT1_ADDR_MASK_C_UPPER_ADDR A:0xfc3822ac
y.create.l HWIO_BIMC_BRIC_SEGMENT2_ADDR_MASK_C_UPPER_ADDR A:0xfc38232c
y.create.l HWIO_BIMC_CONFIG_APU_XPU_SCR_ADDR A:0xfc384000
y.create.l HWIO_BIMC_CONFIG_APU_XPU_SWDR_ADDR A:0xfc384004
y.create.l HWIO_BIMC_CONFIG_APU_XPU_SEAR0_ADDR A:0xfc384040
y.create.l HWIO_BIMC_CONFIG_APU_XPU_SESR_ADDR A:0xfc384048
y.create.l HWIO_BIMC_CONFIG_APU_XPU_SESRRESTORE_ADDR A:0xfc38404c
y.create.l HWIO_BIMC_CONFIG_APU_XPU_SESYNR0_ADDR A:0xfc384050
y.create.l HWIO_BIMC_CONFIG_APU_XPU_SESYNR1_ADDR A:0xfc384054
y.create.l HWIO_BIMC_CONFIG_APU_XPU_SESYNR2_ADDR A:0xfc384058
y.create.l HWIO_BIMC_CONFIG_APU_XPU_MCR_ADDR A:0xfc384100
y.create.l HWIO_BIMC_CONFIG_APU_XPU_MEAR0_ADDR A:0xfc384140
y.create.l HWIO_BIMC_CONFIG_APU_XPU_MESR_ADDR A:0xfc384148
y.create.l HWIO_BIMC_CONFIG_APU_XPU_MESRRESTORE_ADDR A:0xfc38414c
y.create.l HWIO_BIMC_CONFIG_APU_XPU_MESYNR0_ADDR A:0xfc384150
y.create.l HWIO_BIMC_CONFIG_APU_XPU_MESYNR1_ADDR A:0xfc384154
y.create.l HWIO_BIMC_CONFIG_APU_XPU_MESYNR2_ADDR A:0xfc384158
y.create.l HWIO_BIMC_CONFIG_APU_XPU_CR_ADDR A:0xfc384080
y.create.l HWIO_BIMC_CONFIG_APU_XPU_RPU_ACR0_ADDR A:0xfc3840a0
y.create.l HWIO_BIMC_CONFIG_APU_XPU_EAR0_ADDR A:0xfc3840c0
y.create.l HWIO_BIMC_CONFIG_APU_XPU_ESR_ADDR A:0xfc3840c8
y.create.l HWIO_BIMC_CONFIG_APU_XPU_ESRRESTORE_ADDR A:0xfc3840cc
y.create.l HWIO_BIMC_CONFIG_APU_XPU_ESYNR0_ADDR A:0xfc3840d0
y.create.l HWIO_BIMC_CONFIG_APU_XPU_ESYNR1_ADDR A:0xfc3840d4
y.create.l HWIO_BIMC_CONFIG_APU_XPU_ESYNR2_ADDR A:0xfc3840d8
y.create.l HWIO_BIMC_CONFIG_APU_XPU_IDR0_ADDR A:0xfc384074
y.create.l HWIO_BIMC_CONFIG_APU_XPU_IDR1_ADDR A:0xfc384078
y.create.l HWIO_BIMC_CONFIG_APU_XPU_REV_ADDR A:0xfc38407c
y.create.l HWIO_BIMC_CONFIG_APU_XPU_RG0_RACR0_ADDR A:0xfc384200
y.create.l HWIO_BIMC_CONFIG_APU_XPU_RG1_RACR0_ADDR A:0xfc384280
y.create.l HWIO_BIMC_CONFIG_APU_XPU_RG2_RACR0_ADDR A:0xfc384300
y.create.l HWIO_BIMC_CONFIG_APU_XPU_RG3_RACR0_ADDR A:0xfc384380
y.create.l HWIO_BIMC_CONFIG_APU_XPU_RG4_RACR0_ADDR A:0xfc384400
y.create.l HWIO_BIMC_CONFIG_APU_XPU_RG5_RACR0_ADDR A:0xfc384480
y.create.l HWIO_BIMC_CONFIG_APU_XPU_RG6_RACR0_ADDR A:0xfc384500
y.create.l HWIO_BIMC_CONFIG_APU_XPU_RG7_RACR0_ADDR A:0xfc384580
y.create.l HWIO_BIMC_CONFIG_APU_XPU_RG8_RACR0_ADDR A:0xfc384600
y.create.l HWIO_BIMC_CONFIG_APU_XPU_RG9_RACR0_ADDR A:0xfc384680
y.create.l HWIO_BIMC_CONFIG_APU_XPU_RG0_WACR0_ADDR A:0xfc384220
y.create.l HWIO_BIMC_CONFIG_APU_XPU_RG1_WACR0_ADDR A:0xfc3842a0
y.create.l HWIO_BIMC_CONFIG_APU_XPU_RG2_WACR0_ADDR A:0xfc384320
y.create.l HWIO_BIMC_CONFIG_APU_XPU_RG3_WACR0_ADDR A:0xfc3843a0
y.create.l HWIO_BIMC_CONFIG_APU_XPU_RG4_WACR0_ADDR A:0xfc384420
y.create.l HWIO_BIMC_CONFIG_APU_XPU_RG5_WACR0_ADDR A:0xfc3844a0
y.create.l HWIO_BIMC_CONFIG_APU_XPU_RG6_WACR0_ADDR A:0xfc384520
y.create.l HWIO_BIMC_CONFIG_APU_XPU_RG7_WACR0_ADDR A:0xfc3845a0
y.create.l HWIO_BIMC_CONFIG_APU_XPU_RG8_WACR0_ADDR A:0xfc384620
y.create.l HWIO_BIMC_CONFIG_APU_XPU_RG9_WACR0_ADDR A:0xfc3846a0
y.create.l HWIO_BIMC_CONFIG_APU_XPU_RG0_SCR_ADDR A:0xfc384250
y.create.l HWIO_BIMC_CONFIG_APU_XPU_RG1_SCR_ADDR A:0xfc3842d0
y.create.l HWIO_BIMC_CONFIG_APU_XPU_RG2_SCR_ADDR A:0xfc384350
y.create.l HWIO_BIMC_CONFIG_APU_XPU_RG3_SCR_ADDR A:0xfc3843d0
y.create.l HWIO_BIMC_CONFIG_APU_XPU_RG4_SCR_ADDR A:0xfc384450
y.create.l HWIO_BIMC_CONFIG_APU_XPU_RG5_SCR_ADDR A:0xfc3844d0
y.create.l HWIO_BIMC_CONFIG_APU_XPU_RG6_SCR_ADDR A:0xfc384550
y.create.l HWIO_BIMC_CONFIG_APU_XPU_RG7_SCR_ADDR A:0xfc3845d0
y.create.l HWIO_BIMC_CONFIG_APU_XPU_RG8_SCR_ADDR A:0xfc384650
y.create.l HWIO_BIMC_CONFIG_APU_XPU_RG9_SCR_ADDR A:0xfc3846d0
y.create.l HWIO_BIMC_CONFIG_APU_XPU_RG0_MCR_ADDR A:0xfc384254
y.create.l HWIO_BIMC_CONFIG_APU_XPU_RG1_MCR_ADDR A:0xfc3842d4
y.create.l HWIO_BIMC_CONFIG_APU_XPU_RG2_MCR_ADDR A:0xfc384354
y.create.l HWIO_BIMC_CONFIG_APU_XPU_RG3_MCR_ADDR A:0xfc3843d4
y.create.l HWIO_BIMC_CONFIG_APU_XPU_RG4_MCR_ADDR A:0xfc384454
y.create.l HWIO_BIMC_CONFIG_APU_XPU_RG5_MCR_ADDR A:0xfc3844d4
y.create.l HWIO_BIMC_CONFIG_APU_XPU_RG6_MCR_ADDR A:0xfc384554
y.create.l HWIO_BIMC_CONFIG_APU_XPU_RG7_MCR_ADDR A:0xfc3845d4
y.create.l HWIO_BIMC_CONFIG_APU_XPU_RG8_MCR_ADDR A:0xfc384654
y.create.l HWIO_BIMC_CONFIG_APU_XPU_RG9_MCR_ADDR A:0xfc3846d4
y.create.l HWIO_BIMC_PERFMON_COMPONENT_INFO_ADDR A:0xfc383000
y.create.l HWIO_BIMC_PERFMON_CONFIGURATION_INFO_ADDR A:0xfc383020
y.create.l HWIO_BIMC_PERFMON_CLOCK_CTRL_ADDR A:0xfc383200
y.create.l HWIO_BIMC_PERFMON_MODE_ADDR A:0xfc383210
y.create.l HWIO_BIMC_PERFMON_DUMP_ADDR A:0xfc383214
y.create.l HWIO_BIMC_PERFMON_TIMED_MODE_INTERVAL_ADDR A:0xfc383220
y.create.l HWIO_BIMC_PERFMON_TIMED_MODE_ITERATIONS_ADDR A:0xfc383230
y.create.l HWIO_BIMC_PERFMON_STATUS_ADDR A:0xfc3832f0
y.create.l HWIO_BIMC_PERFMON_COUNTER_0_CONFIG_ADDR A:0xfc383300
y.create.l HWIO_BIMC_PERFMON_COUNTER_1_CONFIG_ADDR A:0xfc383310
y.create.l HWIO_BIMC_PERFMON_COUNTER_2_CONFIG_ADDR A:0xfc383320
y.create.l HWIO_BIMC_PERFMON_COUNTER_3_CONFIG_ADDR A:0xfc383330
y.create.l HWIO_BIMC_PERFMON_COUNTER_4_CONFIG_ADDR A:0xfc383340
y.create.l HWIO_BIMC_PERFMON_COUNTER_5_CONFIG_ADDR A:0xfc383350
y.create.l HWIO_BIMC_PERFMON_COUNTER_6_CONFIG_ADDR A:0xfc383360
y.create.l HWIO_BIMC_PERFMON_COUNTER_7_CONFIG_ADDR A:0xfc383370
y.create.l HWIO_BIMC_PERFMON_COUNTER_8_CONFIG_ADDR A:0xfc383380
y.create.l HWIO_BIMC_PERFMON_COUNTER_9_CONFIG_ADDR A:0xfc383390
y.create.l HWIO_BIMC_PERFMON_COUNTER_0_ADDR A:0xfc383308
y.create.l HWIO_BIMC_PERFMON_COUNTER_1_ADDR A:0xfc383318
y.create.l HWIO_BIMC_PERFMON_COUNTER_2_ADDR A:0xfc383328
y.create.l HWIO_BIMC_PERFMON_COUNTER_3_ADDR A:0xfc383338
y.create.l HWIO_BIMC_PERFMON_COUNTER_4_ADDR A:0xfc383348
y.create.l HWIO_BIMC_PERFMON_COUNTER_5_ADDR A:0xfc383358
y.create.l HWIO_BIMC_PERFMON_COUNTER_6_ADDR A:0xfc383368
y.create.l HWIO_BIMC_PERFMON_COUNTER_7_ADDR A:0xfc383378
y.create.l HWIO_BIMC_PERFMON_COUNTER_8_ADDR A:0xfc383388
y.create.l HWIO_BIMC_PERFMON_COUNTER_9_ADDR A:0xfc383398
y.create.l HWIO_BIMC_PERFMON_COUNTER_0_OVERFLOW_ADDR A:0xfc38330c
y.create.l HWIO_BIMC_PERFMON_COUNTER_1_OVERFLOW_ADDR A:0xfc38331c
y.create.l HWIO_BIMC_PERFMON_COUNTER_2_OVERFLOW_ADDR A:0xfc38332c
y.create.l HWIO_BIMC_PERFMON_COUNTER_3_OVERFLOW_ADDR A:0xfc38333c
y.create.l HWIO_BIMC_PERFMON_COUNTER_4_OVERFLOW_ADDR A:0xfc38334c
y.create.l HWIO_BIMC_PERFMON_COUNTER_5_OVERFLOW_ADDR A:0xfc38335c
y.create.l HWIO_BIMC_PERFMON_COUNTER_6_OVERFLOW_ADDR A:0xfc38336c
y.create.l HWIO_BIMC_PERFMON_COUNTER_7_OVERFLOW_ADDR A:0xfc38337c
y.create.l HWIO_BIMC_PERFMON_COUNTER_8_OVERFLOW_ADDR A:0xfc38338c
y.create.l HWIO_BIMC_PERFMON_COUNTER_9_OVERFLOW_ADDR A:0xfc38339c
y.create.l HWIO_BIMC_DTE_HW_INFO_ADDR A:0xfc386000
y.create.l HWIO_BIMC_DTE_GLOBAL_CNTL_ADDR A:0xfc386004
y.create.l HWIO_BIMC_DTE_PROGRAM_CNTL_ADDR A:0xfc38600c
y.create.l HWIO_BIMC_DTE_REG_CNTL_ADDR A:0xfc386010
y.create.l HWIO_BIMC_DTE_REG_DATA_ADDR A:0xfc386014
y.create.l HWIO_BIMC_DTE_TEST_STATUS_DDR_ADDR A:0xfc386020
y.create.l HWIO_BIMC_DTE_TEST_STATUS_QSB_ADDR A:0xfc386024
y.create.l HWIO_BIMC_DTE_TEST_MEM_CNTL_ADDR A:0xfc386030
y.create.l HWIO_BIMC_DTE_TEST_MEM_DATA_0_ADDR A:0xfc386038
y.create.l HWIO_BIMC_DTE_TEST_MEM_DATA_1_ADDR A:0xfc38603c
y.create.l HWIO_BIMC_M_APP0_MPORT_COMPONENT_INFO_ADDR A:0xfc388000
y.create.l HWIO_BIMC_M_APP0_MPORT_CONFIGURATION_INFO_0_ADDR A:0xfc388020
y.create.l HWIO_BIMC_M_APP0_MPORT_CONFIGURATION_INFO_1_ADDR A:0xfc388030
y.create.l HWIO_BIMC_M_APP0_MPORT_CONFIGURATION_INFO_2_ADDR A:0xfc388040
y.create.l HWIO_BIMC_M_APP0_MPORT_CONFIGURATION_INFO_3_ADDR A:0xfc388050
y.create.l HWIO_BIMC_M_APP0_MPORT_CONFIGURATION_INFO_4_ADDR A:0xfc388060
y.create.l HWIO_BIMC_M_APP0_MPORT_CONFIGURATION_INFO_5_ADDR A:0xfc388070
y.create.l HWIO_BIMC_M_APP0_MPORT_INTERRUPT_STATUS_ADDR A:0xfc388100
y.create.l HWIO_BIMC_M_APP0_MPORT_INTERRUPT_CLEAR_ADDR A:0xfc388108
y.create.l HWIO_BIMC_M_APP0_MPORT_INTERRUPT_ENABLE_ADDR A:0xfc38810c
y.create.l HWIO_BIMC_M_APP0_MPORT_CLOCK_CTRL_ADDR A:0xfc388200
y.create.l HWIO_BIMC_M_APP0_MPORT_MODE_ADDR A:0xfc388210
y.create.l HWIO_BIMC_M_APP0_MPORT_WR_WAY_CROSSING_ADDR A:0xfc388220
y.create.l HWIO_BIMC_M_APP0_MPORT_PRIORITYLVL_OVERRIDE_ADDR A:0xfc388230
y.create.l HWIO_BIMC_M_APP0_MPORT_READ_COMMAND_OVERRIDE_ADDR A:0xfc388240
y.create.l HWIO_BIMC_M_APP0_MPORT_WRITE_COMMAND_OVERRIDE_ADDR A:0xfc388250
y.create.l HWIO_BIMC_M_APP0_MPORT_BKE_ENABLE_ADDR A:0xfc388300
y.create.l HWIO_BIMC_M_APP0_MPORT_BKE_GRANT_PERIOD_ADDR A:0xfc388304
y.create.l HWIO_BIMC_M_APP0_MPORT_BKE_GRANT_COUNT_ADDR A:0xfc388308
y.create.l HWIO_BIMC_M_APP0_MPORT_BKE_THRESHOLD_HIGH_ADDR A:0xfc388320
y.create.l HWIO_BIMC_M_APP0_MPORT_BKE_THRESHOLD_MEDIUM_ADDR A:0xfc388324
y.create.l HWIO_BIMC_M_APP0_MPORT_BKE_THRESHOLD_LOW_ADDR A:0xfc388328
y.create.l HWIO_BIMC_M_APP0_MPORT_BKE_HEALTH_0_ADDR A:0xfc388340
y.create.l HWIO_BIMC_M_APP0_MPORT_BKE_HEALTH_1_ADDR A:0xfc388344
y.create.l HWIO_BIMC_M_APP0_MPORT_BKE_HEALTH_2_ADDR A:0xfc388348
y.create.l HWIO_BIMC_M_APP0_MPORT_BKE_HEALTH_3_ADDR A:0xfc38834c
y.create.l HWIO_BIMC_M_APP0_MPORT_BUFFER_STATUS_0_ADDR A:0xfc388400
y.create.l HWIO_BIMC_M_APP0_MPORT_BUFFER_STATUS_1_ADDR A:0xfc388410
y.create.l HWIO_BIMC_M_DSP0_MPORT_COMPONENT_INFO_ADDR A:0xfc38c000
y.create.l HWIO_BIMC_M_DSP0_MPORT_CONFIGURATION_INFO_0_ADDR A:0xfc38c020
y.create.l HWIO_BIMC_M_DSP0_MPORT_CONFIGURATION_INFO_1_ADDR A:0xfc38c030
y.create.l HWIO_BIMC_M_DSP0_MPORT_CONFIGURATION_INFO_2_ADDR A:0xfc38c040
y.create.l HWIO_BIMC_M_DSP0_MPORT_CONFIGURATION_INFO_3_ADDR A:0xfc38c050
y.create.l HWIO_BIMC_M_DSP0_MPORT_CONFIGURATION_INFO_4_ADDR A:0xfc38c060
y.create.l HWIO_BIMC_M_DSP0_MPORT_CONFIGURATION_INFO_5_ADDR A:0xfc38c070
y.create.l HWIO_BIMC_M_DSP0_MPORT_INTERRUPT_STATUS_ADDR A:0xfc38c100
y.create.l HWIO_BIMC_M_DSP0_MPORT_INTERRUPT_CLEAR_ADDR A:0xfc38c108
y.create.l HWIO_BIMC_M_DSP0_MPORT_INTERRUPT_ENABLE_ADDR A:0xfc38c10c
y.create.l HWIO_BIMC_M_DSP0_MPORT_CLOCK_CTRL_ADDR A:0xfc38c200
y.create.l HWIO_BIMC_M_DSP0_MPORT_MODE_ADDR A:0xfc38c210
y.create.l HWIO_BIMC_M_DSP0_MPORT_WR_WAY_CROSSING_ADDR A:0xfc38c220
y.create.l HWIO_BIMC_M_DSP0_MPORT_PRIORITYLVL_OVERRIDE_ADDR A:0xfc38c230
y.create.l HWIO_BIMC_M_DSP0_MPORT_READ_COMMAND_OVERRIDE_ADDR A:0xfc38c240
y.create.l HWIO_BIMC_M_DSP0_MPORT_WRITE_COMMAND_OVERRIDE_ADDR A:0xfc38c250
y.create.l HWIO_BIMC_M_DSP0_MPORT_BKE_ENABLE_ADDR A:0xfc38c300
y.create.l HWIO_BIMC_M_DSP0_MPORT_BKE_GRANT_PERIOD_ADDR A:0xfc38c304
y.create.l HWIO_BIMC_M_DSP0_MPORT_BKE_GRANT_COUNT_ADDR A:0xfc38c308
y.create.l HWIO_BIMC_M_DSP0_MPORT_BKE_THRESHOLD_HIGH_ADDR A:0xfc38c320
y.create.l HWIO_BIMC_M_DSP0_MPORT_BKE_THRESHOLD_MEDIUM_ADDR A:0xfc38c324
y.create.l HWIO_BIMC_M_DSP0_MPORT_BKE_THRESHOLD_LOW_ADDR A:0xfc38c328
y.create.l HWIO_BIMC_M_DSP0_MPORT_BKE_HEALTH_0_ADDR A:0xfc38c340
y.create.l HWIO_BIMC_M_DSP0_MPORT_BKE_HEALTH_1_ADDR A:0xfc38c344
y.create.l HWIO_BIMC_M_DSP0_MPORT_BKE_HEALTH_2_ADDR A:0xfc38c348
y.create.l HWIO_BIMC_M_DSP0_MPORT_BKE_HEALTH_3_ADDR A:0xfc38c34c
y.create.l HWIO_BIMC_M_DSP0_MPORT_BUFFER_STATUS_0_ADDR A:0xfc38c400
y.create.l HWIO_BIMC_M_DSP0_MPORT_BUFFER_STATUS_1_ADDR A:0xfc38c410
y.create.l HWIO_BIMC_M_SYS0_MPORT_COMPONENT_INFO_ADDR A:0xfc390000
y.create.l HWIO_BIMC_M_SYS0_MPORT_CONFIGURATION_INFO_0_ADDR A:0xfc390020
y.create.l HWIO_BIMC_M_SYS0_MPORT_CONFIGURATION_INFO_1_ADDR A:0xfc390030
y.create.l HWIO_BIMC_M_SYS0_MPORT_CONFIGURATION_INFO_2_ADDR A:0xfc390040
y.create.l HWIO_BIMC_M_SYS0_MPORT_CONFIGURATION_INFO_3_ADDR A:0xfc390050
y.create.l HWIO_BIMC_M_SYS0_MPORT_CONFIGURATION_INFO_4_ADDR A:0xfc390060
y.create.l HWIO_BIMC_M_SYS0_MPORT_CONFIGURATION_INFO_5_ADDR A:0xfc390070
y.create.l HWIO_BIMC_M_SYS0_MPORT_INTERRUPT_STATUS_ADDR A:0xfc390100
y.create.l HWIO_BIMC_M_SYS0_MPORT_INTERRUPT_CLEAR_ADDR A:0xfc390108
y.create.l HWIO_BIMC_M_SYS0_MPORT_INTERRUPT_ENABLE_ADDR A:0xfc39010c
y.create.l HWIO_BIMC_M_SYS0_MPORT_CLOCK_CTRL_ADDR A:0xfc390200
y.create.l HWIO_BIMC_M_SYS0_MPORT_MODE_ADDR A:0xfc390210
y.create.l HWIO_BIMC_M_SYS0_MPORT_WR_WAY_CROSSING_ADDR A:0xfc390220
y.create.l HWIO_BIMC_M_SYS0_MPORT_PRIORITYLVL_OVERRIDE_ADDR A:0xfc390230
y.create.l HWIO_BIMC_M_SYS0_MPORT_READ_COMMAND_OVERRIDE_ADDR A:0xfc390240
y.create.l HWIO_BIMC_M_SYS0_MPORT_WRITE_COMMAND_OVERRIDE_ADDR A:0xfc390250
y.create.l HWIO_BIMC_M_SYS0_MPORT_BKE_ENABLE_ADDR A:0xfc390300
y.create.l HWIO_BIMC_M_SYS0_MPORT_BKE_GRANT_PERIOD_ADDR A:0xfc390304
y.create.l HWIO_BIMC_M_SYS0_MPORT_BKE_GRANT_COUNT_ADDR A:0xfc390308
y.create.l HWIO_BIMC_M_SYS0_MPORT_BKE_THRESHOLD_HIGH_ADDR A:0xfc390320
y.create.l HWIO_BIMC_M_SYS0_MPORT_BKE_THRESHOLD_MEDIUM_ADDR A:0xfc390324
y.create.l HWIO_BIMC_M_SYS0_MPORT_BKE_THRESHOLD_LOW_ADDR A:0xfc390328
y.create.l HWIO_BIMC_M_SYS0_MPORT_BKE_HEALTH_0_ADDR A:0xfc390340
y.create.l HWIO_BIMC_M_SYS0_MPORT_BKE_HEALTH_1_ADDR A:0xfc390344
y.create.l HWIO_BIMC_M_SYS0_MPORT_BKE_HEALTH_2_ADDR A:0xfc390348
y.create.l HWIO_BIMC_M_SYS0_MPORT_BKE_HEALTH_3_ADDR A:0xfc39034c
y.create.l HWIO_BIMC_M_SYS0_MPORT_BUFFER_STATUS_0_ADDR A:0xfc390400
y.create.l HWIO_BIMC_M_SYS0_MPORT_BUFFER_STATUS_1_ADDR A:0xfc390410
y.create.l HWIO_BIMC_M_APP0_PROF_COMPONENT_INFO_ADDR A:0xfc389000
y.create.l HWIO_BIMC_M_APP0_PROF_CONFIGURATION_INFO_0_ADDR A:0xfc389020
y.create.l HWIO_BIMC_M_APP0_PROF_CONFIGURATION_INFO_1_ADDR A:0xfc389030
y.create.l HWIO_BIMC_M_APP0_PROF_CLOCK_CTRL_ADDR A:0xfc389200
y.create.l HWIO_BIMC_M_APP0_PROF_MODE_ADDR A:0xfc389210
y.create.l HWIO_BIMC_M_APP0_PROF_RD_TENURE_THRESHOLD_ADDR A:0xfc389214
y.create.l HWIO_BIMC_M_APP0_PROF_WR_TENURE_THRESHOLD_ADDR A:0xfc389218
y.create.l HWIO_BIMC_M_APP0_PROF_SWAY_SELECT_ADDR A:0xfc389220
y.create.l HWIO_BIMC_M_APP0_PROF_MID_MASK_ADDR A:0xfc389230
y.create.l HWIO_BIMC_M_APP0_PROF_MID_MATCH_ADDR A:0xfc389234
y.create.l HWIO_BIMC_M_APP0_PROF_MID_INV_MATCH_ADDR A:0xfc389238
y.create.l HWIO_BIMC_M_APP0_PROF_ADDR_MASK_LOWER_ADDR A:0xfc389240
y.create.l HWIO_BIMC_M_APP0_PROF_ADDR_MASK_UPPER_ADDR A:0xfc389244
y.create.l HWIO_BIMC_M_APP0_PROF_ADDR_MATCH_LOWER_ADDR A:0xfc389248
y.create.l HWIO_BIMC_M_APP0_PROF_ADDR_MATCH_UPPER_ADDR A:0xfc38924c
y.create.l HWIO_BIMC_M_APP0_PROF_ADDR_INV_MATCH_ADDR A:0xfc389250
y.create.l HWIO_BIMC_M_APP0_PROF_ACH_MASK_0_ADDR A:0xfc389260
y.create.l HWIO_BIMC_M_APP0_PROF_ACH_MATCH_0_ADDR A:0xfc389264
y.create.l HWIO_BIMC_M_APP0_PROF_ACH_MASK_1_ADDR A:0xfc389270
y.create.l HWIO_BIMC_M_APP0_PROF_ACH_MATCH_1_ADDR A:0xfc389274
y.create.l HWIO_BIMC_M_APP0_PROF_ACH_INV_MATCH_1_ADDR A:0xfc389278
y.create.l HWIO_BIMC_M_APP0_PROF_ACH_MASK_2_ADDR A:0xfc389280
y.create.l HWIO_BIMC_M_APP0_PROF_ACH_MATCH_2_ADDR A:0xfc389284
y.create.l HWIO_BIMC_M_APP0_PROF_ACH_MASK_3_ADDR A:0xfc389290
y.create.l HWIO_BIMC_M_APP0_PROF_ACH_MATCH_3_ADDR A:0xfc389294
y.create.l HWIO_BIMC_M_APP0_PROF_ACH_INV_MATCH_3_ADDR A:0xfc389298
y.create.l HWIO_BIMC_M_APP0_PROF_ACH_MASK_4_ADDR A:0xfc3892a0
y.create.l HWIO_BIMC_M_APP0_PROF_ACH_MATCH_4_ADDR A:0xfc3892a4
y.create.l HWIO_BIMC_M_APP0_PROF_ACH_INV_MATCH_4_ADDR A:0xfc3892a8
y.create.l HWIO_BIMC_M_APP0_PROF_BCH_MASK_ADDR A:0xfc389300
y.create.l HWIO_BIMC_M_APP0_PROF_BCH_MATCH_ADDR A:0xfc389304
y.create.l HWIO_BIMC_M_APP0_PROF_BCH_INV_MATCH_ADDR A:0xfc389308
y.create.l HWIO_BIMC_M_APP0_PROF_RCH_MASK_ADDR A:0xfc389340
y.create.l HWIO_BIMC_M_APP0_PROF_RCH_MATCH_ADDR A:0xfc389344
y.create.l HWIO_BIMC_M_APP0_PROF_RCH_INV_MATCH_ADDR A:0xfc389348
y.create.l HWIO_BIMC_M_APP0_PROF_RD_STATUS_ADDR A:0xfc389400
y.create.l HWIO_BIMC_M_APP0_PROF_WR_STATUS_ADDR A:0xfc389410
y.create.l HWIO_BIMC_M_DSP0_PROF_COMPONENT_INFO_ADDR A:0xfc38d000
y.create.l HWIO_BIMC_M_DSP0_PROF_CONFIGURATION_INFO_0_ADDR A:0xfc38d020
y.create.l HWIO_BIMC_M_DSP0_PROF_CONFIGURATION_INFO_1_ADDR A:0xfc38d030
y.create.l HWIO_BIMC_M_DSP0_PROF_CLOCK_CTRL_ADDR A:0xfc38d200
y.create.l HWIO_BIMC_M_DSP0_PROF_MODE_ADDR A:0xfc38d210
y.create.l HWIO_BIMC_M_DSP0_PROF_RD_TENURE_THRESHOLD_ADDR A:0xfc38d214
y.create.l HWIO_BIMC_M_DSP0_PROF_WR_TENURE_THRESHOLD_ADDR A:0xfc38d218
y.create.l HWIO_BIMC_M_DSP0_PROF_SWAY_SELECT_ADDR A:0xfc38d220
y.create.l HWIO_BIMC_M_DSP0_PROF_MID_MASK_ADDR A:0xfc38d230
y.create.l HWIO_BIMC_M_DSP0_PROF_MID_MATCH_ADDR A:0xfc38d234
y.create.l HWIO_BIMC_M_DSP0_PROF_MID_INV_MATCH_ADDR A:0xfc38d238
y.create.l HWIO_BIMC_M_DSP0_PROF_ADDR_MASK_LOWER_ADDR A:0xfc38d240
y.create.l HWIO_BIMC_M_DSP0_PROF_ADDR_MASK_UPPER_ADDR A:0xfc38d244
y.create.l HWIO_BIMC_M_DSP0_PROF_ADDR_MATCH_LOWER_ADDR A:0xfc38d248
y.create.l HWIO_BIMC_M_DSP0_PROF_ADDR_MATCH_UPPER_ADDR A:0xfc38d24c
y.create.l HWIO_BIMC_M_DSP0_PROF_ADDR_INV_MATCH_ADDR A:0xfc38d250
y.create.l HWIO_BIMC_M_DSP0_PROF_ACH_MASK_0_ADDR A:0xfc38d260
y.create.l HWIO_BIMC_M_DSP0_PROF_ACH_MATCH_0_ADDR A:0xfc38d264
y.create.l HWIO_BIMC_M_DSP0_PROF_ACH_MASK_1_ADDR A:0xfc38d270
y.create.l HWIO_BIMC_M_DSP0_PROF_ACH_MATCH_1_ADDR A:0xfc38d274
y.create.l HWIO_BIMC_M_DSP0_PROF_ACH_INV_MATCH_1_ADDR A:0xfc38d278
y.create.l HWIO_BIMC_M_DSP0_PROF_ACH_MASK_2_ADDR A:0xfc38d280
y.create.l HWIO_BIMC_M_DSP0_PROF_ACH_MATCH_2_ADDR A:0xfc38d284
y.create.l HWIO_BIMC_M_DSP0_PROF_ACH_MASK_3_ADDR A:0xfc38d290
y.create.l HWIO_BIMC_M_DSP0_PROF_ACH_MATCH_3_ADDR A:0xfc38d294
y.create.l HWIO_BIMC_M_DSP0_PROF_ACH_INV_MATCH_3_ADDR A:0xfc38d298
y.create.l HWIO_BIMC_M_DSP0_PROF_ACH_MASK_4_ADDR A:0xfc38d2a0
y.create.l HWIO_BIMC_M_DSP0_PROF_ACH_MATCH_4_ADDR A:0xfc38d2a4
y.create.l HWIO_BIMC_M_DSP0_PROF_ACH_INV_MATCH_4_ADDR A:0xfc38d2a8
y.create.l HWIO_BIMC_M_DSP0_PROF_BCH_MASK_ADDR A:0xfc38d300
y.create.l HWIO_BIMC_M_DSP0_PROF_BCH_MATCH_ADDR A:0xfc38d304
y.create.l HWIO_BIMC_M_DSP0_PROF_BCH_INV_MATCH_ADDR A:0xfc38d308
y.create.l HWIO_BIMC_M_DSP0_PROF_RCH_MASK_ADDR A:0xfc38d340
y.create.l HWIO_BIMC_M_DSP0_PROF_RCH_MATCH_ADDR A:0xfc38d344
y.create.l HWIO_BIMC_M_DSP0_PROF_RCH_INV_MATCH_ADDR A:0xfc38d348
y.create.l HWIO_BIMC_M_DSP0_PROF_RD_STATUS_ADDR A:0xfc38d400
y.create.l HWIO_BIMC_M_DSP0_PROF_WR_STATUS_ADDR A:0xfc38d410
y.create.l HWIO_BIMC_M_SYS0_PROF_COMPONENT_INFO_ADDR A:0xfc391000
y.create.l HWIO_BIMC_M_SYS0_PROF_CONFIGURATION_INFO_0_ADDR A:0xfc391020
y.create.l HWIO_BIMC_M_SYS0_PROF_CONFIGURATION_INFO_1_ADDR A:0xfc391030
y.create.l HWIO_BIMC_M_SYS0_PROF_CLOCK_CTRL_ADDR A:0xfc391200
y.create.l HWIO_BIMC_M_SYS0_PROF_MODE_ADDR A:0xfc391210
y.create.l HWIO_BIMC_M_SYS0_PROF_RD_TENURE_THRESHOLD_ADDR A:0xfc391214
y.create.l HWIO_BIMC_M_SYS0_PROF_WR_TENURE_THRESHOLD_ADDR A:0xfc391218
y.create.l HWIO_BIMC_M_SYS0_PROF_SWAY_SELECT_ADDR A:0xfc391220
y.create.l HWIO_BIMC_M_SYS0_PROF_MID_MASK_ADDR A:0xfc391230
y.create.l HWIO_BIMC_M_SYS0_PROF_MID_MATCH_ADDR A:0xfc391234
y.create.l HWIO_BIMC_M_SYS0_PROF_MID_INV_MATCH_ADDR A:0xfc391238
y.create.l HWIO_BIMC_M_SYS0_PROF_ADDR_MASK_LOWER_ADDR A:0xfc391240
y.create.l HWIO_BIMC_M_SYS0_PROF_ADDR_MASK_UPPER_ADDR A:0xfc391244
y.create.l HWIO_BIMC_M_SYS0_PROF_ADDR_MATCH_LOWER_ADDR A:0xfc391248
y.create.l HWIO_BIMC_M_SYS0_PROF_ADDR_MATCH_UPPER_ADDR A:0xfc39124c
y.create.l HWIO_BIMC_M_SYS0_PROF_ADDR_INV_MATCH_ADDR A:0xfc391250
y.create.l HWIO_BIMC_M_SYS0_PROF_ACH_MASK_0_ADDR A:0xfc391260
y.create.l HWIO_BIMC_M_SYS0_PROF_ACH_MATCH_0_ADDR A:0xfc391264
y.create.l HWIO_BIMC_M_SYS0_PROF_ACH_MASK_1_ADDR A:0xfc391270
y.create.l HWIO_BIMC_M_SYS0_PROF_ACH_MATCH_1_ADDR A:0xfc391274
y.create.l HWIO_BIMC_M_SYS0_PROF_ACH_INV_MATCH_1_ADDR A:0xfc391278
y.create.l HWIO_BIMC_M_SYS0_PROF_ACH_MASK_2_ADDR A:0xfc391280
y.create.l HWIO_BIMC_M_SYS0_PROF_ACH_MATCH_2_ADDR A:0xfc391284
y.create.l HWIO_BIMC_M_SYS0_PROF_ACH_MASK_3_ADDR A:0xfc391290
y.create.l HWIO_BIMC_M_SYS0_PROF_ACH_MATCH_3_ADDR A:0xfc391294
y.create.l HWIO_BIMC_M_SYS0_PROF_ACH_INV_MATCH_3_ADDR A:0xfc391298
y.create.l HWIO_BIMC_M_SYS0_PROF_ACH_MASK_4_ADDR A:0xfc3912a0
y.create.l HWIO_BIMC_M_SYS0_PROF_ACH_MATCH_4_ADDR A:0xfc3912a4
y.create.l HWIO_BIMC_M_SYS0_PROF_ACH_INV_MATCH_4_ADDR A:0xfc3912a8
y.create.l HWIO_BIMC_M_SYS0_PROF_BCH_MASK_ADDR A:0xfc391300
y.create.l HWIO_BIMC_M_SYS0_PROF_BCH_MATCH_ADDR A:0xfc391304
y.create.l HWIO_BIMC_M_SYS0_PROF_BCH_INV_MATCH_ADDR A:0xfc391308
y.create.l HWIO_BIMC_M_SYS0_PROF_RCH_MASK_ADDR A:0xfc391340
y.create.l HWIO_BIMC_M_SYS0_PROF_RCH_MATCH_ADDR A:0xfc391344
y.create.l HWIO_BIMC_M_SYS0_PROF_RCH_INV_MATCH_ADDR A:0xfc391348
y.create.l HWIO_BIMC_M_SYS0_PROF_RD_STATUS_ADDR A:0xfc391400
y.create.l HWIO_BIMC_M_SYS0_PROF_WR_STATUS_ADDR A:0xfc391410
y.create.l HWIO_BIMC_S_SYS_SWAY_COMPONENT_INFO_ADDR A:0xfc3d0000
y.create.l HWIO_BIMC_S_SYS_SWAY_CONFIGURATION_INFO_0_ADDR A:0xfc3d0020
y.create.l HWIO_BIMC_S_SYS_SWAY_CONFIGURATION_INFO_1_ADDR A:0xfc3d0030
y.create.l HWIO_BIMC_S_SYS_SWAY_CONFIGURATION_INFO_2_ADDR A:0xfc3d0040
y.create.l HWIO_BIMC_S_SYS_SWAY_CONFIGURATION_INFO_3_ADDR A:0xfc3d0050
y.create.l HWIO_BIMC_S_SYS_SWAY_CONFIGURATION_INFO_4_ADDR A:0xfc3d0060
y.create.l HWIO_BIMC_S_SYS_SWAY_CONFIGURATION_INFO_5_ADDR A:0xfc3d0070
y.create.l HWIO_BIMC_S_SYS_SWAY_CONFIGURATION_INFO_6_ADDR A:0xfc3d0080
y.create.l HWIO_BIMC_S_SYS_SWAY_INTERRUPT_STATUS_ADDR A:0xfc3d0100
y.create.l HWIO_BIMC_S_SYS_SWAY_INTERRUPT_CLEAR_ADDR A:0xfc3d0108
y.create.l HWIO_BIMC_S_SYS_SWAY_INTERRUPT_ENABLE_ADDR A:0xfc3d010c
y.create.l HWIO_BIMC_S_SYS_SWAY_CLOCK_CTRL_ADDR A:0xfc3d0200
y.create.l HWIO_BIMC_S_SYS_SWAY_RCH_SELECT_ADDR A:0xfc3d0210
y.create.l HWIO_BIMC_S_SYS_SWAY_MAX_OUTSTANDING_REQUESTS_ADDR A:0xfc3d0220
y.create.l HWIO_BIMC_S_SYS_SWAY_BUFFER_STATUS_0_ADDR A:0xfc3d0400
y.create.l HWIO_BIMC_S_SYS_SWAY_BUFFER_STATUS_1_ADDR A:0xfc3d0410
y.create.l HWIO_BIMC_S_SYS_SWAY_BUFFER_STATUS_2_ADDR A:0xfc3d0420
y.create.l HWIO_BIMC_S_DEFAULT_SWAY_COMPONENT_INFO_ADDR A:0xfc3d8000
y.create.l HWIO_BIMC_S_DEFAULT_SWAY_CONFIGURATION_INFO_0_ADDR A:0xfc3d8020
y.create.l HWIO_BIMC_S_DEFAULT_SWAY_CONFIGURATION_INFO_1_ADDR A:0xfc3d8030
y.create.l HWIO_BIMC_S_DEFAULT_SWAY_INTERRUPT_STATUS_ADDR A:0xfc3d8100
y.create.l HWIO_BIMC_S_DEFAULT_SWAY_INTERRUPT_CLEAR_ADDR A:0xfc3d8108
y.create.l HWIO_BIMC_S_DEFAULT_SWAY_INTERRUPT_ENABLE_ADDR A:0xfc3d810c
y.create.l HWIO_BIMC_S_DEFAULT_SWAY_DEFAULT_SLAVE_STATUS_0_ADDR A:0xfc3d8400
y.create.l HWIO_BIMC_S_DEFAULT_SWAY_DEFAULT_SLAVE_STATUS_1_ADDR A:0xfc3d8410
y.create.l HWIO_BIMC_S_DEFAULT_SWAY_DEFAULT_SLAVE_STATUS_2_ADDR A:0xfc3d8420
y.create.l HWIO_BIMC_S_DDR0_ARB_COMPONENT_INFO_ADDR A:0xfc3c9000
y.create.l HWIO_BIMC_S_DDR0_ARB_CONFIGURATION_INFO_0_ADDR A:0xfc3c9020
y.create.l HWIO_BIMC_S_DDR0_ARB_CONFIGURATION_INFO_1_ADDR A:0xfc3c9030
y.create.l HWIO_BIMC_S_DDR0_ARB_CLOCK_CTRL_ADDR A:0xfc3c9200
y.create.l HWIO_BIMC_S_DDR0_ARB_MODE_ADDR A:0xfc3c9210
y.create.l HWIO_BIMC_S_SYS_ARB_COMPONENT_INFO_ADDR A:0xfc3d1000
y.create.l HWIO_BIMC_S_SYS_ARB_CONFIGURATION_INFO_0_ADDR A:0xfc3d1020
y.create.l HWIO_BIMC_S_SYS_ARB_CONFIGURATION_INFO_1_ADDR A:0xfc3d1030
y.create.l HWIO_BIMC_S_SYS_ARB_CLOCK_CTRL_ADDR A:0xfc3d1200
y.create.l HWIO_BIMC_S_SYS_ARB_MODE_ADDR A:0xfc3d1210
y.create.l HWIO_BIMC_S_DEFAULT_ARB_COMPONENT_INFO_ADDR A:0xfc3d9000
y.create.l HWIO_BIMC_S_DEFAULT_ARB_CONFIGURATION_INFO_0_ADDR A:0xfc3d9020
y.create.l HWIO_BIMC_S_DEFAULT_ARB_CONFIGURATION_INFO_1_ADDR A:0xfc3d9030
y.create.l HWIO_BIMC_S_DEFAULT_ARB_CLOCK_CTRL_ADDR A:0xfc3d9200
y.create.l HWIO_BIMC_S_DEFAULT_ARB_MODE_ADDR A:0xfc3d9210
y.create.l HWIO_BIMC_S_DDR0_SCMO_COMPONENT_INFO_ADDR A:0xfc3c8000
y.create.l HWIO_BIMC_S_DDR0_SCMO_HW_INFO_ADDR A:0xfc3c8010
y.create.l HWIO_BIMC_S_DDR0_SCMO_CONFIGURATION_INFO_0_ADDR A:0xfc3c8020
y.create.l HWIO_BIMC_S_DDR0_SCMO_CONFIGURATION_INFO_1_ADDR A:0xfc3c8030
y.create.l HWIO_BIMC_S_DDR0_SCMO_CONFIGURATION_INFO_2_ADDR A:0xfc3c8040
y.create.l HWIO_BIMC_S_DDR0_SCMO_CONFIGURATION_INFO_3_ADDR A:0xfc3c8050
y.create.l HWIO_BIMC_S_DDR0_SCMO_CONFIGURATION_INFO_4_ADDR A:0xfc3c8060
y.create.l HWIO_BIMC_S_DDR0_SCMO_CONFIGURATION_INFO_5_ADDR A:0xfc3c8070
y.create.l HWIO_BIMC_S_DDR0_SCMO_CONFIGURATION_INFO_6_ADDR A:0xfc3c8080
y.create.l HWIO_BIMC_S_DDR0_SCMO_INTERRUPT_STATUS_ADDR A:0xfc3c8100
y.create.l HWIO_BIMC_S_DDR0_SCMO_INTERRUPT_CLEAR_ADDR A:0xfc3c8108
y.create.l HWIO_BIMC_S_DDR0_SCMO_INTERRUPT_ENABLE_ADDR A:0xfc3c810c
y.create.l HWIO_BIMC_S_DDR0_SCMO_ESYN_ADDR_ADDR A:0xfc3c8120
y.create.l HWIO_BIMC_S_DDR0_SCMO_ESYN_APACKET_0_ADDR A:0xfc3c8128
y.create.l HWIO_BIMC_S_DDR0_SCMO_ESYN_APACKET_1_ADDR A:0xfc3c812c
y.create.l HWIO_BIMC_S_DDR0_SCMO_CLOCK_CTRL_ADDR A:0xfc3c8200
y.create.l HWIO_BIMC_S_DDR0_SCMO_SLV_INTERLEAVE_CFG_ADDR A:0xfc3c8400
y.create.l HWIO_BIMC_S_DDR0_SCMO_ADDR_BASE_CS0_ADDR A:0xfc3c8410
y.create.l HWIO_BIMC_S_DDR0_SCMO_ADDR_BASE_CS1_ADDR A:0xfc3c8414
y.create.l HWIO_BIMC_S_DDR0_SCMO_ADDR_MAP_CS0_ADDR A:0xfc3c8420
y.create.l HWIO_BIMC_S_DDR0_SCMO_ADDR_MAP_CS1_ADDR A:0xfc3c8424
y.create.l HWIO_BIMC_S_DDR0_SCMO_ADDR_MASK_CS0_ADDR A:0xfc3c8430
y.create.l HWIO_BIMC_S_DDR0_SCMO_ADDR_MASK_CS1_ADDR A:0xfc3c8434
y.create.l HWIO_BIMC_S_DDR0_SCMO_SLV_STATUS_ADDR A:0xfc3c8450
y.create.l HWIO_BIMC_S_DDR0_SCMO_CMD_BUF_CFG_ADDR A:0xfc3c8500
y.create.l HWIO_BIMC_S_DDR0_SCMO_CMD_BUF_STATUS_ADDR A:0xfc3c8520
y.create.l HWIO_BIMC_S_DDR0_SCMO_RCH_SELECT_ADDR A:0xfc3c8540
y.create.l HWIO_BIMC_S_DDR0_SCMO_RCH_BKPR_CFG_ADDR A:0xfc3c8544
y.create.l HWIO_BIMC_S_DDR0_SCMO_RCH_STATUS_ADDR A:0xfc3c8560
y.create.l HWIO_BIMC_S_DDR0_SCMO_WCH_BUF_CFG_ADDR A:0xfc3c8580
y.create.l HWIO_BIMC_S_DDR0_SCMO_WCH_STATUS_ADDR A:0xfc3c85a0
y.create.l HWIO_BIMC_S_DDR0_SCMO_FLUSH_CFG_ADDR A:0xfc3c85c0
y.create.l HWIO_BIMC_S_DDR0_SCMO_FLUSH_CMD_ADDR A:0xfc3c85c4
y.create.l HWIO_BIMC_S_DDR0_SCMO_CMD_OPT_CFG0_ADDR A:0xfc3c8700
y.create.l HWIO_BIMC_S_DDR0_SCMO_CMD_OPT_CFG1_ADDR A:0xfc3c8704
y.create.l HWIO_BIMC_S_DDR0_SCMO_CMD_OPT_CFG2_ADDR A:0xfc3c8708
y.create.l HWIO_BIMC_S_DDR0_SCMO_CMD_OPT_CFG3_ADDR A:0xfc3c870c
y.create.l HWIO_BIMC_S_DDR0_XPU_SCR_ADDR A:0xfc3ca000
y.create.l HWIO_BIMC_S_DDR0_XPU_SWDR_ADDR A:0xfc3ca004
y.create.l HWIO_BIMC_S_DDR0_XPU_PRTN_RACR_SSHADOW_ADDR A:0xfc3ca008
y.create.l HWIO_BIMC_S_DDR0_XPU_PRTN_WACR_SSHADOW_ADDR A:0xfc3ca00c
y.create.l HWIO_BIMC_S_DDR0_XPU_PRTN_START_SSHADOW0_ADDR A:0xfc3ca010
y.create.l HWIO_BIMC_S_DDR0_XPU_PRTN_END_SSHADOW0_ADDR A:0xfc3ca018
y.create.l HWIO_BIMC_S_DDR0_XPU_SEAR0_ADDR A:0xfc3ca040
y.create.l HWIO_BIMC_S_DDR0_XPU_SESR_ADDR A:0xfc3ca048
y.create.l HWIO_BIMC_S_DDR0_XPU_SESRRESTORE_ADDR A:0xfc3ca04c
y.create.l HWIO_BIMC_S_DDR0_XPU_SESYNR0_ADDR A:0xfc3ca050
y.create.l HWIO_BIMC_S_DDR0_XPU_SESYNR1_ADDR A:0xfc3ca054
y.create.l HWIO_BIMC_S_DDR0_XPU_SESYNR2_ADDR A:0xfc3ca058
y.create.l HWIO_BIMC_S_DDR0_XPU_MCR_ADDR A:0xfc3ca100
y.create.l HWIO_BIMC_S_DDR0_XPU_MEAR0_ADDR A:0xfc3ca140
y.create.l HWIO_BIMC_S_DDR0_XPU_MESR_ADDR A:0xfc3ca148
y.create.l HWIO_BIMC_S_DDR0_XPU_MESRRESTORE_ADDR A:0xfc3ca14c
y.create.l HWIO_BIMC_S_DDR0_XPU_MESYNR0_ADDR A:0xfc3ca150
y.create.l HWIO_BIMC_S_DDR0_XPU_MESYNR1_ADDR A:0xfc3ca154
y.create.l HWIO_BIMC_S_DDR0_XPU_MESYNR2_ADDR A:0xfc3ca158
y.create.l HWIO_BIMC_S_DDR0_XPU_CR_ADDR A:0xfc3ca080
y.create.l HWIO_BIMC_S_DDR0_XPU_PRTN_RACR_SHADOW_ADDR A:0xfc3ca088
y.create.l HWIO_BIMC_S_DDR0_XPU_PRTN_WACR_SHADOW_ADDR A:0xfc3ca08c
y.create.l HWIO_BIMC_S_DDR0_XPU_PRTN_START_SHADOW0_ADDR A:0xfc3ca090
y.create.l HWIO_BIMC_S_DDR0_XPU_PRTN_END_SHADOW0_ADDR A:0xfc3ca098
y.create.l HWIO_BIMC_S_DDR0_XPU_RPU_ACR0_ADDR A:0xfc3ca0a0
y.create.l HWIO_BIMC_S_DDR0_XPU_EAR0_ADDR A:0xfc3ca0c0
y.create.l HWIO_BIMC_S_DDR0_XPU_ESR_ADDR A:0xfc3ca0c8
y.create.l HWIO_BIMC_S_DDR0_XPU_ESRRESTORE_ADDR A:0xfc3ca0cc
y.create.l HWIO_BIMC_S_DDR0_XPU_ESYNR0_ADDR A:0xfc3ca0d0
y.create.l HWIO_BIMC_S_DDR0_XPU_ESYNR1_ADDR A:0xfc3ca0d4
y.create.l HWIO_BIMC_S_DDR0_XPU_ESYNR2_ADDR A:0xfc3ca0d8
y.create.l HWIO_BIMC_S_DDR0_XPU_UMR_RACR_ADDR A:0xfc3ca0e0
y.create.l HWIO_BIMC_S_DDR0_XPU_UMR_WACR_ADDR A:0xfc3ca0e4
y.create.l HWIO_BIMC_S_DDR0_XPU_IDR0_ADDR A:0xfc3ca074
y.create.l HWIO_BIMC_S_DDR0_XPU_IDR1_ADDR A:0xfc3ca078
y.create.l HWIO_BIMC_S_DDR0_XPU_REV_ADDR A:0xfc3ca07c
y.create.l HWIO_BIMC_S_DDR0_XPU_PRT0_RACR0_ADDR A:0xfc3ca200
y.create.l HWIO_BIMC_S_DDR0_XPU_PRT1_RACR0_ADDR A:0xfc3ca280
y.create.l HWIO_BIMC_S_DDR0_XPU_PRT2_RACR0_ADDR A:0xfc3ca300
y.create.l HWIO_BIMC_S_DDR0_XPU_PRT3_RACR0_ADDR A:0xfc3ca380
y.create.l HWIO_BIMC_S_DDR0_XPU_PRT4_RACR0_ADDR A:0xfc3ca400
y.create.l HWIO_BIMC_S_DDR0_XPU_PRT5_RACR0_ADDR A:0xfc3ca480
y.create.l HWIO_BIMC_S_DDR0_XPU_PRT6_RACR0_ADDR A:0xfc3ca500
y.create.l HWIO_BIMC_S_DDR0_XPU_PRT7_RACR0_ADDR A:0xfc3ca580
y.create.l HWIO_BIMC_S_DDR0_XPU_PRT8_RACR0_ADDR A:0xfc3ca600
y.create.l HWIO_BIMC_S_DDR0_XPU_PRT9_RACR0_ADDR A:0xfc3ca680
y.create.l HWIO_BIMC_S_DDR0_XPU_PRT0_WACR0_ADDR A:0xfc3ca220
y.create.l HWIO_BIMC_S_DDR0_XPU_PRT1_WACR0_ADDR A:0xfc3ca2a0
y.create.l HWIO_BIMC_S_DDR0_XPU_PRT2_WACR0_ADDR A:0xfc3ca320
y.create.l HWIO_BIMC_S_DDR0_XPU_PRT3_WACR0_ADDR A:0xfc3ca3a0
y.create.l HWIO_BIMC_S_DDR0_XPU_PRT4_WACR0_ADDR A:0xfc3ca420
y.create.l HWIO_BIMC_S_DDR0_XPU_PRT5_WACR0_ADDR A:0xfc3ca4a0
y.create.l HWIO_BIMC_S_DDR0_XPU_PRT6_WACR0_ADDR A:0xfc3ca520
y.create.l HWIO_BIMC_S_DDR0_XPU_PRT7_WACR0_ADDR A:0xfc3ca5a0
y.create.l HWIO_BIMC_S_DDR0_XPU_PRT8_WACR0_ADDR A:0xfc3ca620
y.create.l HWIO_BIMC_S_DDR0_XPU_PRT9_WACR0_ADDR A:0xfc3ca6a0
y.create.l HWIO_BIMC_S_DDR0_XPU_PRT0_START0_ADDR A:0xfc3ca240
y.create.l HWIO_BIMC_S_DDR0_XPU_PRT1_START0_ADDR A:0xfc3ca2c0
y.create.l HWIO_BIMC_S_DDR0_XPU_PRT2_START0_ADDR A:0xfc3ca340
y.create.l HWIO_BIMC_S_DDR0_XPU_PRT3_START0_ADDR A:0xfc3ca3c0
y.create.l HWIO_BIMC_S_DDR0_XPU_PRT4_START0_ADDR A:0xfc3ca440
y.create.l HWIO_BIMC_S_DDR0_XPU_PRT5_START0_ADDR A:0xfc3ca4c0
y.create.l HWIO_BIMC_S_DDR0_XPU_PRT6_START0_ADDR A:0xfc3ca540
y.create.l HWIO_BIMC_S_DDR0_XPU_PRT7_START0_ADDR A:0xfc3ca5c0
y.create.l HWIO_BIMC_S_DDR0_XPU_PRT8_START0_ADDR A:0xfc3ca640
y.create.l HWIO_BIMC_S_DDR0_XPU_PRT9_START0_ADDR A:0xfc3ca6c0
y.create.l HWIO_BIMC_S_DDR0_XPU_PRT0_END0_ADDR A:0xfc3ca248
y.create.l HWIO_BIMC_S_DDR0_XPU_PRT1_END0_ADDR A:0xfc3ca2c8
y.create.l HWIO_BIMC_S_DDR0_XPU_PRT2_END0_ADDR A:0xfc3ca348
y.create.l HWIO_BIMC_S_DDR0_XPU_PRT3_END0_ADDR A:0xfc3ca3c8
y.create.l HWIO_BIMC_S_DDR0_XPU_PRT4_END0_ADDR A:0xfc3ca448
y.create.l HWIO_BIMC_S_DDR0_XPU_PRT5_END0_ADDR A:0xfc3ca4c8
y.create.l HWIO_BIMC_S_DDR0_XPU_PRT6_END0_ADDR A:0xfc3ca548
y.create.l HWIO_BIMC_S_DDR0_XPU_PRT7_END0_ADDR A:0xfc3ca5c8
y.create.l HWIO_BIMC_S_DDR0_XPU_PRT8_END0_ADDR A:0xfc3ca648
y.create.l HWIO_BIMC_S_DDR0_XPU_PRT9_END0_ADDR A:0xfc3ca6c8
y.create.l HWIO_BIMC_S_DDR0_XPU_PRT0_SCR_ADDR A:0xfc3ca250
y.create.l HWIO_BIMC_S_DDR0_XPU_PRT1_SCR_ADDR A:0xfc3ca2d0
y.create.l HWIO_BIMC_S_DDR0_XPU_PRT2_SCR_ADDR A:0xfc3ca350
y.create.l HWIO_BIMC_S_DDR0_XPU_PRT3_SCR_ADDR A:0xfc3ca3d0
y.create.l HWIO_BIMC_S_DDR0_XPU_PRT4_SCR_ADDR A:0xfc3ca450
y.create.l HWIO_BIMC_S_DDR0_XPU_PRT5_SCR_ADDR A:0xfc3ca4d0
y.create.l HWIO_BIMC_S_DDR0_XPU_PRT6_SCR_ADDR A:0xfc3ca550
y.create.l HWIO_BIMC_S_DDR0_XPU_PRT7_SCR_ADDR A:0xfc3ca5d0
y.create.l HWIO_BIMC_S_DDR0_XPU_PRT8_SCR_ADDR A:0xfc3ca650
y.create.l HWIO_BIMC_S_DDR0_XPU_PRT9_SCR_ADDR A:0xfc3ca6d0
y.create.l HWIO_BIMC_S_DDR0_XPU_PRT0_MCR_ADDR A:0xfc3ca254
y.create.l HWIO_BIMC_S_DDR0_XPU_PRT1_MCR_ADDR A:0xfc3ca2d4
y.create.l HWIO_BIMC_S_DDR0_XPU_PRT2_MCR_ADDR A:0xfc3ca354
y.create.l HWIO_BIMC_S_DDR0_XPU_PRT3_MCR_ADDR A:0xfc3ca3d4
y.create.l HWIO_BIMC_S_DDR0_XPU_PRT4_MCR_ADDR A:0xfc3ca454
y.create.l HWIO_BIMC_S_DDR0_XPU_PRT5_MCR_ADDR A:0xfc3ca4d4
y.create.l HWIO_BIMC_S_DDR0_XPU_PRT6_MCR_ADDR A:0xfc3ca554
y.create.l HWIO_BIMC_S_DDR0_XPU_PRT7_MCR_ADDR A:0xfc3ca5d4
y.create.l HWIO_BIMC_S_DDR0_XPU_PRT8_MCR_ADDR A:0xfc3ca654
y.create.l HWIO_BIMC_S_DDR0_XPU_PRT9_MCR_ADDR A:0xfc3ca6d4
y.create.l HWIO_BIMC_S_DDR0_XPU_PRT0_CNTL0_ADDR A:0xfc3ca258
y.create.l HWIO_BIMC_S_DDR0_XPU_PRT1_CNTL0_ADDR A:0xfc3ca2d8
y.create.l HWIO_BIMC_S_DDR0_XPU_PRT2_CNTL0_ADDR A:0xfc3ca358
y.create.l HWIO_BIMC_S_DDR0_XPU_PRT3_CNTL0_ADDR A:0xfc3ca3d8
y.create.l HWIO_BIMC_S_DDR0_XPU_PRT4_CNTL0_ADDR A:0xfc3ca458
y.create.l HWIO_BIMC_S_DDR0_XPU_PRT5_CNTL0_ADDR A:0xfc3ca4d8
y.create.l HWIO_BIMC_S_DDR0_XPU_PRT6_CNTL0_ADDR A:0xfc3ca558
y.create.l HWIO_BIMC_S_DDR0_XPU_PRT7_CNTL0_ADDR A:0xfc3ca5d8
y.create.l HWIO_BIMC_S_DDR0_XPU_PRT8_CNTL0_ADDR A:0xfc3ca658
y.create.l HWIO_BIMC_S_DDR0_XPU_PRT9_CNTL0_ADDR A:0xfc3ca6d8
y.create.l HWIO_BIMC_S_DDR0_XPU_PRT0_CNTL1_ADDR A:0xfc3ca25c
y.create.l HWIO_BIMC_S_DDR0_XPU_PRT1_CNTL1_ADDR A:0xfc3ca2dc
y.create.l HWIO_BIMC_S_DDR0_XPU_PRT2_CNTL1_ADDR A:0xfc3ca35c
y.create.l HWIO_BIMC_S_DDR0_XPU_PRT3_CNTL1_ADDR A:0xfc3ca3dc
y.create.l HWIO_BIMC_S_DDR0_XPU_PRT4_CNTL1_ADDR A:0xfc3ca45c
y.create.l HWIO_BIMC_S_DDR0_XPU_PRT5_CNTL1_ADDR A:0xfc3ca4dc
y.create.l HWIO_BIMC_S_DDR0_XPU_PRT6_CNTL1_ADDR A:0xfc3ca55c
y.create.l HWIO_BIMC_S_DDR0_XPU_PRT7_CNTL1_ADDR A:0xfc3ca5dc
y.create.l HWIO_BIMC_S_DDR0_XPU_PRT8_CNTL1_ADDR A:0xfc3ca65c
y.create.l HWIO_BIMC_S_DDR0_XPU_PRT9_CNTL1_ADDR A:0xfc3ca6dc
y.create.l HWIO_BIMC_S_DDR0_XPU_AMT_RACR_ADDR A:0xfc3ca0e8
y.create.l HWIO_BIMC_S_DDR0_XPU_AMT_WACR_ADDR A:0xfc3ca0ec
y.create.l HWIO_BIMC_S_DDR0_XPU_AMTR0_ADDR A:0xfc3cae80
y.create.l HWIO_BIMC_S_DDR0_XPU_AMTR1_ADDR A:0xfc3cae84
y.create.l HWIO_BIMC_S_DDR0_XPU_AMTR2_ADDR A:0xfc3cae88
y.create.l HWIO_BIMC_S_DDR0_XPU_AMTR3_ADDR A:0xfc3cae8c
y.create.l HWIO_BIMC_S_DDR0_XPU_AMTR4_ADDR A:0xfc3cae90
y.create.l HWIO_BIMC_S_DDR0_XPU_AMTR5_ADDR A:0xfc3cae94
y.create.l HWIO_BIMC_S_DDR0_XPU_AMTR6_ADDR A:0xfc3cae98
y.create.l HWIO_BIMC_S_DDR0_XPU_AMTR7_ADDR A:0xfc3cae9c
y.create.l HWIO_BIMC_S_DDR0_XPU_AMTR8_ADDR A:0xfc3caea0
y.create.l HWIO_BIMC_S_DDR0_XPU_AMTR9_ADDR A:0xfc3caea4
y.create.l HWIO_BIMC_S_DDR0_DPE_HW_INFO_ADDR A:0xfc3cc000
y.create.l HWIO_BIMC_S_DDR0_DPE_CONFIG_0_ADDR A:0xfc3cc010
y.create.l HWIO_BIMC_S_DDR0_DPE_CONFIG_1_ADDR A:0xfc3cc014
y.create.l HWIO_BIMC_S_DDR0_DPE_CONFIG_2_ADDR A:0xfc3cc018
y.create.l HWIO_BIMC_S_DDR0_DPE_CONFIG_3_ADDR A:0xfc3cc01c
y.create.l HWIO_BIMC_S_DDR0_DPE_CONFIG_4_ADDR A:0xfc3cc020
y.create.l HWIO_BIMC_S_DDR0_DPE_CONFIG_5_ADDR A:0xfc3cc024
y.create.l HWIO_BIMC_S_DDR0_DPE_CONFIG_6_ADDR A:0xfc3cc028
y.create.l HWIO_BIMC_S_DDR0_DPE_CONFIG_7_ADDR A:0xfc3cc02c
y.create.l HWIO_BIMC_S_DDR0_DPE_CA_TRAIN_PRE_CS_ADDR A:0xfc3cc050
y.create.l HWIO_BIMC_S_DDR0_DPE_CA_TRAIN_CS_ADDR A:0xfc3cc054
y.create.l HWIO_BIMC_S_DDR0_DPE_CA_TRAIN_POST_CS_ADDR A:0xfc3cc058
y.create.l HWIO_BIMC_S_DDR0_DPE_PWR_CTRL_0_ADDR A:0xfc3cc068
y.create.l HWIO_BIMC_S_DDR0_DPE_OPT_CTRL_0_ADDR A:0xfc3cc078
y.create.l HWIO_BIMC_S_DDR0_DPE_OPT_CTRL_1_ADDR A:0xfc3cc07c
y.create.l HWIO_BIMC_S_DDR0_DPE_DRAM_STATUS_0_ADDR A:0xfc3cc08c
y.create.l HWIO_BIMC_S_DDR0_DPE_MEMC_STATUS_0_ADDR A:0xfc3cc09c
y.create.l HWIO_BIMC_S_DDR0_DPE_MEMC_STATUS_1_ADDR A:0xfc3cc0a0
y.create.l HWIO_BIMC_S_DDR0_DPE_MEMC_STATUS_2_ADDR A:0xfc3cc0a4
y.create.l HWIO_BIMC_S_DDR0_DPE_INTERRUPT_ENABLE_ADDR A:0xfc3cc0b4
y.create.l HWIO_BIMC_S_DDR0_DPE_INTERRUPT_STATUS_ADDR A:0xfc3cc0b8
y.create.l HWIO_BIMC_S_DDR0_DPE_INTERRUPT_CLR_ADDR A:0xfc3cc0bc
y.create.l HWIO_BIMC_S_DDR0_DPE_INTERRUPT_SET_ADDR A:0xfc3cc0c0
y.create.l HWIO_BIMC_S_DDR0_DPE_ELEVATE_PRI_RD_ADDR A:0xfc3cc0d0
y.create.l HWIO_BIMC_S_DDR0_DPE_ELEVATE_PRI_WR_ADDR A:0xfc3cc0d4
y.create.l HWIO_BIMC_S_DDR0_DPE_TIMER_0_ADDR A:0xfc3cc0e4
y.create.l HWIO_BIMC_S_DDR0_DPE_TIMER_1_ADDR A:0xfc3cc0e8
y.create.l HWIO_BIMC_S_DDR0_DPE_TIMER_2_ADDR A:0xfc3cc0ec
y.create.l HWIO_BIMC_S_DDR0_DPE_TIMER_3_ADDR A:0xfc3cc0f0
y.create.l HWIO_BIMC_S_DDR0_DPE_MRW_BEFORE_FREQ_SWITCH_0_ADDR A:0xfc3cc114
y.create.l HWIO_BIMC_S_DDR0_DPE_MRW_BEFORE_FREQ_SWITCH_1_ADDR A:0xfc3cc118
y.create.l HWIO_BIMC_S_DDR0_DPE_MRW_BEFORE_FREQ_SWITCH_2_ADDR A:0xfc3cc11c
y.create.l HWIO_BIMC_S_DDR0_DPE_MRW_BEFORE_FREQ_SWITCH_3_ADDR A:0xfc3cc120
y.create.l HWIO_BIMC_S_DDR0_DPE_MRW_AFTER_FREQ_SWITCH_0_ADDR A:0xfc3cc124
y.create.l HWIO_BIMC_S_DDR0_DPE_MRW_AFTER_FREQ_SWITCH_1_ADDR A:0xfc3cc128
y.create.l HWIO_BIMC_S_DDR0_DPE_MRW_AFTER_FREQ_SWITCH_2_ADDR A:0xfc3cc12c
y.create.l HWIO_BIMC_S_DDR0_DPE_MRW_AFTER_FREQ_SWITCH_3_ADDR A:0xfc3cc130
y.create.l HWIO_BIMC_S_DDR0_DPE_MRW_FREQ_SWITCH_ADDR A:0xfc3cc134
y.create.l HWIO_BIMC_S_DDR0_DPE_DRAM_TIMING_0_ADDR A:0xfc3cc144
y.create.l HWIO_BIMC_S_DDR0_DPE_DRAM_TIMING_1_ADDR A:0xfc3cc148
y.create.l HWIO_BIMC_S_DDR0_DPE_DRAM_TIMING_2_ADDR A:0xfc3cc14c
y.create.l HWIO_BIMC_S_DDR0_DPE_DRAM_TIMING_3_ADDR A:0xfc3cc150
y.create.l HWIO_BIMC_S_DDR0_DPE_DRAM_TIMING_4_ADDR A:0xfc3cc154
y.create.l HWIO_BIMC_S_DDR0_DPE_DRAM_TIMING_5_ADDR A:0xfc3cc158
y.create.l HWIO_BIMC_S_DDR0_DPE_DRAM_TIMING_6_ADDR A:0xfc3cc15c
y.create.l HWIO_BIMC_S_DDR0_DPE_DRAM_TIMING_7_ADDR A:0xfc3cc160
y.create.l HWIO_BIMC_S_DDR0_DPE_DRAM_TIMING_8_ADDR A:0xfc3cc164
y.create.l HWIO_BIMC_S_DDR0_DPE_DRAM_TIMING_9_ADDR A:0xfc3cc168
y.create.l HWIO_BIMC_S_DDR0_DPE_DRAM_TIMING_10_ADDR A:0xfc3cc16c
y.create.l HWIO_BIMC_S_DDR0_DPE_DRAM_TIMING_11_ADDR A:0xfc3cc170
y.create.l HWIO_BIMC_S_DDR0_DPE_DRAM_TIMING_12_ADDR A:0xfc3cc174
y.create.l HWIO_BIMC_S_DDR0_DPE_DRAM_TIMING_13_ADDR A:0xfc3cc178
y.create.l HWIO_BIMC_S_DDR0_DPE_DRAM_TIMING_14_ADDR A:0xfc3cc17c
y.create.l HWIO_BIMC_S_DDR0_DPE_DRAM_TIMING_15_ADDR A:0xfc3cc180
y.create.l HWIO_BIMC_S_DDR0_DPE_DRAM_TIMING_16_ADDR A:0xfc3cc184
y.create.l HWIO_BIMC_S_DDR0_DPE_DRAM_TIMING_17_ADDR A:0xfc3cc188
y.create.l HWIO_BIMC_S_DDR0_DPE_DRAM_TIMING_0_ACT_ADDR A:0xfc3cc1a4
y.create.l HWIO_BIMC_S_DDR0_DPE_DRAM_TIMING_1_ACT_ADDR A:0xfc3cc1a8
y.create.l HWIO_BIMC_S_DDR0_DPE_DRAM_TIMING_2_ACT_ADDR A:0xfc3cc1ac
y.create.l HWIO_BIMC_S_DDR0_DPE_DRAM_TIMING_3_ACT_ADDR A:0xfc3cc1b0
y.create.l HWIO_BIMC_S_DDR0_DPE_DRAM_TIMING_4_ACT_ADDR A:0xfc3cc1b4
y.create.l HWIO_BIMC_S_DDR0_DPE_DRAM_TIMING_5_ACT_ADDR A:0xfc3cc1b8
y.create.l HWIO_BIMC_S_DDR0_DPE_DRAM_TIMING_6_ACT_ADDR A:0xfc3cc1bc
y.create.l HWIO_BIMC_S_DDR0_DPE_DRAM_TIMING_7_ACT_ADDR A:0xfc3cc1c0
y.create.l HWIO_BIMC_S_DDR0_DPE_DRAM_TIMING_8_ACT_ADDR A:0xfc3cc1c4
y.create.l HWIO_BIMC_S_DDR0_DPE_DRAM_TIMING_9_ACT_ADDR A:0xfc3cc1c8
y.create.l HWIO_BIMC_S_DDR0_DPE_DRAM_TIMING_10_ACT_ADDR A:0xfc3cc1cc
y.create.l HWIO_BIMC_S_DDR0_DPE_DRAM_TIMING_11_ACT_ADDR A:0xfc3cc1d0
y.create.l HWIO_BIMC_S_DDR0_DPE_DRAM_TIMING_12_ACT_ADDR A:0xfc3cc1d4
y.create.l HWIO_BIMC_S_DDR0_DPE_DRAM_TIMING_13_ACT_ADDR A:0xfc3cc1d8
y.create.l HWIO_BIMC_S_DDR0_DPE_DRAM_TIMING_14_ACT_ADDR A:0xfc3cc1dc
y.create.l HWIO_BIMC_S_DDR0_DPE_DRAM_TIMING_15_ACT_ADDR A:0xfc3cc1e0
y.create.l HWIO_BIMC_S_DDR0_DPE_DRAM_TIMING_16_ACT_ADDR A:0xfc3cc1e4
y.create.l HWIO_BIMC_S_DDR0_DPE_DRAM_TIMING_17_ACT_ADDR A:0xfc3cc1e8
y.create.l HWIO_BIMC_S_DDR0_DPE_TESTBUS_CTRL_ADDR A:0xfc3cc204
y.create.l HWIO_BIMC_S_DDR0_DPE_SPARE_REG_ADDR A:0xfc3cc214
y.create.l HWIO_BIMC_S_DDR0_DPE_SPARE_REG_ACT_ADDR A:0xfc3cc224
y.create.l HWIO_BIMC_S_DDR0_DPE_CGC_CTRL_ADDR A:0xfc3cc2fc
y.create.l HWIO_BIMC_S_DDR0_DPE_PMON_EN_ADDR A:0xfc3cc300
y.create.l HWIO_BIMC_S_DDR0_DPE_PMON_CFG_ADDR A:0xfc3cc304
y.create.l HWIO_BIMC_S_DDR0_DPE_PMON_CMD_QUEUED_0_ADDR A:0xfc3cc310
y.create.l HWIO_BIMC_S_DDR0_DPE_PMON_CMD_QUEUED_1_ADDR A:0xfc3cc314
y.create.l HWIO_BIMC_S_DDR0_DPE_PMON_CMD_QUEUED_2_ADDR A:0xfc3cc318
y.create.l HWIO_BIMC_S_DDR0_DPE_PMON_CMD_QUEUED_3_ADDR A:0xfc3cc31c
y.create.l HWIO_BIMC_S_DDR0_DPE_PMON_CMD_EXEC_0_ADDR A:0xfc3cc320
y.create.l HWIO_BIMC_S_DDR0_DPE_PMON_CMD_EXEC_1_ADDR A:0xfc3cc324
y.create.l HWIO_BIMC_S_DDR0_DPE_PMON_CMD_EXEC_2_ADDR A:0xfc3cc328
y.create.l HWIO_BIMC_S_DDR0_DPE_PMON_CMD_EXEC_3_ADDR A:0xfc3cc32c
y.create.l HWIO_BIMC_S_DDR0_DPE_PMON_CMD_FLTR_0_ADDR A:0xfc3cc330
y.create.l HWIO_BIMC_S_DDR0_DPE_PMON_CMD_FLTR_1_ADDR A:0xfc3cc334
y.create.l HWIO_BIMC_S_DDR0_DPE_PMON_CMD_FLTR_2_ADDR A:0xfc3cc338
y.create.l HWIO_BIMC_S_DDR0_DPE_PMON_CMD_FLTR_3_ADDR A:0xfc3cc33c
y.create.l HWIO_BIMC_S_DDR0_DPE_PMON_ADDR_FLTR_0_ADDR A:0xfc3cc340
y.create.l HWIO_BIMC_S_DDR0_DPE_PMON_ADDR_FLTR_1_ADDR A:0xfc3cc344
y.create.l HWIO_BIMC_S_DDR0_DPE_PMON_ADDR_FLTR_2_ADDR A:0xfc3cc348
y.create.l HWIO_BIMC_S_DDR0_DPE_PMON_ADDR_FLTR_3_ADDR A:0xfc3cc34c
y.create.l HWIO_BIMC_S_DDR0_DPE_PMON_MID_FLTR_0_ADDR A:0xfc3cc350
y.create.l HWIO_BIMC_S_DDR0_DPE_PMON_MID_FLTR_1_ADDR A:0xfc3cc354
y.create.l HWIO_BIMC_S_DDR0_DPE_PMON_LAT_LIM_0_ADDR A:0xfc3cc360
y.create.l HWIO_BIMC_S_DDR0_DPE_PMON_LAT_LIM_1_ADDR A:0xfc3cc364
y.create.l HWIO_BIMC_S_DDR0_DPE_PMON_LAT_LIM_2_ADDR A:0xfc3cc368
y.create.l HWIO_BIMC_S_DDR0_DPE_PMON_LAT_LIM_3_ADDR A:0xfc3cc36c
y.create.l HWIO_BIMC_S_DDR0_DPE_PMON_PRI_FLTR_0_ADDR A:0xfc3cc370
y.create.l HWIO_BIMC_S_DDR0_DPE_PMON_PRI_FLTR_1_ADDR A:0xfc3cc374
y.create.l HWIO_BIMC_S_DDR0_DPE_PMON_PRI_FLTR_2_ADDR A:0xfc3cc378
y.create.l HWIO_BIMC_S_DDR0_DPE_PMON_PRI_FLTR_3_ADDR A:0xfc3cc37c
y.create.l HWIO_BIMC_S_DDR0_DPE_PMON_CMDQ_0_ADDR A:0xfc3cc380
y.create.l HWIO_BIMC_S_DDR0_DPE_PMON_CMDQ_1_ADDR A:0xfc3cc384
y.create.l HWIO_BIMC_S_DDR0_DPE_PMON_WRBUF_0_ADDR A:0xfc3cc388
y.create.l HWIO_BIMC_S_DDR0_DPE_PMON_WRBUF_1_ADDR A:0xfc3cc38c
y.create.l HWIO_BIMC_S_DDR0_DPE_PMON_DDR_CMD_0_ADDR A:0xfc3cc390
y.create.l HWIO_BIMC_S_DDR0_DPE_PMON_DDR_CMD_1_ADDR A:0xfc3cc394
y.create.l HWIO_BIMC_S_DDR0_DPE_PMON_DDR_CMD_2_ADDR A:0xfc3cc398
y.create.l HWIO_BIMC_S_DDR0_DPE_PMON_DDR_CMD_3_ADDR A:0xfc3cc39c
y.create.l HWIO_BIMC_S_DDR0_DPE_PMON_DDR_DATA_0_ADDR A:0xfc3cc3a0
y.create.l HWIO_BIMC_S_DDR0_DPE_PMON_DDR_DATA_1_ADDR A:0xfc3cc3a4
y.create.l HWIO_BIMC_S_DDR0_DPE_PMON_RANK_STATE_0_ADDR A:0xfc3cc3b0
y.create.l HWIO_BIMC_S_DDR0_DPE_PMON_RANK_STATE_1_ADDR A:0xfc3cc3b4
y.create.l HWIO_BIMC_S_DDR0_DPE_PMON_RANK_STATE_2_ADDR A:0xfc3cc3b8
y.create.l HWIO_BIMC_S_DDR0_DPE_PMON_RANK_STATE_3_ADDR A:0xfc3cc3bc
y.create.l HWIO_BIMC_S_DDR0_DPE_PMON_SHKE_0_ADDR A:0xfc3cc3c0
y.create.l HWIO_BIMC_S_DDR0_DPE_PMON_SHKE_1_ADDR A:0xfc3cc3c4
y.create.l HWIO_BIMC_S_DDR0_DPE_PMON_SHKE_2_ADDR A:0xfc3cc3c8
y.create.l HWIO_BIMC_S_DDR0_DPE_PMON_SHKE_3_ADDR A:0xfc3cc3cc
y.create.l HWIO_BIMC_S_DDR0_DPE_PMON_SHKE_4_ADDR A:0xfc3cc3d0
y.create.l HWIO_BIMC_S_DDR0_DPE_PMON_SHKE_5_ADDR A:0xfc3cc3d4
y.create.l HWIO_BIMC_S_DDR0_DPE_PMON_SHKE_6_ADDR A:0xfc3cc3d8
y.create.l HWIO_BIMC_S_DDR0_DPE_PMON_SHKE_7_ADDR A:0xfc3cc3dc
y.create.l HWIO_BIMC_S_DDR0_SHKE_HW_INFO_ADDR A:0xfc3cd000
y.create.l HWIO_BIMC_S_DDR0_SHKE_CONFIG_ADDR A:0xfc3cd004
y.create.l HWIO_BIMC_S_DDR0_SHKE_CGC_CNTL_ADDR A:0xfc3cd010
y.create.l HWIO_BIMC_S_DDR0_SHKE_DRAM_MANUAL_0_ADDR A:0xfc3cd020
y.create.l HWIO_BIMC_S_DDR0_SHKE_DRAM_MANUAL_1_ADDR A:0xfc3cd024
y.create.l HWIO_BIMC_S_DDR0_SHKE_MREG_ADDR_WDATA_CNTL_ADDR A:0xfc3cd030
y.create.l HWIO_BIMC_S_DDR0_SHKE_MREG_RDATA_RANK1_U_ADDR A:0xfc3cd050
y.create.l HWIO_BIMC_S_DDR0_SHKE_MREG_RDATA_RANK1_L_ADDR A:0xfc3cd054
y.create.l HWIO_BIMC_S_DDR0_SHKE_MREG_RDATA_RANK0_U_ADDR A:0xfc3cd060
y.create.l HWIO_BIMC_S_DDR0_SHKE_MREG_RDATA_RANK0_L_ADDR A:0xfc3cd064
y.create.l HWIO_BIMC_S_DDR0_SHKE_MREG_RDATA_STATUS_ADDR A:0xfc3cd070
y.create.l HWIO_BIMC_S_DDR0_SHKE_DRAM_STATUS_ADDR A:0xfc3cd074
y.create.l HWIO_BIMC_S_DDR0_SHKE_DRAM_DEBUG_CMD_0_ADDR A:0xfc3cd080
y.create.l HWIO_BIMC_S_DDR0_SHKE_DRAM_DEBUG_CMD_1_ADDR A:0xfc3cd084
y.create.l HWIO_BIMC_S_DDR0_SHKE_DRAM_DEBUG_CMD_2_ADDR A:0xfc3cd088
y.create.l HWIO_BIMC_S_DDR0_SHKE_PERIODIC_MRR_ADDR A:0xfc3cd0a0
y.create.l HWIO_BIMC_S_DDR0_SHKE_PERIODIC_MRR_RDATA_RANK1_U_ADDR A:0xfc3cd0b0
y.create.l HWIO_BIMC_S_DDR0_SHKE_PERIODIC_MRR_RDATA_RANK1_L_ADDR A:0xfc3cd0b4
y.create.l HWIO_BIMC_S_DDR0_SHKE_PERIODIC_MRR_RDATA_RANK0_U_ADDR A:0xfc3cd0b8
y.create.l HWIO_BIMC_S_DDR0_SHKE_PERIODIC_MRR_RDATA_RANK0_L_ADDR A:0xfc3cd0bc
y.create.l HWIO_BIMC_S_DDR0_SHKE_PERIODIC_ZQCAL_ADDR A:0xfc3cd0d0
y.create.l HWIO_BIMC_S_DDR0_SHKE_AUTO_REFRESH_CNTL_ADDR A:0xfc3cd0f0
y.create.l HWIO_BIMC_S_DDR0_SHKE_SELF_REFRESH_CNTL_ADDR A:0xfc3cd0f4
y.create.l HWIO_BIMC_S_DDR0_SHKE_AUTO_REFRESH_CNTL_1_ADDR A:0xfc3cd100
y.create.l HWIO_BIMC_S_DDR0_SHKE_AUTO_REFRESH_CNTL_2_ADDR A:0xfc3cd104
y.create.l HWIO_BIMC_S_DDR0_SHKE_TESTBUS_CNTL_ADDR A:0xfc3cd114
y.create.l HWIO_BIMC_S_DDR0_SHKE_SPARE_REG_ADDR A:0xfc3cd130
y.create.l HWIO_BOOT_ROM_XPU_SCR_ADDR A:0xfc0ff000
y.create.l HWIO_BOOT_ROM_XPU_SWDR_ADDR A:0xfc0ff004
y.create.l HWIO_BOOT_ROM_XPU_PRTN_RACR_SSHADOW_ADDR A:0xfc0ff008
y.create.l HWIO_BOOT_ROM_XPU_PRTN_START_SSHADOW0_ADDR A:0xfc0ff010
y.create.l HWIO_BOOT_ROM_XPU_PRTN_END_SSHADOW0_ADDR A:0xfc0ff018
y.create.l HWIO_BOOT_ROM_XPU_SEAR0_ADDR A:0xfc0ff040
y.create.l HWIO_BOOT_ROM_XPU_SESR_ADDR A:0xfc0ff048
y.create.l HWIO_BOOT_ROM_XPU_SESRRESTORE_ADDR A:0xfc0ff04c
y.create.l HWIO_BOOT_ROM_XPU_SESYNR0_ADDR A:0xfc0ff050
y.create.l HWIO_BOOT_ROM_XPU_SESYNR1_ADDR A:0xfc0ff054
y.create.l HWIO_BOOT_ROM_XPU_SESYNR2_ADDR A:0xfc0ff058
y.create.l HWIO_BOOT_ROM_XPU_MCR_ADDR A:0xfc0ff100
y.create.l HWIO_BOOT_ROM_XPU_MEAR0_ADDR A:0xfc0ff140
y.create.l HWIO_BOOT_ROM_XPU_MESR_ADDR A:0xfc0ff148
y.create.l HWIO_BOOT_ROM_XPU_MESRRESTORE_ADDR A:0xfc0ff14c
y.create.l HWIO_BOOT_ROM_XPU_MESYNR0_ADDR A:0xfc0ff150
y.create.l HWIO_BOOT_ROM_XPU_MESYNR1_ADDR A:0xfc0ff154
y.create.l HWIO_BOOT_ROM_XPU_MESYNR2_ADDR A:0xfc0ff158
y.create.l HWIO_BOOT_ROM_XPU_CR_ADDR A:0xfc0ff080
y.create.l HWIO_BOOT_ROM_XPU_PRTN_RACR_SHADOW_ADDR A:0xfc0ff088
y.create.l HWIO_BOOT_ROM_XPU_PRTN_START_SHADOW0_ADDR A:0xfc0ff090
y.create.l HWIO_BOOT_ROM_XPU_PRTN_END_SHADOW0_ADDR A:0xfc0ff098
y.create.l HWIO_BOOT_ROM_XPU_RPU_ACR0_ADDR A:0xfc0ff0a0
y.create.l HWIO_BOOT_ROM_XPU_EAR0_ADDR A:0xfc0ff0c0
y.create.l HWIO_BOOT_ROM_XPU_ESR_ADDR A:0xfc0ff0c8
y.create.l HWIO_BOOT_ROM_XPU_ESRRESTORE_ADDR A:0xfc0ff0cc
y.create.l HWIO_BOOT_ROM_XPU_ESYNR0_ADDR A:0xfc0ff0d0
y.create.l HWIO_BOOT_ROM_XPU_ESYNR1_ADDR A:0xfc0ff0d4
y.create.l HWIO_BOOT_ROM_XPU_ESYNR2_ADDR A:0xfc0ff0d8
y.create.l HWIO_BOOT_ROM_XPU_UMR_RACR_ADDR A:0xfc0ff0e0
y.create.l HWIO_BOOT_ROM_XPU_UMR_WACR_ADDR A:0xfc0ff0e4
y.create.l HWIO_BOOT_ROM_XPU_IDR0_ADDR A:0xfc0ff074
y.create.l HWIO_BOOT_ROM_XPU_IDR1_ADDR A:0xfc0ff078
y.create.l HWIO_BOOT_ROM_XPU_REV_ADDR A:0xfc0ff07c
y.create.l HWIO_BOOT_ROM_XPU_PRT0_RACR0_ADDR A:0xfc0ff200
y.create.l HWIO_BOOT_ROM_XPU_PRT1_RACR0_ADDR A:0xfc0ff280
y.create.l HWIO_BOOT_ROM_XPU_PRT2_RACR0_ADDR A:0xfc0ff300
y.create.l HWIO_BOOT_ROM_XPU_PRT3_RACR0_ADDR A:0xfc0ff380
y.create.l HWIO_BOOT_ROM_XPU_PRT0_START0_ADDR A:0xfc0ff240
y.create.l HWIO_BOOT_ROM_XPU_PRT1_START0_ADDR A:0xfc0ff2c0
y.create.l HWIO_BOOT_ROM_XPU_PRT2_START0_ADDR A:0xfc0ff340
y.create.l HWIO_BOOT_ROM_XPU_PRT3_START0_ADDR A:0xfc0ff3c0
y.create.l HWIO_BOOT_ROM_XPU_PRT0_END0_ADDR A:0xfc0ff248
y.create.l HWIO_BOOT_ROM_XPU_PRT1_END0_ADDR A:0xfc0ff2c8
y.create.l HWIO_BOOT_ROM_XPU_PRT2_END0_ADDR A:0xfc0ff348
y.create.l HWIO_BOOT_ROM_XPU_PRT3_END0_ADDR A:0xfc0ff3c8
y.create.l HWIO_BOOT_ROM_XPU_PRT0_SCR_ADDR A:0xfc0ff250
y.create.l HWIO_BOOT_ROM_XPU_PRT1_SCR_ADDR A:0xfc0ff2d0
y.create.l HWIO_BOOT_ROM_XPU_PRT2_SCR_ADDR A:0xfc0ff350
y.create.l HWIO_BOOT_ROM_XPU_PRT3_SCR_ADDR A:0xfc0ff3d0
y.create.l HWIO_BOOT_ROM_XPU_PRT0_MCR_ADDR A:0xfc0ff254
y.create.l HWIO_BOOT_ROM_XPU_PRT1_MCR_ADDR A:0xfc0ff2d4
y.create.l HWIO_BOOT_ROM_XPU_PRT2_MCR_ADDR A:0xfc0ff354
y.create.l HWIO_BOOT_ROM_XPU_PRT3_MCR_ADDR A:0xfc0ff3d4
y.create.l HWIO_BOOT_ROM_XPU_PRT0_CNTL0_ADDR A:0xfc0ff258
y.create.l HWIO_BOOT_ROM_XPU_PRT1_CNTL0_ADDR A:0xfc0ff2d8
y.create.l HWIO_BOOT_ROM_XPU_PRT2_CNTL0_ADDR A:0xfc0ff358
y.create.l HWIO_BOOT_ROM_XPU_PRT3_CNTL0_ADDR A:0xfc0ff3d8
y.create.l HWIO_BOOT_ROM_XPU_PRT0_CNTL1_ADDR A:0xfc0ff25c
y.create.l HWIO_BOOT_ROM_XPU_PRT1_CNTL1_ADDR A:0xfc0ff2dc
y.create.l HWIO_BOOT_ROM_XPU_PRT2_CNTL1_ADDR A:0xfc0ff35c
y.create.l HWIO_BOOT_ROM_XPU_PRT3_CNTL1_ADDR A:0xfc0ff3dc
y.create.l HWIO_GCC_GPLL0_MODE_ADDR A:0xfc400000
y.create.l HWIO_GCC_GPLL0_L_VAL_ADDR A:0xfc400004
y.create.l HWIO_GCC_GPLL0_ALPHA_VAL_ADDR A:0xfc400008
y.create.l HWIO_GCC_GPLL0_ALPHA_VAL_U_ADDR A:0xfc40000c
y.create.l HWIO_GCC_GPLL0_USER_CTL_ADDR A:0xfc400010
y.create.l HWIO_GCC_GPLL0_USER_CTL_U_ADDR A:0xfc400014
y.create.l HWIO_GCC_GPLL0_CONFIG_CTL_ADDR A:0xfc400018
y.create.l HWIO_GCC_GPLL0_TEST_CTL_ADDR A:0xfc40001c
y.create.l HWIO_GCC_GPLL0_TEST_CTL_U_ADDR A:0xfc400020
y.create.l HWIO_GCC_GPLL0_FREQ_CTL_ADDR A:0xfc400028
y.create.l HWIO_GCC_GPLL0_STATUS_ADDR A:0xfc400024
y.create.l HWIO_GCC_GPLL1_MODE_ADDR A:0xfc400040
y.create.l HWIO_GCC_GPLL1_L_VAL_ADDR A:0xfc400044
y.create.l HWIO_GCC_GPLL1_ALPHA_VAL_ADDR A:0xfc400048
y.create.l HWIO_GCC_GPLL1_ALPHA_VAL_U_ADDR A:0xfc40004c
y.create.l HWIO_GCC_GPLL1_USER_CTL_ADDR A:0xfc400050
y.create.l HWIO_GCC_GPLL1_USER_CTL_U_ADDR A:0xfc400054
y.create.l HWIO_GCC_GPLL1_CONFIG_CTL_ADDR A:0xfc400058
y.create.l HWIO_GCC_GPLL1_TEST_CTL_ADDR A:0xfc40005c
y.create.l HWIO_GCC_GPLL1_TEST_CTL_U_ADDR A:0xfc400060
y.create.l HWIO_GCC_GPLL1_FREQ_CTL_ADDR A:0xfc400068
y.create.l HWIO_GCC_GPLL1_STATUS_ADDR A:0xfc400064
y.create.l HWIO_GCC_GPLL2_MODE_ADDR A:0xfc400080
y.create.l HWIO_GCC_GPLL2_L_VAL_ADDR A:0xfc400084
y.create.l HWIO_GCC_GPLL2_ALPHA_VAL_ADDR A:0xfc400088
y.create.l HWIO_GCC_GPLL2_ALPHA_VAL_U_ADDR A:0xfc40008c
y.create.l HWIO_GCC_GPLL2_USER_CTL_ADDR A:0xfc400090
y.create.l HWIO_GCC_GPLL2_USER_CTL_U_ADDR A:0xfc400094
y.create.l HWIO_GCC_GPLL2_CONFIG_CTL_ADDR A:0xfc400098
y.create.l HWIO_GCC_GPLL2_TEST_CTL_ADDR A:0xfc40009c
y.create.l HWIO_GCC_GPLL2_TEST_CTL_U_ADDR A:0xfc4000a0
y.create.l HWIO_GCC_GPLL2_FREQ_CTL_ADDR A:0xfc4000a8
y.create.l HWIO_GCC_GPLL2_STATUS_ADDR A:0xfc4000a4
y.create.l HWIO_GCC_GPLL3_MODE_ADDR A:0xfc4000c0
y.create.l HWIO_GCC_GPLL3_L_VAL_ADDR A:0xfc4000c4
y.create.l HWIO_GCC_GPLL3_ALPHA_VAL_ADDR A:0xfc4000c8
y.create.l HWIO_GCC_GPLL3_ALPHA_VAL_U_ADDR A:0xfc4000cc
y.create.l HWIO_GCC_GPLL3_USER_CTL_ADDR A:0xfc4000d0
y.create.l HWIO_GCC_GPLL3_USER_CTL_U_ADDR A:0xfc4000d4
y.create.l HWIO_GCC_GPLL3_CONFIG_CTL_ADDR A:0xfc4000d8
y.create.l HWIO_GCC_GPLL3_TEST_CTL_ADDR A:0xfc4000dc
y.create.l HWIO_GCC_GPLL3_TEST_CTL_U_ADDR A:0xfc4000e0
y.create.l HWIO_GCC_GPLL3_FREQ_CTL_ADDR A:0xfc4000e8
y.create.l HWIO_GCC_GPLL3_STATUS_ADDR A:0xfc4000e4
y.create.l HWIO_GCC_SYSTEM_NOC_BCR_ADDR A:0xfc400100
y.create.l HWIO_GCC_SYSTEM_NOC_CMD_RCGR_ADDR A:0xfc400120
y.create.l HWIO_GCC_SYSTEM_NOC_CFG_RCGR_ADDR A:0xfc400124
y.create.l HWIO_GCC_SNOC_QOSGEN_EXTREF_CTL_ADDR A:0xfc400134
y.create.l HWIO_GCC_CONFIG_NOC_CMD_RCGR_ADDR A:0xfc400150
y.create.l HWIO_GCC_CONFIG_NOC_CFG_RCGR_ADDR A:0xfc400154
y.create.l HWIO_GCC_PERIPH_NOC_CMD_RCGR_ADDR A:0xfc400190
y.create.l HWIO_GCC_PERIPH_NOC_CFG_RCGR_ADDR A:0xfc400194
y.create.l HWIO_GCC_SYS_NOC_AXI_CBCR_ADDR A:0xfc400104
y.create.l HWIO_GCC_SYS_NOC_USB3_AXI_CBCR_ADDR A:0xfc400108
y.create.l HWIO_GCC_SYS_NOC_QDSS_STM_AXI_CBCR_ADDR A:0xfc40010c
y.create.l HWIO_GCC_SYS_NOC_KPSS_AHB_CBCR_ADDR A:0xfc400110
y.create.l HWIO_GCC_SNOC_CNOC_AHB_CBCR_ADDR A:0xfc400114
y.create.l HWIO_GCC_SNOC_PNOC_AHB_CBCR_ADDR A:0xfc400118
y.create.l HWIO_GCC_SYS_NOC_AT_CBCR_ADDR A:0xfc40011c
y.create.l HWIO_GCC_SYS_NOC_IPA_AXI_CBCR_ADDR A:0xfc400128
y.create.l HWIO_GCC_CONFIG_NOC_BCR_ADDR A:0xfc400140
y.create.l HWIO_GCC_CFG_NOC_AHB_CBCR_ADDR A:0xfc400144
y.create.l HWIO_GCC_CFG_NOC_DDR_CFG_CBCR_ADDR A:0xfc400148
y.create.l HWIO_GCC_CFG_NOC_RPM_AHB_CBCR_ADDR A:0xfc40014c
y.create.l HWIO_GCC_PERIPH_NOC_BCR_ADDR A:0xfc400180
y.create.l HWIO_GCC_PERIPH_NOC_AHB_CBCR_ADDR A:0xfc400184
y.create.l HWIO_GCC_PERIPH_NOC_CFG_AHB_CBCR_ADDR A:0xfc400188
y.create.l HWIO_GCC_PERIPH_NOC_AT_CBCR_ADDR A:0xfc40018c
y.create.l HWIO_GCC_NOC_CONF_XPU_AHB_CBCR_ADDR A:0xfc4001c0
y.create.l HWIO_GCC_IMEM_BCR_ADDR A:0xfc400200
y.create.l HWIO_GCC_IMEM_AXI_CBCR_ADDR A:0xfc400204
y.create.l HWIO_GCC_IMEM_CFG_AHB_CBCR_ADDR A:0xfc400208
y.create.l HWIO_GCC_MSS_CFG_AHB_CBCR_ADDR A:0xfc400280
y.create.l HWIO_GCC_MSS_Q6_BIMC_AXI_CBCR_ADDR A:0xfc400284
y.create.l HWIO_GCC_QDSS_RBCPR_XPU_AHB_CBCR_ADDR A:0xfc4002c0
y.create.l HWIO_GCC_QDSS_BCR_ADDR A:0xfc400300
y.create.l HWIO_GCC_QDSS_DAP_AHB_CBCR_ADDR A:0xfc400304
y.create.l HWIO_GCC_QDSS_CFG_AHB_CBCR_ADDR A:0xfc400308
y.create.l HWIO_GCC_QDSS_AT_CMD_RCGR_ADDR A:0xfc400340
y.create.l HWIO_GCC_QDSS_AT_CFG_RCGR_ADDR A:0xfc400344
y.create.l HWIO_GCC_QDSS_AT_CBCR_ADDR A:0xfc40030c
y.create.l HWIO_GCC_QDSS_ETR_USB_CBCR_ADDR A:0xfc400310
y.create.l HWIO_GCC_QDSS_STM_CMD_RCGR_ADDR A:0xfc400358
y.create.l HWIO_GCC_QDSS_STM_CFG_RCGR_ADDR A:0xfc40035c
y.create.l HWIO_GCC_QDSS_STM_CBCR_ADDR A:0xfc400314
y.create.l HWIO_GCC_QDSS_TRACECLKIN_CMD_RCGR_ADDR A:0xfc400380
y.create.l HWIO_GCC_QDSS_TRACECLKIN_CFG_RCGR_ADDR A:0xfc400384
y.create.l HWIO_GCC_QDSS_TRACECLKIN_CBCR_ADDR A:0xfc400318
y.create.l HWIO_GCC_QDSS_TSCTR_CMD_RCGR_ADDR A:0xfc400398
y.create.l HWIO_GCC_QDSS_TSCTR_CFG_RCGR_ADDR A:0xfc40039c
y.create.l HWIO_GCC_QDSS_TSCTR_DIV2_CBCR_ADDR A:0xfc40031c
y.create.l HWIO_GCC_QDSS_TSCTR_DIV3_CBCR_ADDR A:0xfc400320
y.create.l HWIO_GCC_QDSS_DAP_CBCR_ADDR A:0xfc400324
y.create.l HWIO_GCC_QDSS_TSCTR_DIV4_CBCR_ADDR A:0xfc400328
y.create.l HWIO_GCC_QDSS_TSCTR_DIV8_CBCR_ADDR A:0xfc40032c
y.create.l HWIO_GCC_USB_30_BCR_ADDR A:0xfc4003c0
y.create.l HWIO_GCC_USB_30_MISC_ADDR A:0xfc4003c4
y.create.l HWIO_GCC_USB30_MASTER_CBCR_ADDR A:0xfc4003c8
y.create.l HWIO_GCC_USB30_SLEEP_CBCR_ADDR A:0xfc4003cc
y.create.l HWIO_GCC_USB30_MOCK_UTMI_CBCR_ADDR A:0xfc4003d0
y.create.l HWIO_GCC_USB30_MASTER_CMD_RCGR_ADDR A:0xfc4003d4
y.create.l HWIO_GCC_USB30_MASTER_CFG_RCGR_ADDR A:0xfc4003d8
y.create.l HWIO_GCC_USB30_MASTER_M_ADDR A:0xfc4003dc
y.create.l HWIO_GCC_USB30_MASTER_N_ADDR A:0xfc4003e0
y.create.l HWIO_GCC_USB30_MASTER_D_ADDR A:0xfc4003e4
y.create.l HWIO_GCC_USB30_MOCK_UTMI_CMD_RCGR_ADDR A:0xfc4003e8
y.create.l HWIO_GCC_USB30_MOCK_UTMI_CFG_RCGR_ADDR A:0xfc4003ec
y.create.l HWIO_GCC_USB3_PHY_BCR_ADDR A:0xfc4003fc
y.create.l HWIO_GCC_USB3_PHY_COM_BCR_ADDR A:0xfc401b88
y.create.l HWIO_GCC_USB3PHY_PHY_BCR_ADDR A:0xfc401b8c
y.create.l HWIO_GCC_USB3_PIPE_CBCR_ADDR A:0xfc401b90
y.create.l HWIO_GCC_USB3_AUX_CBCR_ADDR A:0xfc401b94
y.create.l HWIO_GCC_USB3_PIPE_CMD_RCGR_ADDR A:0xfc401b98
y.create.l HWIO_GCC_USB3_PIPE_CFG_RCGR_ADDR A:0xfc401b9c
y.create.l HWIO_GCC_USB3_AUX_CMD_RCGR_ADDR A:0xfc401bc0
y.create.l HWIO_GCC_USB3_AUX_CFG_RCGR_ADDR A:0xfc401bc4
y.create.l HWIO_GCC_USB3_AUX_M_ADDR A:0xfc401bc8
y.create.l HWIO_GCC_USB3_AUX_N_ADDR A:0xfc401bcc
y.create.l HWIO_GCC_USB3_AUX_D_ADDR A:0xfc401bd0
y.create.l HWIO_GCC_QDSS_TSCTR_DIV16_CBCR_ADDR A:0xfc400330
y.create.l HWIO_GCC_GCC_SLEEP_CMD_RCGR_ADDR A:0xfc4010d0
y.create.l HWIO_GCC_USB_HS_HSIC_BCR_ADDR A:0xfc400400
y.create.l HWIO_GCC_USB_HS_HSIC_GDSCR_ADDR A:0xfc400404
y.create.l HWIO_GCC_USB_HSIC_AHB_CBCR_ADDR A:0xfc400408
y.create.l HWIO_GCC_USB_HSIC_SYSTEM_CMD_RCGR_ADDR A:0xfc40041c
y.create.l HWIO_GCC_USB_HSIC_SYSTEM_CFG_RCGR_ADDR A:0xfc400420
y.create.l HWIO_GCC_USB_HSIC_SYSTEM_CBCR_ADDR A:0xfc40040c
y.create.l HWIO_GCC_USB_HSIC_CMD_RCGR_ADDR A:0xfc400440
y.create.l HWIO_GCC_USB_HSIC_CFG_RCGR_ADDR A:0xfc400444
y.create.l HWIO_GCC_USB_HSIC_CBCR_ADDR A:0xfc400410
y.create.l HWIO_GCC_USB_HSIC_IO_CAL_CMD_RCGR_ADDR A:0xfc400458
y.create.l HWIO_GCC_USB_HSIC_IO_CAL_CFG_RCGR_ADDR A:0xfc40045c
y.create.l HWIO_GCC_USB_HSIC_IO_CAL_CBCR_ADDR A:0xfc400414
y.create.l HWIO_GCC_USB_HSIC_IO_CAL_SLEEP_CBCR_ADDR A:0xfc400418
y.create.l HWIO_GCC_USB_HSIC_XCVR_FS_CMD_RCGR_ADDR A:0xfc400424
y.create.l HWIO_GCC_USB_HSIC_XCVR_FS_CFG_RCGR_ADDR A:0xfc400428
y.create.l HWIO_GCC_USB_HSIC_XCVR_FS_CBCR_ADDR A:0xfc40042c
y.create.l HWIO_GCC_USB_HS_BCR_ADDR A:0xfc400480
y.create.l HWIO_GCC_USB_HS_SYSTEM_CBCR_ADDR A:0xfc400484
y.create.l HWIO_GCC_USB_HS_AHB_CBCR_ADDR A:0xfc400488
y.create.l HWIO_GCC_USB_HS_INACTIVITY_TIMERS_CBCR_ADDR A:0xfc40048c
y.create.l HWIO_GCC_USB_HS_SYSTEM_CMD_RCGR_ADDR A:0xfc400490
y.create.l HWIO_GCC_USB_HS_SYSTEM_CFG_RCGR_ADDR A:0xfc400494
y.create.l HWIO_GCC_USB2A_PHY_BCR_ADDR A:0xfc4004a8
y.create.l HWIO_GCC_USB2A_PHY_SLEEP_CBCR_ADDR A:0xfc4004ac
y.create.l HWIO_GCC_USB2B_PHY_BCR_ADDR A:0xfc4004b0
y.create.l HWIO_GCC_USB2B_PHY_SLEEP_CBCR_ADDR A:0xfc4004b4
y.create.l HWIO_GCC_USB_HS_PHY_BCR_ADDR A:0xfc4004b8
y.create.l HWIO_GCC_SDCC2_BCR_ADDR A:0xfc400500
y.create.l HWIO_GCC_SDCC2_APPS_CMD_RCGR_ADDR A:0xfc400510
y.create.l HWIO_GCC_SDCC2_APPS_CFG_RCGR_ADDR A:0xfc400514
y.create.l HWIO_GCC_SDCC2_APPS_M_ADDR A:0xfc400518
y.create.l HWIO_GCC_SDCC2_APPS_N_ADDR A:0xfc40051c
y.create.l HWIO_GCC_SDCC2_APPS_D_ADDR A:0xfc400520
y.create.l HWIO_GCC_SDCC2_APPS_CBCR_ADDR A:0xfc400504
y.create.l HWIO_GCC_SDCC2_AHB_CBCR_ADDR A:0xfc400508
y.create.l HWIO_GCC_SDCC2_INACTIVITY_TIMERS_CBCR_ADDR A:0xfc40050c
y.create.l HWIO_GCC_SDCC3_BCR_ADDR A:0xfc400540
y.create.l HWIO_GCC_SDCC3_APPS_CMD_RCGR_ADDR A:0xfc400550
y.create.l HWIO_GCC_SDCC3_APPS_CFG_RCGR_ADDR A:0xfc400554
y.create.l HWIO_GCC_SDCC3_APPS_M_ADDR A:0xfc400558
y.create.l HWIO_GCC_SDCC3_APPS_N_ADDR A:0xfc40055c
y.create.l HWIO_GCC_SDCC3_APPS_D_ADDR A:0xfc400560
y.create.l HWIO_GCC_SDCC3_APPS_CBCR_ADDR A:0xfc400544
y.create.l HWIO_GCC_SDCC3_AHB_CBCR_ADDR A:0xfc400548
y.create.l HWIO_GCC_SDCC3_INACTIVITY_TIMERS_CBCR_ADDR A:0xfc40054c
y.create.l HWIO_GCC_BLSP1_BCR_ADDR A:0xfc4005c0
y.create.l HWIO_GCC_BLSP1_SLEEP_CBCR_ADDR A:0xfc4005c8
y.create.l HWIO_GCC_BLSP1_AHB_CBCR_ADDR A:0xfc4005c4
y.create.l HWIO_GCC_BLSP1_QUP1_BCR_ADDR A:0xfc400640
y.create.l HWIO_GCC_BLSP1_QUP1_SPI_APPS_CBCR_ADDR A:0xfc400644
y.create.l HWIO_GCC_BLSP1_QUP1_I2C_APPS_CBCR_ADDR A:0xfc400648
y.create.l HWIO_GCC_BLSP1_QUP1_I2C_APPS_CMD_RCGR_ADDR A:0xfc400660
y.create.l HWIO_GCC_BLSP1_QUP1_I2C_APPS_CFG_RCGR_ADDR A:0xfc400664
y.create.l HWIO_GCC_BLSP1_QUP2_I2C_APPS_CMD_RCGR_ADDR A:0xfc4006e0
y.create.l HWIO_GCC_BLSP1_QUP2_I2C_APPS_CFG_RCGR_ADDR A:0xfc4006e4
y.create.l HWIO_GCC_BLSP1_QUP3_I2C_APPS_CMD_RCGR_ADDR A:0xfc400760
y.create.l HWIO_GCC_BLSP1_QUP3_I2C_APPS_CFG_RCGR_ADDR A:0xfc400764
y.create.l HWIO_GCC_BLSP1_QUP4_I2C_APPS_CMD_RCGR_ADDR A:0xfc4007e0
y.create.l HWIO_GCC_BLSP1_QUP4_I2C_APPS_CFG_RCGR_ADDR A:0xfc4007e4
y.create.l HWIO_GCC_BLSP1_QUP5_I2C_APPS_CMD_RCGR_ADDR A:0xfc400860
y.create.l HWIO_GCC_BLSP1_QUP5_I2C_APPS_CFG_RCGR_ADDR A:0xfc400864
y.create.l HWIO_GCC_BLSP1_QUP6_I2C_APPS_CMD_RCGR_ADDR A:0xfc4008e0
y.create.l HWIO_GCC_BLSP1_QUP6_I2C_APPS_CFG_RCGR_ADDR A:0xfc4008e4
y.create.l HWIO_GCC_BLSP1_QUP1_SPI_APPS_CMD_RCGR_ADDR A:0xfc40064c
y.create.l HWIO_GCC_BLSP1_QUP1_SPI_APPS_CFG_RCGR_ADDR A:0xfc400650
y.create.l HWIO_GCC_BLSP1_QUP1_SPI_APPS_M_ADDR A:0xfc400654
y.create.l HWIO_GCC_BLSP1_QUP1_SPI_APPS_N_ADDR A:0xfc400658
y.create.l HWIO_GCC_BLSP1_QUP1_SPI_APPS_D_ADDR A:0xfc40065c
y.create.l HWIO_GCC_BLSP1_UART1_BCR_ADDR A:0xfc400680
y.create.l HWIO_GCC_BLSP1_UART1_APPS_CBCR_ADDR A:0xfc400684
y.create.l HWIO_GCC_BLSP1_UART1_SIM_CBCR_ADDR A:0xfc400688
y.create.l HWIO_GCC_BLSP1_UART1_APPS_CMD_RCGR_ADDR A:0xfc40068c
y.create.l HWIO_GCC_BLSP1_UART1_APPS_CFG_RCGR_ADDR A:0xfc400690
y.create.l HWIO_GCC_BLSP1_UART1_APPS_M_ADDR A:0xfc400694
y.create.l HWIO_GCC_BLSP1_UART1_APPS_N_ADDR A:0xfc400698
y.create.l HWIO_GCC_BLSP1_UART1_APPS_D_ADDR A:0xfc40069c
y.create.l HWIO_GCC_BLSP1_QUP2_BCR_ADDR A:0xfc4006c0
y.create.l HWIO_GCC_BLSP1_QUP2_SPI_APPS_CBCR_ADDR A:0xfc4006c4
y.create.l HWIO_GCC_BLSP1_QUP2_I2C_APPS_CBCR_ADDR A:0xfc4006c8
y.create.l HWIO_GCC_BLSP1_QUP2_SPI_APPS_CMD_RCGR_ADDR A:0xfc4006cc
y.create.l HWIO_GCC_BLSP1_QUP2_SPI_APPS_CFG_RCGR_ADDR A:0xfc4006d0
y.create.l HWIO_GCC_BLSP1_QUP2_SPI_APPS_M_ADDR A:0xfc4006d4
y.create.l HWIO_GCC_BLSP1_QUP2_SPI_APPS_N_ADDR A:0xfc4006d8
y.create.l HWIO_GCC_BLSP1_QUP2_SPI_APPS_D_ADDR A:0xfc4006dc
y.create.l HWIO_GCC_BLSP1_UART2_BCR_ADDR A:0xfc400700
y.create.l HWIO_GCC_BLSP1_UART2_APPS_CBCR_ADDR A:0xfc400704
y.create.l HWIO_GCC_BLSP1_UART2_SIM_CBCR_ADDR A:0xfc400708
y.create.l HWIO_GCC_BLSP1_UART2_APPS_CMD_RCGR_ADDR A:0xfc40070c
y.create.l HWIO_GCC_BLSP1_UART2_APPS_CFG_RCGR_ADDR A:0xfc400710
y.create.l HWIO_GCC_BLSP1_UART2_APPS_M_ADDR A:0xfc400714
y.create.l HWIO_GCC_BLSP1_UART2_APPS_N_ADDR A:0xfc400718
y.create.l HWIO_GCC_BLSP1_UART2_APPS_D_ADDR A:0xfc40071c
y.create.l HWIO_GCC_BLSP1_QUP3_BCR_ADDR A:0xfc400740
y.create.l HWIO_GCC_BLSP1_QUP3_SPI_APPS_CBCR_ADDR A:0xfc400744
y.create.l HWIO_GCC_BLSP1_QUP3_I2C_APPS_CBCR_ADDR A:0xfc400748
y.create.l HWIO_GCC_BLSP1_QUP3_SPI_APPS_CMD_RCGR_ADDR A:0xfc40074c
y.create.l HWIO_GCC_BLSP1_QUP3_SPI_APPS_CFG_RCGR_ADDR A:0xfc400750
y.create.l HWIO_GCC_BLSP1_QUP3_SPI_APPS_M_ADDR A:0xfc400754
y.create.l HWIO_GCC_BLSP1_QUP3_SPI_APPS_N_ADDR A:0xfc400758
y.create.l HWIO_GCC_BLSP1_QUP3_SPI_APPS_D_ADDR A:0xfc40075c
y.create.l HWIO_GCC_BLSP1_UART3_BCR_ADDR A:0xfc400780
y.create.l HWIO_GCC_BLSP1_UART3_APPS_CBCR_ADDR A:0xfc400784
y.create.l HWIO_GCC_BLSP1_UART3_SIM_CBCR_ADDR A:0xfc400788
y.create.l HWIO_GCC_BLSP1_UART3_APPS_CMD_RCGR_ADDR A:0xfc40078c
y.create.l HWIO_GCC_BLSP1_UART3_APPS_CFG_RCGR_ADDR A:0xfc400790
y.create.l HWIO_GCC_BLSP1_UART3_APPS_M_ADDR A:0xfc400794
y.create.l HWIO_GCC_BLSP1_UART3_APPS_N_ADDR A:0xfc400798
y.create.l HWIO_GCC_BLSP1_UART3_APPS_D_ADDR A:0xfc40079c
y.create.l HWIO_GCC_BLSP1_QUP4_BCR_ADDR A:0xfc4007c0
y.create.l HWIO_GCC_BLSP1_QUP4_SPI_APPS_CBCR_ADDR A:0xfc4007c4
y.create.l HWIO_GCC_BLSP1_QUP4_I2C_APPS_CBCR_ADDR A:0xfc4007c8
y.create.l HWIO_GCC_BLSP1_QUP4_SPI_APPS_CMD_RCGR_ADDR A:0xfc4007cc
y.create.l HWIO_GCC_BLSP1_QUP4_SPI_APPS_CFG_RCGR_ADDR A:0xfc4007d0
y.create.l HWIO_GCC_BLSP1_QUP4_SPI_APPS_M_ADDR A:0xfc4007d4
y.create.l HWIO_GCC_BLSP1_QUP4_SPI_APPS_N_ADDR A:0xfc4007d8
y.create.l HWIO_GCC_BLSP1_QUP4_SPI_APPS_D_ADDR A:0xfc4007dc
y.create.l HWIO_GCC_BLSP1_UART4_BCR_ADDR A:0xfc400800
y.create.l HWIO_GCC_BLSP1_UART4_APPS_CBCR_ADDR A:0xfc400804
y.create.l HWIO_GCC_BLSP1_UART4_SIM_CBCR_ADDR A:0xfc400808
y.create.l HWIO_GCC_BLSP1_UART4_APPS_CMD_RCGR_ADDR A:0xfc40080c
y.create.l HWIO_GCC_BLSP1_UART4_APPS_CFG_RCGR_ADDR A:0xfc400810
y.create.l HWIO_GCC_BLSP1_UART4_APPS_M_ADDR A:0xfc400814
y.create.l HWIO_GCC_BLSP1_UART4_APPS_N_ADDR A:0xfc400818
y.create.l HWIO_GCC_BLSP1_UART4_APPS_D_ADDR A:0xfc40081c
y.create.l HWIO_GCC_BLSP1_QUP5_BCR_ADDR A:0xfc400840
y.create.l HWIO_GCC_BLSP1_QUP5_SPI_APPS_CBCR_ADDR A:0xfc400844
y.create.l HWIO_GCC_BLSP1_QUP5_I2C_APPS_CBCR_ADDR A:0xfc400848
y.create.l HWIO_GCC_BLSP1_QUP5_SPI_APPS_CMD_RCGR_ADDR A:0xfc40084c
y.create.l HWIO_GCC_BLSP1_QUP5_SPI_APPS_CFG_RCGR_ADDR A:0xfc400850
y.create.l HWIO_GCC_BLSP1_QUP5_SPI_APPS_M_ADDR A:0xfc400854
y.create.l HWIO_GCC_BLSP1_QUP5_SPI_APPS_N_ADDR A:0xfc400858
y.create.l HWIO_GCC_BLSP1_QUP5_SPI_APPS_D_ADDR A:0xfc40085c
y.create.l HWIO_GCC_BLSP1_UART5_BCR_ADDR A:0xfc400880
y.create.l HWIO_GCC_BLSP1_UART5_APPS_CBCR_ADDR A:0xfc400884
y.create.l HWIO_GCC_BLSP1_UART5_SIM_CBCR_ADDR A:0xfc400888
y.create.l HWIO_GCC_BLSP1_UART5_APPS_CMD_RCGR_ADDR A:0xfc40088c
y.create.l HWIO_GCC_BLSP1_UART5_APPS_CFG_RCGR_ADDR A:0xfc400890
y.create.l HWIO_GCC_BLSP1_UART5_APPS_M_ADDR A:0xfc400894
y.create.l HWIO_GCC_BLSP1_UART5_APPS_N_ADDR A:0xfc400898
y.create.l HWIO_GCC_BLSP1_UART5_APPS_D_ADDR A:0xfc40089c
y.create.l HWIO_GCC_BLSP1_QUP6_BCR_ADDR A:0xfc4008c0
y.create.l HWIO_GCC_BLSP1_QUP6_SPI_APPS_CBCR_ADDR A:0xfc4008c4
y.create.l HWIO_GCC_BLSP1_QUP6_I2C_APPS_CBCR_ADDR A:0xfc4008c8
y.create.l HWIO_GCC_BLSP1_QUP6_SPI_APPS_CMD_RCGR_ADDR A:0xfc4008cc
y.create.l HWIO_GCC_BLSP1_QUP6_SPI_APPS_CFG_RCGR_ADDR A:0xfc4008d0
y.create.l HWIO_GCC_BLSP1_QUP6_SPI_APPS_M_ADDR A:0xfc4008d4
y.create.l HWIO_GCC_BLSP1_QUP6_SPI_APPS_N_ADDR A:0xfc4008d8
y.create.l HWIO_GCC_BLSP1_QUP6_SPI_APPS_D_ADDR A:0xfc4008dc
y.create.l HWIO_GCC_BLSP1_UART6_BCR_ADDR A:0xfc400900
y.create.l HWIO_GCC_BLSP1_UART6_APPS_CBCR_ADDR A:0xfc400904
y.create.l HWIO_GCC_BLSP1_UART6_SIM_CBCR_ADDR A:0xfc400908
y.create.l HWIO_GCC_BLSP1_UART6_APPS_CMD_RCGR_ADDR A:0xfc40090c
y.create.l HWIO_GCC_BLSP1_UART6_APPS_CFG_RCGR_ADDR A:0xfc400910
y.create.l HWIO_GCC_BLSP1_UART6_APPS_M_ADDR A:0xfc400914
y.create.l HWIO_GCC_BLSP1_UART6_APPS_N_ADDR A:0xfc400918
y.create.l HWIO_GCC_BLSP1_UART6_APPS_D_ADDR A:0xfc40091c
y.create.l HWIO_GCC_BLSP_UART_SIM_CMD_RCGR_ADDR A:0xfc400600
y.create.l HWIO_GCC_BLSP_UART_SIM_CFG_RCGR_ADDR A:0xfc400604
y.create.l HWIO_GCC_PERIPH_XPU_AHB_CBCR_ADDR A:0xfc400c80
y.create.l HWIO_GCC_PDM_BCR_ADDR A:0xfc400cc0
y.create.l HWIO_GCC_PDM_AHB_CBCR_ADDR A:0xfc400cc4
y.create.l HWIO_GCC_PDM_XO4_CBCR_ADDR A:0xfc400cc8
y.create.l HWIO_GCC_PDM2_CBCR_ADDR A:0xfc400ccc
y.create.l HWIO_GCC_PDM2_CMD_RCGR_ADDR A:0xfc400cd0
y.create.l HWIO_GCC_PDM2_CFG_RCGR_ADDR A:0xfc400cd4
y.create.l HWIO_GCC_PRNG_BCR_ADDR A:0xfc400d00
y.create.l HWIO_GCC_PRNG_AHB_CBCR_ADDR A:0xfc400d04
y.create.l HWIO_GCC_BAM_DMA_BCR_ADDR A:0xfc400d40
y.create.l HWIO_GCC_BAM_DMA_AHB_CBCR_ADDR A:0xfc400d44
y.create.l HWIO_GCC_BAM_DMA_INACTIVITY_TIMERS_CBCR_ADDR A:0xfc400d48
y.create.l HWIO_GCC_TCSR_BCR_ADDR A:0xfc400dc0
y.create.l HWIO_GCC_TCSR_AHB_CBCR_ADDR A:0xfc400dc4
y.create.l HWIO_GCC_BOOT_ROM_BCR_ADDR A:0xfc400e00
y.create.l HWIO_GCC_BOOT_ROM_AHB_CBCR_ADDR A:0xfc400e04
y.create.l HWIO_GCC_MSG_RAM_BCR_ADDR A:0xfc400e40
y.create.l HWIO_GCC_MSG_RAM_AHB_CBCR_ADDR A:0xfc400e44
y.create.l HWIO_GCC_TLMM_BCR_ADDR A:0xfc400e80
y.create.l HWIO_GCC_TLMM_AHB_CBCR_ADDR A:0xfc400e84
y.create.l HWIO_GCC_TLMM_CBCR_ADDR A:0xfc400e88
y.create.l HWIO_GCC_MPM_BCR_ADDR A:0xfc400ec0
y.create.l HWIO_GCC_MPM_MISC_ADDR A:0xfc400ec4
y.create.l HWIO_GCC_MPM_AHB_CBCR_ADDR A:0xfc400ec8
y.create.l HWIO_GCC_RPM_PROC_HCLK_CBCR_ADDR A:0xfc400f00
y.create.l HWIO_GCC_RPM_BUS_AHB_CBCR_ADDR A:0xfc400f04
y.create.l HWIO_GCC_RPM_SLEEP_CBCR_ADDR A:0xfc400f08
y.create.l HWIO_GCC_RPM_TIMER_CBCR_ADDR A:0xfc400f0c
y.create.l HWIO_GCC_RPM_CMD_RCGR_ADDR A:0xfc400f10
y.create.l HWIO_GCC_RPM_CFG_RCGR_ADDR A:0xfc400f14
y.create.l HWIO_GCC_RPM_MISC_ADDR A:0xfc400f24
y.create.l HWIO_GCC_SEC_CTRL_BCR_ADDR A:0xfc400f40
y.create.l HWIO_GCC_ACC_CMD_RCGR_ADDR A:0xfc400f80
y.create.l HWIO_GCC_ACC_CFG_RCGR_ADDR A:0xfc400f84
y.create.l HWIO_GCC_ACC_MISC_ADDR A:0xfc400f94
y.create.l HWIO_GCC_SEC_CTRL_ACC_CBCR_ADDR A:0xfc400f44
y.create.l HWIO_GCC_SEC_CTRL_AHB_CBCR_ADDR A:0xfc400f48
y.create.l HWIO_GCC_SEC_CTRL_CBCR_ADDR A:0xfc400f4c
y.create.l HWIO_GCC_SEC_CTRL_SENSE_CBCR_ADDR A:0xfc400f50
y.create.l HWIO_GCC_SEC_CTRL_BOOT_ROM_PATCH_CBCR_ADDR A:0xfc400f54
y.create.l HWIO_GCC_SEC_CTRL_CMD_RCGR_ADDR A:0xfc400f98
y.create.l HWIO_GCC_SEC_CTRL_CFG_RCGR_ADDR A:0xfc400f9c
y.create.l HWIO_GCC_SPMI_BCR_ADDR A:0xfc400fc0
y.create.l HWIO_GCC_SPMI_SER_CMD_RCGR_ADDR A:0xfc400fd0
y.create.l HWIO_GCC_SPMI_SER_CFG_RCGR_ADDR A:0xfc400fd4
y.create.l HWIO_GCC_SPMI_SER_CBCR_ADDR A:0xfc400fc4
y.create.l HWIO_GCC_SPMI_CNOC_AHB_CBCR_ADDR A:0xfc400fc8
y.create.l HWIO_GCC_SPMI_AHB_CMD_RCGR_ADDR A:0xfc400fe8
y.create.l HWIO_GCC_SPMI_AHB_CFG_RCGR_ADDR A:0xfc400fec
y.create.l HWIO_GCC_SPMI_AHB_CBCR_ADDR A:0xfc400fcc
y.create.l HWIO_GCC_SPDM_BCR_ADDR A:0xfc401000
y.create.l HWIO_GCC_SPDM_CFG_AHB_CBCR_ADDR A:0xfc401004
y.create.l HWIO_GCC_SPDM_MSTR_AHB_CBCR_ADDR A:0xfc401008
y.create.l HWIO_GCC_SPDM_FF_CBCR_ADDR A:0xfc40100c
y.create.l HWIO_GCC_SPDM_BIMC_CY_CBCR_ADDR A:0xfc401010
y.create.l HWIO_GCC_SPDM_SNOC_CY_CBCR_ADDR A:0xfc401014
y.create.l HWIO_GCC_SPDM_DEBUG_CY_CBCR_ADDR A:0xfc401018
y.create.l HWIO_GCC_SPDM_PNOC_CY_CBCR_ADDR A:0xfc40101c
y.create.l HWIO_GCC_SPDM_RPM_CY_CBCR_ADDR A:0xfc401020
y.create.l HWIO_GCC_CE1_BCR_ADDR A:0xfc401040
y.create.l HWIO_GCC_CE1_CMD_RCGR_ADDR A:0xfc401050
y.create.l HWIO_GCC_CE1_CFG_RCGR_ADDR A:0xfc401054
y.create.l HWIO_GCC_CE1_CBCR_ADDR A:0xfc401044
y.create.l HWIO_GCC_CE1_AXI_CBCR_ADDR A:0xfc401048
y.create.l HWIO_GCC_CE1_AHB_CBCR_ADDR A:0xfc40104c
y.create.l HWIO_GCC_GCC_AHB_CBCR_ADDR A:0xfc4010c0
y.create.l HWIO_GCC_GCC_XO_CMD_RCGR_ADDR A:0xfc4010e8
y.create.l HWIO_GCC_GCC_XO_CBCR_ADDR A:0xfc4010c4
y.create.l HWIO_GCC_GCC_XO_DIV4_CBCR_ADDR A:0xfc4010c8
y.create.l HWIO_GCC_GCC_IM_SLEEP_CBCR_ADDR A:0xfc4010cc
y.create.l HWIO_GCC_BIMC_BCR_ADDR A:0xfc401100
y.create.l HWIO_GCC_BIMC_GDSCR_ADDR A:0xfc401104
y.create.l HWIO_GCC_BIMC_DDR_XO_CMD_RCGR_ADDR A:0xfc401140
y.create.l HWIO_GCC_BIMC_XO_CBCR_ADDR A:0xfc401108
y.create.l HWIO_GCC_BIMC_CFG_AHB_CBCR_ADDR A:0xfc40110c
y.create.l HWIO_GCC_BIMC_SLEEP_CBCR_ADDR A:0xfc401110
y.create.l HWIO_GCC_BIMC_SYSNOC_AXI_CBCR_ADDR A:0xfc401114
y.create.l HWIO_GCC_BIMC_DDR_CMD_RCGR_ADDR A:0xfc401158
y.create.l HWIO_GCC_BIMC_DDR_CFG_RCGR_ADDR A:0xfc40115c
y.create.l HWIO_GCC_BIMC_MISC_ADDR A:0xfc40116c
y.create.l HWIO_GCC_BIMC_CBCR_ADDR A:0xfc401118
y.create.l HWIO_GCC_BIMC_KPSS_AXI_CBCR_ADDR A:0xfc40111c
y.create.l HWIO_GCC_DDR_DIM_CFG_CBCR_ADDR A:0xfc401180
y.create.l HWIO_GCC_DDR_DIM_SLEEP_CBCR_ADDR A:0xfc40118c
y.create.l HWIO_GCC_LPASS_Q6_AXI_CBCR_ADDR A:0xfc4011c0
y.create.l HWIO_GCC_SYS_NOC_LPASS_SWAY_CBCR_ADDR A:0xfc4011c4
y.create.l HWIO_GCC_SYS_NOC_LPASS_MPORT_CBCR_ADDR A:0xfc4011c8
y.create.l HWIO_GCC_KPSS_AHB_CMD_RCGR_ADDR A:0xfc40120c
y.create.l HWIO_GCC_KPSS_AHB_CFG_RCGR_ADDR A:0xfc401210
y.create.l HWIO_GCC_KPSS_AHB_MISC_ADDR A:0xfc401220
y.create.l HWIO_GCC_KPSS_AHB_CBCR_ADDR A:0xfc401204
y.create.l HWIO_GCC_KPSS_AXI_CBCR_ADDR A:0xfc401208
y.create.l HWIO_GCC_SNOC_BUS_TIMEOUT0_BCR_ADDR A:0xfc401240
y.create.l HWIO_GCC_SNOC_BUS_TIMEOUT0_AHB_CBCR_ADDR A:0xfc401244
y.create.l HWIO_GCC_SNOC_BUS_TIMEOUT2_BCR_ADDR A:0xfc401248
y.create.l HWIO_GCC_SNOC_BUS_TIMEOUT2_AHB_CBCR_ADDR A:0xfc40124c
y.create.l HWIO_GCC_PNOC_BUS_TIMEOUT0_BCR_ADDR A:0xfc401280
y.create.l HWIO_GCC_PNOC_BUS_TIMEOUT0_AHB_CBCR_ADDR A:0xfc401284
y.create.l HWIO_GCC_PNOC_BUS_TIMEOUT1_BCR_ADDR A:0xfc401288
y.create.l HWIO_GCC_PNOC_BUS_TIMEOUT1_AHB_CBCR_ADDR A:0xfc40128c
y.create.l HWIO_GCC_PNOC_BUS_TIMEOUT2_BCR_ADDR A:0xfc401290
y.create.l HWIO_GCC_PNOC_BUS_TIMEOUT2_AHB_CBCR_ADDR A:0xfc401294
y.create.l HWIO_GCC_PNOC_BUS_TIMEOUT3_BCR_ADDR A:0xfc401298
y.create.l HWIO_GCC_PNOC_BUS_TIMEOUT3_AHB_CBCR_ADDR A:0xfc40129c
y.create.l HWIO_GCC_PNOC_BUS_TIMEOUT4_BCR_ADDR A:0xfc4012a0
y.create.l HWIO_GCC_PNOC_BUS_TIMEOUT4_AHB_CBCR_ADDR A:0xfc4012a4
y.create.l HWIO_GCC_CNOC_BUS_TIMEOUT0_BCR_ADDR A:0xfc4012c0
y.create.l HWIO_GCC_CNOC_BUS_TIMEOUT0_AHB_CBCR_ADDR A:0xfc4012c4
y.create.l HWIO_GCC_CNOC_BUS_TIMEOUT1_BCR_ADDR A:0xfc4012c8
y.create.l HWIO_GCC_CNOC_BUS_TIMEOUT1_AHB_CBCR_ADDR A:0xfc4012cc
y.create.l HWIO_GCC_CNOC_BUS_TIMEOUT2_BCR_ADDR A:0xfc4012d0
y.create.l HWIO_GCC_CNOC_BUS_TIMEOUT2_AHB_CBCR_ADDR A:0xfc4012d4
y.create.l HWIO_GCC_CNOC_BUS_TIMEOUT3_BCR_ADDR A:0xfc4012d8
y.create.l HWIO_GCC_CNOC_BUS_TIMEOUT3_AHB_CBCR_ADDR A:0xfc4012dc
y.create.l HWIO_GCC_CNOC_BUS_TIMEOUT4_BCR_ADDR A:0xfc4012e0
y.create.l HWIO_GCC_CNOC_BUS_TIMEOUT4_AHB_CBCR_ADDR A:0xfc4012e4
y.create.l HWIO_GCC_CNOC_BUS_TIMEOUT5_BCR_ADDR A:0xfc4012e8
y.create.l HWIO_GCC_CNOC_BUS_TIMEOUT5_AHB_CBCR_ADDR A:0xfc4012ec
y.create.l HWIO_GCC_CNOC_BUS_TIMEOUT6_BCR_ADDR A:0xfc4012f0
y.create.l HWIO_GCC_CNOC_BUS_TIMEOUT6_AHB_CBCR_ADDR A:0xfc4012f4
y.create.l HWIO_GCC_DEHR_BCR_ADDR A:0xfc401300
y.create.l HWIO_GCC_DEHR_CBCR_ADDR A:0xfc401304
y.create.l HWIO_GCC_PERIPH_NOC_MPU_CFG_AHB_CBCR_ADDR A:0xfc401340
y.create.l HWIO_GCC_RBCPR_BCR_ADDR A:0xfc401380
y.create.l HWIO_GCC_RBCPR_CBCR_ADDR A:0xfc401384
y.create.l HWIO_GCC_RBCPR_AHB_CBCR_ADDR A:0xfc401388
y.create.l HWIO_GCC_RBCPR_CMD_RCGR_ADDR A:0xfc40138c
y.create.l HWIO_GCC_RBCPR_CFG_RCGR_ADDR A:0xfc401390
y.create.l HWIO_GCC_RPM_GPLL_ENA_VOTE_ADDR A:0xfc401440
y.create.l HWIO_GCC_RPM_CLOCK_BRANCH_ENA_VOTE_ADDR A:0xfc401444
y.create.l HWIO_GCC_RPM_CLOCK_SLEEP_ENA_VOTE_ADDR A:0xfc401448
y.create.l HWIO_GCC_APCS_GPLL_ENA_VOTE_ADDR A:0xfc401480
y.create.l HWIO_GCC_APCS_CLOCK_BRANCH_ENA_VOTE_ADDR A:0xfc401484
y.create.l HWIO_GCC_APCS_CLOCK_SLEEP_ENA_VOTE_ADDR A:0xfc401488
y.create.l HWIO_GCC_APCS_TZ_GPLL_ENA_VOTE_ADDR A:0xfc4014c0
y.create.l HWIO_GCC_APCS_TZ_CLOCK_BRANCH_ENA_VOTE_ADDR A:0xfc4014c4
y.create.l HWIO_GCC_APCS_TZ_CLOCK_SLEEP_ENA_VOTE_ADDR A:0xfc4014c8
y.create.l HWIO_GCC_MSS_Q6_GPLL_ENA_VOTE_ADDR A:0xfc401500
y.create.l HWIO_GCC_MSS_Q6_CLOCK_BRANCH_ENA_VOTE_ADDR A:0xfc401504
y.create.l HWIO_GCC_MSS_Q6_CLOCK_SLEEP_ENA_VOTE_ADDR A:0xfc401508
y.create.l HWIO_GCC_LPASS_DSP_GPLL_ENA_VOTE_ADDR A:0xfc401540
y.create.l HWIO_GCC_LPASS_DSP_CLOCK_BRANCH_ENA_VOTE_ADDR A:0xfc401544
y.create.l HWIO_GCC_LPASS_DSP_CLOCK_SLEEP_ENA_VOTE_ADDR A:0xfc401548
y.create.l HWIO_GCC_SPARE_GPLL_ENA_VOTE_ADDR A:0xfc4015c0
y.create.l HWIO_GCC_SPARE_CLOCK_BRANCH_ENA_VOTE_ADDR A:0xfc4015c4
y.create.l HWIO_GCC_QDSS_STM_EVENT0_CTL_REG_ADDR A:0xfc401600
y.create.l HWIO_GCC_QDSS_STM_EVENT1_CTL_REG_ADDR A:0xfc401604
y.create.l HWIO_GCC_QDSS_STM_EVENT2_CTL_REG_ADDR A:0xfc401608
y.create.l HWIO_GCC_QDSS_STM_EVENT3_CTL_REG_ADDR A:0xfc40160c
y.create.l HWIO_GCC_QDSS_STM_EVENT4_CTL_REG_ADDR A:0xfc401610
y.create.l HWIO_GCC_QDSS_STM_EVENT5_CTL_REG_ADDR A:0xfc401614
y.create.l HWIO_GCC_QDSS_STM_EVENT6_CTL_REG_ADDR A:0xfc401618
y.create.l HWIO_GCC_QDSS_STM_EVENT7_CTL_REG_ADDR A:0xfc40161c
y.create.l HWIO_GCC_QDSS_STM_EVENT8_CTL_REG_ADDR A:0xfc401620
y.create.l HWIO_GCC_QDSS_STM_EVENT9_CTL_REG_ADDR A:0xfc401624
y.create.l HWIO_GCC_QDSS_STM_EVENT10_CTL_REG_ADDR A:0xfc401628
y.create.l HWIO_GCC_QDSS_STM_EVENT11_CTL_REG_ADDR A:0xfc40162c
y.create.l HWIO_GCC_QDSS_STM_EVENT12_CTL_REG_ADDR A:0xfc401630
y.create.l HWIO_GCC_QDSS_STM_EVENT13_CTL_REG_ADDR A:0xfc401634
y.create.l HWIO_GCC_QDSS_STM_EVENT14_CTL_REG_ADDR A:0xfc401638
y.create.l HWIO_GCC_QDSS_STM_EVENT15_CTL_REG_ADDR A:0xfc40163c
y.create.l HWIO_GCC_QDSS_STM_EVENT16_CTL_REG_ADDR A:0xfc401640
y.create.l HWIO_GCC_QDSS_STM_EVENT17_CTL_REG_ADDR A:0xfc401644
y.create.l HWIO_GCC_QDSS_STM_EVENT18_CTL_REG_ADDR A:0xfc401648
y.create.l HWIO_GCC_QDSS_STM_EVENT19_CTL_REG_ADDR A:0xfc40164c
y.create.l HWIO_GCC_QDSS_STM_EVENT20_CTL_REG_ADDR A:0xfc401650
y.create.l HWIO_GCC_QDSS_STM_EVENT21_CTL_REG_ADDR A:0xfc401654
y.create.l HWIO_GCC_QDSS_STM_EVENT22_CTL_REG_ADDR A:0xfc401658
y.create.l HWIO_GCC_QDSS_STM_EVENT23_CTL_REG_ADDR A:0xfc40165c
y.create.l HWIO_GCC_QDSS_STM_EVENT24_CTL_REG_ADDR A:0xfc401660
y.create.l HWIO_GCC_QDSS_STM_EVENT25_CTL_REG_ADDR A:0xfc401664
y.create.l HWIO_GCC_QDSS_STM_EVENT26_CTL_REG_ADDR A:0xfc401668
y.create.l HWIO_GCC_QDSS_STM_EVENT27_CTL_REG_ADDR A:0xfc40166c
y.create.l HWIO_GCC_QDSS_STM_EVENT28_CTL_REG_ADDR A:0xfc401670
y.create.l HWIO_GCC_QDSS_STM_EVENT29_CTL_REG_ADDR A:0xfc401674
y.create.l HWIO_GCC_QDSS_STM_EVENT30_CTL_REG_ADDR A:0xfc401678
y.create.l HWIO_GCC_QDSS_STM_EVENT31_CTL_REG_ADDR A:0xfc40167c
y.create.l HWIO_GCC_MSS_RESTART_ADDR A:0xfc401680
y.create.l HWIO_GCC_LPASS_RESTART_ADDR A:0xfc4016c0
y.create.l HWIO_GCC_WDOG_DEBUG_ADDR A:0xfc401780
y.create.l HWIO_GCC_FLUSH_ETR_DEBUG_TIMER_ADDR A:0xfc401784
y.create.l HWIO_GCC_RESET_STATUS_ADDR A:0xfc4017c0
y.create.l HWIO_GCC_SW_SRST_ADDR A:0xfc401800
y.create.l HWIO_GCC_PROC_HALT_ADDR A:0xfc401840
y.create.l HWIO_GCC_GCC_DEBUG_CLK_CTL_ADDR A:0xfc401880
y.create.l HWIO_GCC_CLOCK_FRQ_MEASURE_CTL_ADDR A:0xfc401884
y.create.l HWIO_GCC_CLOCK_FRQ_MEASURE_STATUS_ADDR A:0xfc401888
y.create.l HWIO_GCC_PLLTEST_PAD_CFG_ADDR A:0xfc40188c
y.create.l HWIO_GCC_JITTER_PROBE_CFG_ADDR A:0xfc401890
y.create.l HWIO_GCC_JITTER_PROBE_VAL_ADDR A:0xfc401894
y.create.l HWIO_GCC_GP1_CBCR_ADDR A:0xfc401900
y.create.l HWIO_GCC_GP1_CMD_RCGR_ADDR A:0xfc401904
y.create.l HWIO_GCC_GP1_CFG_RCGR_ADDR A:0xfc401908
y.create.l HWIO_GCC_GP1_M_ADDR A:0xfc40190c
y.create.l HWIO_GCC_GP1_N_ADDR A:0xfc401910
y.create.l HWIO_GCC_GP1_D_ADDR A:0xfc401914
y.create.l HWIO_GCC_GP2_CBCR_ADDR A:0xfc401940
y.create.l HWIO_GCC_GP2_CMD_RCGR_ADDR A:0xfc401944
y.create.l HWIO_GCC_GP2_CFG_RCGR_ADDR A:0xfc401948
y.create.l HWIO_GCC_GP2_M_ADDR A:0xfc40194c
y.create.l HWIO_GCC_GP2_N_ADDR A:0xfc401950
y.create.l HWIO_GCC_GP2_D_ADDR A:0xfc401954
y.create.l HWIO_GCC_GP3_CBCR_ADDR A:0xfc401980
y.create.l HWIO_GCC_GP3_CMD_RCGR_ADDR A:0xfc401984
y.create.l HWIO_GCC_GP3_CFG_RCGR_ADDR A:0xfc401988
y.create.l HWIO_GCC_GP3_M_ADDR A:0xfc40198c
y.create.l HWIO_GCC_GP3_N_ADDR A:0xfc401990
y.create.l HWIO_GCC_GP3_D_ADDR A:0xfc401994
y.create.l HWIO_GCC_KPSS_BOOT_CLOCK_CTL_ADDR A:0xfc4019c0
y.create.l HWIO_GCC_USB_BOOT_CLOCK_CTL_ADDR A:0xfc401a00
y.create.l HWIO_GCC_PCIE_BOOT_CLOCK_CTL_ADDR A:0xfc401b40
y.create.l HWIO_GCC_QPIC_BCR_ADDR A:0xfc401a40
y.create.l HWIO_GCC_QPIC_CMD_RCGR_ADDR A:0xfc401a50
y.create.l HWIO_GCC_QPIC_CFG_RCGR_ADDR A:0xfc401a54
y.create.l HWIO_GCC_QPIC_M_ADDR A:0xfc401a58
y.create.l HWIO_GCC_QPIC_N_ADDR A:0xfc401a5c
y.create.l HWIO_GCC_QPIC_D_ADDR A:0xfc401a60
y.create.l HWIO_GCC_QPIC_CBCR_ADDR A:0xfc401a44
y.create.l HWIO_GCC_QPIC_AHB_CBCR_ADDR A:0xfc401a48
y.create.l HWIO_GCC_QPIC_SYSTEM_CBCR_ADDR A:0xfc401a4c
y.create.l HWIO_GCC_IPA_BCR_ADDR A:0xfc401a80
y.create.l HWIO_GCC_IPA_CMD_RCGR_ADDR A:0xfc401a90
y.create.l HWIO_GCC_IPA_CFG_RCGR_ADDR A:0xfc401a94
y.create.l HWIO_GCC_IPA_M_ADDR A:0xfc401a98
y.create.l HWIO_GCC_IPA_N_ADDR A:0xfc401a9c
y.create.l HWIO_GCC_IPA_D_ADDR A:0xfc401aa0
y.create.l HWIO_GCC_IPA_CBCR_ADDR A:0xfc401a84
y.create.l HWIO_GCC_IPA_CNOC_CBCR_ADDR A:0xfc401a88
y.create.l HWIO_GCC_IPA_SLEEP_CBCR_ADDR A:0xfc401a8c
y.create.l HWIO_GCC_IPA_GDSCR_ADDR A:0xfc401aa8
y.create.l HWIO_GCC_DCS_BCR_ADDR A:0xfc401ac0
y.create.l HWIO_GCC_DCS_CBCR_ADDR A:0xfc401ac4
y.create.l HWIO_GCC_RAW_SLEEP_CLK_CTRL_ADDR A:0xfc401fc0
y.create.l HWIO_GCC_PCIE_BCR_ADDR A:0xfc401c00
y.create.l HWIO_GCC_PCIE_CFG_AHB_CBCR_ADDR A:0xfc401c04
y.create.l HWIO_GCC_PCIE_PIPE_CBCR_ADDR A:0xfc401c08
y.create.l HWIO_GCC_PCIE_AXI_CBCR_ADDR A:0xfc401c0c
y.create.l HWIO_GCC_PCIE_SLEEP_CBCR_ADDR A:0xfc401c10
y.create.l HWIO_GCC_PCIE_AXI_MSTR_CBCR_ADDR A:0xfc401c2c
y.create.l HWIO_GCC_PCIE_PIPE_CMD_RCGR_ADDR A:0xfc401c14
y.create.l HWIO_GCC_PCIE_PIPE_CFG_RCGR_ADDR A:0xfc401c18
y.create.l HWIO_GCC_PCIE_AUX_CMD_RCGR_ADDR A:0xfc401e00
y.create.l HWIO_GCC_PCIE_AUX_CFG_RCGR_ADDR A:0xfc401e04
y.create.l HWIO_GCC_PCIE_AUX_M_ADDR A:0xfc401e08
y.create.l HWIO_GCC_PCIE_AUX_N_ADDR A:0xfc401e0c
y.create.l HWIO_GCC_PCIE_AUX_D_ADDR A:0xfc401e10
y.create.l HWIO_GCC_USB_30_GDSCR_ADDR A:0xfc401b80
y.create.l HWIO_GCC_PCIE_GDSCR_ADDR A:0xfc401e18
y.create.l HWIO_GCC_PCIEPHY_PHY_BCR_ADDR A:0xfc401e1c
y.create.l HWIO_GCC_RBCPR_MX_BCR_ADDR A:0xfc401b00
y.create.l HWIO_GCC_RBCPR_MX_CBCR_ADDR A:0xfc401b04
y.create.l HWIO_GCC_RBCPR_MX_AHB_CBCR_ADDR A:0xfc401b08
y.create.l HWIO_GCC_RBCPR_MX_CMD_RCGR_ADDR A:0xfc401b0c
y.create.l HWIO_GCC_RBCPR_MX_CFG_RCGR_ADDR A:0xfc401b10
y.create.l HWIO_GCC_PCIE_GPIO_LDO_EN_ADDR A:0xfc401e40
y.create.l HWIO_GCC_USB_SS_LDO_EN_ADDR A:0xfc401e44
y.create.l HWIO_GCC_USB_PHY_CFG_AHB_CBCR_ADDR A:0xfc401b84
y.create.l HWIO_GCC_SNOC_DCD_CONFIG_ADDR A:0xfc401ac8
y.create.l HWIO_GCC_SNOC_DCD_HYSTERESIS_CNT_ADDR A:0xfc401acc
y.create.l HWIO_GCC_CNOC_DCD_CONFIG_ADDR A:0xfc401ad0
y.create.l HWIO_GCC_CNOC_DCD_HYSTERESIS_CNT_ADDR A:0xfc401ad4
y.create.l HWIO_GCC_PNOC_DCD_CONFIG_ADDR A:0xfc401ad8
y.create.l HWIO_GCC_PNOC_DCD_HYSTERESIS_CNT_ADDR A:0xfc401adc
y.create.l HWIO_GCC_RPU_XPU_SCR_ADDR A:0xfc410000
y.create.l HWIO_GCC_RPU_XPU_SWDR_ADDR A:0xfc410004
y.create.l HWIO_GCC_RPU_XPU_SEAR0_ADDR A:0xfc410040
y.create.l HWIO_GCC_RPU_XPU_SESR_ADDR A:0xfc410048
y.create.l HWIO_GCC_RPU_XPU_SESRRESTORE_ADDR A:0xfc41004c
y.create.l HWIO_GCC_RPU_XPU_SESYNR0_ADDR A:0xfc410050
y.create.l HWIO_GCC_RPU_XPU_SESYNR1_ADDR A:0xfc410054
y.create.l HWIO_GCC_RPU_XPU_SESYNR2_ADDR A:0xfc410058
y.create.l HWIO_GCC_RPU_XPU_MCR_ADDR A:0xfc410100
y.create.l HWIO_GCC_RPU_XPU_MEAR0_ADDR A:0xfc410140
y.create.l HWIO_GCC_RPU_XPU_MESR_ADDR A:0xfc410148
y.create.l HWIO_GCC_RPU_XPU_MESRRESTORE_ADDR A:0xfc41014c
y.create.l HWIO_GCC_RPU_XPU_MESYNR0_ADDR A:0xfc410150
y.create.l HWIO_GCC_RPU_XPU_MESYNR1_ADDR A:0xfc410154
y.create.l HWIO_GCC_RPU_XPU_MESYNR2_ADDR A:0xfc410158
y.create.l HWIO_GCC_RPU_XPU_CR_ADDR A:0xfc410080
y.create.l HWIO_GCC_RPU_XPU_RPU_ACR0_ADDR A:0xfc4100a0
y.create.l HWIO_GCC_RPU_XPU_EAR0_ADDR A:0xfc4100c0
y.create.l HWIO_GCC_RPU_XPU_ESR_ADDR A:0xfc4100c8
y.create.l HWIO_GCC_RPU_XPU_ESRRESTORE_ADDR A:0xfc4100cc
y.create.l HWIO_GCC_RPU_XPU_ESYNR0_ADDR A:0xfc4100d0
y.create.l HWIO_GCC_RPU_XPU_ESYNR1_ADDR A:0xfc4100d4
y.create.l HWIO_GCC_RPU_XPU_ESYNR2_ADDR A:0xfc4100d8
y.create.l HWIO_GCC_RPU_XPU_IDR0_ADDR A:0xfc410074
y.create.l HWIO_GCC_RPU_XPU_IDR1_ADDR A:0xfc410078
y.create.l HWIO_GCC_RPU_XPU_REV_ADDR A:0xfc41007c
y.create.l HWIO_GCC_RPU_XPU_RG0_RACR0_ADDR A:0xfc410200
y.create.l HWIO_GCC_RPU_XPU_RG1_RACR0_ADDR A:0xfc410280
y.create.l HWIO_GCC_RPU_XPU_RG2_RACR0_ADDR A:0xfc410300
y.create.l HWIO_GCC_RPU_XPU_RG3_RACR0_ADDR A:0xfc410380
y.create.l HWIO_GCC_RPU_XPU_RG4_RACR0_ADDR A:0xfc410400
y.create.l HWIO_GCC_RPU_XPU_RG5_RACR0_ADDR A:0xfc410480
y.create.l HWIO_GCC_RPU_XPU_RG6_RACR0_ADDR A:0xfc410500
y.create.l HWIO_GCC_RPU_XPU_RG7_RACR0_ADDR A:0xfc410580
y.create.l HWIO_GCC_RPU_XPU_RG8_RACR0_ADDR A:0xfc410600
y.create.l HWIO_GCC_RPU_XPU_RG9_RACR0_ADDR A:0xfc410680
y.create.l HWIO_GCC_RPU_XPU_RG0_SCR_ADDR A:0xfc410250
y.create.l HWIO_GCC_RPU_XPU_RG1_SCR_ADDR A:0xfc4102d0
y.create.l HWIO_GCC_RPU_XPU_RG2_SCR_ADDR A:0xfc410350
y.create.l HWIO_GCC_RPU_XPU_RG3_SCR_ADDR A:0xfc4103d0
y.create.l HWIO_GCC_RPU_XPU_RG4_SCR_ADDR A:0xfc410450
y.create.l HWIO_GCC_RPU_XPU_RG5_SCR_ADDR A:0xfc4104d0
y.create.l HWIO_GCC_RPU_XPU_RG6_SCR_ADDR A:0xfc410550
y.create.l HWIO_GCC_RPU_XPU_RG7_SCR_ADDR A:0xfc4105d0
y.create.l HWIO_GCC_RPU_XPU_RG8_SCR_ADDR A:0xfc410650
y.create.l HWIO_GCC_RPU_XPU_RG9_SCR_ADDR A:0xfc4106d0
y.create.l HWIO_GCC_RPU_XPU_RG0_MCR_ADDR A:0xfc410254
y.create.l HWIO_GCC_RPU_XPU_RG1_MCR_ADDR A:0xfc4102d4
y.create.l HWIO_GCC_RPU_XPU_RG2_MCR_ADDR A:0xfc410354
y.create.l HWIO_GCC_RPU_XPU_RG3_MCR_ADDR A:0xfc4103d4
y.create.l HWIO_GCC_RPU_XPU_RG4_MCR_ADDR A:0xfc410454
y.create.l HWIO_GCC_RPU_XPU_RG5_MCR_ADDR A:0xfc4104d4
y.create.l HWIO_GCC_RPU_XPU_RG6_MCR_ADDR A:0xfc410554
y.create.l HWIO_GCC_RPU_XPU_RG7_MCR_ADDR A:0xfc4105d4
y.create.l HWIO_GCC_RPU_XPU_RG8_MCR_ADDR A:0xfc410654
y.create.l HWIO_GCC_RPU_XPU_RG9_MCR_ADDR A:0xfc4106d4
y.create.l HWIO_CNOC_0_ABT_HW_VERSION_ADDR A:0xfc448000
y.create.l HWIO_CNOC_0_ABT_INST_ID_ADDR A:0xfc448004
y.create.l HWIO_CNOC_0_ABT_NUM_SLAVES_ADDR A:0xfc448008
y.create.l HWIO_CNOC_0_ABT_TIMER_LOADVAL_ADDR A:0xfc44800c
y.create.l HWIO_CNOC_0_ABT_TIMER_MODE_ADDR A:0xfc448010
y.create.l HWIO_CNOC_0_ABT_INTR_STATUS_ADDR A:0xfc448014
y.create.l HWIO_CNOC_0_ABT_INTR_CLEAR_ADDR A:0xfc448018
y.create.l HWIO_CNOC_0_ABT_INTR_ENABLE_ADDR A:0xfc44801c
y.create.l HWIO_CNOC_0_ABT_SYND_VALID_ADDR A:0xfc448020
y.create.l HWIO_CNOC_0_ABT_SYND_CLEAR_ADDR A:0xfc448024
y.create.l HWIO_CNOC_0_ABT_SYND_ID_ADDR A:0xfc448028
y.create.l HWIO_CNOC_0_ABT_SYND_ADDR0_ADDR A:0xfc44802c
y.create.l HWIO_CNOC_0_ABT_SYND_ADDR1_ADDR A:0xfc448030
y.create.l HWIO_CNOC_0_ABT_SYND_HREADY_ADDR A:0xfc448034
y.create.l HWIO_CNOC_1_ABT_HW_VERSION_ADDR A:0xfc449000
y.create.l HWIO_CNOC_1_ABT_INST_ID_ADDR A:0xfc449004
y.create.l HWIO_CNOC_1_ABT_NUM_SLAVES_ADDR A:0xfc449008
y.create.l HWIO_CNOC_1_ABT_TIMER_LOADVAL_ADDR A:0xfc44900c
y.create.l HWIO_CNOC_1_ABT_TIMER_MODE_ADDR A:0xfc449010
y.create.l HWIO_CNOC_1_ABT_INTR_STATUS_ADDR A:0xfc449014
y.create.l HWIO_CNOC_1_ABT_INTR_CLEAR_ADDR A:0xfc449018
y.create.l HWIO_CNOC_1_ABT_INTR_ENABLE_ADDR A:0xfc44901c
y.create.l HWIO_CNOC_1_ABT_SYND_VALID_ADDR A:0xfc449020
y.create.l HWIO_CNOC_1_ABT_SYND_CLEAR_ADDR A:0xfc449024
y.create.l HWIO_CNOC_1_ABT_SYND_ID_ADDR A:0xfc449028
y.create.l HWIO_CNOC_1_ABT_SYND_ADDR0_ADDR A:0xfc44902c
y.create.l HWIO_CNOC_1_ABT_SYND_ADDR1_ADDR A:0xfc449030
y.create.l HWIO_CNOC_1_ABT_SYND_HREADY_ADDR A:0xfc449034
y.create.l HWIO_CNOC_2_ABT_HW_VERSION_ADDR A:0xfc44a000
y.create.l HWIO_CNOC_2_ABT_INST_ID_ADDR A:0xfc44a004
y.create.l HWIO_CNOC_2_ABT_NUM_SLAVES_ADDR A:0xfc44a008
y.create.l HWIO_CNOC_2_ABT_TIMER_LOADVAL_ADDR A:0xfc44a00c
y.create.l HWIO_CNOC_2_ABT_TIMER_MODE_ADDR A:0xfc44a010
y.create.l HWIO_CNOC_2_ABT_INTR_STATUS_ADDR A:0xfc44a014
y.create.l HWIO_CNOC_2_ABT_INTR_CLEAR_ADDR A:0xfc44a018
y.create.l HWIO_CNOC_2_ABT_INTR_ENABLE_ADDR A:0xfc44a01c
y.create.l HWIO_CNOC_2_ABT_SYND_VALID_ADDR A:0xfc44a020
y.create.l HWIO_CNOC_2_ABT_SYND_CLEAR_ADDR A:0xfc44a024
y.create.l HWIO_CNOC_2_ABT_SYND_ID_ADDR A:0xfc44a028
y.create.l HWIO_CNOC_2_ABT_SYND_ADDR0_ADDR A:0xfc44a02c
y.create.l HWIO_CNOC_2_ABT_SYND_ADDR1_ADDR A:0xfc44a030
y.create.l HWIO_CNOC_2_ABT_SYND_HREADY_ADDR A:0xfc44a034
y.create.l HWIO_CNOC_3_ABT_HW_VERSION_ADDR A:0xfc44b000
y.create.l HWIO_CNOC_3_ABT_INST_ID_ADDR A:0xfc44b004
y.create.l HWIO_CNOC_3_ABT_NUM_SLAVES_ADDR A:0xfc44b008
y.create.l HWIO_CNOC_3_ABT_TIMER_LOADVAL_ADDR A:0xfc44b00c
y.create.l HWIO_CNOC_3_ABT_TIMER_MODE_ADDR A:0xfc44b010
y.create.l HWIO_CNOC_3_ABT_INTR_STATUS_ADDR A:0xfc44b014
y.create.l HWIO_CNOC_3_ABT_INTR_CLEAR_ADDR A:0xfc44b018
y.create.l HWIO_CNOC_3_ABT_INTR_ENABLE_ADDR A:0xfc44b01c
y.create.l HWIO_CNOC_3_ABT_SYND_VALID_ADDR A:0xfc44b020
y.create.l HWIO_CNOC_3_ABT_SYND_CLEAR_ADDR A:0xfc44b024
y.create.l HWIO_CNOC_3_ABT_SYND_ID_ADDR A:0xfc44b028
y.create.l HWIO_CNOC_3_ABT_SYND_ADDR0_ADDR A:0xfc44b02c
y.create.l HWIO_CNOC_3_ABT_SYND_ADDR1_ADDR A:0xfc44b030
y.create.l HWIO_CNOC_3_ABT_SYND_HREADY_ADDR A:0xfc44b034
y.create.l HWIO_CNOC_4_ABT_HW_VERSION_ADDR A:0xfc44c000
y.create.l HWIO_CNOC_4_ABT_INST_ID_ADDR A:0xfc44c004
y.create.l HWIO_CNOC_4_ABT_NUM_SLAVES_ADDR A:0xfc44c008
y.create.l HWIO_CNOC_4_ABT_TIMER_LOADVAL_ADDR A:0xfc44c00c
y.create.l HWIO_CNOC_4_ABT_TIMER_MODE_ADDR A:0xfc44c010
y.create.l HWIO_CNOC_4_ABT_INTR_STATUS_ADDR A:0xfc44c014
y.create.l HWIO_CNOC_4_ABT_INTR_CLEAR_ADDR A:0xfc44c018
y.create.l HWIO_CNOC_4_ABT_INTR_ENABLE_ADDR A:0xfc44c01c
y.create.l HWIO_CNOC_4_ABT_SYND_VALID_ADDR A:0xfc44c020
y.create.l HWIO_CNOC_4_ABT_SYND_CLEAR_ADDR A:0xfc44c024
y.create.l HWIO_CNOC_4_ABT_SYND_ID_ADDR A:0xfc44c028
y.create.l HWIO_CNOC_4_ABT_SYND_ADDR0_ADDR A:0xfc44c02c
y.create.l HWIO_CNOC_4_ABT_SYND_ADDR1_ADDR A:0xfc44c030
y.create.l HWIO_CNOC_4_ABT_SYND_HREADY_ADDR A:0xfc44c034
y.create.l HWIO_CNOC_5_ABT_HW_VERSION_ADDR A:0xfc44d000
y.create.l HWIO_CNOC_5_ABT_INST_ID_ADDR A:0xfc44d004
y.create.l HWIO_CNOC_5_ABT_NUM_SLAVES_ADDR A:0xfc44d008
y.create.l HWIO_CNOC_5_ABT_TIMER_LOADVAL_ADDR A:0xfc44d00c
y.create.l HWIO_CNOC_5_ABT_TIMER_MODE_ADDR A:0xfc44d010
y.create.l HWIO_CNOC_5_ABT_INTR_STATUS_ADDR A:0xfc44d014
y.create.l HWIO_CNOC_5_ABT_INTR_CLEAR_ADDR A:0xfc44d018
y.create.l HWIO_CNOC_5_ABT_INTR_ENABLE_ADDR A:0xfc44d01c
y.create.l HWIO_CNOC_5_ABT_SYND_VALID_ADDR A:0xfc44d020
y.create.l HWIO_CNOC_5_ABT_SYND_CLEAR_ADDR A:0xfc44d024
y.create.l HWIO_CNOC_5_ABT_SYND_ID_ADDR A:0xfc44d028
y.create.l HWIO_CNOC_5_ABT_SYND_ADDR0_ADDR A:0xfc44d02c
y.create.l HWIO_CNOC_5_ABT_SYND_ADDR1_ADDR A:0xfc44d030
y.create.l HWIO_CNOC_5_ABT_SYND_HREADY_ADDR A:0xfc44d034
y.create.l HWIO_CNOC_6_ABT_HW_VERSION_ADDR A:0xfc44e000
y.create.l HWIO_CNOC_6_ABT_INST_ID_ADDR A:0xfc44e004
y.create.l HWIO_CNOC_6_ABT_NUM_SLAVES_ADDR A:0xfc44e008
y.create.l HWIO_CNOC_6_ABT_TIMER_LOADVAL_ADDR A:0xfc44e00c
y.create.l HWIO_CNOC_6_ABT_TIMER_MODE_ADDR A:0xfc44e010
y.create.l HWIO_CNOC_6_ABT_INTR_STATUS_ADDR A:0xfc44e014
y.create.l HWIO_CNOC_6_ABT_INTR_CLEAR_ADDR A:0xfc44e018
y.create.l HWIO_CNOC_6_ABT_INTR_ENABLE_ADDR A:0xfc44e01c
y.create.l HWIO_CNOC_6_ABT_SYND_VALID_ADDR A:0xfc44e020
y.create.l HWIO_CNOC_6_ABT_SYND_CLEAR_ADDR A:0xfc44e024
y.create.l HWIO_CNOC_6_ABT_SYND_ID_ADDR A:0xfc44e028
y.create.l HWIO_CNOC_6_ABT_SYND_ADDR0_ADDR A:0xfc44e02c
y.create.l HWIO_CNOC_6_ABT_SYND_ADDR1_ADDR A:0xfc44e030
y.create.l HWIO_CNOC_6_ABT_SYND_HREADY_ADDR A:0xfc44e034
y.create.l HWIO_CNOC_OBS_ID_COREID_ADDR A:0xfc480000
y.create.l HWIO_CNOC_OBS_ID_REVISIONID_ADDR A:0xfc480004
y.create.l HWIO_CNOC_OBS_FAULTEN_ADDR A:0xfc480008
y.create.l HWIO_CNOC_OBS_ERRVLD_ADDR A:0xfc48000c
y.create.l HWIO_CNOC_OBS_ERRCLR_ADDR A:0xfc480010
y.create.l HWIO_CNOC_OBS_ERRLOG0_ADDR A:0xfc480014
y.create.l HWIO_CNOC_OBS_ERRLOG1_ADDR A:0xfc480018
y.create.l HWIO_CNOC_OBS_ERRLOG3_ADDR A:0xfc480020
y.create.l HWIO_CNOC_OBS_ERRLOG4_ADDR A:0xfc480024
y.create.l HWIO_CNOC_OBS_ERRLOG5_ADDR A:0xfc480028
y.create.l HWIO_TCSR_MUTEX_XPU_SCR_ADDR A:0xfd480000
y.create.l HWIO_TCSR_MUTEX_XPU_SWDR_ADDR A:0xfd480004
y.create.l HWIO_TCSR_MUTEX_XPU_SEAR0_ADDR A:0xfd480040
y.create.l HWIO_TCSR_MUTEX_XPU_SESR_ADDR A:0xfd480048
y.create.l HWIO_TCSR_MUTEX_XPU_SESRRESTORE_ADDR A:0xfd48004c
y.create.l HWIO_TCSR_MUTEX_XPU_SESYNR0_ADDR A:0xfd480050
y.create.l HWIO_TCSR_MUTEX_XPU_SESYNR1_ADDR A:0xfd480054
y.create.l HWIO_TCSR_MUTEX_XPU_SESYNR2_ADDR A:0xfd480058
y.create.l HWIO_TCSR_MUTEX_XPU_MCR_ADDR A:0xfd480100
y.create.l HWIO_TCSR_MUTEX_XPU_MEAR0_ADDR A:0xfd480140
y.create.l HWIO_TCSR_MUTEX_XPU_MESR_ADDR A:0xfd480148
y.create.l HWIO_TCSR_MUTEX_XPU_MESRRESTORE_ADDR A:0xfd48014c
y.create.l HWIO_TCSR_MUTEX_XPU_MESYNR0_ADDR A:0xfd480150
y.create.l HWIO_TCSR_MUTEX_XPU_MESYNR1_ADDR A:0xfd480154
y.create.l HWIO_TCSR_MUTEX_XPU_MESYNR2_ADDR A:0xfd480158
y.create.l HWIO_TCSR_MUTEX_XPU_CR_ADDR A:0xfd480080
y.create.l HWIO_TCSR_MUTEX_XPU_RPU_ACR0_ADDR A:0xfd4800a0
y.create.l HWIO_TCSR_MUTEX_XPU_EAR0_ADDR A:0xfd4800c0
y.create.l HWIO_TCSR_MUTEX_XPU_ESR_ADDR A:0xfd4800c8
y.create.l HWIO_TCSR_MUTEX_XPU_ESRRESTORE_ADDR A:0xfd4800cc
y.create.l HWIO_TCSR_MUTEX_XPU_ESYNR0_ADDR A:0xfd4800d0
y.create.l HWIO_TCSR_MUTEX_XPU_ESYNR1_ADDR A:0xfd4800d4
y.create.l HWIO_TCSR_MUTEX_XPU_ESYNR2_ADDR A:0xfd4800d8
y.create.l HWIO_TCSR_MUTEX_XPU_IDR0_ADDR A:0xfd480074
y.create.l HWIO_TCSR_MUTEX_XPU_IDR1_ADDR A:0xfd480078
y.create.l HWIO_TCSR_MUTEX_XPU_REV_ADDR A:0xfd48007c
y.create.l HWIO_TCSR_MUTEX_XPU_RG0_RACR0_ADDR A:0xfd480200
y.create.l HWIO_TCSR_MUTEX_XPU_RG1_RACR0_ADDR A:0xfd480280
y.create.l HWIO_TCSR_MUTEX_XPU_RG2_RACR0_ADDR A:0xfd480300
y.create.l HWIO_TCSR_MUTEX_XPU_RG3_RACR0_ADDR A:0xfd480380
y.create.l HWIO_TCSR_MUTEX_XPU_RG4_RACR0_ADDR A:0xfd480400
y.create.l HWIO_TCSR_MUTEX_XPU_RG5_RACR0_ADDR A:0xfd480480
y.create.l HWIO_TCSR_MUTEX_XPU_RG6_RACR0_ADDR A:0xfd480500
y.create.l HWIO_TCSR_MUTEX_XPU_RG7_RACR0_ADDR A:0xfd480580
y.create.l HWIO_TCSR_MUTEX_XPU_RG8_RACR0_ADDR A:0xfd480600
y.create.l HWIO_TCSR_MUTEX_XPU_RG9_RACR0_ADDR A:0xfd480680
y.create.l HWIO_TCSR_MUTEX_XPU_RG0_WACR0_ADDR A:0xfd480220
y.create.l HWIO_TCSR_MUTEX_XPU_RG1_WACR0_ADDR A:0xfd4802a0
y.create.l HWIO_TCSR_MUTEX_XPU_RG2_WACR0_ADDR A:0xfd480320
y.create.l HWIO_TCSR_MUTEX_XPU_RG3_WACR0_ADDR A:0xfd4803a0
y.create.l HWIO_TCSR_MUTEX_XPU_RG4_WACR0_ADDR A:0xfd480420
y.create.l HWIO_TCSR_MUTEX_XPU_RG5_WACR0_ADDR A:0xfd4804a0
y.create.l HWIO_TCSR_MUTEX_XPU_RG6_WACR0_ADDR A:0xfd480520
y.create.l HWIO_TCSR_MUTEX_XPU_RG7_WACR0_ADDR A:0xfd4805a0
y.create.l HWIO_TCSR_MUTEX_XPU_RG8_WACR0_ADDR A:0xfd480620
y.create.l HWIO_TCSR_MUTEX_XPU_RG9_WACR0_ADDR A:0xfd4806a0
y.create.l HWIO_TCSR_MUTEX_XPU_RG0_SCR_ADDR A:0xfd480250
y.create.l HWIO_TCSR_MUTEX_XPU_RG1_SCR_ADDR A:0xfd4802d0
y.create.l HWIO_TCSR_MUTEX_XPU_RG2_SCR_ADDR A:0xfd480350
y.create.l HWIO_TCSR_MUTEX_XPU_RG3_SCR_ADDR A:0xfd4803d0
y.create.l HWIO_TCSR_MUTEX_XPU_RG4_SCR_ADDR A:0xfd480450
y.create.l HWIO_TCSR_MUTEX_XPU_RG5_SCR_ADDR A:0xfd4804d0
y.create.l HWIO_TCSR_MUTEX_XPU_RG6_SCR_ADDR A:0xfd480550
y.create.l HWIO_TCSR_MUTEX_XPU_RG7_SCR_ADDR A:0xfd4805d0
y.create.l HWIO_TCSR_MUTEX_XPU_RG8_SCR_ADDR A:0xfd480650
y.create.l HWIO_TCSR_MUTEX_XPU_RG9_SCR_ADDR A:0xfd4806d0
y.create.l HWIO_TCSR_MUTEX_XPU_RG0_MCR_ADDR A:0xfd480254
y.create.l HWIO_TCSR_MUTEX_XPU_RG1_MCR_ADDR A:0xfd4802d4
y.create.l HWIO_TCSR_MUTEX_XPU_RG2_MCR_ADDR A:0xfd480354
y.create.l HWIO_TCSR_MUTEX_XPU_RG3_MCR_ADDR A:0xfd4803d4
y.create.l HWIO_TCSR_MUTEX_XPU_RG4_MCR_ADDR A:0xfd480454
y.create.l HWIO_TCSR_MUTEX_XPU_RG5_MCR_ADDR A:0xfd4804d4
y.create.l HWIO_TCSR_MUTEX_XPU_RG6_MCR_ADDR A:0xfd480554
y.create.l HWIO_TCSR_MUTEX_XPU_RG7_MCR_ADDR A:0xfd4805d4
y.create.l HWIO_TCSR_MUTEX_XPU_RG8_MCR_ADDR A:0xfd480654
y.create.l HWIO_TCSR_MUTEX_XPU_RG9_MCR_ADDR A:0xfd4806d4
y.create.l HWIO_TCSR_MUTEX_REG_0_ADDR A:0xfd484000
y.create.l HWIO_TCSR_MUTEX_REG_1_ADDR A:0xfd484080
y.create.l HWIO_TCSR_MUTEX_REG_2_ADDR A:0xfd484100
y.create.l HWIO_TCSR_MUTEX_REG_3_ADDR A:0xfd484180
y.create.l HWIO_TCSR_MUTEX_REG_4_ADDR A:0xfd484200
y.create.l HWIO_TCSR_MUTEX_REG_5_ADDR A:0xfd484280
y.create.l HWIO_TCSR_MUTEX_REG_6_ADDR A:0xfd484300
y.create.l HWIO_TCSR_MUTEX_REG_7_ADDR A:0xfd484380
y.create.l HWIO_TCSR_MUTEX_REG_8_ADDR A:0xfd484400
y.create.l HWIO_TCSR_MUTEX_REG_9_ADDR A:0xfd484480
y.create.l HWIO_TCSR_CRYPTO0_HALTREQ_ADDR A:0xfd485000
y.create.l HWIO_TCSR_CRYPTO0_HALTACK_ADDR A:0xfd485004
y.create.l HWIO_TCSR_CRYPTO0_MASTER_IDLE_ADDR A:0xfd485008
y.create.l HWIO_TCSR_CRYPTO1_HALTREQ_ADDR A:0xfd485080
y.create.l HWIO_TCSR_CRYPTO1_HALTACK_ADDR A:0xfd485084
y.create.l HWIO_TCSR_CRYPTO1_MASTER_IDLE_ADDR A:0xfd485088
y.create.l HWIO_TCSR_LPASS_HALTREQ_ADDR A:0xfd485100
y.create.l HWIO_TCSR_LPASS_HALTACK_ADDR A:0xfd485104
y.create.l HWIO_TCSR_LPASS_MASTER_IDLE_ADDR A:0xfd485108
y.create.l HWIO_TCSR_LPASSQ6_POWER_STATE_ADDR A:0xfd485110
y.create.l HWIO_TCSR_MSSQ6_HALTREQ_ADDR A:0xfd485180
y.create.l HWIO_TCSR_MSSQ6_HALTACK_ADDR A:0xfd485184
y.create.l HWIO_TCSR_MSSQ6_MASTER_IDLE_ADDR A:0xfd485188
y.create.l HWIO_TCSR_MSSQ6_POWER_STATE_ADDR A:0xfd485190
y.create.l HWIO_TCSR_MSS_MODEM_HALTREQ_ADDR A:0xfd485200
y.create.l HWIO_TCSR_MSS_MODEM_HALTACK_ADDR A:0xfd485204
y.create.l HWIO_TCSR_MSS_MODEM_MASTER_IDLE_ADDR A:0xfd485208
y.create.l HWIO_TCSR_MSS_NC_HALTREQ_ADDR A:0xfd485280
y.create.l HWIO_TCSR_MSS_NC_HALTACK_ADDR A:0xfd485284
y.create.l HWIO_TCSR_MSS_NC_MASTER_IDLE_ADDR A:0xfd485288
y.create.l HWIO_TCSR_WCSS_HALTREQ_ADDR A:0xfd485300
y.create.l HWIO_TCSR_WCSS_HALTACK_ADDR A:0xfd485304
y.create.l HWIO_TCSR_WCSS_MASTER_IDLE_ADDR A:0xfd485308
y.create.l HWIO_TCSR_MUTEX_REG_RESET_ADDR A:0xfd485380
y.create.l HWIO_TCSR_IPA_HALTREQ_ADDR A:0xfd485400
y.create.l HWIO_TCSR_IPA_HALTACK_ADDR A:0xfd485404
y.create.l HWIO_TCSR_LPASS_CORE_HALTREQ_ADDR A:0xfd485480
y.create.l HWIO_TCSR_LPASS_CORE_HALTACK_ADDR A:0xfd485484
y.create.l HWIO_TCSR_LPASS_CORE_MASTER_IDLE_ADDR A:0xfd485488
y.create.l HWIO_TCSR_REGS_XPU_SCR_ADDR A:0xfd498000
y.create.l HWIO_TCSR_REGS_XPU_SWDR_ADDR A:0xfd498004
y.create.l HWIO_TCSR_REGS_XPU_SEAR0_ADDR A:0xfd498040
y.create.l HWIO_TCSR_REGS_XPU_SESR_ADDR A:0xfd498048
y.create.l HWIO_TCSR_REGS_XPU_SESRRESTORE_ADDR A:0xfd49804c
y.create.l HWIO_TCSR_REGS_XPU_SESYNR0_ADDR A:0xfd498050
y.create.l HWIO_TCSR_REGS_XPU_SESYNR1_ADDR A:0xfd498054
y.create.l HWIO_TCSR_REGS_XPU_SESYNR2_ADDR A:0xfd498058
y.create.l HWIO_TCSR_REGS_XPU_MCR_ADDR A:0xfd498100
y.create.l HWIO_TCSR_REGS_XPU_MEAR0_ADDR A:0xfd498140
y.create.l HWIO_TCSR_REGS_XPU_MESR_ADDR A:0xfd498148
y.create.l HWIO_TCSR_REGS_XPU_MESRRESTORE_ADDR A:0xfd49814c
y.create.l HWIO_TCSR_REGS_XPU_MESYNR0_ADDR A:0xfd498150
y.create.l HWIO_TCSR_REGS_XPU_MESYNR1_ADDR A:0xfd498154
y.create.l HWIO_TCSR_REGS_XPU_MESYNR2_ADDR A:0xfd498158
y.create.l HWIO_TCSR_REGS_XPU_CR_ADDR A:0xfd498080
y.create.l HWIO_TCSR_REGS_XPU_RPU_ACR0_ADDR A:0xfd4980a0
y.create.l HWIO_TCSR_REGS_XPU_EAR0_ADDR A:0xfd4980c0
y.create.l HWIO_TCSR_REGS_XPU_ESR_ADDR A:0xfd4980c8
y.create.l HWIO_TCSR_REGS_XPU_ESRRESTORE_ADDR A:0xfd4980cc
y.create.l HWIO_TCSR_REGS_XPU_ESYNR0_ADDR A:0xfd4980d0
y.create.l HWIO_TCSR_REGS_XPU_ESYNR1_ADDR A:0xfd4980d4
y.create.l HWIO_TCSR_REGS_XPU_ESYNR2_ADDR A:0xfd4980d8
y.create.l HWIO_TCSR_REGS_XPU_IDR0_ADDR A:0xfd498074
y.create.l HWIO_TCSR_REGS_XPU_IDR1_ADDR A:0xfd498078
y.create.l HWIO_TCSR_REGS_XPU_REV_ADDR A:0xfd49807c
y.create.l HWIO_TCSR_REGS_XPU_RG0_RACR0_ADDR A:0xfd498200
y.create.l HWIO_TCSR_REGS_XPU_RG1_RACR0_ADDR A:0xfd498280
y.create.l HWIO_TCSR_REGS_XPU_RG2_RACR0_ADDR A:0xfd498300
y.create.l HWIO_TCSR_REGS_XPU_RG3_RACR0_ADDR A:0xfd498380
y.create.l HWIO_TCSR_REGS_XPU_RG4_RACR0_ADDR A:0xfd498400
y.create.l HWIO_TCSR_REGS_XPU_RG5_RACR0_ADDR A:0xfd498480
y.create.l HWIO_TCSR_REGS_XPU_RG6_RACR0_ADDR A:0xfd498500
y.create.l HWIO_TCSR_REGS_XPU_RG7_RACR0_ADDR A:0xfd498580
y.create.l HWIO_TCSR_REGS_XPU_RG8_RACR0_ADDR A:0xfd498600
y.create.l HWIO_TCSR_REGS_XPU_RG9_RACR0_ADDR A:0xfd498680
y.create.l HWIO_TCSR_REGS_XPU_RG0_WACR0_ADDR A:0xfd498220
y.create.l HWIO_TCSR_REGS_XPU_RG1_WACR0_ADDR A:0xfd4982a0
y.create.l HWIO_TCSR_REGS_XPU_RG2_WACR0_ADDR A:0xfd498320
y.create.l HWIO_TCSR_REGS_XPU_RG3_WACR0_ADDR A:0xfd4983a0
y.create.l HWIO_TCSR_REGS_XPU_RG4_WACR0_ADDR A:0xfd498420
y.create.l HWIO_TCSR_REGS_XPU_RG5_WACR0_ADDR A:0xfd4984a0
y.create.l HWIO_TCSR_REGS_XPU_RG6_WACR0_ADDR A:0xfd498520
y.create.l HWIO_TCSR_REGS_XPU_RG7_WACR0_ADDR A:0xfd4985a0
y.create.l HWIO_TCSR_REGS_XPU_RG8_WACR0_ADDR A:0xfd498620
y.create.l HWIO_TCSR_REGS_XPU_RG9_WACR0_ADDR A:0xfd4986a0
y.create.l HWIO_TCSR_REGS_XPU_RG0_SCR_ADDR A:0xfd498250
y.create.l HWIO_TCSR_REGS_XPU_RG1_SCR_ADDR A:0xfd4982d0
y.create.l HWIO_TCSR_REGS_XPU_RG2_SCR_ADDR A:0xfd498350
y.create.l HWIO_TCSR_REGS_XPU_RG3_SCR_ADDR A:0xfd4983d0
y.create.l HWIO_TCSR_REGS_XPU_RG4_SCR_ADDR A:0xfd498450
y.create.l HWIO_TCSR_REGS_XPU_RG5_SCR_ADDR A:0xfd4984d0
y.create.l HWIO_TCSR_REGS_XPU_RG6_SCR_ADDR A:0xfd498550
y.create.l HWIO_TCSR_REGS_XPU_RG7_SCR_ADDR A:0xfd4985d0
y.create.l HWIO_TCSR_REGS_XPU_RG8_SCR_ADDR A:0xfd498650
y.create.l HWIO_TCSR_REGS_XPU_RG9_SCR_ADDR A:0xfd4986d0
y.create.l HWIO_TCSR_REGS_XPU_RG0_MCR_ADDR A:0xfd498254
y.create.l HWIO_TCSR_REGS_XPU_RG1_MCR_ADDR A:0xfd4982d4
y.create.l HWIO_TCSR_REGS_XPU_RG2_MCR_ADDR A:0xfd498354
y.create.l HWIO_TCSR_REGS_XPU_RG3_MCR_ADDR A:0xfd4983d4
y.create.l HWIO_TCSR_REGS_XPU_RG4_MCR_ADDR A:0xfd498454
y.create.l HWIO_TCSR_REGS_XPU_RG5_MCR_ADDR A:0xfd4984d4
y.create.l HWIO_TCSR_REGS_XPU_RG6_MCR_ADDR A:0xfd498554
y.create.l HWIO_TCSR_REGS_XPU_RG7_MCR_ADDR A:0xfd4985d4
y.create.l HWIO_TCSR_REGS_XPU_RG8_MCR_ADDR A:0xfd498654
y.create.l HWIO_TCSR_REGS_XPU_RG9_MCR_ADDR A:0xfd4986d4
y.create.l HWIO_TCSR_KPSS_QRIB_XPU2_ADDR A:0xfd4a0080
y.create.l HWIO_TCSR_BIMC_CFG_QRIB_XPU2_INIT_ADDR A:0xfd4a0100
y.create.l HWIO_TCSR_BIMC_QXS0_QRIB_XPU2_INIT_ADDR A:0xfd4a0104
y.create.l HWIO_TCSR_BIMC_QXS1_QRIB_XPU2_INIT_ADDR A:0xfd4a0108
y.create.l HWIO_TCSR_LPASS_LPM_QRIB_XPU2_INIT_ADDR A:0xfd4a0180
y.create.l HWIO_TCSR_LPASS_LPC_CSR_QRIB_XPU2_INIT_ADDR A:0xfd4a0184
y.create.l HWIO_TCSR_LPASS_LPAIF_QRIB_XPU2_INIT_ADDR A:0xfd4a0188
y.create.l HWIO_TCSR_LPASS_RSMP_QRIB_XPU2_INIT_ADDR A:0xfd4a018c
y.create.l HWIO_TCSR_LPASS_LPC_COM_QRIB_XPU2_INIT_ADDR A:0xfd4a0190
y.create.l HWIO_TCSR_LPASS_SB_QRIB_XPU2_INIT_ADDR A:0xfd4a0194
y.create.l HWIO_TCSR_LPASS_AXIM_QRIB_XPU2_INIT_ADDR A:0xfd4a0198
y.create.l HWIO_TCSR_LPASS_CORE_AXIM_QRIB_XPU2_INIT_ADDR A:0xfd4a019c
y.create.l HWIO_TCSR_MPM_QDSS_QRIB_XPU2_INIT_ADDR A:0xfd4a0200
y.create.l HWIO_TCSR_MMSS_VENUS0_VBIF_QRIB_XPU2_INIT_ADDR A:0xfd4a0380
y.create.l HWIO_TCSR_MMSS_VENUS0_WRAPPER_QRIB_XPU2_INIT_ADDR A:0xfd4a0384
y.create.l HWIO_TCSR_MMSS_VFE_QRIB_XPU2_INIT_ADDR A:0xfd4a038c
y.create.l HWIO_TCSR_MMSS_JPEG_QRIB_XPU2_INIT_ADDR A:0xfd4a0390
y.create.l HWIO_TCSR_MMSS_MDP_QRIB_XPU2_INIT_ADDR A:0xfd4a0394
y.create.l HWIO_TCSR_MMSS_VENUS0_MMU_QRIB_NS_ADDR A:0xfd4a0400
y.create.l HWIO_TCSR_MMSS_VENUS0_MMU_QRIB_NS_EN_ADDR A:0xfd4a0404
y.create.l HWIO_TCSR_MMSS_VFE_MMU_QRIB_NS_ADDR A:0xfd4a0410
y.create.l HWIO_TCSR_MMSS_VFE_MMU_QRIB_NS_EN_ADDR A:0xfd4a0414
y.create.l HWIO_TCSR_MMSS_JPEG_MMU_QRIB_NS_ADDR A:0xfd4a0418
y.create.l HWIO_TCSR_MMSS_JPEG_MMU_QRIB_NS_EN_ADDR A:0xfd4a041c
y.create.l HWIO_TCSR_MMSS_MDP_MMU_QRIB_NS_ADDR A:0xfd4a0420
y.create.l HWIO_TCSR_MMSS_MDP_MMU_QRIB_NS_EN_ADDR A:0xfd4a0424
y.create.l HWIO_TCSR_MMSS_OXILI_MMU_QRIB_NS_ADDR A:0xfd4a0428
y.create.l HWIO_TCSR_MMSS_OXILI_MMU_QRIB_NS_EN_ADDR A:0xfd4a042c
y.create.l HWIO_TCSR_LPASS_AXIM_QRIB_SMMU_NS_ADDR A:0xfd4a0430
y.create.l HWIO_TCSR_LPASS_AXIM_QRIB_SMMU_NS_EN_ADDR A:0xfd4a0434
y.create.l HWIO_TCSR_LPASS_CORE_AXIM_QRIB_SMMU_NS_ADDR A:0xfd4a0438
y.create.l HWIO_TCSR_LPASS_CORE_AXIM_QRIB_SMMU_NS_EN_ADDR A:0xfd4a043c
y.create.l HWIO_TCSR_MMSS_OXILICX_QRIB_XPU2_INIT_ADDR A:0xfd4a0500
y.create.l HWIO_TCSR_MMSS_OXILI_VBIF_QRIB_XPU2_INIT_ADDR A:0xfd4a0504
y.create.l HWIO_TCSR_MMSS_OCMEM_DM_QRIB_XPU2_INIT_ADDR A:0xfd4a0600
y.create.l HWIO_TCSR_MMSS_OCMEM_QRIB_XPU2_INIT_ADDR A:0xfd4a0604
y.create.l HWIO_TCSR_MMSS_OCMEM_OSW0_QRIB_XPU2_INIT_ADDR A:0xfd4a0608
y.create.l HWIO_TCSR_MMSS_OCMEM_OSW1_QRIB_XPU2_INIT_ADDR A:0xfd4a060c
y.create.l HWIO_TCSR_MMSS_OCMEM_OSWDM_QRIB_XPU2_INIT_ADDR A:0xfd4a0610
y.create.l HWIO_TCSR_MMSS_OCMEM_OSWSYS_QRIB_XPU2_INIT_ADDR A:0xfd4a0614
y.create.l HWIO_TCSR_PHSS_USB1_HS_QRIB_XPU2_INIT_ADDR A:0xfd4a0700
y.create.l HWIO_TCSR_PHSS_USB2_HSIC_QRIB_XPU2_INIT_ADDR A:0xfd4a0704
y.create.l HWIO_TCSR_PHSS_BLSP1_QRIB_XPU2_INIT_ADDR A:0xfd4a0708
y.create.l HWIO_TCSR_PHSS_BLSP2_QRIB_XPU2_INIT_ADDR A:0xfd4a070c
y.create.l HWIO_TCSR_PHSS_TSIF_BAM_QRIB_XPU2_INIT_ADDR A:0xfd4a0710
y.create.l HWIO_TCSR_PHSS_BAM_DMA_QRIB_XPU2_INIT_ADDR A:0xfd4a0714
y.create.l HWIO_TCSR_PHSS_USB20_QRIB_XPU2_INIT_ADDR A:0xfd4a0718
y.create.l HWIO_TCSR_PHSS_USB30_QRIB_XPU2_INIT_ADDR A:0xfd4a071c
y.create.l HWIO_TCSR_TIMEOUT_SLAVE_GLB_EN_ADDR A:0xfd4a0800
y.create.l HWIO_TCSR_XPU_NSEN_STATUS_ADDR A:0xfd4a0820
y.create.l HWIO_TCSR_XPU_VMIDEN_STATUS_ADDR A:0xfd4a0824
y.create.l HWIO_TCSR_XPU_MSAEN_STATUS_ADDR A:0xfd4a0828
y.create.l HWIO_TCSR_IPA_BAM_XPU2_QRIB_XPU2_INIT_ADDR A:0xfd4a0900
y.create.l HWIO_TCSR_PCIE20_PARF_QRIB_XPU2_INIT_ADDR A:0xfd4a0904
y.create.l HWIO_TCSR_PCIE20_SLV_QRIB_XPU2_INIT_ADDR A:0xfd4a0908
y.create.l HWIO_TCSR_BIMC_CFG_QRIB_XPU2_ACR_ADDR A:0xfd4a1000
y.create.l HWIO_TCSR_BIMC_CFG_QRIB_XPU2_VMIDEN_INIT_ADDR A:0xfd4a1004
y.create.l HWIO_TCSR_BIMC_QXS0_QRIB_XPU2_ACR_ADDR A:0xfd4a1008
y.create.l HWIO_TCSR_BIMC_QXS0_QRIB_XPU2_VMIDEN_INIT_ADDR A:0xfd4a100c
y.create.l HWIO_TCSR_BIMC_QXS1_QRIB_XPU2_ACR_ADDR A:0xfd4a1010
y.create.l HWIO_TCSR_BIMC_QXS1_QRIB_XPU2_VMIDEN_INIT_ADDR A:0xfd4a1014
y.create.l HWIO_TCSR_LPASS_LPM_QRIB_XPU2_ACR_ADDR A:0xfd4a1180
y.create.l HWIO_TCSR_LPASS_LPM_QRIB_XPU2_VMIDEN_INIT_ADDR A:0xfd4a1184
y.create.l HWIO_TCSR_LPASS_LPC_CSR_QRIB_XPU2_ACR_ADDR A:0xfd4a1188
y.create.l HWIO_TCSR_LPASS_LPC_CSR_QRIB_XPU2_VMIDEN_INIT_ADDR A:0xfd4a118c
y.create.l HWIO_TCSR_LPASS_LPAIF_QRIB_XPU2_ACR_ADDR A:0xfd4a1190
y.create.l HWIO_TCSR_LPASS_LPAIF_QRIB_XPU2_VMIDEN_INIT_ADDR A:0xfd4a1194
y.create.l HWIO_TCSR_LPASS_RSMP_QRIB_XPU2_ACR_ADDR A:0xfd4a1198
y.create.l HWIO_TCSR_LPASS_RSMP_QRIB_XPU2_VMIDEN_INIT_ADDR A:0xfd4a119c
y.create.l HWIO_TCSR_LPASS_LPC_COM_QRIB_XPU2_ACR_ADDR A:0xfd4a1280
y.create.l HWIO_TCSR_LPASS_LPC_COM_QRIB_XPU2_VMIDEN_INIT_ADDR A:0xfd4a11a4
y.create.l HWIO_TCSR_LPASS_SB_QRIB_XPU2_ACR_ADDR A:0xfd4a11b8
y.create.l HWIO_TCSR_LPASS_SB_QRIB_XPU2_VMIDEN_INIT_ADDR A:0xfd4a11bc
y.create.l HWIO_TCSR_LPASS_SB_QRIB_VMIDMT_INIT_ACR_INIT_ADDR A:0xfd4a11c0
y.create.l HWIO_TCSR_LPASS_SB_QRIB_VMIDMT_EN_ADDR A:0xfd4a11c4
y.create.l HWIO_TCSR_LPASS_AIF_QRIB_VMIDMT_INIT_ACR_INIT_ADDR A:0xfd4a11c8
y.create.l HWIO_TCSR_LPASS_AIF_QRIB_VMIDMT_EN_ADDR A:0xfd4a11cc
y.create.l HWIO_TCSR_LPASS_DML_QRIB_VMIDMT_INIT_ACR_INIT_ADDR A:0xfd4a11d0
y.create.l HWIO_TCSR_LPASS_DML_QRIB_VMIDMT_EN_ADDR A:0xfd4a11d4
y.create.l HWIO_TCSR_LPASS_MIDI_QRIB_VMIDMT_INIT_ACR_INIT_ADDR A:0xfd4a11d8
y.create.l HWIO_TCSR_LPASS_MIDI_QRIB_VMIDMT_EN_ADDR A:0xfd4a11dc
y.create.l HWIO_TCSR_LPASS_RSMPLR_QRIB_VMIDMT_INIT_ACR_INIT_ADDR A:0xfd4a11e0
y.create.l HWIO_TCSR_LPASS_RSMPLR_QRIB_VMIDMT_EN_ADDR A:0xfd4a11e4
y.create.l HWIO_TCSR_LPASS_HDMIRX_QRIB_VMIDMT_INIT_ACR_INIT_ADDR A:0xfd4a11e8
y.create.l HWIO_TCSR_LPASS_HDMIRX_QRIB_VMIDMT_EN_ADDR A:0xfd4a11ec
y.create.l HWIO_TCSR_LPASS_SPDIFTX_QRIB_VMIDMT_INIT_ACR_INIT_ADDR A:0xfd4a11f0
y.create.l HWIO_TCSR_LPASS_SPDIFTX_QRIB_VMIDMT_EN_ADDR A:0xfd4a11f4
y.create.l HWIO_TCSR_LPASS_AXIM_QRIB_XPU2_ACR_ADDR A:0xfd4a11f8
y.create.l HWIO_TCSR_LPASS_AXIM_QRIB_XPU2_VMIDEN_INIT_ADDR A:0xfd4a11fc
y.create.l HWIO_TCSR_LPASS_CORE_AXIM_QRIB_XPU2_ACR_ADDR A:0xfd4a1220
y.create.l HWIO_TCSR_LPASS_CORE_AXIM_QRIB_XPU2_VMIDEN_INIT_ADDR A:0xfd4a1224
y.create.l HWIO_TCSR_MPM_QDSS_QRIB_XPU2_ACR_ADDR A:0xfd4a1200
y.create.l HWIO_TCSR_MPM_QDSS_QRIB_XPU2_VMIDEN_INIT_ADDR A:0xfd4a1204
y.create.l HWIO_TCSR_MMSS_VENUS0_VBIF_QRIB_XPU2_ACR_ADDR A:0xfd4a1380
y.create.l HWIO_TCSR_MMSS_VENUS0_VBIF_QRIB_XPU2_VMIDEN_INIT_ADDR A:0xfd4a1384
y.create.l HWIO_TCSR_MMSS_VENUS0_CPU_QRIB_VMIDMT_INIT_ACR_INIT_ADDR A:0xfd4a1388
y.create.l HWIO_TCSR_MMSS_VENUS0_CPU_QRIB_VMIDMT_EN_ADDR A:0xfd4a138c
y.create.l HWIO_TCSR_MMSS_VENUS0_WRAPPER_QRIB_XPU2_ACR_ADDR A:0xfd4a1390
y.create.l HWIO_TCSR_MMSS_VENUS0_WRAPPER_QRIB_XPU2_VMIDEN_INIT_ADDR A:0xfd4a1394
y.create.l HWIO_TCSR_MMSS_VENUS0_VBIF_QRIB_VMIDMT_INIT_ACR_INIT_ADDR A:0xfd4a1398
y.create.l HWIO_TCSR_MMSS_VENUS0_VBIF_QRIB_VMIDMT_EN_ADDR A:0xfd4a139c
y.create.l HWIO_TCSR_MMSS_VFE_QRIB_XPU2_ACR_ADDR A:0xfd4a13b0
y.create.l HWIO_TCSR_MMSS_VFE_QRIB_XPU2_VMIDEN_INIT_ADDR A:0xfd4a13b4
y.create.l HWIO_TCSR_MMSS_VFE_QRIB_VMIDMT_INIT_ACR_INIT_ADDR A:0xfd4a13b8
y.create.l HWIO_TCSR_MMSS_VFE_QRIB_VMIDMT_EN_ADDR A:0xfd4a13bc
y.create.l HWIO_TCSR_MMSS_JPEG_QRIB_XPU2_ACR_ADDR A:0xfd4a13c0
y.create.l HWIO_TCSR_MMSS_JPEG_QRIB_XPU2_VMIDEN_INIT_ADDR A:0xfd4a13c4
y.create.l HWIO_TCSR_MMSS_JPEG_QRIB_VMIDMT_INIT_ACR_INIT_ADDR A:0xfd4a13c8
y.create.l HWIO_TCSR_MMSS_JPEG_QRIB_VMIDMT_EN_ADDR A:0xfd4a13cc
y.create.l HWIO_TCSR_MMSS_MDP_QRIB_XPU2_ACR_ADDR A:0xfd4a13d0
y.create.l HWIO_TCSR_MMSS_MDP_QRIB_XPU2_VMIDEN_INIT_ADDR A:0xfd4a13d4
y.create.l HWIO_TCSR_MMSS_MDP_QRIB_VMIDMT_INIT_ACR_INIT_ADDR A:0xfd4a13d8
y.create.l HWIO_TCSR_MMSS_MDP_QRIB_VMIDMT_EN_ADDR A:0xfd4a13dc
y.create.l HWIO_TCSR_MMSS_VENUS0_MMU_QRIB_VMID_INIT_EN_ADDR A:0xfd4a1480
y.create.l HWIO_TCSR_MMSS_VENUS0_MMU_QRIB_VMID_INIT_ADDR A:0xfd4a1484
y.create.l HWIO_TCSR_MMSS_VENUS0_MMU_QRIB_VMID_EN_ADDR A:0xfd4a1488
y.create.l HWIO_TCSR_MMSS_VENUS0_MMU_QRIB_VMID_ADDR A:0xfd4a148c
y.create.l HWIO_TCSR_MMSS_VFE_MMU_QRIB_VMID_INIT_EN_ADDR A:0xfd4a14a0
y.create.l HWIO_TCSR_MMSS_VFE_MMU_QRIB_VMID_INIT_ADDR A:0xfd4a14a4
y.create.l HWIO_TCSR_MMSS_VFE_MMU_QRIB_VMID_EN_ADDR A:0xfd4a14a8
y.create.l HWIO_TCSR_MMSS_VFE_MMU_QRIB_VMID_ADDR A:0xfd4a14ac
y.create.l HWIO_TCSR_MMSS_JPEG_MMU_QRIB_VMID_INIT_EN_ADDR A:0xfd4a14b0
y.create.l HWIO_TCSR_MMSS_JPEG_MMU_QRIB_VMID_INIT_ADDR A:0xfd4a14b4
y.create.l HWIO_TCSR_MMSS_JPEG_MMU_QRIB_VMID_EN_ADDR A:0xfd4a14b8
y.create.l HWIO_TCSR_MMSS_JPEG_MMU_QRIB_VMID_ADDR A:0xfd4a14bc
y.create.l HWIO_TCSR_MMSS_MDP_MMU_QRIB_VMID_INIT_EN_ADDR A:0xfd4a14c0
y.create.l HWIO_TCSR_MMSS_MDP_MMU_QRIB_VMID_INIT_ADDR A:0xfd4a14c4
y.create.l HWIO_TCSR_MMSS_MDP_MMU_QRIB_VMID_EN_ADDR A:0xfd4a14c8
y.create.l HWIO_TCSR_MMSS_MDP_MMU_QRIB_VMID_ADDR A:0xfd4a14cc
y.create.l HWIO_TCSR_MMSS_OXILI_MMU_QRIB_VMID_INIT_EN_ADDR A:0xfd4a14d0
y.create.l HWIO_TCSR_MMSS_OXILI_MMU_QRIB_VMID_INIT_ADDR A:0xfd4a14d4
y.create.l HWIO_TCSR_MMSS_OXILI_MMU_QRIB_VMID_EN_ADDR A:0xfd4a14d8
y.create.l HWIO_TCSR_MMSS_OXILI_MMU_QRIB_VMID_ADDR A:0xfd4a14dc
y.create.l HWIO_TCSR_LPASS_AXIM_QRIB_SMMU_VMID_INIT_EN_ADDR A:0xfd4a14e0
y.create.l HWIO_TCSR_LPASS_AXIM_QRIB_SMMU_VMID_INIT_ADDR A:0xfd4a14e4
y.create.l HWIO_TCSR_LPASS_AXIM_QRIB_SMMU_VMID_EN_ADDR A:0xfd4a14e8
y.create.l HWIO_TCSR_LPASS_AXIM_QRIB_SMMU_VMID_ADDR A:0xfd4a14ec
y.create.l HWIO_TCSR_LPASS_CORE_AXIM_QRIB_SMMU_VMID_INIT_EN_ADDR A:0xfd4a14f0
y.create.l HWIO_TCSR_LPASS_CORE_AXIM_QRIB_SMMU_VMID_INIT_ADDR A:0xfd4a14f4
y.create.l HWIO_TCSR_LPASS_CORE_AXIM_QRIB_SMMU_VMID_EN_ADDR A:0xfd4a14f8
y.create.l HWIO_TCSR_LPASS_CORE_AXIM_QRIB_SMMU_VMID_ADDR A:0xfd4a14fc
y.create.l HWIO_TCSR_MMSS_OXILICX_QRIB_XPU2_ACR_ADDR A:0xfd4a1500
y.create.l HWIO_TCSR_MMSS_OXILICX_QRIB_XPU2_VMIDEN_INIT_ADDR A:0xfd4a1504
y.create.l HWIO_TCSR_MMSS_OXILI_RBBM_QRIB_VMIDMT_INIT_ACR_INIT_ADDR A:0xfd4a1508
y.create.l HWIO_TCSR_MMSS_OXILI_RBBM_QRIB_VMIDMT_EN_ADDR A:0xfd4a150c
y.create.l HWIO_TCSR_MMSS_OXILI_VBIF_QRIB_XPU2_ACR_ADDR A:0xfd4a1510
y.create.l HWIO_TCSR_MMSS_OXILI_VBIF_QRIB_XPU2_VMIDEN_INIT_ADDR A:0xfd4a1514
y.create.l HWIO_TCSR_MMSS_OCMEM_DM_QRIB_XPU2_ACR_ADDR A:0xfd4a1600
y.create.l HWIO_TCSR_MMSS_OCMEM_DM_QRIB_XPU2_VMIDEN_INIT_ADDR A:0xfd4a1604
y.create.l HWIO_TCSR_MMSS_OCMEM_DMOCMEM_QRIB_VMIDMT_INIT_ACR_INIT_ADDR A:0xfd4a1608
y.create.l HWIO_TCSR_MMSS_OCMEM_DMOCMEM_QRIB_VMIDMT_EN_ADDR A:0xfd4a160c
y.create.l HWIO_TCSR_MMSS_OCMEM_DMSYS_QRIB_VMIDMT_INIT_ACR_INIT_ADDR A:0xfd4a1610
y.create.l HWIO_TCSR_MMSS_OCMEM_DMSYS_QRIB_VMIDMT_EN_ADDR A:0xfd4a1614
y.create.l HWIO_TCSR_MMSS_OCMEM_QRIB_XPU2_ACR_ADDR A:0xfd4a1618
y.create.l HWIO_TCSR_MMSS_OCMEM_QRIB_XPU2_VMIDEN_INIT_ADDR A:0xfd4a161c
y.create.l HWIO_TCSR_MMSS_OCMEM_OSW0_QRIB_XPU2_ACR_ADDR A:0xfd4a1620
y.create.l HWIO_TCSR_MMSS_OCMEM_OSW0_QRIB_XPU2_VMIDEN_INIT_ADDR A:0xfd4a1624
y.create.l HWIO_TCSR_MMSS_OCMEM_OSW1_QRIB_XPU2_ACR_ADDR A:0xfd4a1628
y.create.l HWIO_TCSR_MMSS_OCMEM_OSW1_QRIB_XPU2_VMIDEN_INIT_ADDR A:0xfd4a162c
y.create.l HWIO_TCSR_MMSS_OCMEM_OSWDM_QRIB_XPU2_ACR_ADDR A:0xfd4a1630
y.create.l HWIO_TCSR_MMSS_OCMEM_OSWDM_QRIB_XPU2_VMIDEN_INIT_ADDR A:0xfd4a1634
y.create.l HWIO_TCSR_MMSS_OCMEM_OSWSYS_QRIB_XPU2_ACR_ADDR A:0xfd4a1638
y.create.l HWIO_TCSR_MMSS_OCMEM_OSWSYS_QRIB_XPU2_VMIDEN_INIT_ADDR A:0xfd4a163c
y.create.l HWIO_TCSR_PHSS_USB1_HS_QRIB_XPU2_ACR_ADDR A:0xfd4a1700
y.create.l HWIO_TCSR_PHSS_USB1_HS_QRIB_XPU2_VMIDEN_INIT_ADDR A:0xfd4a1704
y.create.l HWIO_TCSR_PHSS_USB2_HSIC_QRIB_XPU2_ACR_ADDR A:0xfd4a1708
y.create.l HWIO_TCSR_PHSS_USB2_HSIC_QRIB_XPU2_VMIDEN_INIT_ADDR A:0xfd4a170c
y.create.l HWIO_TCSR_PHSS_BLSP1_QRIB_XPU2_ACR_ADDR A:0xfd4a1710
y.create.l HWIO_TCSR_PHSS_BLSP1_QRIB_XPU2_VMIDEN_INIT_ADDR A:0xfd4a1714
y.create.l HWIO_TCSR_PHSS_BLSP2_QRIB_XPU2_ACR_ADDR A:0xfd4a1718
y.create.l HWIO_TCSR_PHSS_BLSP2_QRIB_XPU2_VMIDEN_INIT_ADDR A:0xfd4a171c
y.create.l HWIO_TCSR_PHSS_TSIF_BAM_QRIB_XPU2_ACR_ADDR A:0xfd4a1720
y.create.l HWIO_TCSR_PHSS_TSIF_BAM_QRIB_XPU2_VMIDEN_INIT_ADDR A:0xfd4a1724
y.create.l HWIO_TCSR_PHSS_BAM_DMA_QRIB_XPU2_ACR_ADDR A:0xfd4a1728
y.create.l HWIO_TCSR_PHSS_BAM_DMA_QRIB_XPU2_VMIDEN_INIT_ADDR A:0xfd4a172c
y.create.l HWIO_TCSR_PHSS_USB1_HS_QRIB_VMIDMT_INIT_ACR_INIT_ADDR A:0xfd4a1730
y.create.l HWIO_TCSR_PHSS_USB1_HS_QRIB_VMIDMT_EN_ADDR A:0xfd4a1734
y.create.l HWIO_TCSR_PHSS_USB2_HSIC_QRIB_VMIDMT_INIT_ACR_INIT_ADDR A:0xfd4a1738
y.create.l HWIO_TCSR_PHSS_USB2_HSIC_QRIB_VMIDMT_EN_ADDR A:0xfd4a173c
y.create.l HWIO_TCSR_PHSS_BLSP1_QRIB_VMIDMT_INIT_ACR_INIT_ADDR A:0xfd4a1740
y.create.l HWIO_TCSR_PHSS_BLSP1_QRIB_VMIDMT_EN_ADDR A:0xfd4a1744
y.create.l HWIO_TCSR_PHSS_BLSP2_QRIB_VMIDMT_INIT_ACR_INIT_ADDR A:0xfd4a1748
y.create.l HWIO_TCSR_PHSS_BLSP2_QRIB_VMIDMT_EN_ADDR A:0xfd4a174c
y.create.l HWIO_TCSR_PHSS_TSIF_BAM_QRIB_VMIDMT_INIT_ACR_INIT_ADDR A:0xfd4a1750
y.create.l HWIO_TCSR_PHSS_TSIF_BAM_QRIB_VMIDMT_EN_ADDR A:0xfd4a1754
y.create.l HWIO_TCSR_PHSS_BAM_DMA_QRIB_VMIDMT_INIT_ACR_INIT_ADDR A:0xfd4a1758
y.create.l HWIO_TCSR_PHSS_BAM_DMA_QRIB_VMIDMT_EN_ADDR A:0xfd4a175c
y.create.l HWIO_TCSR_PHSS_USB20_QRIB_XPU2_ACR_ADDR A:0xfd4a1760
y.create.l HWIO_TCSR_PHSS_USB20_QRIB_XPU2_VMIDEN_INIT_ADDR A:0xfd4a1764
y.create.l HWIO_TCSR_PHSS_USB20_QRIB_VMIDMT_INIT_ACR_INIT_ADDR A:0xfd4a1768
y.create.l HWIO_TCSR_PHSS_USB20_QRIB_VMIDMT_EN_ADDR A:0xfd4a176c
y.create.l HWIO_TCSR_PHSS_USB30_QRIB_XPU2_ACR_ADDR A:0xfd4a1770
y.create.l HWIO_TCSR_PHSS_USB30_QRIB_XPU2_VMIDEN_INIT_ADDR A:0xfd4a1774
y.create.l HWIO_TCSR_PHSS_USB30_QRIB_VMIDMT_INIT_ACR_INIT_ADDR A:0xfd4a1778
y.create.l HWIO_TCSR_PHSS_USB30_QRIB_VMIDMT_EN_ADDR A:0xfd4a177c
y.create.l HWIO_TCSR_IPA_BAM_XPU2_QRIB_XPU2_VMIDEN_INIT_ADDR A:0xfd4a1800
y.create.l HWIO_TCSR_IPA_BAM_XPU2_QRIB_XPU2_ACR_ADDR A:0xfd4a1804
y.create.l HWIO_TCSR_IPA_BAM_QRIB_VMIDMT_INIT_ACR_INIT_ADDR A:0xfd4a1808
y.create.l HWIO_TCSR_IPA_BAM_QRIB_VMIDMT_EN_ADDR A:0xfd4a180c
y.create.l HWIO_TCSR_IPA_QRIB_VMIDMT_INIT_ACR_INIT_ADDR A:0xfd4a1810
y.create.l HWIO_TCSR_IPA_QRIB_VMIDMT_EN_ADDR A:0xfd4a1814
y.create.l HWIO_TCSR_PCIE_QRIB_VMIDMT_INIT_ACR_INIT_ADDR A:0xfd4a1900
y.create.l HWIO_TCSR_PCIE_QRIB_VMIDMT_EN_ADDR A:0xfd4a1904
y.create.l HWIO_TCSR_PCIE20_PARF_QRIB_XPU2_ACR_ADDR A:0xfd4a1908
y.create.l HWIO_TCSR_PCIE20_PARF_QRIB_XPU2_VMIDEN_INIT_ADDR A:0xfd4a190c
y.create.l HWIO_TCSR_PCIE20_SLV_QRIB_XPU2_ACR_ADDR A:0xfd4a1910
y.create.l HWIO_TCSR_PCIE20_SLV_QRIB_XPU2_VMIDEN_INIT_ADDR A:0xfd4a1914
y.create.l HWIO_TCSR_SS_XPU2_NON_SEC_INTR0_ADDR A:0xfd4a2000
y.create.l HWIO_TCSR_SS_XPU2_NON_SEC_INTR1_ADDR A:0xfd4a2004
y.create.l HWIO_TCSR_SS_XPU2_NON_SEC_INTR2_ADDR A:0xfd4a2008
y.create.l HWIO_TCSR_SS_XPU2_NON_SEC_INTR0_ENABLE_ADDR A:0xfd4a2040
y.create.l HWIO_TCSR_SS_XPU2_NON_SEC_INTR1_ENABLE_ADDR A:0xfd4a2044
y.create.l HWIO_TCSR_SS_XPU2_NON_SEC_INTR2_ENABLE_ADDR A:0xfd4a2048
y.create.l HWIO_TCSR_SS_VMIDMT_CLIENT_NON_SEC_INTR_ADDR A:0xfd4a2010
y.create.l HWIO_TCSR_SS_MMU_CLIENT_NON_SEC_INTR_ADDR A:0xfd4a2014
y.create.l HWIO_TCSR_SS_VMIDMT_CLIENT_NON_SEC_INTR1_ADDR A:0xfd4a2018
y.create.l HWIO_TCSR_SS_VMIDMT_CLIENT_NON_SEC_INTR_ENABLE_ADDR A:0xfd4a2050
y.create.l HWIO_TCSR_SS_MMU_CLIENT_NON_SEC_INTR_ENABLE_ADDR A:0xfd4a2054
y.create.l HWIO_TCSR_SS_VMIDMT_CLIENT_NON_SEC_INTR1_ENABLE_ADDR A:0xfd4a2058
y.create.l HWIO_TCSR_SS_VMIDMT_CFG_NON_SEC_INTR_ADDR A:0xfd4a3000
y.create.l HWIO_TCSR_SS_MMU_CFG_NON_SEC_INTR_ADDR A:0xfd4a3004
y.create.l HWIO_TCSR_SS_VMIDMT_CFG_NON_SEC_INTR1_ADDR A:0xfd4a3008
y.create.l HWIO_TCSR_SS_VMIDMT_CFG_NON_SEC_INTR_ENABLE_ADDR A:0xfd4a3040
y.create.l HWIO_TCSR_SS_MMU_CFG_NON_SEC_INTR_ENABLE_ADDR A:0xfd4a3044
y.create.l HWIO_TCSR_SS_VMIDMT_CFG_NON_SEC_INTR1_ENABLE_ADDR A:0xfd4a3048
y.create.l HWIO_TCSR_SS_XPU2_SEC_INTR0_ADDR A:0xfd4a4000
y.create.l HWIO_TCSR_SS_XPU2_SEC_INTR1_ADDR A:0xfd4a4004
y.create.l HWIO_TCSR_SS_XPU2_SEC_INTR2_ADDR A:0xfd4a4008
y.create.l HWIO_TCSR_SS_XPU2_SEC_INTR0_ENABLE_ADDR A:0xfd4a4040
y.create.l HWIO_TCSR_SS_XPU2_SEC_INTR1_ENABLE_ADDR A:0xfd4a4044
y.create.l HWIO_TCSR_SS_XPU2_SEC_INTR2_ENABLE_ADDR A:0xfd4a4048
y.create.l HWIO_TCSR_SS_VMIDMT_CLIENT_SEC_INTR_ADDR A:0xfd4a4010
y.create.l HWIO_TCSR_SS_MMU_CLIENT_SEC_INTR_ADDR A:0xfd4a4014
y.create.l HWIO_TCSR_SS_VMIDMT_CLIENT_SEC_INTR1_ADDR A:0xfd4a4018
y.create.l HWIO_TCSR_SS_VMIDMT_CLIENT_SEC_INTR_ENABLE_ADDR A:0xfd4a4050
y.create.l HWIO_TCSR_SS_MMU_CLIENT_SEC_INTR_ENABLE_ADDR A:0xfd4a4054
y.create.l HWIO_TCSR_SS_VMIDMT_CLIENT_SEC_INTR1_ENABLE_ADDR A:0xfd4a4058
y.create.l HWIO_TCSR_SS_VMIDMT_CFG_SEC_INTR_ADDR A:0xfd4a5000
y.create.l HWIO_TCSR_SS_MMU_CFG_SEC_INTR_ADDR A:0xfd4a5004
y.create.l HWIO_TCSR_SS_VMIDMT_CFG_SEC_INTR1_ADDR A:0xfd4a5008
y.create.l HWIO_TCSR_SS_VMIDMT_CFG_SEC_INTR_ENABLE_ADDR A:0xfd4a5040
y.create.l HWIO_TCSR_SS_MMU_CFG_SEC_INTR_ENABLE_ADDR A:0xfd4a5044
y.create.l HWIO_TCSR_SS_VMIDMT_CFG_SEC_INTR1_ENABLE_ADDR A:0xfd4a5048
y.create.l HWIO_TCSR_SS_XPU2_MSA_INTR0_ADDR A:0xfd4a6000
y.create.l HWIO_TCSR_SS_XPU2_MSA_INTR1_ADDR A:0xfd4a6004
y.create.l HWIO_TCSR_SS_XPU2_MSA_INTR2_ADDR A:0xfd4a6008
y.create.l HWIO_TCSR_SS_XPU2_MSA_INTR0_ENABLE_ADDR A:0xfd4a6040
y.create.l HWIO_TCSR_SS_XPU2_MSA_INTR1_ENABLE_ADDR A:0xfd4a6044
y.create.l HWIO_TCSR_SS_XPU2_MSA_INTR2_ENABLE_ADDR A:0xfd4a6048
y.create.l HWIO_TCSR_SPDM_CNT_CLK_CTRL_ADDR A:0xfd4a7000
y.create.l HWIO_TCSR_SPDM_DLY_FIFO_EN_ADDR A:0xfd4a7004
y.create.l HWIO_TCSR_SPDM_STG1_MUX_SEL_ADDR A:0xfd4a7008
y.create.l HWIO_TCSR_SPDM_STG2_A_MUX_SEL_ADDR A:0xfd4a700c
y.create.l HWIO_TCSR_SPDM_STG2_B_MUX_SEL_ADDR A:0xfd4a7010
y.create.l HWIO_TCSR_SPDM_STG3_A_MUX_SEL_ADDR A:0xfd4a7014
y.create.l HWIO_TCSR_SPDM_STG3_B_MUX_SEL_ADDR A:0xfd4a7018
y.create.l HWIO_TCSR_SOC_HW_VERSION_ADDR A:0xfd4a8000
y.create.l HWIO_TCSR_TIMEOUT_INTR_PENDING_ADDR A:0xfd4a8020
y.create.l HWIO_TCSR_TIMEOUT_INTR_RPM_ENABLE_ADDR A:0xfd4a8030
y.create.l HWIO_TCSR_TIMEOUT_INTR_KPSS_ENABLE_ADDR A:0xfd4a8040
y.create.l HWIO_TCSR_TIMEOUT_INTR_LPASS_ENABLE_ADDR A:0xfd4a8050
y.create.l HWIO_TCSR_TIMEOUT_INTR_MSS_ENABLE_ADDR A:0xfd4a8060
y.create.l HWIO_TCSR_TCSR_CLK_EN_ADDR A:0xfd4a907c
y.create.l HWIO_TCSR_SYS_POWER_CTRL_ADDR A:0xfd4aa000
y.create.l HWIO_TCSR_USB_CORE_ID_ADDR A:0xfd4aa004
y.create.l HWIO_TCSR_SPARE_REG0_ADDR A:0xfd4aa044
y.create.l HWIO_TCSR_SPARE_REG1_ADDR A:0xfd4aa048
y.create.l HWIO_TCSR_PHSS_USB2_PHY_SEL_ADDR A:0xfd4ab000
y.create.l HWIO_TCSR_PHSS_ATEST_USB2_PHY_SEL_ADDR A:0xfd4ab004
y.create.l HWIO_TCSR_PHSS_TEST_BUS_SEL_ADDR A:0xfd4ab008
y.create.l HWIO_TCSR_PHSS_PNOC_SNOC_MEMTYPE_ADDR A:0xfd4ab020
y.create.l HWIO_TCSR_PHSS_UART_LPASS_INT_SEL_0_ADDR A:0xfd4ab040
y.create.l HWIO_TCSR_PHSS_UART_LPASS_INT_SEL_1_ADDR A:0xfd4ab050
y.create.l HWIO_TCSR_PHSS_UART_PRONTO_INT_SEL_0_ADDR A:0xfd4ab080
y.create.l HWIO_TCSR_PHSS_UART_PRONTO_INT_SEL_1_ADDR A:0xfd4ab090
y.create.l HWIO_TCSR_PHSS_UART_MSS_INT_SEL_0_ADDR A:0xfd4ab0c0
y.create.l HWIO_TCSR_PHSS_UART_MSS_INT_SEL_1_ADDR A:0xfd4ab0d0
y.create.l HWIO_TCSR_PHSS_QUP_PRONTO_INT_SEL_0_ADDR A:0xfd4ab100
y.create.l HWIO_TCSR_PHSS_QUP_PRONTO_INT_SEL_1_ADDR A:0xfd4ab110
y.create.l HWIO_TCSR_PHSS_QUP_MSS_INT_SEL_0_ADDR A:0xfd4ab140
y.create.l HWIO_TCSR_PHSS_QUP_MSS_INT_SEL_1_ADDR A:0xfd4ab150
y.create.l HWIO_TCSR_PHSS_QDSS_HW_EVENTS_CTRL_0_ADDR A:0xfd4ab160
y.create.l HWIO_TCSR_PHSS_QDSS_HW_EVENTS_CTRL_1_ADDR A:0xfd4ab164
y.create.l HWIO_TCSR_PHSS_QDSS_HW_EVENTS_CTRL_2_ADDR A:0xfd4ab168
y.create.l HWIO_TCSR_PHSS_QDSS_HW_EVENTS_CTRL_3_ADDR A:0xfd4ab16c
y.create.l HWIO_TCSR_PHSS_QDSS_HW_EVENTS_CTRL_4_ADDR A:0xfd4ab170
y.create.l HWIO_TCSR_PHSS_QDSS_HW_EVENTS_CTRL_5_ADDR A:0xfd4ab174
y.create.l HWIO_TCSR_PHSS_QDSS_HW_EVENTS_CTRL_6_ADDR A:0xfd4ab178
y.create.l HWIO_TCSR_PHSS_QDSS_HW_EVENTS_CTRL_7_ADDR A:0xfd4ab17c
y.create.l HWIO_TCSR_PHSS_QDSS_HW_EVENTS_CTRL_8_ADDR A:0xfd4ab180
y.create.l HWIO_TCSR_PHSS_QDSS_HW_EVENTS_CTRL_9_ADDR A:0xfd4ab184
y.create.l HWIO_TCSR_LDO_SLEEP_CTRL_ADDR A:0xfd4ac000
y.create.l HWIO_TCSR_LDO_UPDATE_STATE_CTRL_ADDR A:0xfd4ac004
y.create.l HWIO_TCSR_LDO_OBIAS_CTRL_ADDR A:0xfd4ac008
y.create.l HWIO_TCSR_LDO_VREF_CONFIG_ADDR A:0xfd4ac00c
y.create.l HWIO_TCSR_LDO_IB_CONFIG_ADDR A:0xfd4ac010
y.create.l HWIO_TCSR_LDO_BGC_CONFIG_ADDR A:0xfd4ac014
y.create.l HWIO_TCSR_LDO_VREF_CTRL_ADDR A:0xfd4ac018
y.create.l HWIO_TCSR_LDO_LD_EN_ADDR A:0xfd4ac01c
y.create.l HWIO_TCSR_LDO_LD_CTRL_ADDR A:0xfd4ac020
y.create.l HWIO_TCSR_LDO_OSC_RESETB_ADDR A:0xfd4ac024
y.create.l HWIO_TCSR_LDO_OSC_CTRL_ADDR A:0xfd4ac028
y.create.l HWIO_TCSR_LDO_DFT_EN_CTRL_ADDR A:0xfd4ac02c
y.create.l HWIO_TCSR_LDO_DFT_CTRL_ADDR A:0xfd4ac030
y.create.l HWIO_TCSR_LDO_ENABLE_ADDR A:0xfd4ac034
y.create.l HWIO_TCSR_COMPILER_VDDMSS_ACC_0_ADDR A:0xfd4ad000
y.create.l HWIO_TCSR_COMPILER_VDDMSS_ACC_1_ADDR A:0xfd4ad004
y.create.l HWIO_TCSR_CUSTOM_ACC_QCRF4221_82_CUSTOM4P_LHLH_TYPE1_VDDMSS_ADDR A:0xfd4ad010
y.create.l HWIO_TCSR_CUSTOM_ACC_QCRF8441_82_CUSTOM8P_LHLH_TYPE2_VDDMSS_ADDR A:0xfd4ad014
y.create.l HWIO_TCSR_CUSTOM_ACC_QCSRAM1111_STDSP0890_RHLH_NS_NP_TYPE3_VDDMSS_ADDR A:0xfd4ad018
y.create.l HWIO_TCSR_CUSTOM_ACC_QCSRAM1111_42_STDSP0890_RHLH_NS_NP_TYPE4_VDDMSS_ADDR A:0xfd4ad01c
y.create.l HWIO_TCSR_CUSTOM_ACC_QCSRAM1111_LLSP0810_RHLH_NS_NP_TYPE5_VDDMSS_ADDR A:0xfd4ad020
y.create.l HWIO_TCSR_CUSTOM_ACC_QCSRAM1111_LLSP0810_RHLH_SS_NP_TYPE6_VDDMSS_ADDR A:0xfd4ad024
y.create.l HWIO_TCSR_CUSTOM_ACC_QCSRAM1111_LLSP0810_RHLH_NS_NP_TYPE7_VDDMSS_ADDR A:0xfd4ad028
y.create.l HWIO_TCSR_CUSTOM_ACC_MEMPOOL_7K_32_TYPE8_VDDMSS_ADDR A:0xfd4ad02c
y.create.l HWIO_TCSR_COMPILER_VDDCX_ACC_0_ADDR A:0xfd4ad080
y.create.l HWIO_TCSR_COMPILER_VDDCX_ACC_1_ADDR A:0xfd4ad084
y.create.l HWIO_TCSR_CUSTOM_ACC_QCRF4221_82_CUSTOM4P_LHLH_TYPE1_VDDCX_ADDR A:0xfd4ad090
y.create.l HWIO_TCSR_CUSTOM_ACC_QCRF8441_82_CUSTOM8P_LHLH_TYPE2_VDDCX_ADDR A:0xfd4ad094
y.create.l HWIO_TCSR_CUSTOM_ACC_QCSRAM1111_STDSP0890_RHLH_NS_NP_TYPE3_VDDCX_ADDR A:0xfd4ad098
y.create.l HWIO_TCSR_CUSTOM_ACC_QCSRAM1111_42_STDSP0890_RHLH_NS_NP_TYPE4_VDDCX_ADDR A:0xfd4ad09c
y.create.l HWIO_TCSR_CUSTOM_ACC_QCSRAM1111_LLSP0810_RHLH_NS_NP_TYPE5_VDDCX_ADDR A:0xfd4ad0a0
y.create.l HWIO_TCSR_CUSTOM_ACC_QCSRAM1111_LLSP0810_RHLH_SS_NP_TYPE6_VDDCX_ADDR A:0xfd4ad0a4
y.create.l HWIO_TCSR_CUSTOM_ACC_QCSRAM1111_LLSP0810_RHLH_NS_NP_TYPE7_VDDCX_ADDR A:0xfd4ad0a8
y.create.l HWIO_TCSR_CUSTOM_ACC_MEMPOOL_7K_32_TYPE8_VDDCX_ADDR A:0xfd4ad0ac
y.create.l HWIO_TCSR_COMPILER_VDDGFX_ACC_0_ADDR A:0xfd4ad100
y.create.l HWIO_TCSR_COMPILER_VDDGFX_ACC_1_ADDR A:0xfd4ad104
y.create.l HWIO_TCSR_CUSTOM_ACC_QCRF4221_82_CUSTOM4P_LHLH_TYPE1_VDDGFX_ADDR A:0xfd4ad110
y.create.l HWIO_TCSR_CUSTOM_ACC_QCRF8441_82_CUSTOM8P_LHLH_TYPE2_VDDGFX_ADDR A:0xfd4ad114
y.create.l HWIO_TCSR_CUSTOM_ACC_QCSRAM1111_STDSP0890_RHLH_NS_NP_TYPE3_VDDGFX_ADDR A:0xfd4ad118
y.create.l HWIO_TCSR_CUSTOM_ACC_QCSRAM1111_42_STDSP0890_RHLH_NS_NP_TYPE4_VDDGFX_ADDR A:0xfd4ad11c
y.create.l HWIO_TCSR_CUSTOM_ACC_QCSRAM1111_LLSP0810_RHLH_NS_NP_TYPE5_VDDGFX_ADDR A:0xfd4ad120
y.create.l HWIO_TCSR_CUSTOM_ACC_QCSRAM1111_LLSP0810_RHLH_SS_NP_TYPE6_VDDGFX_ADDR A:0xfd4ad124
y.create.l HWIO_TCSR_CUSTOM_ACC_QCSRAM1111_LLSP0810_RHLH_NS_NP_TYPE7_VDDGFX_ADDR A:0xfd4ad128
y.create.l HWIO_TCSR_CUSTOM_ACC_MEMPOOL_7K_32_TYPE8_VDDGFX_ADDR A:0xfd4ad12c
y.create.l HWIO_TCSR_MEM_ARRY_STBY_ADDR A:0xfd4ad180
y.create.l HWIO_TCSR_MEM_ACC_SEL_VDDCX_ADDR A:0xfd4ae000
y.create.l HWIO_TCSR_MEM_SVS_SEL_VDDCX_ADDR A:0xfd4ae004
y.create.l HWIO_TCSR_MEM_ACC_SEL_VDDGFX_ADDR A:0xfd4af000
y.create.l HWIO_TCSR_MEM_SVS_SEL_VDDGFX_ADDR A:0xfd4af004
y.create.l HWIO_TCSR_DCS_CLK_CHG_WINDOW_ADDR A:0xfd4af100
y.create.l HWIO_TCSR_DCS_MSTR_PRIORITY_ADDR A:0xfd4af104
y.create.l HWIO_TCSR_DCS_ENABLE_ADDR A:0xfd4af108
y.create.l HWIO_CRYPTO0_CRYPTO_VERSION_ADDR A:0xfd41a000
y.create.l HWIO_CRYPTO0_CRYPTO_DATA_IN0_ADDR A:0xfd41a010
y.create.l HWIO_CRYPTO0_CRYPTO_DATA_IN1_ADDR A:0xfd41a014
y.create.l HWIO_CRYPTO0_CRYPTO_DATA_IN2_ADDR A:0xfd41a018
y.create.l HWIO_CRYPTO0_CRYPTO_DATA_IN3_ADDR A:0xfd41a01c
y.create.l HWIO_CRYPTO0_CRYPTO_DATA_OUT0_ADDR A:0xfd41a020
y.create.l HWIO_CRYPTO0_CRYPTO_DATA_OUT1_ADDR A:0xfd41a024
y.create.l HWIO_CRYPTO0_CRYPTO_DATA_OUT2_ADDR A:0xfd41a028
y.create.l HWIO_CRYPTO0_CRYPTO_DATA_OUT3_ADDR A:0xfd41a02c
y.create.l HWIO_CRYPTO0_CRYPTO_STATUS_ADDR A:0xfd41a100
y.create.l HWIO_CRYPTO0_CRYPTO_STATUS2_ADDR A:0xfd41a104
y.create.l HWIO_CRYPTO0_CRYPTO_ENGINES_AVAIL_ADDR A:0xfd41a108
y.create.l HWIO_CRYPTO0_CRYPTO_FIFO_SIZES_ADDR A:0xfd41a10c
y.create.l HWIO_CRYPTO0_CRYPTO_SEG_SIZE_ADDR A:0xfd41a110
y.create.l HWIO_CRYPTO0_CRYPTO_GOPROC_ADDR A:0xfd41a120
y.create.l HWIO_CRYPTO0_CRYPTO_GOPROC_QC_KEY_ADDR A:0xfd41b000
y.create.l HWIO_CRYPTO0_CRYPTO_GOPROC_OEM_KEY_ADDR A:0xfd41c000
y.create.l HWIO_CRYPTO0_CRYPTO_ENCR_SEG_CFG_ADDR A:0xfd41a200
y.create.l HWIO_CRYPTO0_CRYPTO_ENCR_SEG_SIZE_ADDR A:0xfd41a204
y.create.l HWIO_CRYPTO0_CRYPTO_ENCR_SEG_START_ADDR A:0xfd41a208
y.create.l HWIO_CRYPTO0_CRYPTO_ENCR_KEY0_ADDR A:0xfd41d000
y.create.l HWIO_CRYPTO0_CRYPTO_ENCR_KEY1_ADDR A:0xfd41d004
y.create.l HWIO_CRYPTO0_CRYPTO_ENCR_KEY2_ADDR A:0xfd41d008
y.create.l HWIO_CRYPTO0_CRYPTO_ENCR_KEY3_ADDR A:0xfd41d00c
y.create.l HWIO_CRYPTO0_CRYPTO_ENCR_KEY4_ADDR A:0xfd41d010
y.create.l HWIO_CRYPTO0_CRYPTO_ENCR_KEY5_ADDR A:0xfd41d014
y.create.l HWIO_CRYPTO0_CRYPTO_ENCR_KEY6_ADDR A:0xfd41d018
y.create.l HWIO_CRYPTO0_CRYPTO_ENCR_KEY7_ADDR A:0xfd41d01c
y.create.l HWIO_CRYPTO0_CRYPTO_ENCR_PIPE0_KEY0_ADDR A:0xfd41e000
y.create.l HWIO_CRYPTO0_CRYPTO_ENCR_PIPE0_KEY1_ADDR A:0xfd41e004
y.create.l HWIO_CRYPTO0_CRYPTO_ENCR_PIPE0_KEY2_ADDR A:0xfd41e008
y.create.l HWIO_CRYPTO0_CRYPTO_ENCR_PIPE0_KEY3_ADDR A:0xfd41e00c
y.create.l HWIO_CRYPTO0_CRYPTO_ENCR_PIPE1_KEY0_ADDR A:0xfd41e020
y.create.l HWIO_CRYPTO0_CRYPTO_ENCR_PIPE1_KEY1_ADDR A:0xfd41e024
y.create.l HWIO_CRYPTO0_CRYPTO_ENCR_PIPE1_KEY2_ADDR A:0xfd41e028
y.create.l HWIO_CRYPTO0_CRYPTO_ENCR_PIPE1_KEY3_ADDR A:0xfd41e02c
y.create.l HWIO_CRYPTO0_CRYPTO_ENCR_PIPE2_KEY0_ADDR A:0xfd41e040
y.create.l HWIO_CRYPTO0_CRYPTO_ENCR_PIPE2_KEY1_ADDR A:0xfd41e044
y.create.l HWIO_CRYPTO0_CRYPTO_ENCR_PIPE2_KEY2_ADDR A:0xfd41e048
y.create.l HWIO_CRYPTO0_CRYPTO_ENCR_PIPE2_KEY3_ADDR A:0xfd41e04c
y.create.l HWIO_CRYPTO0_CRYPTO_ENCR_PIPE3_KEY0_ADDR A:0xfd41e060
y.create.l HWIO_CRYPTO0_CRYPTO_ENCR_PIPE3_KEY1_ADDR A:0xfd41e064
y.create.l HWIO_CRYPTO0_CRYPTO_ENCR_PIPE3_KEY2_ADDR A:0xfd41e068
y.create.l HWIO_CRYPTO0_CRYPTO_ENCR_PIPE3_KEY3_ADDR A:0xfd41e06c
y.create.l HWIO_CRYPTO0_CRYPTO_ENCR_XTS_KEY0_ADDR A:0xfd41d020
y.create.l HWIO_CRYPTO0_CRYPTO_ENCR_XTS_KEY1_ADDR A:0xfd41d024
y.create.l HWIO_CRYPTO0_CRYPTO_ENCR_XTS_KEY2_ADDR A:0xfd41d028
y.create.l HWIO_CRYPTO0_CRYPTO_ENCR_XTS_KEY3_ADDR A:0xfd41d02c
y.create.l HWIO_CRYPTO0_CRYPTO_ENCR_XTS_KEY4_ADDR A:0xfd41d030
y.create.l HWIO_CRYPTO0_CRYPTO_ENCR_XTS_KEY5_ADDR A:0xfd41d034
y.create.l HWIO_CRYPTO0_CRYPTO_ENCR_XTS_KEY6_ADDR A:0xfd41d038
y.create.l HWIO_CRYPTO0_CRYPTO_ENCR_XTS_KEY7_ADDR A:0xfd41d03c
y.create.l HWIO_CRYPTO0_CRYPTO_ENCR_PIPE0_XTS_KEY0_ADDR A:0xfd41e200
y.create.l HWIO_CRYPTO0_CRYPTO_ENCR_PIPE0_XTS_KEY1_ADDR A:0xfd41e204
y.create.l HWIO_CRYPTO0_CRYPTO_ENCR_PIPE0_XTS_KEY2_ADDR A:0xfd41e208
y.create.l HWIO_CRYPTO0_CRYPTO_ENCR_PIPE0_XTS_KEY3_ADDR A:0xfd41e20c
y.create.l HWIO_CRYPTO0_CRYPTO_ENCR_PIPE1_XTS_KEY0_ADDR A:0xfd41e220
y.create.l HWIO_CRYPTO0_CRYPTO_ENCR_PIPE1_XTS_KEY1_ADDR A:0xfd41e224
y.create.l HWIO_CRYPTO0_CRYPTO_ENCR_PIPE1_XTS_KEY2_ADDR A:0xfd41e228
y.create.l HWIO_CRYPTO0_CRYPTO_ENCR_PIPE1_XTS_KEY3_ADDR A:0xfd41e22c
y.create.l HWIO_CRYPTO0_CRYPTO_ENCR_PIPE2_XTS_KEY0_ADDR A:0xfd41e240
y.create.l HWIO_CRYPTO0_CRYPTO_ENCR_PIPE2_XTS_KEY1_ADDR A:0xfd41e244
y.create.l HWIO_CRYPTO0_CRYPTO_ENCR_PIPE2_XTS_KEY2_ADDR A:0xfd41e248
y.create.l HWIO_CRYPTO0_CRYPTO_ENCR_PIPE2_XTS_KEY3_ADDR A:0xfd41e24c
y.create.l HWIO_CRYPTO0_CRYPTO_ENCR_PIPE3_XTS_KEY0_ADDR A:0xfd41e260
y.create.l HWIO_CRYPTO0_CRYPTO_ENCR_PIPE3_XTS_KEY1_ADDR A:0xfd41e264
y.create.l HWIO_CRYPTO0_CRYPTO_ENCR_PIPE3_XTS_KEY2_ADDR A:0xfd41e268
y.create.l HWIO_CRYPTO0_CRYPTO_ENCR_PIPE3_XTS_KEY3_ADDR A:0xfd41e26c
y.create.l HWIO_CRYPTO0_CRYPTO_ENCR_PIPE0_ODD_KEY0_ADDR A:0xfd41e400
y.create.l HWIO_CRYPTO0_CRYPTO_ENCR_PIPE0_ODD_KEY1_ADDR A:0xfd41e404
y.create.l HWIO_CRYPTO0_CRYPTO_ENCR_PIPE0_ODD_KEY2_ADDR A:0xfd41e408
y.create.l HWIO_CRYPTO0_CRYPTO_ENCR_PIPE0_ODD_KEY3_ADDR A:0xfd41e40c
y.create.l HWIO_CRYPTO0_CRYPTO_ENCR_PIPE1_ODD_KEY0_ADDR A:0xfd41e420
y.create.l HWIO_CRYPTO0_CRYPTO_ENCR_PIPE1_ODD_KEY1_ADDR A:0xfd41e424
y.create.l HWIO_CRYPTO0_CRYPTO_ENCR_PIPE1_ODD_KEY2_ADDR A:0xfd41e428
y.create.l HWIO_CRYPTO0_CRYPTO_ENCR_PIPE1_ODD_KEY3_ADDR A:0xfd41e42c
y.create.l HWIO_CRYPTO0_CRYPTO_ENCR_PIPE2_ODD_KEY0_ADDR A:0xfd41e440
y.create.l HWIO_CRYPTO0_CRYPTO_ENCR_PIPE2_ODD_KEY1_ADDR A:0xfd41e444
y.create.l HWIO_CRYPTO0_CRYPTO_ENCR_PIPE2_ODD_KEY2_ADDR A:0xfd41e448
y.create.l HWIO_CRYPTO0_CRYPTO_ENCR_PIPE2_ODD_KEY3_ADDR A:0xfd41e44c
y.create.l HWIO_CRYPTO0_CRYPTO_ENCR_PIPE3_ODD_KEY0_ADDR A:0xfd41e460
y.create.l HWIO_CRYPTO0_CRYPTO_ENCR_PIPE3_ODD_KEY1_ADDR A:0xfd41e464
y.create.l HWIO_CRYPTO0_CRYPTO_ENCR_PIPE3_ODD_KEY2_ADDR A:0xfd41e468
y.create.l HWIO_CRYPTO0_CRYPTO_ENCR_PIPE3_ODD_KEY3_ADDR A:0xfd41e46c
y.create.l HWIO_CRYPTO0_CRYPTO_ENCR_PIPE0_XTS_ODD_KEY0_ADDR A:0xfd41e600
y.create.l HWIO_CRYPTO0_CRYPTO_ENCR_PIPE0_XTS_ODD_KEY1_ADDR A:0xfd41e604
y.create.l HWIO_CRYPTO0_CRYPTO_ENCR_PIPE0_XTS_ODD_KEY2_ADDR A:0xfd41e608
y.create.l HWIO_CRYPTO0_CRYPTO_ENCR_PIPE0_XTS_ODD_KEY3_ADDR A:0xfd41e60c
y.create.l HWIO_CRYPTO0_CRYPTO_ENCR_PIPE1_XTS_ODD_KEY0_ADDR A:0xfd41e620
y.create.l HWIO_CRYPTO0_CRYPTO_ENCR_PIPE1_XTS_ODD_KEY1_ADDR A:0xfd41e624
y.create.l HWIO_CRYPTO0_CRYPTO_ENCR_PIPE1_XTS_ODD_KEY2_ADDR A:0xfd41e628
y.create.l HWIO_CRYPTO0_CRYPTO_ENCR_PIPE1_XTS_ODD_KEY3_ADDR A:0xfd41e62c
y.create.l HWIO_CRYPTO0_CRYPTO_ENCR_PIPE2_XTS_ODD_KEY0_ADDR A:0xfd41e640
y.create.l HWIO_CRYPTO0_CRYPTO_ENCR_PIPE2_XTS_ODD_KEY1_ADDR A:0xfd41e644
y.create.l HWIO_CRYPTO0_CRYPTO_ENCR_PIPE2_XTS_ODD_KEY2_ADDR A:0xfd41e648
y.create.l HWIO_CRYPTO0_CRYPTO_ENCR_PIPE2_XTS_ODD_KEY3_ADDR A:0xfd41e64c
y.create.l HWIO_CRYPTO0_CRYPTO_ENCR_PIPE3_XTS_ODD_KEY0_ADDR A:0xfd41e660
y.create.l HWIO_CRYPTO0_CRYPTO_ENCR_PIPE3_XTS_ODD_KEY1_ADDR A:0xfd41e664
y.create.l HWIO_CRYPTO0_CRYPTO_ENCR_PIPE3_XTS_ODD_KEY2_ADDR A:0xfd41e668
y.create.l HWIO_CRYPTO0_CRYPTO_ENCR_PIPE3_XTS_ODD_KEY3_ADDR A:0xfd41e66c
y.create.l HWIO_CRYPTO0_CRYPTO_ENCR_CNTR0_IV0_ADDR A:0xfd41a20c
y.create.l HWIO_CRYPTO0_CRYPTO_ENCR_CNTR1_IV1_ADDR A:0xfd41a210
y.create.l HWIO_CRYPTO0_CRYPTO_ENCR_CNTR2_IV2_ADDR A:0xfd41a214
y.create.l HWIO_CRYPTO0_CRYPTO_ENCR_CNTR3_IV3_ADDR A:0xfd41a218
y.create.l HWIO_CRYPTO0_CRYPTO_ENCR_CNTR_MASK_ADDR A:0xfd41a21c
y.create.l HWIO_CRYPTO0_CRYPTO_ENCR_CNTR_MASK2_ADDR A:0xfd41a234
y.create.l HWIO_CRYPTO0_CRYPTO_ENCR_CNTR_MASK1_ADDR A:0xfd41a238
y.create.l HWIO_CRYPTO0_CRYPTO_ENCR_CNTR_MASK0_ADDR A:0xfd41a23c
y.create.l HWIO_CRYPTO0_CRYPTO_ENCR_CCM_INIT_CNTR0_ADDR A:0xfd41a220
y.create.l HWIO_CRYPTO0_CRYPTO_ENCR_CCM_INIT_CNTR1_ADDR A:0xfd41a224
y.create.l HWIO_CRYPTO0_CRYPTO_ENCR_CCM_INIT_CNTR2_ADDR A:0xfd41a228
y.create.l HWIO_CRYPTO0_CRYPTO_ENCR_CCM_INIT_CNTR3_ADDR A:0xfd41a22c
y.create.l HWIO_CRYPTO0_CRYPTO_ENCR_XTS_DU_SIZE_ADDR A:0xfd41a230
y.create.l HWIO_CRYPTO0_CRYPTO_AUTH_SEG_CFG_ADDR A:0xfd41a300
y.create.l HWIO_CRYPTO0_CRYPTO_AUTH_SEG_SIZE_ADDR A:0xfd41a304
y.create.l HWIO_CRYPTO0_CRYPTO_AUTH_SEG_START_ADDR A:0xfd41a308
y.create.l HWIO_CRYPTO0_CRYPTO_AUTH_KEY0_ADDR A:0xfd41d040
y.create.l HWIO_CRYPTO0_CRYPTO_AUTH_KEY1_ADDR A:0xfd41d044
y.create.l HWIO_CRYPTO0_CRYPTO_AUTH_KEY2_ADDR A:0xfd41d048
y.create.l HWIO_CRYPTO0_CRYPTO_AUTH_KEY3_ADDR A:0xfd41d04c
y.create.l HWIO_CRYPTO0_CRYPTO_AUTH_KEY4_ADDR A:0xfd41d050
y.create.l HWIO_CRYPTO0_CRYPTO_AUTH_KEY5_ADDR A:0xfd41d054
y.create.l HWIO_CRYPTO0_CRYPTO_AUTH_KEY6_ADDR A:0xfd41d058
y.create.l HWIO_CRYPTO0_CRYPTO_AUTH_KEY7_ADDR A:0xfd41d05c
y.create.l HWIO_CRYPTO0_CRYPTO_AUTH_KEY8_ADDR A:0xfd41d060
y.create.l HWIO_CRYPTO0_CRYPTO_AUTH_KEY9_ADDR A:0xfd41d064
y.create.l HWIO_CRYPTO0_CRYPTO_AUTH_PIPE0_KEY0_ADDR A:0xfd41e800
y.create.l HWIO_CRYPTO0_CRYPTO_AUTH_PIPE0_KEY1_ADDR A:0xfd41e804
y.create.l HWIO_CRYPTO0_CRYPTO_AUTH_PIPE0_KEY2_ADDR A:0xfd41e808
y.create.l HWIO_CRYPTO0_CRYPTO_AUTH_PIPE0_KEY3_ADDR A:0xfd41e80c
y.create.l HWIO_CRYPTO0_CRYPTO_AUTH_PIPE1_KEY0_ADDR A:0xfd41e880
y.create.l HWIO_CRYPTO0_CRYPTO_AUTH_PIPE1_KEY1_ADDR A:0xfd41e884
y.create.l HWIO_CRYPTO0_CRYPTO_AUTH_PIPE1_KEY2_ADDR A:0xfd41e888
y.create.l HWIO_CRYPTO0_CRYPTO_AUTH_PIPE1_KEY3_ADDR A:0xfd41e88c
y.create.l HWIO_CRYPTO0_CRYPTO_AUTH_PIPE2_KEY0_ADDR A:0xfd41e900
y.create.l HWIO_CRYPTO0_CRYPTO_AUTH_PIPE2_KEY1_ADDR A:0xfd41e904
y.create.l HWIO_CRYPTO0_CRYPTO_AUTH_PIPE2_KEY2_ADDR A:0xfd41e908
y.create.l HWIO_CRYPTO0_CRYPTO_AUTH_PIPE2_KEY3_ADDR A:0xfd41e90c
y.create.l HWIO_CRYPTO0_CRYPTO_AUTH_PIPE3_KEY0_ADDR A:0xfd41e980
y.create.l HWIO_CRYPTO0_CRYPTO_AUTH_PIPE3_KEY1_ADDR A:0xfd41e984
y.create.l HWIO_CRYPTO0_CRYPTO_AUTH_PIPE3_KEY2_ADDR A:0xfd41e988
y.create.l HWIO_CRYPTO0_CRYPTO_AUTH_PIPE3_KEY3_ADDR A:0xfd41e98c
y.create.l HWIO_CRYPTO0_CRYPTO_AUTH_IV0_ADDR A:0xfd41a310
y.create.l HWIO_CRYPTO0_CRYPTO_AUTH_IV1_ADDR A:0xfd41a314
y.create.l HWIO_CRYPTO0_CRYPTO_AUTH_IV2_ADDR A:0xfd41a318
y.create.l HWIO_CRYPTO0_CRYPTO_AUTH_IV3_ADDR A:0xfd41a31c
y.create.l HWIO_CRYPTO0_CRYPTO_AUTH_IV4_ADDR A:0xfd41a320
y.create.l HWIO_CRYPTO0_CRYPTO_AUTH_IV5_ADDR A:0xfd41a324
y.create.l HWIO_CRYPTO0_CRYPTO_AUTH_IV6_ADDR A:0xfd41a328
y.create.l HWIO_CRYPTO0_CRYPTO_AUTH_IV7_ADDR A:0xfd41a32c
y.create.l HWIO_CRYPTO0_CRYPTO_AUTH_INFO_NONCE0_ADDR A:0xfd41a350
y.create.l HWIO_CRYPTO0_CRYPTO_AUTH_INFO_NONCE1_ADDR A:0xfd41a354
y.create.l HWIO_CRYPTO0_CRYPTO_AUTH_INFO_NONCE2_ADDR A:0xfd41a358
y.create.l HWIO_CRYPTO0_CRYPTO_AUTH_INFO_NONCE3_ADDR A:0xfd41a35c
y.create.l HWIO_CRYPTO0_CRYPTO_AUTH_BYTECNT0_ADDR A:0xfd41a390
y.create.l HWIO_CRYPTO0_CRYPTO_AUTH_BYTECNT1_ADDR A:0xfd41a394
y.create.l HWIO_CRYPTO0_CRYPTO_AUTH_EXP_MAC0_ADDR A:0xfd41a3a0
y.create.l HWIO_CRYPTO0_CRYPTO_AUTH_EXP_MAC1_ADDR A:0xfd41a3a4
y.create.l HWIO_CRYPTO0_CRYPTO_AUTH_EXP_MAC2_ADDR A:0xfd41a3a8
y.create.l HWIO_CRYPTO0_CRYPTO_AUTH_EXP_MAC3_ADDR A:0xfd41a3ac
y.create.l HWIO_CRYPTO0_CRYPTO_AUTH_EXP_MAC4_ADDR A:0xfd41a3b0
y.create.l HWIO_CRYPTO0_CRYPTO_AUTH_EXP_MAC5_ADDR A:0xfd41a3b4
y.create.l HWIO_CRYPTO0_CRYPTO_AUTH_EXP_MAC6_ADDR A:0xfd41a3b8
y.create.l HWIO_CRYPTO0_CRYPTO_AUTH_EXP_MAC7_ADDR A:0xfd41a3bc
y.create.l HWIO_CRYPTO0_CRYPTO_CONFIG_ADDR A:0xfd41a400
y.create.l HWIO_CRYPTO0_CRYPTO_DEBUG_ENABLE_ADDR A:0xfd41f000
y.create.l HWIO_CRYPTO0_CRYPTO_DEBUG_ADDR A:0xfd41f004
y.create.l HWIO_CRYPTO0_CRYPTO_PWR_CTRL_ADDR A:0xfd41f008
y.create.l HWIO_CRYPTO0_CRYPTO_AXI_VMIDMT_SCR0_ADDR A:0xfd419000
y.create.l HWIO_CRYPTO0_CRYPTO_AXI_VMIDMT_SCR1_ADDR A:0xfd419004
y.create.l HWIO_CRYPTO0_CRYPTO_AXI_VMIDMT_SCR2_ADDR A:0xfd419008
y.create.l HWIO_CRYPTO0_CRYPTO_AXI_VMIDMT_SACR_ADDR A:0xfd419010
y.create.l HWIO_CRYPTO0_CRYPTO_AXI_VMIDMT_SIDR0_ADDR A:0xfd419020
y.create.l HWIO_CRYPTO0_CRYPTO_AXI_VMIDMT_SIDR1_ADDR A:0xfd419024
y.create.l HWIO_CRYPTO0_CRYPTO_AXI_VMIDMT_SIDR2_ADDR A:0xfd419028
y.create.l HWIO_CRYPTO0_CRYPTO_AXI_VMIDMT_SIDR4_ADDR A:0xfd419030
y.create.l HWIO_CRYPTO0_CRYPTO_AXI_VMIDMT_SIDR5_ADDR A:0xfd419034
y.create.l HWIO_CRYPTO0_CRYPTO_AXI_VMIDMT_SIDR7_ADDR A:0xfd41903c
y.create.l HWIO_CRYPTO0_CRYPTO_AXI_VMIDMT_SGFAR0_ADDR A:0xfd419040
y.create.l HWIO_CRYPTO0_CRYPTO_AXI_VMIDMT_SGFSR_ADDR A:0xfd419048
y.create.l HWIO_CRYPTO0_CRYPTO_AXI_VMIDMT_SGFSRRESTORE_ADDR A:0xfd41904c
y.create.l HWIO_CRYPTO0_CRYPTO_AXI_VMIDMT_SGFSYNDR0_ADDR A:0xfd419050
y.create.l HWIO_CRYPTO0_CRYPTO_AXI_VMIDMT_SGFSYNDR1_ADDR A:0xfd419054
y.create.l HWIO_CRYPTO0_CRYPTO_AXI_VMIDMT_SGFSYNDR2_ADDR A:0xfd419058
y.create.l HWIO_CRYPTO0_CRYPTO_AXI_VMIDMT_VMIDMTSCR0_ADDR A:0xfd419090
y.create.l HWIO_CRYPTO0_CRYPTO_AXI_VMIDMT_CR0_ADDR A:0xfd419000
y.create.l HWIO_CRYPTO0_CRYPTO_AXI_VMIDMT_CR2_ADDR A:0xfd419008
y.create.l HWIO_CRYPTO0_CRYPTO_AXI_VMIDMT_ACR_ADDR A:0xfd419010
y.create.l HWIO_CRYPTO0_CRYPTO_AXI_VMIDMT_IDR0_ADDR A:0xfd419020
y.create.l HWIO_CRYPTO0_CRYPTO_AXI_VMIDMT_IDR1_ADDR A:0xfd419024
y.create.l HWIO_CRYPTO0_CRYPTO_AXI_VMIDMT_IDR2_ADDR A:0xfd419028
y.create.l HWIO_CRYPTO0_CRYPTO_AXI_VMIDMT_IDR4_ADDR A:0xfd419030
y.create.l HWIO_CRYPTO0_CRYPTO_AXI_VMIDMT_IDR5_ADDR A:0xfd419034
y.create.l HWIO_CRYPTO0_CRYPTO_AXI_VMIDMT_IDR7_ADDR A:0xfd41903c
y.create.l HWIO_CRYPTO0_CRYPTO_AXI_VMIDMT_GFAR0_ADDR A:0xfd419040
y.create.l HWIO_CRYPTO0_CRYPTO_AXI_VMIDMT_GFSR_ADDR A:0xfd419048
y.create.l HWIO_CRYPTO0_CRYPTO_AXI_VMIDMT_GFSRRESTORE_ADDR A:0xfd41904c
y.create.l HWIO_CRYPTO0_CRYPTO_AXI_VMIDMT_GFSYNDR0_ADDR A:0xfd419050
y.create.l HWIO_CRYPTO0_CRYPTO_AXI_VMIDMT_GFSYNDR1_ADDR A:0xfd419054
y.create.l HWIO_CRYPTO0_CRYPTO_AXI_VMIDMT_GFSYNDR2_ADDR A:0xfd419058
y.create.l HWIO_CRYPTO0_CRYPTO_AXI_VMIDMT_VMIDMTCR0_ADDR A:0xfd419090
y.create.l HWIO_CRYPTO0_CRYPTO_AXI_VMIDMT_VMIDMTACR_ADDR A:0xfd41909c
y.create.l HWIO_CRYPTO0_CRYPTO_AXI_VMIDMT_NSCR0_ADDR A:0xfd419400
y.create.l HWIO_CRYPTO0_CRYPTO_AXI_VMIDMT_NSCR2_ADDR A:0xfd419408
y.create.l HWIO_CRYPTO0_CRYPTO_AXI_VMIDMT_NSACR_ADDR A:0xfd419410
y.create.l HWIO_CRYPTO0_CRYPTO_AXI_VMIDMT_NSGFAR0_ADDR A:0xfd419440
y.create.l HWIO_CRYPTO0_CRYPTO_AXI_VMIDMT_NSGFSR_ADDR A:0xfd419448
y.create.l HWIO_CRYPTO0_CRYPTO_AXI_VMIDMT_NSGFSRRESTORE_ADDR A:0xfd41944c
y.create.l HWIO_CRYPTO0_CRYPTO_AXI_VMIDMT_NSGFSYNDR0_ADDR A:0xfd419450
y.create.l HWIO_CRYPTO0_CRYPTO_AXI_VMIDMT_NSGFSYNDR1_ADDR A:0xfd419454
y.create.l HWIO_CRYPTO0_CRYPTO_AXI_VMIDMT_NSGFSYNDR2_ADDR A:0xfd419458
y.create.l HWIO_CRYPTO0_CRYPTO_AXI_VMIDMT_NSVMIDMTCR0_ADDR A:0xfd419490
y.create.l HWIO_CRYPTO0_CRYPTO_AXI_VMIDMT_SSDR0_ADDR A:0xfd419080
y.create.l HWIO_CRYPTO0_CRYPTO_AXI_VMIDMT_MSDR0_ADDR A:0xfd419480
y.create.l HWIO_CRYPTO0_CRYPTO_AXI_VMIDMT_MCR_ADDR A:0xfd419494
y.create.l HWIO_CRYPTO0_CRYPTO_AXI_VMIDMT_S2VR0_ADDR A:0xfd419c00
y.create.l HWIO_CRYPTO0_CRYPTO_AXI_VMIDMT_S2VR1_ADDR A:0xfd419c04
y.create.l HWIO_CRYPTO0_CRYPTO_AXI_VMIDMT_S2VR2_ADDR A:0xfd419c08
y.create.l HWIO_CRYPTO0_CRYPTO_AXI_VMIDMT_S2VR3_ADDR A:0xfd419c0c
y.create.l HWIO_CRYPTO0_CRYPTO_AXI_VMIDMT_S2VR4_ADDR A:0xfd419c10
y.create.l HWIO_CRYPTO0_CRYPTO_AXI_VMIDMT_S2VR5_ADDR A:0xfd419c14
y.create.l HWIO_CRYPTO0_CRYPTO_AXI_VMIDMT_S2VR6_ADDR A:0xfd419c18
y.create.l HWIO_CRYPTO0_CRYPTO_AXI_VMIDMT_S2VR7_ADDR A:0xfd419c1c
y.create.l HWIO_CRYPTO0_CRYPTO_AXI_VMIDMT_S2VR8_ADDR A:0xfd419c20
y.create.l HWIO_CRYPTO0_CRYPTO_AXI_VMIDMT_S2VR9_ADDR A:0xfd419c24
y.create.l HWIO_CRYPTO0_CRYPTO_AXI_VMIDMT_AS2VR0_ADDR A:0xfd419e00
y.create.l HWIO_CRYPTO0_CRYPTO_AXI_VMIDMT_AS2VR1_ADDR A:0xfd419e04
y.create.l HWIO_CRYPTO0_CRYPTO_AXI_VMIDMT_AS2VR2_ADDR A:0xfd419e08
y.create.l HWIO_CRYPTO0_CRYPTO_AXI_VMIDMT_AS2VR3_ADDR A:0xfd419e0c
y.create.l HWIO_CRYPTO0_CRYPTO_AXI_VMIDMT_AS2VR4_ADDR A:0xfd419e10
y.create.l HWIO_CRYPTO0_CRYPTO_AXI_VMIDMT_AS2VR5_ADDR A:0xfd419e14
y.create.l HWIO_CRYPTO0_CRYPTO_AXI_VMIDMT_AS2VR6_ADDR A:0xfd419e18
y.create.l HWIO_CRYPTO0_CRYPTO_AXI_VMIDMT_AS2VR7_ADDR A:0xfd419e1c
y.create.l HWIO_CRYPTO0_CRYPTO_AXI_VMIDMT_AS2VR8_ADDR A:0xfd419e20
y.create.l HWIO_CRYPTO0_CRYPTO_AXI_VMIDMT_AS2VR9_ADDR A:0xfd419e24
y.create.l HWIO_CRYPTO0_CRYPTO_AXI_VMIDMT_SMR0_ADDR A:0xfd419800
y.create.l HWIO_CRYPTO0_CRYPTO_AXI_VMIDMT_SMR1_ADDR A:0xfd419804
y.create.l HWIO_CRYPTO0_CRYPTO_AXI_VMIDMT_SMR2_ADDR A:0xfd419808
y.create.l HWIO_CRYPTO0_CRYPTO_AXI_VMIDMT_SMR3_ADDR A:0xfd41980c
y.create.l HWIO_CRYPTO0_CRYPTO_AXI_VMIDMT_SMR4_ADDR A:0xfd419810
y.create.l HWIO_CRYPTO0_CRYPTO_AXI_VMIDMT_SMR5_ADDR A:0xfd419814
y.create.l HWIO_CRYPTO0_CRYPTO_AXI_VMIDMT_SMR6_ADDR A:0xfd419818
y.create.l HWIO_CRYPTO0_CRYPTO_AXI_VMIDMT_SMR7_ADDR A:0xfd41981c
y.create.l HWIO_CRYPTO0_CRYPTO_AXI_VMIDMT_SMR8_ADDR A:0xfd419820
y.create.l HWIO_CRYPTO0_CRYPTO_AXI_VMIDMT_SMR9_ADDR A:0xfd419824
y.create.l HWIO_CRYPTO0_CRYPTO_BAM_CTRL_ADDR A:0xfd404000
y.create.l HWIO_CRYPTO0_CRYPTO_BAM_REVISION_ADDR A:0xfd404004
y.create.l HWIO_CRYPTO0_CRYPTO_BAM_SW_VERSION_ADDR A:0xfd404080
y.create.l HWIO_CRYPTO0_CRYPTO_BAM_NUM_PIPES_ADDR A:0xfd40403c
y.create.l HWIO_CRYPTO0_CRYPTO_BAM_TIMER_ADDR A:0xfd404040
y.create.l HWIO_CRYPTO0_CRYPTO_BAM_TIMER_CTRL_ADDR A:0xfd404044
y.create.l HWIO_CRYPTO0_CRYPTO_BAM_DESC_CNT_TRSHLD_ADDR A:0xfd404008
y.create.l HWIO_CRYPTO0_CRYPTO_BAM_IRQ_SRCS_ADDR A:0xfd40400c
y.create.l HWIO_CRYPTO0_CRYPTO_BAM_IRQ_SRCS_MSK_ADDR A:0xfd404010
y.create.l HWIO_CRYPTO0_CRYPTO_BAM_IRQ_SRCS_UNMASKED_ADDR A:0xfd404030
y.create.l HWIO_CRYPTO0_CRYPTO_BAM_IRQ_STTS_ADDR A:0xfd404014
y.create.l HWIO_CRYPTO0_CRYPTO_BAM_IRQ_CLR_ADDR A:0xfd404018
y.create.l HWIO_CRYPTO0_CRYPTO_BAM_IRQ_EN_ADDR A:0xfd40401c
y.create.l HWIO_CRYPTO0_CRYPTO_BAM_AHB_MASTER_ERR_CTRLS_ADDR A:0xfd404024
y.create.l HWIO_CRYPTO0_CRYPTO_BAM_AHB_MASTER_ERR_ADDR_ADDR A:0xfd404028
y.create.l HWIO_CRYPTO0_CRYPTO_BAM_AHB_MASTER_ERR_ADDR_LSB_ADDR A:0xfd404100
y.create.l HWIO_CRYPTO0_CRYPTO_BAM_AHB_MASTER_ERR_ADDR_MSB_ADDR A:0xfd404104
y.create.l HWIO_CRYPTO0_CRYPTO_BAM_AHB_MASTER_ERR_DATA_ADDR A:0xfd40402c
y.create.l HWIO_CRYPTO0_CRYPTO_BAM_TRUST_REG_ADDR A:0xfd404070
y.create.l HWIO_CRYPTO0_CRYPTO_BAM_TEST_BUS_SEL_ADDR A:0xfd404074
y.create.l HWIO_CRYPTO0_CRYPTO_BAM_TEST_BUS_REG_ADDR A:0xfd404078
y.create.l HWIO_CRYPTO0_CRYPTO_BAM_CNFG_BITS_ADDR A:0xfd40407c
y.create.l HWIO_CRYPTO0_CRYPTO_BAM_IRQ_SRCS_EE0_ADDR A:0xfd404800
y.create.l HWIO_CRYPTO0_CRYPTO_BAM_IRQ_SRCS_EE1_ADDR A:0xfd404880
y.create.l HWIO_CRYPTO0_CRYPTO_BAM_IRQ_SRCS_EE2_ADDR A:0xfd404900
y.create.l HWIO_CRYPTO0_CRYPTO_BAM_IRQ_SRCS_EE3_ADDR A:0xfd404980
y.create.l HWIO_CRYPTO0_CRYPTO_BAM_IRQ_SRCS_EE4_ADDR A:0xfd404a00
y.create.l HWIO_CRYPTO0_CRYPTO_BAM_IRQ_SRCS_EE5_ADDR A:0xfd404a80
y.create.l HWIO_CRYPTO0_CRYPTO_BAM_IRQ_SRCS_EE6_ADDR A:0xfd404b00
y.create.l HWIO_CRYPTO0_CRYPTO_BAM_IRQ_SRCS_EE7_ADDR A:0xfd404b80
y.create.l HWIO_CRYPTO0_CRYPTO_BAM_IRQ_SRCS_MSK_EE0_ADDR A:0xfd404804
y.create.l HWIO_CRYPTO0_CRYPTO_BAM_IRQ_SRCS_MSK_EE1_ADDR A:0xfd404884
y.create.l HWIO_CRYPTO0_CRYPTO_BAM_IRQ_SRCS_MSK_EE2_ADDR A:0xfd404904
y.create.l HWIO_CRYPTO0_CRYPTO_BAM_IRQ_SRCS_MSK_EE3_ADDR A:0xfd404984
y.create.l HWIO_CRYPTO0_CRYPTO_BAM_IRQ_SRCS_MSK_EE4_ADDR A:0xfd404a04
y.create.l HWIO_CRYPTO0_CRYPTO_BAM_IRQ_SRCS_MSK_EE5_ADDR A:0xfd404a84
y.create.l HWIO_CRYPTO0_CRYPTO_BAM_IRQ_SRCS_MSK_EE6_ADDR A:0xfd404b04
y.create.l HWIO_CRYPTO0_CRYPTO_BAM_IRQ_SRCS_MSK_EE7_ADDR A:0xfd404b84
y.create.l HWIO_CRYPTO0_CRYPTO_BAM_IRQ_SRCS_UNMASKED_EE0_ADDR A:0xfd404808
y.create.l HWIO_CRYPTO0_CRYPTO_BAM_IRQ_SRCS_UNMASKED_EE1_ADDR A:0xfd404888
y.create.l HWIO_CRYPTO0_CRYPTO_BAM_IRQ_SRCS_UNMASKED_EE2_ADDR A:0xfd404908
y.create.l HWIO_CRYPTO0_CRYPTO_BAM_IRQ_SRCS_UNMASKED_EE3_ADDR A:0xfd404988
y.create.l HWIO_CRYPTO0_CRYPTO_BAM_IRQ_SRCS_UNMASKED_EE4_ADDR A:0xfd404a08
y.create.l HWIO_CRYPTO0_CRYPTO_BAM_IRQ_SRCS_UNMASKED_EE5_ADDR A:0xfd404a88
y.create.l HWIO_CRYPTO0_CRYPTO_BAM_IRQ_SRCS_UNMASKED_EE6_ADDR A:0xfd404b08
y.create.l HWIO_CRYPTO0_CRYPTO_BAM_IRQ_SRCS_UNMASKED_EE7_ADDR A:0xfd404b88
y.create.l HWIO_CRYPTO0_CRYPTO_BAM_PIPE_ATTR_EE0_ADDR A:0xfd40480c
y.create.l HWIO_CRYPTO0_CRYPTO_BAM_PIPE_ATTR_EE1_ADDR A:0xfd40488c
y.create.l HWIO_CRYPTO0_CRYPTO_BAM_PIPE_ATTR_EE2_ADDR A:0xfd40490c
y.create.l HWIO_CRYPTO0_CRYPTO_BAM_PIPE_ATTR_EE3_ADDR A:0xfd40498c
y.create.l HWIO_CRYPTO0_CRYPTO_BAM_PIPE_ATTR_EE4_ADDR A:0xfd404a0c
y.create.l HWIO_CRYPTO0_CRYPTO_BAM_PIPE_ATTR_EE5_ADDR A:0xfd404a8c
y.create.l HWIO_CRYPTO0_CRYPTO_BAM_PIPE_ATTR_EE6_ADDR A:0xfd404b0c
y.create.l HWIO_CRYPTO0_CRYPTO_BAM_PIPE_ATTR_EE7_ADDR A:0xfd404b8c
y.create.l HWIO_CRYPTO0_CRYPTO_BAM_P_CTRL0_ADDR A:0xfd405000
y.create.l HWIO_CRYPTO0_CRYPTO_BAM_P_CTRL1_ADDR A:0xfd406000
y.create.l HWIO_CRYPTO0_CRYPTO_BAM_P_CTRL2_ADDR A:0xfd407000
y.create.l HWIO_CRYPTO0_CRYPTO_BAM_P_CTRL3_ADDR A:0xfd408000
y.create.l HWIO_CRYPTO0_CRYPTO_BAM_P_CTRL4_ADDR A:0xfd409000
y.create.l HWIO_CRYPTO0_CRYPTO_BAM_P_CTRL5_ADDR A:0xfd40a000
y.create.l HWIO_CRYPTO0_CRYPTO_BAM_P_CTRL6_ADDR A:0xfd40b000
y.create.l HWIO_CRYPTO0_CRYPTO_BAM_P_CTRL7_ADDR A:0xfd40c000
y.create.l HWIO_CRYPTO0_CRYPTO_BAM_P_RST0_ADDR A:0xfd405004
y.create.l HWIO_CRYPTO0_CRYPTO_BAM_P_RST1_ADDR A:0xfd406004
y.create.l HWIO_CRYPTO0_CRYPTO_BAM_P_RST2_ADDR A:0xfd407004
y.create.l HWIO_CRYPTO0_CRYPTO_BAM_P_RST3_ADDR A:0xfd408004
y.create.l HWIO_CRYPTO0_CRYPTO_BAM_P_RST4_ADDR A:0xfd409004
y.create.l HWIO_CRYPTO0_CRYPTO_BAM_P_RST5_ADDR A:0xfd40a004
y.create.l HWIO_CRYPTO0_CRYPTO_BAM_P_RST6_ADDR A:0xfd40b004
y.create.l HWIO_CRYPTO0_CRYPTO_BAM_P_RST7_ADDR A:0xfd40c004
y.create.l HWIO_CRYPTO0_CRYPTO_BAM_P_HALT0_ADDR A:0xfd405008
y.create.l HWIO_CRYPTO0_CRYPTO_BAM_P_HALT1_ADDR A:0xfd406008
y.create.l HWIO_CRYPTO0_CRYPTO_BAM_P_HALT2_ADDR A:0xfd407008
y.create.l HWIO_CRYPTO0_CRYPTO_BAM_P_HALT3_ADDR A:0xfd408008
y.create.l HWIO_CRYPTO0_CRYPTO_BAM_P_HALT4_ADDR A:0xfd409008
y.create.l HWIO_CRYPTO0_CRYPTO_BAM_P_HALT5_ADDR A:0xfd40a008
y.create.l HWIO_CRYPTO0_CRYPTO_BAM_P_HALT6_ADDR A:0xfd40b008
y.create.l HWIO_CRYPTO0_CRYPTO_BAM_P_HALT7_ADDR A:0xfd40c008
y.create.l HWIO_CRYPTO0_CRYPTO_BAM_P_TRUST_REG0_ADDR A:0xfd405030
y.create.l HWIO_CRYPTO0_CRYPTO_BAM_P_TRUST_REG1_ADDR A:0xfd406030
y.create.l HWIO_CRYPTO0_CRYPTO_BAM_P_TRUST_REG2_ADDR A:0xfd407030
y.create.l HWIO_CRYPTO0_CRYPTO_BAM_P_TRUST_REG3_ADDR A:0xfd408030
y.create.l HWIO_CRYPTO0_CRYPTO_BAM_P_TRUST_REG4_ADDR A:0xfd409030
y.create.l HWIO_CRYPTO0_CRYPTO_BAM_P_TRUST_REG5_ADDR A:0xfd40a030
y.create.l HWIO_CRYPTO0_CRYPTO_BAM_P_TRUST_REG6_ADDR A:0xfd40b030
y.create.l HWIO_CRYPTO0_CRYPTO_BAM_P_TRUST_REG7_ADDR A:0xfd40c030
y.create.l HWIO_CRYPTO0_CRYPTO_BAM_P_IRQ_STTS0_ADDR A:0xfd405010
y.create.l HWIO_CRYPTO0_CRYPTO_BAM_P_IRQ_STTS1_ADDR A:0xfd406010
y.create.l HWIO_CRYPTO0_CRYPTO_BAM_P_IRQ_STTS2_ADDR A:0xfd407010
y.create.l HWIO_CRYPTO0_CRYPTO_BAM_P_IRQ_STTS3_ADDR A:0xfd408010
y.create.l HWIO_CRYPTO0_CRYPTO_BAM_P_IRQ_STTS4_ADDR A:0xfd409010
y.create.l HWIO_CRYPTO0_CRYPTO_BAM_P_IRQ_STTS5_ADDR A:0xfd40a010
y.create.l HWIO_CRYPTO0_CRYPTO_BAM_P_IRQ_STTS6_ADDR A:0xfd40b010
y.create.l HWIO_CRYPTO0_CRYPTO_BAM_P_IRQ_STTS7_ADDR A:0xfd40c010
y.create.l HWIO_CRYPTO0_CRYPTO_BAM_P_IRQ_CLR0_ADDR A:0xfd405014
y.create.l HWIO_CRYPTO0_CRYPTO_BAM_P_IRQ_CLR1_ADDR A:0xfd406014
y.create.l HWIO_CRYPTO0_CRYPTO_BAM_P_IRQ_CLR2_ADDR A:0xfd407014
y.create.l HWIO_CRYPTO0_CRYPTO_BAM_P_IRQ_CLR3_ADDR A:0xfd408014
y.create.l HWIO_CRYPTO0_CRYPTO_BAM_P_IRQ_CLR4_ADDR A:0xfd409014
y.create.l HWIO_CRYPTO0_CRYPTO_BAM_P_IRQ_CLR5_ADDR A:0xfd40a014
y.create.l HWIO_CRYPTO0_CRYPTO_BAM_P_IRQ_CLR6_ADDR A:0xfd40b014
y.create.l HWIO_CRYPTO0_CRYPTO_BAM_P_IRQ_CLR7_ADDR A:0xfd40c014
y.create.l HWIO_CRYPTO0_CRYPTO_BAM_P_IRQ_EN0_ADDR A:0xfd405018
y.create.l HWIO_CRYPTO0_CRYPTO_BAM_P_IRQ_EN1_ADDR A:0xfd406018
y.create.l HWIO_CRYPTO0_CRYPTO_BAM_P_IRQ_EN2_ADDR A:0xfd407018
y.create.l HWIO_CRYPTO0_CRYPTO_BAM_P_IRQ_EN3_ADDR A:0xfd408018
y.create.l HWIO_CRYPTO0_CRYPTO_BAM_P_IRQ_EN4_ADDR A:0xfd409018
y.create.l HWIO_CRYPTO0_CRYPTO_BAM_P_IRQ_EN5_ADDR A:0xfd40a018
y.create.l HWIO_CRYPTO0_CRYPTO_BAM_P_IRQ_EN6_ADDR A:0xfd40b018
y.create.l HWIO_CRYPTO0_CRYPTO_BAM_P_IRQ_EN7_ADDR A:0xfd40c018
y.create.l HWIO_CRYPTO0_CRYPTO_BAM_P_TIMER0_ADDR A:0xfd40501c
y.create.l HWIO_CRYPTO0_CRYPTO_BAM_P_TIMER1_ADDR A:0xfd40601c
y.create.l HWIO_CRYPTO0_CRYPTO_BAM_P_TIMER2_ADDR A:0xfd40701c
y.create.l HWIO_CRYPTO0_CRYPTO_BAM_P_TIMER3_ADDR A:0xfd40801c
y.create.l HWIO_CRYPTO0_CRYPTO_BAM_P_TIMER4_ADDR A:0xfd40901c
y.create.l HWIO_CRYPTO0_CRYPTO_BAM_P_TIMER5_ADDR A:0xfd40a01c
y.create.l HWIO_CRYPTO0_CRYPTO_BAM_P_TIMER6_ADDR A:0xfd40b01c
y.create.l HWIO_CRYPTO0_CRYPTO_BAM_P_TIMER7_ADDR A:0xfd40c01c
y.create.l HWIO_CRYPTO0_CRYPTO_BAM_P_TIMER_CTRL0_ADDR A:0xfd405020
y.create.l HWIO_CRYPTO0_CRYPTO_BAM_P_TIMER_CTRL1_ADDR A:0xfd406020
y.create.l HWIO_CRYPTO0_CRYPTO_BAM_P_TIMER_CTRL2_ADDR A:0xfd407020
y.create.l HWIO_CRYPTO0_CRYPTO_BAM_P_TIMER_CTRL3_ADDR A:0xfd408020
y.create.l HWIO_CRYPTO0_CRYPTO_BAM_P_TIMER_CTRL4_ADDR A:0xfd409020
y.create.l HWIO_CRYPTO0_CRYPTO_BAM_P_TIMER_CTRL5_ADDR A:0xfd40a020
y.create.l HWIO_CRYPTO0_CRYPTO_BAM_P_TIMER_CTRL6_ADDR A:0xfd40b020
y.create.l HWIO_CRYPTO0_CRYPTO_BAM_P_TIMER_CTRL7_ADDR A:0xfd40c020
y.create.l HWIO_CRYPTO0_CRYPTO_BAM_P_PRDCR_SDBND0_ADDR A:0xfd405024
y.create.l HWIO_CRYPTO0_CRYPTO_BAM_P_PRDCR_SDBND1_ADDR A:0xfd406024
y.create.l HWIO_CRYPTO0_CRYPTO_BAM_P_PRDCR_SDBND2_ADDR A:0xfd407024
y.create.l HWIO_CRYPTO0_CRYPTO_BAM_P_PRDCR_SDBND3_ADDR A:0xfd408024
y.create.l HWIO_CRYPTO0_CRYPTO_BAM_P_PRDCR_SDBND4_ADDR A:0xfd409024
y.create.l HWIO_CRYPTO0_CRYPTO_BAM_P_PRDCR_SDBND5_ADDR A:0xfd40a024
y.create.l HWIO_CRYPTO0_CRYPTO_BAM_P_PRDCR_SDBND6_ADDR A:0xfd40b024
y.create.l HWIO_CRYPTO0_CRYPTO_BAM_P_PRDCR_SDBND7_ADDR A:0xfd40c024
y.create.l HWIO_CRYPTO0_CRYPTO_BAM_P_CNSMR_SDBND0_ADDR A:0xfd405028
y.create.l HWIO_CRYPTO0_CRYPTO_BAM_P_CNSMR_SDBND1_ADDR A:0xfd406028
y.create.l HWIO_CRYPTO0_CRYPTO_BAM_P_CNSMR_SDBND2_ADDR A:0xfd407028
y.create.l HWIO_CRYPTO0_CRYPTO_BAM_P_CNSMR_SDBND3_ADDR A:0xfd408028
y.create.l HWIO_CRYPTO0_CRYPTO_BAM_P_CNSMR_SDBND4_ADDR A:0xfd409028
y.create.l HWIO_CRYPTO0_CRYPTO_BAM_P_CNSMR_SDBND5_ADDR A:0xfd40a028
y.create.l HWIO_CRYPTO0_CRYPTO_BAM_P_CNSMR_SDBND6_ADDR A:0xfd40b028
y.create.l HWIO_CRYPTO0_CRYPTO_BAM_P_CNSMR_SDBND7_ADDR A:0xfd40c028
y.create.l HWIO_CRYPTO0_CRYPTO_BAM_P_EVNT_DEST_ADDR0_ADDR A:0xfd40582c
y.create.l HWIO_CRYPTO0_CRYPTO_BAM_P_EVNT_DEST_ADDR1_ADDR A:0xfd40682c
y.create.l HWIO_CRYPTO0_CRYPTO_BAM_P_EVNT_DEST_ADDR2_ADDR A:0xfd40782c
y.create.l HWIO_CRYPTO0_CRYPTO_BAM_P_EVNT_DEST_ADDR3_ADDR A:0xfd40882c
y.create.l HWIO_CRYPTO0_CRYPTO_BAM_P_EVNT_DEST_ADDR4_ADDR A:0xfd40982c
y.create.l HWIO_CRYPTO0_CRYPTO_BAM_P_EVNT_DEST_ADDR5_ADDR A:0xfd40a82c
y.create.l HWIO_CRYPTO0_CRYPTO_BAM_P_EVNT_DEST_ADDR6_ADDR A:0xfd40b82c
y.create.l HWIO_CRYPTO0_CRYPTO_BAM_P_EVNT_DEST_ADDR7_ADDR A:0xfd40c82c
y.create.l HWIO_CRYPTO0_CRYPTO_BAM_P_EVNT_DEST_ADDR_LSB0_ADDR A:0xfd405930
y.create.l HWIO_CRYPTO0_CRYPTO_BAM_P_EVNT_DEST_ADDR_LSB1_ADDR A:0xfd406930
y.create.l HWIO_CRYPTO0_CRYPTO_BAM_P_EVNT_DEST_ADDR_LSB2_ADDR A:0xfd407930
y.create.l HWIO_CRYPTO0_CRYPTO_BAM_P_EVNT_DEST_ADDR_LSB3_ADDR A:0xfd408930
y.create.l HWIO_CRYPTO0_CRYPTO_BAM_P_EVNT_DEST_ADDR_LSB4_ADDR A:0xfd409930
y.create.l HWIO_CRYPTO0_CRYPTO_BAM_P_EVNT_DEST_ADDR_LSB5_ADDR A:0xfd40a930
y.create.l HWIO_CRYPTO0_CRYPTO_BAM_P_EVNT_DEST_ADDR_LSB6_ADDR A:0xfd40b930
y.create.l HWIO_CRYPTO0_CRYPTO_BAM_P_EVNT_DEST_ADDR_LSB7_ADDR A:0xfd40c930
y.create.l HWIO_CRYPTO0_CRYPTO_BAM_P_EVNT_DEST_ADDR_MSB0_ADDR A:0xfd405934
y.create.l HWIO_CRYPTO0_CRYPTO_BAM_P_EVNT_DEST_ADDR_MSB1_ADDR A:0xfd406934
y.create.l HWIO_CRYPTO0_CRYPTO_BAM_P_EVNT_DEST_ADDR_MSB2_ADDR A:0xfd407934
y.create.l HWIO_CRYPTO0_CRYPTO_BAM_P_EVNT_DEST_ADDR_MSB3_ADDR A:0xfd408934
y.create.l HWIO_CRYPTO0_CRYPTO_BAM_P_EVNT_DEST_ADDR_MSB4_ADDR A:0xfd409934
y.create.l HWIO_CRYPTO0_CRYPTO_BAM_P_EVNT_DEST_ADDR_MSB5_ADDR A:0xfd40a934
y.create.l HWIO_CRYPTO0_CRYPTO_BAM_P_EVNT_DEST_ADDR_MSB6_ADDR A:0xfd40b934
y.create.l HWIO_CRYPTO0_CRYPTO_BAM_P_EVNT_DEST_ADDR_MSB7_ADDR A:0xfd40c934
y.create.l HWIO_CRYPTO0_CRYPTO_BAM_P_EVNT_REG0_ADDR A:0xfd405818
y.create.l HWIO_CRYPTO0_CRYPTO_BAM_P_EVNT_REG1_ADDR A:0xfd406818
y.create.l HWIO_CRYPTO0_CRYPTO_BAM_P_EVNT_REG2_ADDR A:0xfd407818
y.create.l HWIO_CRYPTO0_CRYPTO_BAM_P_EVNT_REG3_ADDR A:0xfd408818
y.create.l HWIO_CRYPTO0_CRYPTO_BAM_P_EVNT_REG4_ADDR A:0xfd409818
y.create.l HWIO_CRYPTO0_CRYPTO_BAM_P_EVNT_REG5_ADDR A:0xfd40a818
y.create.l HWIO_CRYPTO0_CRYPTO_BAM_P_EVNT_REG6_ADDR A:0xfd40b818
y.create.l HWIO_CRYPTO0_CRYPTO_BAM_P_EVNT_REG7_ADDR A:0xfd40c818
y.create.l HWIO_CRYPTO0_CRYPTO_BAM_P_SW_OFSTS0_ADDR A:0xfd405800
y.create.l HWIO_CRYPTO0_CRYPTO_BAM_P_SW_OFSTS1_ADDR A:0xfd406800
y.create.l HWIO_CRYPTO0_CRYPTO_BAM_P_SW_OFSTS2_ADDR A:0xfd407800
y.create.l HWIO_CRYPTO0_CRYPTO_BAM_P_SW_OFSTS3_ADDR A:0xfd408800
y.create.l HWIO_CRYPTO0_CRYPTO_BAM_P_SW_OFSTS4_ADDR A:0xfd409800
y.create.l HWIO_CRYPTO0_CRYPTO_BAM_P_SW_OFSTS5_ADDR A:0xfd40a800
y.create.l HWIO_CRYPTO0_CRYPTO_BAM_P_SW_OFSTS6_ADDR A:0xfd40b800
y.create.l HWIO_CRYPTO0_CRYPTO_BAM_P_SW_OFSTS7_ADDR A:0xfd40c800
y.create.l HWIO_CRYPTO0_CRYPTO_BAM_P_DATA_FIFO_ADDR0_ADDR A:0xfd405824
y.create.l HWIO_CRYPTO0_CRYPTO_BAM_P_DATA_FIFO_ADDR1_ADDR A:0xfd406824
y.create.l HWIO_CRYPTO0_CRYPTO_BAM_P_DATA_FIFO_ADDR2_ADDR A:0xfd407824
y.create.l HWIO_CRYPTO0_CRYPTO_BAM_P_DATA_FIFO_ADDR3_ADDR A:0xfd408824
y.create.l HWIO_CRYPTO0_CRYPTO_BAM_P_DATA_FIFO_ADDR4_ADDR A:0xfd409824
y.create.l HWIO_CRYPTO0_CRYPTO_BAM_P_DATA_FIFO_ADDR5_ADDR A:0xfd40a824
y.create.l HWIO_CRYPTO0_CRYPTO_BAM_P_DATA_FIFO_ADDR6_ADDR A:0xfd40b824
y.create.l HWIO_CRYPTO0_CRYPTO_BAM_P_DATA_FIFO_ADDR7_ADDR A:0xfd40c824
y.create.l HWIO_CRYPTO0_CRYPTO_BAM_P_DATA_FIFO_ADDR_LSB0_ADDR A:0xfd405920
y.create.l HWIO_CRYPTO0_CRYPTO_BAM_P_DATA_FIFO_ADDR_LSB1_ADDR A:0xfd406920
y.create.l HWIO_CRYPTO0_CRYPTO_BAM_P_DATA_FIFO_ADDR_LSB2_ADDR A:0xfd407920
y.create.l HWIO_CRYPTO0_CRYPTO_BAM_P_DATA_FIFO_ADDR_LSB3_ADDR A:0xfd408920
y.create.l HWIO_CRYPTO0_CRYPTO_BAM_P_DATA_FIFO_ADDR_LSB4_ADDR A:0xfd409920
y.create.l HWIO_CRYPTO0_CRYPTO_BAM_P_DATA_FIFO_ADDR_LSB5_ADDR A:0xfd40a920
y.create.l HWIO_CRYPTO0_CRYPTO_BAM_P_DATA_FIFO_ADDR_LSB6_ADDR A:0xfd40b920
y.create.l HWIO_CRYPTO0_CRYPTO_BAM_P_DATA_FIFO_ADDR_LSB7_ADDR A:0xfd40c920
y.create.l HWIO_CRYPTO0_CRYPTO_BAM_P_DATA_FIFO_ADDR_MSB0_ADDR A:0xfd405924
y.create.l HWIO_CRYPTO0_CRYPTO_BAM_P_DATA_FIFO_ADDR_MSB1_ADDR A:0xfd406924
y.create.l HWIO_CRYPTO0_CRYPTO_BAM_P_DATA_FIFO_ADDR_MSB2_ADDR A:0xfd407924
y.create.l HWIO_CRYPTO0_CRYPTO_BAM_P_DATA_FIFO_ADDR_MSB3_ADDR A:0xfd408924
y.create.l HWIO_CRYPTO0_CRYPTO_BAM_P_DATA_FIFO_ADDR_MSB4_ADDR A:0xfd409924
y.create.l HWIO_CRYPTO0_CRYPTO_BAM_P_DATA_FIFO_ADDR_MSB5_ADDR A:0xfd40a924
y.create.l HWIO_CRYPTO0_CRYPTO_BAM_P_DATA_FIFO_ADDR_MSB6_ADDR A:0xfd40b924
y.create.l HWIO_CRYPTO0_CRYPTO_BAM_P_DATA_FIFO_ADDR_MSB7_ADDR A:0xfd40c924
y.create.l HWIO_CRYPTO0_CRYPTO_BAM_P_DESC_FIFO_ADDR0_ADDR A:0xfd40581c
y.create.l HWIO_CRYPTO0_CRYPTO_BAM_P_DESC_FIFO_ADDR1_ADDR A:0xfd40681c
y.create.l HWIO_CRYPTO0_CRYPTO_BAM_P_DESC_FIFO_ADDR2_ADDR A:0xfd40781c
y.create.l HWIO_CRYPTO0_CRYPTO_BAM_P_DESC_FIFO_ADDR3_ADDR A:0xfd40881c
y.create.l HWIO_CRYPTO0_CRYPTO_BAM_P_DESC_FIFO_ADDR4_ADDR A:0xfd40981c
y.create.l HWIO_CRYPTO0_CRYPTO_BAM_P_DESC_FIFO_ADDR5_ADDR A:0xfd40a81c
y.create.l HWIO_CRYPTO0_CRYPTO_BAM_P_DESC_FIFO_ADDR6_ADDR A:0xfd40b81c
y.create.l HWIO_CRYPTO0_CRYPTO_BAM_P_DESC_FIFO_ADDR7_ADDR A:0xfd40c81c
y.create.l HWIO_CRYPTO0_CRYPTO_BAM_P_DESC_FIFO_ADDR_LSB0_ADDR A:0xfd405910
y.create.l HWIO_CRYPTO0_CRYPTO_BAM_P_DESC_FIFO_ADDR_LSB1_ADDR A:0xfd406910
y.create.l HWIO_CRYPTO0_CRYPTO_BAM_P_DESC_FIFO_ADDR_LSB2_ADDR A:0xfd407910
y.create.l HWIO_CRYPTO0_CRYPTO_BAM_P_DESC_FIFO_ADDR_LSB3_ADDR A:0xfd408910
y.create.l HWIO_CRYPTO0_CRYPTO_BAM_P_DESC_FIFO_ADDR_LSB4_ADDR A:0xfd409910
y.create.l HWIO_CRYPTO0_CRYPTO_BAM_P_DESC_FIFO_ADDR_LSB5_ADDR A:0xfd40a910
y.create.l HWIO_CRYPTO0_CRYPTO_BAM_P_DESC_FIFO_ADDR_LSB6_ADDR A:0xfd40b910
y.create.l HWIO_CRYPTO0_CRYPTO_BAM_P_DESC_FIFO_ADDR_LSB7_ADDR A:0xfd40c910
y.create.l HWIO_CRYPTO0_CRYPTO_BAM_P_DESC_FIFO_ADDR_MSB0_ADDR A:0xfd405914
y.create.l HWIO_CRYPTO0_CRYPTO_BAM_P_DESC_FIFO_ADDR_MSB1_ADDR A:0xfd406914
y.create.l HWIO_CRYPTO0_CRYPTO_BAM_P_DESC_FIFO_ADDR_MSB2_ADDR A:0xfd407914
y.create.l HWIO_CRYPTO0_CRYPTO_BAM_P_DESC_FIFO_ADDR_MSB3_ADDR A:0xfd408914
y.create.l HWIO_CRYPTO0_CRYPTO_BAM_P_DESC_FIFO_ADDR_MSB4_ADDR A:0xfd409914
y.create.l HWIO_CRYPTO0_CRYPTO_BAM_P_DESC_FIFO_ADDR_MSB5_ADDR A:0xfd40a914
y.create.l HWIO_CRYPTO0_CRYPTO_BAM_P_DESC_FIFO_ADDR_MSB6_ADDR A:0xfd40b914
y.create.l HWIO_CRYPTO0_CRYPTO_BAM_P_DESC_FIFO_ADDR_MSB7_ADDR A:0xfd40c914
y.create.l HWIO_CRYPTO0_CRYPTO_BAM_P_EVNT_GEN_TRSHLD0_ADDR A:0xfd405828
y.create.l HWIO_CRYPTO0_CRYPTO_BAM_P_EVNT_GEN_TRSHLD1_ADDR A:0xfd406828
y.create.l HWIO_CRYPTO0_CRYPTO_BAM_P_EVNT_GEN_TRSHLD2_ADDR A:0xfd407828
y.create.l HWIO_CRYPTO0_CRYPTO_BAM_P_EVNT_GEN_TRSHLD3_ADDR A:0xfd408828
y.create.l HWIO_CRYPTO0_CRYPTO_BAM_P_EVNT_GEN_TRSHLD4_ADDR A:0xfd409828
y.create.l HWIO_CRYPTO0_CRYPTO_BAM_P_EVNT_GEN_TRSHLD5_ADDR A:0xfd40a828
y.create.l HWIO_CRYPTO0_CRYPTO_BAM_P_EVNT_GEN_TRSHLD6_ADDR A:0xfd40b828
y.create.l HWIO_CRYPTO0_CRYPTO_BAM_P_EVNT_GEN_TRSHLD7_ADDR A:0xfd40c828
y.create.l HWIO_CRYPTO0_CRYPTO_BAM_P_FIFO_SIZES0_ADDR A:0xfd405820
y.create.l HWIO_CRYPTO0_CRYPTO_BAM_P_FIFO_SIZES1_ADDR A:0xfd406820
y.create.l HWIO_CRYPTO0_CRYPTO_BAM_P_FIFO_SIZES2_ADDR A:0xfd407820
y.create.l HWIO_CRYPTO0_CRYPTO_BAM_P_FIFO_SIZES3_ADDR A:0xfd408820
y.create.l HWIO_CRYPTO0_CRYPTO_BAM_P_FIFO_SIZES4_ADDR A:0xfd409820
y.create.l HWIO_CRYPTO0_CRYPTO_BAM_P_FIFO_SIZES5_ADDR A:0xfd40a820
y.create.l HWIO_CRYPTO0_CRYPTO_BAM_P_FIFO_SIZES6_ADDR A:0xfd40b820
y.create.l HWIO_CRYPTO0_CRYPTO_BAM_P_FIFO_SIZES7_ADDR A:0xfd40c820
y.create.l HWIO_CRYPTO0_CRYPTO_BAM_P_RETR_CNTXT_0_ADDR A:0xfd405834
y.create.l HWIO_CRYPTO0_CRYPTO_BAM_P_RETR_CNTXT_1_ADDR A:0xfd406834
y.create.l HWIO_CRYPTO0_CRYPTO_BAM_P_RETR_CNTXT_2_ADDR A:0xfd407834
y.create.l HWIO_CRYPTO0_CRYPTO_BAM_P_RETR_CNTXT_3_ADDR A:0xfd408834
y.create.l HWIO_CRYPTO0_CRYPTO_BAM_P_RETR_CNTXT_4_ADDR A:0xfd409834
y.create.l HWIO_CRYPTO0_CRYPTO_BAM_P_RETR_CNTXT_5_ADDR A:0xfd40a834
y.create.l HWIO_CRYPTO0_CRYPTO_BAM_P_RETR_CNTXT_6_ADDR A:0xfd40b834
y.create.l HWIO_CRYPTO0_CRYPTO_BAM_P_RETR_CNTXT_7_ADDR A:0xfd40c834
y.create.l HWIO_CRYPTO0_CRYPTO_BAM_P_SI_CNTXT_0_ADDR A:0xfd405838
y.create.l HWIO_CRYPTO0_CRYPTO_BAM_P_SI_CNTXT_1_ADDR A:0xfd406838
y.create.l HWIO_CRYPTO0_CRYPTO_BAM_P_SI_CNTXT_2_ADDR A:0xfd407838
y.create.l HWIO_CRYPTO0_CRYPTO_BAM_P_SI_CNTXT_3_ADDR A:0xfd408838
y.create.l HWIO_CRYPTO0_CRYPTO_BAM_P_SI_CNTXT_4_ADDR A:0xfd409838
y.create.l HWIO_CRYPTO0_CRYPTO_BAM_P_SI_CNTXT_5_ADDR A:0xfd40a838
y.create.l HWIO_CRYPTO0_CRYPTO_BAM_P_SI_CNTXT_6_ADDR A:0xfd40b838
y.create.l HWIO_CRYPTO0_CRYPTO_BAM_P_SI_CNTXT_7_ADDR A:0xfd40c838
y.create.l HWIO_CRYPTO0_CRYPTO_BAM_P_DF_CNTXT_0_ADDR A:0xfd405830
y.create.l HWIO_CRYPTO0_CRYPTO_BAM_P_DF_CNTXT_1_ADDR A:0xfd406830
y.create.l HWIO_CRYPTO0_CRYPTO_BAM_P_DF_CNTXT_2_ADDR A:0xfd407830
y.create.l HWIO_CRYPTO0_CRYPTO_BAM_P_DF_CNTXT_3_ADDR A:0xfd408830
y.create.l HWIO_CRYPTO0_CRYPTO_BAM_P_DF_CNTXT_4_ADDR A:0xfd409830
y.create.l HWIO_CRYPTO0_CRYPTO_BAM_P_DF_CNTXT_5_ADDR A:0xfd40a830
y.create.l HWIO_CRYPTO0_CRYPTO_BAM_P_DF_CNTXT_6_ADDR A:0xfd40b830
y.create.l HWIO_CRYPTO0_CRYPTO_BAM_P_DF_CNTXT_7_ADDR A:0xfd40c830
y.create.l HWIO_CRYPTO0_CRYPTO_BAM_P_AU_PSM_CNTXT_1_0_ADDR A:0xfd405804
y.create.l HWIO_CRYPTO0_CRYPTO_BAM_P_AU_PSM_CNTXT_1_1_ADDR A:0xfd406804
y.create.l HWIO_CRYPTO0_CRYPTO_BAM_P_AU_PSM_CNTXT_1_2_ADDR A:0xfd407804
y.create.l HWIO_CRYPTO0_CRYPTO_BAM_P_AU_PSM_CNTXT_1_3_ADDR A:0xfd408804
y.create.l HWIO_CRYPTO0_CRYPTO_BAM_P_AU_PSM_CNTXT_1_4_ADDR A:0xfd409804
y.create.l HWIO_CRYPTO0_CRYPTO_BAM_P_AU_PSM_CNTXT_1_5_ADDR A:0xfd40a804
y.create.l HWIO_CRYPTO0_CRYPTO_BAM_P_AU_PSM_CNTXT_1_6_ADDR A:0xfd40b804
y.create.l HWIO_CRYPTO0_CRYPTO_BAM_P_AU_PSM_CNTXT_1_7_ADDR A:0xfd40c804
y.create.l HWIO_CRYPTO0_CRYPTO_BAM_P_PSM_CNTXT_2_0_ADDR A:0xfd405808
y.create.l HWIO_CRYPTO0_CRYPTO_BAM_P_PSM_CNTXT_2_1_ADDR A:0xfd406808
y.create.l HWIO_CRYPTO0_CRYPTO_BAM_P_PSM_CNTXT_2_2_ADDR A:0xfd407808
y.create.l HWIO_CRYPTO0_CRYPTO_BAM_P_PSM_CNTXT_2_3_ADDR A:0xfd408808
y.create.l HWIO_CRYPTO0_CRYPTO_BAM_P_PSM_CNTXT_2_4_ADDR A:0xfd409808
y.create.l HWIO_CRYPTO0_CRYPTO_BAM_P_PSM_CNTXT_2_5_ADDR A:0xfd40a808
y.create.l HWIO_CRYPTO0_CRYPTO_BAM_P_PSM_CNTXT_2_6_ADDR A:0xfd40b808
y.create.l HWIO_CRYPTO0_CRYPTO_BAM_P_PSM_CNTXT_2_7_ADDR A:0xfd40c808
y.create.l HWIO_CRYPTO0_CRYPTO_BAM_P_PSM_CNTXT_3_0_ADDR A:0xfd40580c
y.create.l HWIO_CRYPTO0_CRYPTO_BAM_P_PSM_CNTXT_3_1_ADDR A:0xfd40680c
y.create.l HWIO_CRYPTO0_CRYPTO_BAM_P_PSM_CNTXT_3_2_ADDR A:0xfd40780c
y.create.l HWIO_CRYPTO0_CRYPTO_BAM_P_PSM_CNTXT_3_3_ADDR A:0xfd40880c
y.create.l HWIO_CRYPTO0_CRYPTO_BAM_P_PSM_CNTXT_3_4_ADDR A:0xfd40980c
y.create.l HWIO_CRYPTO0_CRYPTO_BAM_P_PSM_CNTXT_3_5_ADDR A:0xfd40a80c
y.create.l HWIO_CRYPTO0_CRYPTO_BAM_P_PSM_CNTXT_3_6_ADDR A:0xfd40b80c
y.create.l HWIO_CRYPTO0_CRYPTO_BAM_P_PSM_CNTXT_3_7_ADDR A:0xfd40c80c
y.create.l HWIO_CRYPTO0_CRYPTO_BAM_P_PSM_CNTXT_3_LSB0_ADDR A:0xfd405900
y.create.l HWIO_CRYPTO0_CRYPTO_BAM_P_PSM_CNTXT_3_LSB1_ADDR A:0xfd406900
y.create.l HWIO_CRYPTO0_CRYPTO_BAM_P_PSM_CNTXT_3_LSB2_ADDR A:0xfd407900
y.create.l HWIO_CRYPTO0_CRYPTO_BAM_P_PSM_CNTXT_3_LSB3_ADDR A:0xfd408900
y.create.l HWIO_CRYPTO0_CRYPTO_BAM_P_PSM_CNTXT_3_LSB4_ADDR A:0xfd409900
y.create.l HWIO_CRYPTO0_CRYPTO_BAM_P_PSM_CNTXT_3_LSB5_ADDR A:0xfd40a900
y.create.l HWIO_CRYPTO0_CRYPTO_BAM_P_PSM_CNTXT_3_LSB6_ADDR A:0xfd40b900
y.create.l HWIO_CRYPTO0_CRYPTO_BAM_P_PSM_CNTXT_3_LSB7_ADDR A:0xfd40c900
y.create.l HWIO_CRYPTO0_CRYPTO_BAM_P_PSM_CNTXT_3_MSB0_ADDR A:0xfd405904
y.create.l HWIO_CRYPTO0_CRYPTO_BAM_P_PSM_CNTXT_3_MSB1_ADDR A:0xfd406904
y.create.l HWIO_CRYPTO0_CRYPTO_BAM_P_PSM_CNTXT_3_MSB2_ADDR A:0xfd407904
y.create.l HWIO_CRYPTO0_CRYPTO_BAM_P_PSM_CNTXT_3_MSB3_ADDR A:0xfd408904
y.create.l HWIO_CRYPTO0_CRYPTO_BAM_P_PSM_CNTXT_3_MSB4_ADDR A:0xfd409904
y.create.l HWIO_CRYPTO0_CRYPTO_BAM_P_PSM_CNTXT_3_MSB5_ADDR A:0xfd40a904
y.create.l HWIO_CRYPTO0_CRYPTO_BAM_P_PSM_CNTXT_3_MSB6_ADDR A:0xfd40b904
y.create.l HWIO_CRYPTO0_CRYPTO_BAM_P_PSM_CNTXT_3_MSB7_ADDR A:0xfd40c904
y.create.l HWIO_CRYPTO0_CRYPTO_BAM_P_PSM_CNTXT_4_0_ADDR A:0xfd405810
y.create.l HWIO_CRYPTO0_CRYPTO_BAM_P_PSM_CNTXT_4_1_ADDR A:0xfd406810
y.create.l HWIO_CRYPTO0_CRYPTO_BAM_P_PSM_CNTXT_4_2_ADDR A:0xfd407810
y.create.l HWIO_CRYPTO0_CRYPTO_BAM_P_PSM_CNTXT_4_3_ADDR A:0xfd408810
y.create.l HWIO_CRYPTO0_CRYPTO_BAM_P_PSM_CNTXT_4_4_ADDR A:0xfd409810
y.create.l HWIO_CRYPTO0_CRYPTO_BAM_P_PSM_CNTXT_4_5_ADDR A:0xfd40a810
y.create.l HWIO_CRYPTO0_CRYPTO_BAM_P_PSM_CNTXT_4_6_ADDR A:0xfd40b810
y.create.l HWIO_CRYPTO0_CRYPTO_BAM_P_PSM_CNTXT_4_7_ADDR A:0xfd40c810
y.create.l HWIO_CRYPTO0_CRYPTO_BAM_P_PSM_CNTXT_5_0_ADDR A:0xfd405814
y.create.l HWIO_CRYPTO0_CRYPTO_BAM_P_PSM_CNTXT_5_1_ADDR A:0xfd406814
y.create.l HWIO_CRYPTO0_CRYPTO_BAM_P_PSM_CNTXT_5_2_ADDR A:0xfd407814
y.create.l HWIO_CRYPTO0_CRYPTO_BAM_P_PSM_CNTXT_5_3_ADDR A:0xfd408814
y.create.l HWIO_CRYPTO0_CRYPTO_BAM_P_PSM_CNTXT_5_4_ADDR A:0xfd409814
y.create.l HWIO_CRYPTO0_CRYPTO_BAM_P_PSM_CNTXT_5_5_ADDR A:0xfd40a814
y.create.l HWIO_CRYPTO0_CRYPTO_BAM_P_PSM_CNTXT_5_6_ADDR A:0xfd40b814
y.create.l HWIO_CRYPTO0_CRYPTO_BAM_P_PSM_CNTXT_5_7_ADDR A:0xfd40c814
y.create.l HWIO_CRYPTO0_CRYPTO_BAM_XPU_SCR_ADDR A:0xfd402000
y.create.l HWIO_CRYPTO0_CRYPTO_BAM_XPU_SWDR_ADDR A:0xfd402004
y.create.l HWIO_CRYPTO0_CRYPTO_BAM_XPU_SEAR0_ADDR A:0xfd402040
y.create.l HWIO_CRYPTO0_CRYPTO_BAM_XPU_SESR_ADDR A:0xfd402048
y.create.l HWIO_CRYPTO0_CRYPTO_BAM_XPU_SESRRESTORE_ADDR A:0xfd40204c
y.create.l HWIO_CRYPTO0_CRYPTO_BAM_XPU_SESYNR0_ADDR A:0xfd402050
y.create.l HWIO_CRYPTO0_CRYPTO_BAM_XPU_SESYNR1_ADDR A:0xfd402054
y.create.l HWIO_CRYPTO0_CRYPTO_BAM_XPU_SESYNR2_ADDR A:0xfd402058
y.create.l HWIO_CRYPTO0_CRYPTO_BAM_XPU_MCR_ADDR A:0xfd402100
y.create.l HWIO_CRYPTO0_CRYPTO_BAM_XPU_MEAR0_ADDR A:0xfd402140
y.create.l HWIO_CRYPTO0_CRYPTO_BAM_XPU_MESR_ADDR A:0xfd402148
y.create.l HWIO_CRYPTO0_CRYPTO_BAM_XPU_MESRRESTORE_ADDR A:0xfd40214c
y.create.l HWIO_CRYPTO0_CRYPTO_BAM_XPU_MESYNR0_ADDR A:0xfd402150
y.create.l HWIO_CRYPTO0_CRYPTO_BAM_XPU_MESYNR1_ADDR A:0xfd402154
y.create.l HWIO_CRYPTO0_CRYPTO_BAM_XPU_MESYNR2_ADDR A:0xfd402158
y.create.l HWIO_CRYPTO0_CRYPTO_BAM_XPU_CR_ADDR A:0xfd402080
y.create.l HWIO_CRYPTO0_CRYPTO_BAM_XPU_RPU_ACR0_ADDR A:0xfd4020a0
y.create.l HWIO_CRYPTO0_CRYPTO_BAM_XPU_EAR0_ADDR A:0xfd4020c0
y.create.l HWIO_CRYPTO0_CRYPTO_BAM_XPU_ESR_ADDR A:0xfd4020c8
y.create.l HWIO_CRYPTO0_CRYPTO_BAM_XPU_ESRRESTORE_ADDR A:0xfd4020cc
y.create.l HWIO_CRYPTO0_CRYPTO_BAM_XPU_ESYNR0_ADDR A:0xfd4020d0
y.create.l HWIO_CRYPTO0_CRYPTO_BAM_XPU_ESYNR1_ADDR A:0xfd4020d4
y.create.l HWIO_CRYPTO0_CRYPTO_BAM_XPU_ESYNR2_ADDR A:0xfd4020d8
y.create.l HWIO_CRYPTO0_CRYPTO_BAM_XPU_IDR0_ADDR A:0xfd402074
y.create.l HWIO_CRYPTO0_CRYPTO_BAM_XPU_IDR1_ADDR A:0xfd402078
y.create.l HWIO_CRYPTO0_CRYPTO_BAM_XPU_REV_ADDR A:0xfd40207c
y.create.l HWIO_CRYPTO0_CRYPTO_BAM_XPU_RG0_RACR0_ADDR A:0xfd402200
y.create.l HWIO_CRYPTO0_CRYPTO_BAM_XPU_RG1_RACR0_ADDR A:0xfd402280
y.create.l HWIO_CRYPTO0_CRYPTO_BAM_XPU_RG2_RACR0_ADDR A:0xfd402300
y.create.l HWIO_CRYPTO0_CRYPTO_BAM_XPU_RG3_RACR0_ADDR A:0xfd402380
y.create.l HWIO_CRYPTO0_CRYPTO_BAM_XPU_RG4_RACR0_ADDR A:0xfd402400
y.create.l HWIO_CRYPTO0_CRYPTO_BAM_XPU_RG5_RACR0_ADDR A:0xfd402480
y.create.l HWIO_CRYPTO0_CRYPTO_BAM_XPU_RG6_RACR0_ADDR A:0xfd402500
y.create.l HWIO_CRYPTO0_CRYPTO_BAM_XPU_RG7_RACR0_ADDR A:0xfd402580
y.create.l HWIO_CRYPTO0_CRYPTO_BAM_XPU_RG8_RACR0_ADDR A:0xfd402600
y.create.l HWIO_CRYPTO0_CRYPTO_BAM_XPU_RG9_RACR0_ADDR A:0xfd402680
y.create.l HWIO_CRYPTO0_CRYPTO_BAM_XPU_RG0_SCR_ADDR A:0xfd402250
y.create.l HWIO_CRYPTO0_CRYPTO_BAM_XPU_RG1_SCR_ADDR A:0xfd4022d0
y.create.l HWIO_CRYPTO0_CRYPTO_BAM_XPU_RG2_SCR_ADDR A:0xfd402350
y.create.l HWIO_CRYPTO0_CRYPTO_BAM_XPU_RG3_SCR_ADDR A:0xfd4023d0
y.create.l HWIO_CRYPTO0_CRYPTO_BAM_XPU_RG4_SCR_ADDR A:0xfd402450
y.create.l HWIO_CRYPTO0_CRYPTO_BAM_XPU_RG5_SCR_ADDR A:0xfd4024d0
y.create.l HWIO_CRYPTO0_CRYPTO_BAM_XPU_RG6_SCR_ADDR A:0xfd402550
y.create.l HWIO_CRYPTO0_CRYPTO_BAM_XPU_RG7_SCR_ADDR A:0xfd4025d0
y.create.l HWIO_CRYPTO0_CRYPTO_BAM_XPU_RG8_SCR_ADDR A:0xfd402650
y.create.l HWIO_CRYPTO0_CRYPTO_BAM_XPU_RG9_SCR_ADDR A:0xfd4026d0
y.create.l HWIO_CRYPTO0_CRYPTO_BAM_XPU_RG0_MCR_ADDR A:0xfd402254
y.create.l HWIO_CRYPTO0_CRYPTO_BAM_XPU_RG1_MCR_ADDR A:0xfd4022d4
y.create.l HWIO_CRYPTO0_CRYPTO_BAM_XPU_RG2_MCR_ADDR A:0xfd402354
y.create.l HWIO_CRYPTO0_CRYPTO_BAM_XPU_RG3_MCR_ADDR A:0xfd4023d4
y.create.l HWIO_CRYPTO0_CRYPTO_BAM_XPU_RG4_MCR_ADDR A:0xfd402454
y.create.l HWIO_CRYPTO0_CRYPTO_BAM_XPU_RG5_MCR_ADDR A:0xfd4024d4
y.create.l HWIO_CRYPTO0_CRYPTO_BAM_XPU_RG6_MCR_ADDR A:0xfd402554
y.create.l HWIO_CRYPTO0_CRYPTO_BAM_XPU_RG7_MCR_ADDR A:0xfd4025d4
y.create.l HWIO_CRYPTO0_CRYPTO_BAM_XPU_RG8_MCR_ADDR A:0xfd402654
y.create.l HWIO_CRYPTO0_CRYPTO_BAM_XPU_RG9_MCR_ADDR A:0xfd4026d4
y.create.l HWIO_CRYPTO0_CRYPTO_BAM_VMIDMT_SCR0_ADDR A:0xfd400000
y.create.l HWIO_CRYPTO0_CRYPTO_BAM_VMIDMT_SCR1_ADDR A:0xfd400004
y.create.l HWIO_CRYPTO0_CRYPTO_BAM_VMIDMT_SCR2_ADDR A:0xfd400008
y.create.l HWIO_CRYPTO0_CRYPTO_BAM_VMIDMT_SACR_ADDR A:0xfd400010
y.create.l HWIO_CRYPTO0_CRYPTO_BAM_VMIDMT_SIDR0_ADDR A:0xfd400020
y.create.l HWIO_CRYPTO0_CRYPTO_BAM_VMIDMT_SIDR1_ADDR A:0xfd400024
y.create.l HWIO_CRYPTO0_CRYPTO_BAM_VMIDMT_SIDR2_ADDR A:0xfd400028
y.create.l HWIO_CRYPTO0_CRYPTO_BAM_VMIDMT_SIDR4_ADDR A:0xfd400030
y.create.l HWIO_CRYPTO0_CRYPTO_BAM_VMIDMT_SIDR5_ADDR A:0xfd400034
y.create.l HWIO_CRYPTO0_CRYPTO_BAM_VMIDMT_SIDR7_ADDR A:0xfd40003c
y.create.l HWIO_CRYPTO0_CRYPTO_BAM_VMIDMT_SGFAR0_ADDR A:0xfd400040
y.create.l HWIO_CRYPTO0_CRYPTO_BAM_VMIDMT_SGFSR_ADDR A:0xfd400048
y.create.l HWIO_CRYPTO0_CRYPTO_BAM_VMIDMT_SGFSRRESTORE_ADDR A:0xfd40004c
y.create.l HWIO_CRYPTO0_CRYPTO_BAM_VMIDMT_SGFSYNDR0_ADDR A:0xfd400050
y.create.l HWIO_CRYPTO0_CRYPTO_BAM_VMIDMT_SGFSYNDR1_ADDR A:0xfd400054
y.create.l HWIO_CRYPTO0_CRYPTO_BAM_VMIDMT_SGFSYNDR2_ADDR A:0xfd400058
y.create.l HWIO_CRYPTO0_CRYPTO_BAM_VMIDMT_VMIDMTSCR0_ADDR A:0xfd400090
y.create.l HWIO_CRYPTO0_CRYPTO_BAM_VMIDMT_CR0_ADDR A:0xfd400000
y.create.l HWIO_CRYPTO0_CRYPTO_BAM_VMIDMT_CR2_ADDR A:0xfd400008
y.create.l HWIO_CRYPTO0_CRYPTO_BAM_VMIDMT_ACR_ADDR A:0xfd400010
y.create.l HWIO_CRYPTO0_CRYPTO_BAM_VMIDMT_IDR0_ADDR A:0xfd400020
y.create.l HWIO_CRYPTO0_CRYPTO_BAM_VMIDMT_IDR1_ADDR A:0xfd400024
y.create.l HWIO_CRYPTO0_CRYPTO_BAM_VMIDMT_IDR2_ADDR A:0xfd400028
y.create.l HWIO_CRYPTO0_CRYPTO_BAM_VMIDMT_IDR4_ADDR A:0xfd400030
y.create.l HWIO_CRYPTO0_CRYPTO_BAM_VMIDMT_IDR5_ADDR A:0xfd400034
y.create.l HWIO_CRYPTO0_CRYPTO_BAM_VMIDMT_IDR7_ADDR A:0xfd40003c
y.create.l HWIO_CRYPTO0_CRYPTO_BAM_VMIDMT_GFAR0_ADDR A:0xfd400040
y.create.l HWIO_CRYPTO0_CRYPTO_BAM_VMIDMT_GFSR_ADDR A:0xfd400048
y.create.l HWIO_CRYPTO0_CRYPTO_BAM_VMIDMT_GFSRRESTORE_ADDR A:0xfd40004c
y.create.l HWIO_CRYPTO0_CRYPTO_BAM_VMIDMT_GFSYNDR0_ADDR A:0xfd400050
y.create.l HWIO_CRYPTO0_CRYPTO_BAM_VMIDMT_GFSYNDR1_ADDR A:0xfd400054
y.create.l HWIO_CRYPTO0_CRYPTO_BAM_VMIDMT_GFSYNDR2_ADDR A:0xfd400058
y.create.l HWIO_CRYPTO0_CRYPTO_BAM_VMIDMT_VMIDMTCR0_ADDR A:0xfd400090
y.create.l HWIO_CRYPTO0_CRYPTO_BAM_VMIDMT_VMIDMTACR_ADDR A:0xfd40009c
y.create.l HWIO_CRYPTO0_CRYPTO_BAM_VMIDMT_NSCR0_ADDR A:0xfd400400
y.create.l HWIO_CRYPTO0_CRYPTO_BAM_VMIDMT_NSCR2_ADDR A:0xfd400408
y.create.l HWIO_CRYPTO0_CRYPTO_BAM_VMIDMT_NSACR_ADDR A:0xfd400410
y.create.l HWIO_CRYPTO0_CRYPTO_BAM_VMIDMT_NSGFAR0_ADDR A:0xfd400440
y.create.l HWIO_CRYPTO0_CRYPTO_BAM_VMIDMT_NSGFSR_ADDR A:0xfd400448
y.create.l HWIO_CRYPTO0_CRYPTO_BAM_VMIDMT_NSGFSRRESTORE_ADDR A:0xfd40044c
y.create.l HWIO_CRYPTO0_CRYPTO_BAM_VMIDMT_NSGFSYNDR0_ADDR A:0xfd400450
y.create.l HWIO_CRYPTO0_CRYPTO_BAM_VMIDMT_NSGFSYNDR1_ADDR A:0xfd400454
y.create.l HWIO_CRYPTO0_CRYPTO_BAM_VMIDMT_NSGFSYNDR2_ADDR A:0xfd400458
y.create.l HWIO_CRYPTO0_CRYPTO_BAM_VMIDMT_NSVMIDMTCR0_ADDR A:0xfd400490
y.create.l HWIO_CRYPTO0_CRYPTO_BAM_VMIDMT_SSDR0_ADDR A:0xfd400080
y.create.l HWIO_CRYPTO0_CRYPTO_BAM_VMIDMT_MSDR0_ADDR A:0xfd400480
y.create.l HWIO_CRYPTO0_CRYPTO_BAM_VMIDMT_MCR_ADDR A:0xfd400494
y.create.l HWIO_CRYPTO0_CRYPTO_BAM_VMIDMT_S2VR0_ADDR A:0xfd400c00
y.create.l HWIO_CRYPTO0_CRYPTO_BAM_VMIDMT_S2VR1_ADDR A:0xfd400c04
y.create.l HWIO_CRYPTO0_CRYPTO_BAM_VMIDMT_S2VR2_ADDR A:0xfd400c08
y.create.l HWIO_CRYPTO0_CRYPTO_BAM_VMIDMT_S2VR3_ADDR A:0xfd400c0c
y.create.l HWIO_CRYPTO0_CRYPTO_BAM_VMIDMT_S2VR4_ADDR A:0xfd400c10
y.create.l HWIO_CRYPTO0_CRYPTO_BAM_VMIDMT_S2VR5_ADDR A:0xfd400c14
y.create.l HWIO_CRYPTO0_CRYPTO_BAM_VMIDMT_S2VR6_ADDR A:0xfd400c18
y.create.l HWIO_CRYPTO0_CRYPTO_BAM_VMIDMT_S2VR7_ADDR A:0xfd400c1c
y.create.l HWIO_CRYPTO0_CRYPTO_BAM_VMIDMT_S2VR8_ADDR A:0xfd400c20
y.create.l HWIO_CRYPTO0_CRYPTO_BAM_VMIDMT_AS2VR0_ADDR A:0xfd400e00
y.create.l HWIO_CRYPTO0_CRYPTO_BAM_VMIDMT_AS2VR1_ADDR A:0xfd400e04
y.create.l HWIO_CRYPTO0_CRYPTO_BAM_VMIDMT_AS2VR2_ADDR A:0xfd400e08
y.create.l HWIO_CRYPTO0_CRYPTO_BAM_VMIDMT_AS2VR3_ADDR A:0xfd400e0c
y.create.l HWIO_CRYPTO0_CRYPTO_BAM_VMIDMT_AS2VR4_ADDR A:0xfd400e10
y.create.l HWIO_CRYPTO0_CRYPTO_BAM_VMIDMT_AS2VR5_ADDR A:0xfd400e14
y.create.l HWIO_CRYPTO0_CRYPTO_BAM_VMIDMT_AS2VR6_ADDR A:0xfd400e18
y.create.l HWIO_CRYPTO0_CRYPTO_BAM_VMIDMT_AS2VR7_ADDR A:0xfd400e1c
y.create.l HWIO_CRYPTO0_CRYPTO_BAM_VMIDMT_AS2VR8_ADDR A:0xfd400e20
y.create.l HWIO_CRYPTO0_CRYPTO_BAM_VMIDMT_SMR0_ADDR A:0xfd400800
y.create.l HWIO_CRYPTO0_CRYPTO_BAM_VMIDMT_SMR1_ADDR A:0xfd400804
y.create.l HWIO_CRYPTO0_CRYPTO_BAM_VMIDMT_SMR2_ADDR A:0xfd400808
y.create.l HWIO_CRYPTO0_CRYPTO_BAM_VMIDMT_SMR3_ADDR A:0xfd40080c
y.create.l HWIO_CRYPTO0_CRYPTO_BAM_VMIDMT_SMR4_ADDR A:0xfd400810
y.create.l HWIO_CRYPTO0_CRYPTO_BAM_VMIDMT_SMR5_ADDR A:0xfd400814
y.create.l HWIO_CRYPTO0_CRYPTO_BAM_VMIDMT_SMR6_ADDR A:0xfd400818
y.create.l HWIO_CRYPTO0_CRYPTO_BAM_VMIDMT_SMR7_ADDR A:0xfd40081c
y.create.l HWIO_CRYPTO0_CRYPTO_BAM_VMIDMT_SMR8_ADDR A:0xfd400820
y.create.l HWIO_DEHR_BIMC_DEHR_HW_VERSION_ADDR A:0xfc49a000
y.create.l HWIO_DEHR_BIMC_DEHR_HW_INFO_ADDR A:0xfc49a004
y.create.l HWIO_DEHR_BIMC_DEHR_CGC_CFG_ADDR A:0xfc49a010
y.create.l HWIO_DEHR_BIMC_DEHR_SEC_CFG_ADDR A:0xfc49a100
y.create.l HWIO_DEHR_BIMC_DEHR_RAM_CFG_ADDR A:0xfc49a140
y.create.l HWIO_DEHR_BIMC_DEHR_DMA_STATUS_ADDR A:0xfc49a200
y.create.l HWIO_DEHR_BIMC_DEHR_DBG_CFG_ADDR A:0xfc49a400
y.create.l HWIO_DEHR_BIMC_DEHR_SW_DMA_CFG_ADDR A:0xfc49a404
y.create.l HWIO_DEHR_BIMC_DEHR_DBG_ADDR_ADDR A:0xfc49a408
y.create.l HWIO_DEHR_XPU_SCR_ADDR A:0xfc498000
y.create.l HWIO_DEHR_XPU_SWDR_ADDR A:0xfc498004
y.create.l HWIO_DEHR_XPU_SEAR0_ADDR A:0xfc498040
y.create.l HWIO_DEHR_XPU_SESR_ADDR A:0xfc498048
y.create.l HWIO_DEHR_XPU_SESRRESTORE_ADDR A:0xfc49804c
y.create.l HWIO_DEHR_XPU_SESYNR0_ADDR A:0xfc498050
y.create.l HWIO_DEHR_XPU_SESYNR1_ADDR A:0xfc498054
y.create.l HWIO_DEHR_XPU_SESYNR2_ADDR A:0xfc498058
y.create.l HWIO_DEHR_XPU_MCR_ADDR A:0xfc498100
y.create.l HWIO_DEHR_XPU_MEAR0_ADDR A:0xfc498140
y.create.l HWIO_DEHR_XPU_MESR_ADDR A:0xfc498148
y.create.l HWIO_DEHR_XPU_MESRRESTORE_ADDR A:0xfc49814c
y.create.l HWIO_DEHR_XPU_MESYNR0_ADDR A:0xfc498150
y.create.l HWIO_DEHR_XPU_MESYNR1_ADDR A:0xfc498154
y.create.l HWIO_DEHR_XPU_MESYNR2_ADDR A:0xfc498158
y.create.l HWIO_DEHR_XPU_CR_ADDR A:0xfc498080
y.create.l HWIO_DEHR_XPU_RPU_ACR0_ADDR A:0xfc4980a0
y.create.l HWIO_DEHR_XPU_EAR0_ADDR A:0xfc4980c0
y.create.l HWIO_DEHR_XPU_ESR_ADDR A:0xfc4980c8
y.create.l HWIO_DEHR_XPU_ESRRESTORE_ADDR A:0xfc4980cc
y.create.l HWIO_DEHR_XPU_ESYNR0_ADDR A:0xfc4980d0
y.create.l HWIO_DEHR_XPU_ESYNR1_ADDR A:0xfc4980d4
y.create.l HWIO_DEHR_XPU_ESYNR2_ADDR A:0xfc4980d8
y.create.l HWIO_DEHR_XPU_IDR0_ADDR A:0xfc498074
y.create.l HWIO_DEHR_XPU_IDR1_ADDR A:0xfc498078
y.create.l HWIO_DEHR_XPU_REV_ADDR A:0xfc49807c
y.create.l HWIO_DEHR_XPU_RG0_RACR0_ADDR A:0xfc498200
y.create.l HWIO_DEHR_XPU_RG1_RACR0_ADDR A:0xfc498280
y.create.l HWIO_DEHR_XPU_RG0_SCR_ADDR A:0xfc498250
y.create.l HWIO_DEHR_XPU_RG1_SCR_ADDR A:0xfc4982d0
y.create.l HWIO_DEHR_XPU_RG0_MCR_ADDR A:0xfc498254
y.create.l HWIO_DEHR_XPU_RG1_MCR_ADDR A:0xfc4982d4
y.create.l HWIO_DEHR_VMIDMT_SCR0_ADDR A:0xfc499000
y.create.l HWIO_DEHR_VMIDMT_SCR1_ADDR A:0xfc499004
y.create.l HWIO_DEHR_VMIDMT_SCR2_ADDR A:0xfc499008
y.create.l HWIO_DEHR_VMIDMT_SACR_ADDR A:0xfc499010
y.create.l HWIO_DEHR_VMIDMT_SIDR0_ADDR A:0xfc499020
y.create.l HWIO_DEHR_VMIDMT_SIDR1_ADDR A:0xfc499024
y.create.l HWIO_DEHR_VMIDMT_SIDR2_ADDR A:0xfc499028
y.create.l HWIO_DEHR_VMIDMT_SIDR4_ADDR A:0xfc499030
y.create.l HWIO_DEHR_VMIDMT_SIDR5_ADDR A:0xfc499034
y.create.l HWIO_DEHR_VMIDMT_SIDR7_ADDR A:0xfc49903c
y.create.l HWIO_DEHR_VMIDMT_SGFAR0_ADDR A:0xfc499040
y.create.l HWIO_DEHR_VMIDMT_SGFSR_ADDR A:0xfc499048
y.create.l HWIO_DEHR_VMIDMT_SGFSRRESTORE_ADDR A:0xfc49904c
y.create.l HWIO_DEHR_VMIDMT_SGFSYNDR0_ADDR A:0xfc499050
y.create.l HWIO_DEHR_VMIDMT_SGFSYNDR1_ADDR A:0xfc499054
y.create.l HWIO_DEHR_VMIDMT_SGFSYNDR2_ADDR A:0xfc499058
y.create.l HWIO_DEHR_VMIDMT_VMIDMTSCR0_ADDR A:0xfc499090
y.create.l HWIO_DEHR_VMIDMT_CR0_ADDR A:0xfc499000
y.create.l HWIO_DEHR_VMIDMT_CR2_ADDR A:0xfc499008
y.create.l HWIO_DEHR_VMIDMT_ACR_ADDR A:0xfc499010
y.create.l HWIO_DEHR_VMIDMT_IDR0_ADDR A:0xfc499020
y.create.l HWIO_DEHR_VMIDMT_IDR1_ADDR A:0xfc499024
y.create.l HWIO_DEHR_VMIDMT_IDR2_ADDR A:0xfc499028
y.create.l HWIO_DEHR_VMIDMT_IDR4_ADDR A:0xfc499030
y.create.l HWIO_DEHR_VMIDMT_IDR5_ADDR A:0xfc499034
y.create.l HWIO_DEHR_VMIDMT_IDR7_ADDR A:0xfc49903c
y.create.l HWIO_DEHR_VMIDMT_GFAR0_ADDR A:0xfc499040
y.create.l HWIO_DEHR_VMIDMT_GFSR_ADDR A:0xfc499048
y.create.l HWIO_DEHR_VMIDMT_GFSRRESTORE_ADDR A:0xfc49904c
y.create.l HWIO_DEHR_VMIDMT_GFSYNDR0_ADDR A:0xfc499050
y.create.l HWIO_DEHR_VMIDMT_GFSYNDR1_ADDR A:0xfc499054
y.create.l HWIO_DEHR_VMIDMT_GFSYNDR2_ADDR A:0xfc499058
y.create.l HWIO_DEHR_VMIDMT_VMIDMTCR0_ADDR A:0xfc499090
y.create.l HWIO_DEHR_VMIDMT_VMIDMTACR_ADDR A:0xfc49909c
y.create.l HWIO_DEHR_VMIDMT_NSCR0_ADDR A:0xfc499400
y.create.l HWIO_DEHR_VMIDMT_NSCR2_ADDR A:0xfc499408
y.create.l HWIO_DEHR_VMIDMT_NSACR_ADDR A:0xfc499410
y.create.l HWIO_DEHR_VMIDMT_NSGFAR0_ADDR A:0xfc499440
y.create.l HWIO_DEHR_VMIDMT_NSGFSR_ADDR A:0xfc499448
y.create.l HWIO_DEHR_VMIDMT_NSGFSRRESTORE_ADDR A:0xfc49944c
y.create.l HWIO_DEHR_VMIDMT_NSGFSYNDR0_ADDR A:0xfc499450
y.create.l HWIO_DEHR_VMIDMT_NSGFSYNDR1_ADDR A:0xfc499454
y.create.l HWIO_DEHR_VMIDMT_NSGFSYNDR2_ADDR A:0xfc499458
y.create.l HWIO_DEHR_VMIDMT_NSVMIDMTCR0_ADDR A:0xfc499490
y.create.l HWIO_DEHR_VMIDMT_SSDR0_ADDR A:0xfc499080
y.create.l HWIO_DEHR_VMIDMT_MSDR0_ADDR A:0xfc499480
y.create.l HWIO_DEHR_VMIDMT_MCR_ADDR A:0xfc499494
y.create.l HWIO_DEHR_VMIDMT_S2VR0_ADDR A:0xfc499c00
y.create.l HWIO_DEHR_VMIDMT_AS2VR0_ADDR A:0xfc499e00
y.create.l HWIO_DIM_C00_DIM_CA_TOP_CFG_ADDR A:0xfc4e0000
y.create.l HWIO_DIM_C00_DIM_CA_HW_INFO_ADDR A:0xfc4e0004
y.create.l HWIO_DIM_C00_DIM_CA_HW_VERSION_ADDR A:0xfc4e0008
y.create.l HWIO_DIM_C00_DIM_CA_PAD_CFG0_ADDR A:0xfc4e0010
y.create.l HWIO_DIM_C00_DIM_CA_PAD_CFG1_ADDR A:0xfc4e0014
y.create.l HWIO_DIM_C00_DIM_CA_PAD_CFG2_ADDR A:0xfc4e0018
y.create.l HWIO_DIM_C00_DIM_CA_PAD_CFG3_ADDR A:0xfc4e001c
y.create.l HWIO_DIM_C00_DIM_CA_PAD_CFG4_ADDR A:0xfc4e0020
y.create.l HWIO_DIM_C00_DDRPHY_CA_MISR_CFG_ADDR A:0xfc4e0024
y.create.l HWIO_DIM_C00_DDRPHY_CA_MISR_EVEN_STATUS_ADDR A:0xfc4e0028
y.create.l HWIO_DIM_C00_DDRPHY_CA_MISR_ODD_STATUS_ADDR A:0xfc4e002c
y.create.l HWIO_DIM_C00_DIM_CA_CDC_CTLR_CFG0_ADDR A:0xfc4e0030
y.create.l HWIO_DIM_C00_DIM_CA_CDC_CTLR_CFG1_ADDR A:0xfc4e0034
y.create.l HWIO_DIM_C00_DIM_CA_CDC_CAL_TIMER_CFG0_ADDR A:0xfc4e0038
y.create.l HWIO_DIM_C00_DIM_CA_CDC_CAL_TIMER_CFG1_ADDR A:0xfc4e003c
y.create.l HWIO_DIM_C00_DIM_CA_CDC_REFCOUNT_CFG_ADDR A:0xfc4e0040
y.create.l HWIO_DIM_C00_DIM_CA_CDC_COARSE_CAL_CFG_ADDR A:0xfc4e0044
y.create.l HWIO_DIM_C00_DIM_CA_CDC_RSVD_CFG_ADDR A:0xfc4e0048
y.create.l HWIO_DIM_C00_DIM_CA_CDC_OFFSET_CFG_ADDR A:0xfc4e004c
y.create.l HWIO_DIM_C00_DIM_CA_CDC_DELAY_CFG_ADDR A:0xfc4e0050
y.create.l HWIO_DIM_C00_DIM_CA_CDC_SW_MODE_CFG_ADDR A:0xfc4e0054
y.create.l HWIO_DIM_C00_DIM_CA_CDC_TEST_CFG_ADDR A:0xfc4e0058
y.create.l HWIO_DIM_C00_DIM_CA_CDC_SW_OVRD_CFG_ADDR A:0xfc4e005c
y.create.l HWIO_DIM_C00_DIM_CA_CDC_STATUS0_ADDR A:0xfc4e0070
y.create.l HWIO_DIM_C00_DIM_CA_CDC_STATUS1_ADDR A:0xfc4e0074
y.create.l HWIO_DIM_C00_DIM_CA_CDC_STATUS2_ADDR A:0xfc4e0078
y.create.l HWIO_DIM_C00_DIM_CA_CDC_STATUS3_ADDR A:0xfc4e007c
y.create.l HWIO_DIM_C00_DIM_CA_IOC_CTLR_CFG_ADDR A:0xfc4e00e0
y.create.l HWIO_DIM_C00_DIM_CA_IOC_CTLR_PNCNT_CFG_ADDR A:0xfc4e00e4
y.create.l HWIO_DIM_C00_DIM_CA_IOC_CTLR_TIMER_CFG_ADDR A:0xfc4e00e8
y.create.l HWIO_DIM_C00_DIM_CA_IOC_CTLR_TIMER_STATUS_ADDR A:0xfc4e00ec
y.create.l HWIO_DIM_C00_DIM_CA_IOC_CTLR_CHAR_CFG_ADDR A:0xfc4e00f0
y.create.l HWIO_DIM_C00_DIM_CA_IOC_CTLR_STATUS_ADDR A:0xfc4e00f4
y.create.l HWIO_DIM_C00_DIM_CA_CA_IOC_SLV_CFG_ADDR A:0xfc4e0100
y.create.l HWIO_DIM_C00_DIM_CA_CA_IOC_SLV_STATUS_ADDR A:0xfc4e0104
y.create.l HWIO_DIM_C00_DIM_CA_CK_IOC_SLV_CFG_ADDR A:0xfc4e0110
y.create.l HWIO_DIM_C00_DIM_CA_CK_IOC_SLV_STATUS_ADDR A:0xfc4e0114
y.create.l HWIO_DIM_D00_DIM_DQ_TOP_CFG_ADDR A:0xfc4e0800
y.create.l HWIO_DIM_D00_DIM_DQ_HW_INFO_ADDR A:0xfc4e0804
y.create.l HWIO_DIM_D00_DIM_DQ_HW_VERSION_ADDR A:0xfc4e0808
y.create.l HWIO_DIM_D00_DIM_DQ_PAD_CFG0_ADDR A:0xfc4e0810
y.create.l HWIO_DIM_D00_DIM_DQ_PAD_CFG1_ADDR A:0xfc4e0814
y.create.l HWIO_DIM_D00_DIM_DQ_PAD_CFG2_ADDR A:0xfc4e0818
y.create.l HWIO_DIM_D00_DIM_DQ_PAD_CFG3_ADDR A:0xfc4e0820
y.create.l HWIO_DIM_D00_DDRPHY_DQ_MISR_CFG_ADDR A:0xfc4e080c
y.create.l HWIO_DIM_D00_DDRPHY_DQ_MISR_EVEN_STATUS_ADDR A:0xfc4e0828
y.create.l HWIO_DIM_D00_DDRPHY_DQ_MISR_ODD_STATUS_ADDR A:0xfc4e082c
y.create.l HWIO_DIM_D00_DIM_DQ_CDC_CTLR_CFG0_ADDR A:0xfc4e0830
y.create.l HWIO_DIM_D00_DIM_DQ_CDC_CTLR_CFG1_ADDR A:0xfc4e0834
y.create.l HWIO_DIM_D00_DIM_DQ_CDC_CAL_TIMER_CFG0_ADDR A:0xfc4e0838
y.create.l HWIO_DIM_D00_DIM_DQ_CDC_CAL_TIMER_CFG1_ADDR A:0xfc4e083c
y.create.l HWIO_DIM_D00_DIM_DQ_CDC_REFCOUNT_CFG_ADDR A:0xfc4e0840
y.create.l HWIO_DIM_D00_DIM_DQ_CDC_COARSE_CAL_CFG_ADDR A:0xfc4e0844
y.create.l HWIO_DIM_D00_DIM_DQ_CDC_RSVD_CFG_ADDR A:0xfc4e0848
y.create.l HWIO_DIM_D00_DIM_DQ_RD_CDC_OFFSET_CFG_ADDR A:0xfc4e084c
y.create.l HWIO_DIM_D00_DIM_DQ_RD_CDC_DELAY_CFG_ADDR A:0xfc4e0850
y.create.l HWIO_DIM_D00_DIM_DQ_RD_CDC_SW_MODE_CFG_ADDR A:0xfc4e0854
y.create.l HWIO_DIM_D00_DIM_DQ_RD_CDC_TEST_CFG_ADDR A:0xfc4e0858
y.create.l HWIO_DIM_D00_DIM_DQ_RD_CDC_SW_OVRD_CFG_ADDR A:0xfc4e085c
y.create.l HWIO_DIM_D00_DIM_DQ_RD_CDC_SLAVE_DDA_CFG_ADDR A:0xfc4e0860
y.create.l HWIO_DIM_D00_DIM_DQ_RD_CDC_STATUS0_ADDR A:0xfc4e0870
y.create.l HWIO_DIM_D00_DIM_DQ_RD_CDC_STATUS1_ADDR A:0xfc4e0874
y.create.l HWIO_DIM_D00_DIM_DQ_RD_CDC_STATUS2_ADDR A:0xfc4e0878
y.create.l HWIO_DIM_D00_DIM_DQ_RD_CDC_STATUS3_ADDR A:0xfc4e087c
y.create.l HWIO_DIM_D00_DIM_DQ_RD_CDC_STATUS4_ADDR A:0xfc4e0880
y.create.l HWIO_DIM_D00_DIM_DQ_WR_CDC_OFFSET_CFG_ADDR A:0xfc4e08ac
y.create.l HWIO_DIM_D00_DIM_DQ_WR_CDC_DELAY_CFG_ADDR A:0xfc4e08b0
y.create.l HWIO_DIM_D00_DIM_DQ_WR_CDC_SW_MODE_CFG_ADDR A:0xfc4e08b4
y.create.l HWIO_DIM_D00_DIM_DQ_WR_CDC_TEST_CFG_ADDR A:0xfc4e08b8
y.create.l HWIO_DIM_D00_DIM_DQ_WR_CDC_SW_OVRD_CFG_ADDR A:0xfc4e08bc
y.create.l HWIO_DIM_D00_DIM_DQ_WR_CDC_STATUS0_ADDR A:0xfc4e08d0
y.create.l HWIO_DIM_D00_DIM_DQ_WR_CDC_STATUS1_ADDR A:0xfc4e08d4
y.create.l HWIO_DIM_D00_DIM_DQ_WR_CDC_STATUS2_ADDR A:0xfc4e08d8
y.create.l HWIO_DIM_D00_DIM_DQ_WR_CDC_STATUS3_ADDR A:0xfc4e08dc
y.create.l HWIO_DIM_D00_DIM_DQ_DQ_IOC_SLV_CFG_ADDR A:0xfc4e0900
y.create.l HWIO_DIM_D00_DIM_DQ_DQ_IOC_SLV_STATUS_ADDR A:0xfc4e0904
y.create.l HWIO_DIM_D00_DIM_DQ_DQS_IOC_SLV_CFG_ADDR A:0xfc4e0910
y.create.l HWIO_DIM_D00_DIM_DQ_DQS_IOC_SLV_STATUS_ADDR A:0xfc4e0914
y.create.l HWIO_DIM_D01_DIM_DQ_TOP_CFG_ADDR A:0xfc4e1000
y.create.l HWIO_DIM_D01_DIM_DQ_HW_INFO_ADDR A:0xfc4e1004
y.create.l HWIO_DIM_D01_DIM_DQ_HW_VERSION_ADDR A:0xfc4e1008
y.create.l HWIO_DIM_D01_DIM_DQ_PAD_CFG0_ADDR A:0xfc4e1010
y.create.l HWIO_DIM_D01_DIM_DQ_PAD_CFG1_ADDR A:0xfc4e1014
y.create.l HWIO_DIM_D01_DIM_DQ_PAD_CFG2_ADDR A:0xfc4e1018
y.create.l HWIO_DIM_D01_DIM_DQ_PAD_CFG3_ADDR A:0xfc4e1020
y.create.l HWIO_DIM_D01_DDRPHY_DQ_MISR_CFG_ADDR A:0xfc4e100c
y.create.l HWIO_DIM_D01_DDRPHY_DQ_MISR_EVEN_STATUS_ADDR A:0xfc4e1028
y.create.l HWIO_DIM_D01_DDRPHY_DQ_MISR_ODD_STATUS_ADDR A:0xfc4e102c
y.create.l HWIO_DIM_D01_DIM_DQ_CDC_CTLR_CFG0_ADDR A:0xfc4e1030
y.create.l HWIO_DIM_D01_DIM_DQ_CDC_CTLR_CFG1_ADDR A:0xfc4e1034
y.create.l HWIO_DIM_D01_DIM_DQ_CDC_CAL_TIMER_CFG0_ADDR A:0xfc4e1038
y.create.l HWIO_DIM_D01_DIM_DQ_CDC_CAL_TIMER_CFG1_ADDR A:0xfc4e103c
y.create.l HWIO_DIM_D01_DIM_DQ_CDC_REFCOUNT_CFG_ADDR A:0xfc4e1040
y.create.l HWIO_DIM_D01_DIM_DQ_CDC_COARSE_CAL_CFG_ADDR A:0xfc4e1044
y.create.l HWIO_DIM_D01_DIM_DQ_CDC_RSVD_CFG_ADDR A:0xfc4e1048
y.create.l HWIO_DIM_D01_DIM_DQ_RD_CDC_OFFSET_CFG_ADDR A:0xfc4e104c
y.create.l HWIO_DIM_D01_DIM_DQ_RD_CDC_DELAY_CFG_ADDR A:0xfc4e1050
y.create.l HWIO_DIM_D01_DIM_DQ_RD_CDC_SW_MODE_CFG_ADDR A:0xfc4e1054
y.create.l HWIO_DIM_D01_DIM_DQ_RD_CDC_TEST_CFG_ADDR A:0xfc4e1058
y.create.l HWIO_DIM_D01_DIM_DQ_RD_CDC_SW_OVRD_CFG_ADDR A:0xfc4e105c
y.create.l HWIO_DIM_D01_DIM_DQ_RD_CDC_SLAVE_DDA_CFG_ADDR A:0xfc4e1060
y.create.l HWIO_DIM_D01_DIM_DQ_RD_CDC_STATUS0_ADDR A:0xfc4e1070
y.create.l HWIO_DIM_D01_DIM_DQ_RD_CDC_STATUS1_ADDR A:0xfc4e1074
y.create.l HWIO_DIM_D01_DIM_DQ_RD_CDC_STATUS2_ADDR A:0xfc4e1078
y.create.l HWIO_DIM_D01_DIM_DQ_RD_CDC_STATUS3_ADDR A:0xfc4e107c
y.create.l HWIO_DIM_D01_DIM_DQ_RD_CDC_STATUS4_ADDR A:0xfc4e1080
y.create.l HWIO_DIM_D01_DIM_DQ_WR_CDC_OFFSET_CFG_ADDR A:0xfc4e10ac
y.create.l HWIO_DIM_D01_DIM_DQ_WR_CDC_DELAY_CFG_ADDR A:0xfc4e10b0
y.create.l HWIO_DIM_D01_DIM_DQ_WR_CDC_SW_MODE_CFG_ADDR A:0xfc4e10b4
y.create.l HWIO_DIM_D01_DIM_DQ_WR_CDC_TEST_CFG_ADDR A:0xfc4e10b8
y.create.l HWIO_DIM_D01_DIM_DQ_WR_CDC_SW_OVRD_CFG_ADDR A:0xfc4e10bc
y.create.l HWIO_DIM_D01_DIM_DQ_WR_CDC_STATUS0_ADDR A:0xfc4e10d0
y.create.l HWIO_DIM_D01_DIM_DQ_WR_CDC_STATUS1_ADDR A:0xfc4e10d4
y.create.l HWIO_DIM_D01_DIM_DQ_WR_CDC_STATUS2_ADDR A:0xfc4e10d8
y.create.l HWIO_DIM_D01_DIM_DQ_WR_CDC_STATUS3_ADDR A:0xfc4e10dc
y.create.l HWIO_DIM_D01_DIM_DQ_DQ_IOC_SLV_CFG_ADDR A:0xfc4e1100
y.create.l HWIO_DIM_D01_DIM_DQ_DQ_IOC_SLV_STATUS_ADDR A:0xfc4e1104
y.create.l HWIO_DIM_D01_DIM_DQ_DQS_IOC_SLV_CFG_ADDR A:0xfc4e1110
y.create.l HWIO_DIM_D01_DIM_DQ_DQS_IOC_SLV_STATUS_ADDR A:0xfc4e1114
y.create.l HWIO_DIM_D02_DIM_DQ_TOP_CFG_ADDR A:0xfc4e1800
y.create.l HWIO_DIM_D02_DIM_DQ_HW_INFO_ADDR A:0xfc4e1804
y.create.l HWIO_DIM_D02_DIM_DQ_HW_VERSION_ADDR A:0xfc4e1808
y.create.l HWIO_DIM_D02_DIM_DQ_PAD_CFG0_ADDR A:0xfc4e1810
y.create.l HWIO_DIM_D02_DIM_DQ_PAD_CFG1_ADDR A:0xfc4e1814
y.create.l HWIO_DIM_D02_DIM_DQ_PAD_CFG2_ADDR A:0xfc4e1818
y.create.l HWIO_DIM_D02_DIM_DQ_PAD_CFG3_ADDR A:0xfc4e1820
y.create.l HWIO_DIM_D02_DDRPHY_DQ_MISR_CFG_ADDR A:0xfc4e180c
y.create.l HWIO_DIM_D02_DDRPHY_DQ_MISR_EVEN_STATUS_ADDR A:0xfc4e1828
y.create.l HWIO_DIM_D02_DDRPHY_DQ_MISR_ODD_STATUS_ADDR A:0xfc4e182c
y.create.l HWIO_DIM_D02_DIM_DQ_CDC_CTLR_CFG0_ADDR A:0xfc4e1830
y.create.l HWIO_DIM_D02_DIM_DQ_CDC_CTLR_CFG1_ADDR A:0xfc4e1834
y.create.l HWIO_DIM_D02_DIM_DQ_CDC_CAL_TIMER_CFG0_ADDR A:0xfc4e1838
y.create.l HWIO_DIM_D02_DIM_DQ_CDC_CAL_TIMER_CFG1_ADDR A:0xfc4e183c
y.create.l HWIO_DIM_D02_DIM_DQ_CDC_REFCOUNT_CFG_ADDR A:0xfc4e1840
y.create.l HWIO_DIM_D02_DIM_DQ_CDC_COARSE_CAL_CFG_ADDR A:0xfc4e1844
y.create.l HWIO_DIM_D02_DIM_DQ_CDC_RSVD_CFG_ADDR A:0xfc4e1848
y.create.l HWIO_DIM_D02_DIM_DQ_RD_CDC_OFFSET_CFG_ADDR A:0xfc4e184c
y.create.l HWIO_DIM_D02_DIM_DQ_RD_CDC_DELAY_CFG_ADDR A:0xfc4e1850
y.create.l HWIO_DIM_D02_DIM_DQ_RD_CDC_SW_MODE_CFG_ADDR A:0xfc4e1854
y.create.l HWIO_DIM_D02_DIM_DQ_RD_CDC_TEST_CFG_ADDR A:0xfc4e1858
y.create.l HWIO_DIM_D02_DIM_DQ_RD_CDC_SW_OVRD_CFG_ADDR A:0xfc4e185c
y.create.l HWIO_DIM_D02_DIM_DQ_RD_CDC_SLAVE_DDA_CFG_ADDR A:0xfc4e1860
y.create.l HWIO_DIM_D02_DIM_DQ_RD_CDC_STATUS0_ADDR A:0xfc4e1870
y.create.l HWIO_DIM_D02_DIM_DQ_RD_CDC_STATUS1_ADDR A:0xfc4e1874
y.create.l HWIO_DIM_D02_DIM_DQ_RD_CDC_STATUS2_ADDR A:0xfc4e1878
y.create.l HWIO_DIM_D02_DIM_DQ_RD_CDC_STATUS3_ADDR A:0xfc4e187c
y.create.l HWIO_DIM_D02_DIM_DQ_RD_CDC_STATUS4_ADDR A:0xfc4e1880
y.create.l HWIO_DIM_D02_DIM_DQ_WR_CDC_OFFSET_CFG_ADDR A:0xfc4e18ac
y.create.l HWIO_DIM_D02_DIM_DQ_WR_CDC_DELAY_CFG_ADDR A:0xfc4e18b0
y.create.l HWIO_DIM_D02_DIM_DQ_WR_CDC_SW_MODE_CFG_ADDR A:0xfc4e18b4
y.create.l HWIO_DIM_D02_DIM_DQ_WR_CDC_TEST_CFG_ADDR A:0xfc4e18b8
y.create.l HWIO_DIM_D02_DIM_DQ_WR_CDC_SW_OVRD_CFG_ADDR A:0xfc4e18bc
y.create.l HWIO_DIM_D02_DIM_DQ_WR_CDC_STATUS0_ADDR A:0xfc4e18d0
y.create.l HWIO_DIM_D02_DIM_DQ_WR_CDC_STATUS1_ADDR A:0xfc4e18d4
y.create.l HWIO_DIM_D02_DIM_DQ_WR_CDC_STATUS2_ADDR A:0xfc4e18d8
y.create.l HWIO_DIM_D02_DIM_DQ_WR_CDC_STATUS3_ADDR A:0xfc4e18dc
y.create.l HWIO_DIM_D02_DIM_DQ_DQ_IOC_SLV_CFG_ADDR A:0xfc4e1900
y.create.l HWIO_DIM_D02_DIM_DQ_DQ_IOC_SLV_STATUS_ADDR A:0xfc4e1904
y.create.l HWIO_DIM_D02_DIM_DQ_DQS_IOC_SLV_CFG_ADDR A:0xfc4e1910
y.create.l HWIO_DIM_D02_DIM_DQ_DQS_IOC_SLV_STATUS_ADDR A:0xfc4e1914
y.create.l HWIO_DIM_D03_DIM_DQ_TOP_CFG_ADDR A:0xfc4e2000
y.create.l HWIO_DIM_D03_DIM_DQ_HW_INFO_ADDR A:0xfc4e2004
y.create.l HWIO_DIM_D03_DIM_DQ_HW_VERSION_ADDR A:0xfc4e2008
y.create.l HWIO_DIM_D03_DIM_DQ_PAD_CFG0_ADDR A:0xfc4e2010
y.create.l HWIO_DIM_D03_DIM_DQ_PAD_CFG1_ADDR A:0xfc4e2014
y.create.l HWIO_DIM_D03_DIM_DQ_PAD_CFG2_ADDR A:0xfc4e2018
y.create.l HWIO_DIM_D03_DIM_DQ_PAD_CFG3_ADDR A:0xfc4e2020
y.create.l HWIO_DIM_D03_DDRPHY_DQ_MISR_CFG_ADDR A:0xfc4e200c
y.create.l HWIO_DIM_D03_DDRPHY_DQ_MISR_EVEN_STATUS_ADDR A:0xfc4e2028
y.create.l HWIO_DIM_D03_DDRPHY_DQ_MISR_ODD_STATUS_ADDR A:0xfc4e202c
y.create.l HWIO_DIM_D03_DIM_DQ_CDC_CTLR_CFG0_ADDR A:0xfc4e2030
y.create.l HWIO_DIM_D03_DIM_DQ_CDC_CTLR_CFG1_ADDR A:0xfc4e2034
y.create.l HWIO_DIM_D03_DIM_DQ_CDC_CAL_TIMER_CFG0_ADDR A:0xfc4e2038
y.create.l HWIO_DIM_D03_DIM_DQ_CDC_CAL_TIMER_CFG1_ADDR A:0xfc4e203c
y.create.l HWIO_DIM_D03_DIM_DQ_CDC_REFCOUNT_CFG_ADDR A:0xfc4e2040
y.create.l HWIO_DIM_D03_DIM_DQ_CDC_COARSE_CAL_CFG_ADDR A:0xfc4e2044
y.create.l HWIO_DIM_D03_DIM_DQ_CDC_RSVD_CFG_ADDR A:0xfc4e2048
y.create.l HWIO_DIM_D03_DIM_DQ_RD_CDC_OFFSET_CFG_ADDR A:0xfc4e204c
y.create.l HWIO_DIM_D03_DIM_DQ_RD_CDC_DELAY_CFG_ADDR A:0xfc4e2050
y.create.l HWIO_DIM_D03_DIM_DQ_RD_CDC_SW_MODE_CFG_ADDR A:0xfc4e2054
y.create.l HWIO_DIM_D03_DIM_DQ_RD_CDC_TEST_CFG_ADDR A:0xfc4e2058
y.create.l HWIO_DIM_D03_DIM_DQ_RD_CDC_SW_OVRD_CFG_ADDR A:0xfc4e205c
y.create.l HWIO_DIM_D03_DIM_DQ_RD_CDC_SLAVE_DDA_CFG_ADDR A:0xfc4e2060
y.create.l HWIO_DIM_D03_DIM_DQ_RD_CDC_STATUS0_ADDR A:0xfc4e2070
y.create.l HWIO_DIM_D03_DIM_DQ_RD_CDC_STATUS1_ADDR A:0xfc4e2074
y.create.l HWIO_DIM_D03_DIM_DQ_RD_CDC_STATUS2_ADDR A:0xfc4e2078
y.create.l HWIO_DIM_D03_DIM_DQ_RD_CDC_STATUS3_ADDR A:0xfc4e207c
y.create.l HWIO_DIM_D03_DIM_DQ_RD_CDC_STATUS4_ADDR A:0xfc4e2080
y.create.l HWIO_DIM_D03_DIM_DQ_WR_CDC_OFFSET_CFG_ADDR A:0xfc4e20ac
y.create.l HWIO_DIM_D03_DIM_DQ_WR_CDC_DELAY_CFG_ADDR A:0xfc4e20b0
y.create.l HWIO_DIM_D03_DIM_DQ_WR_CDC_SW_MODE_CFG_ADDR A:0xfc4e20b4
y.create.l HWIO_DIM_D03_DIM_DQ_WR_CDC_TEST_CFG_ADDR A:0xfc4e20b8
y.create.l HWIO_DIM_D03_DIM_DQ_WR_CDC_SW_OVRD_CFG_ADDR A:0xfc4e20bc
y.create.l HWIO_DIM_D03_DIM_DQ_WR_CDC_STATUS0_ADDR A:0xfc4e20d0
y.create.l HWIO_DIM_D03_DIM_DQ_WR_CDC_STATUS1_ADDR A:0xfc4e20d4
y.create.l HWIO_DIM_D03_DIM_DQ_WR_CDC_STATUS2_ADDR A:0xfc4e20d8
y.create.l HWIO_DIM_D03_DIM_DQ_WR_CDC_STATUS3_ADDR A:0xfc4e20dc
y.create.l HWIO_DIM_D03_DIM_DQ_DQ_IOC_SLV_CFG_ADDR A:0xfc4e2100
y.create.l HWIO_DIM_D03_DIM_DQ_DQ_IOC_SLV_STATUS_ADDR A:0xfc4e2104
y.create.l HWIO_DIM_D03_DIM_DQ_DQS_IOC_SLV_CFG_ADDR A:0xfc4e2110
y.create.l HWIO_DIM_D03_DIM_DQ_DQS_IOC_SLV_STATUS_ADDR A:0xfc4e2114
y.create.l HWIO_EBI1_HW_VERSION_ADDR A:0xfc4ff000
y.create.l HWIO_EBI1_HW_INFO_ADDR A:0xfc4ff004
y.create.l HWIO_EBI1_AHB2PHY_BROADCAST_EN_CFG_LOWER_ADDR A:0xfc4ff008
y.create.l HWIO_EBI1_AHB2PHY_BROADCAST_EN_CFG_UPPER_ADDR A:0xfc4ff00c
y.create.l HWIO_EBI1_AHB2PHY_TOP_CFG_ADDR A:0xfc4ff010
y.create.l HWIO_EBI1_AHB2PHY_DEBUG_BUS_CFG_ADDR A:0xfc4ff014
y.create.l HWIO_EBI1_AHB2PHY_BROADCAST_ADDRESS_SPACE_0_ADDR A:0xfc4ff800
y.create.l HWIO_EBI1_AHB2PHY_BROADCAST_ADDRESS_SPACE_1_ADDR A:0xfc4ff804
y.create.l HWIO_EBI1_AHB2PHY_BROADCAST_ADDRESS_SPACE_2_ADDR A:0xfc4ff808
y.create.l HWIO_EBI1_AHB2PHY_BROADCAST_ADDRESS_SPACE_3_ADDR A:0xfc4ff80c
y.create.l HWIO_EBI1_AHB2PHY_BROADCAST_ADDRESS_SPACE_4_ADDR A:0xfc4ff810
y.create.l HWIO_EBI1_AHB2PHY_BROADCAST_ADDRESS_SPACE_5_ADDR A:0xfc4ff814
y.create.l HWIO_EBI1_AHB2PHY_BROADCAST_ADDRESS_SPACE_6_ADDR A:0xfc4ff818
y.create.l HWIO_EBI1_AHB2PHY_BROADCAST_ADDRESS_SPACE_7_ADDR A:0xfc4ff81c
y.create.l HWIO_EBI1_AHB2PHY_BROADCAST_ADDRESS_SPACE_8_ADDR A:0xfc4ff820
y.create.l HWIO_EBI1_AHB2PHY_BROADCAST_ADDRESS_SPACE_9_ADDR A:0xfc4ff824
y.create.l HWIO_BAM_CTRL_ADDR A:0xfd4c4000
y.create.l HWIO_BAM_REVISION_ADDR A:0xfd4c4004
y.create.l HWIO_BAM_SW_VERSION_ADDR A:0xfd4c4080
y.create.l HWIO_BAM_NUM_PIPES_ADDR A:0xfd4c403c
y.create.l HWIO_BAM_TIMER_ADDR A:0xfd4c4040
y.create.l HWIO_BAM_TIMER_CTRL_ADDR A:0xfd4c4044
y.create.l HWIO_BAM_DESC_CNT_TRSHLD_ADDR A:0xfd4c4008
y.create.l HWIO_BAM_IRQ_SRCS_ADDR A:0xfd4c400c
y.create.l HWIO_BAM_IRQ_SRCS_MSK_ADDR A:0xfd4c4010
y.create.l HWIO_BAM_IRQ_SRCS_UNMASKED_ADDR A:0xfd4c4030
y.create.l HWIO_BAM_IRQ_STTS_ADDR A:0xfd4c4014
y.create.l HWIO_BAM_IRQ_CLR_ADDR A:0xfd4c4018
y.create.l HWIO_BAM_IRQ_EN_ADDR A:0xfd4c401c
y.create.l HWIO_BAM_AHB_MASTER_ERR_CTRLS_ADDR A:0xfd4c4024
y.create.l HWIO_BAM_AHB_MASTER_ERR_ADDR_ADDR A:0xfd4c4028
y.create.l HWIO_BAM_AHB_MASTER_ERR_ADDR_LSB_ADDR A:0xfd4c4100
y.create.l HWIO_BAM_AHB_MASTER_ERR_ADDR_MSB_ADDR A:0xfd4c4104
y.create.l HWIO_BAM_AHB_MASTER_ERR_DATA_ADDR A:0xfd4c402c
y.create.l HWIO_BAM_TRUST_REG_ADDR A:0xfd4c4070
y.create.l HWIO_BAM_TEST_BUS_SEL_ADDR A:0xfd4c4074
y.create.l HWIO_BAM_TEST_BUS_REG_ADDR A:0xfd4c4078
y.create.l HWIO_BAM_CNFG_BITS_ADDR A:0xfd4c407c
y.create.l HWIO_BAM_IRQ_SRCS_EE0_ADDR A:0xfd4c4800
y.create.l HWIO_BAM_IRQ_SRCS_EE1_ADDR A:0xfd4c4880
y.create.l HWIO_BAM_IRQ_SRCS_EE2_ADDR A:0xfd4c4900
y.create.l HWIO_BAM_IRQ_SRCS_EE3_ADDR A:0xfd4c4980
y.create.l HWIO_BAM_IRQ_SRCS_EE4_ADDR A:0xfd4c4a00
y.create.l HWIO_BAM_IRQ_SRCS_EE5_ADDR A:0xfd4c4a80
y.create.l HWIO_BAM_IRQ_SRCS_EE6_ADDR A:0xfd4c4b00
y.create.l HWIO_BAM_IRQ_SRCS_EE7_ADDR A:0xfd4c4b80
y.create.l HWIO_BAM_IRQ_SRCS_MSK_EE0_ADDR A:0xfd4c4804
y.create.l HWIO_BAM_IRQ_SRCS_MSK_EE1_ADDR A:0xfd4c4884
y.create.l HWIO_BAM_IRQ_SRCS_MSK_EE2_ADDR A:0xfd4c4904
y.create.l HWIO_BAM_IRQ_SRCS_MSK_EE3_ADDR A:0xfd4c4984
y.create.l HWIO_BAM_IRQ_SRCS_MSK_EE4_ADDR A:0xfd4c4a04
y.create.l HWIO_BAM_IRQ_SRCS_MSK_EE5_ADDR A:0xfd4c4a84
y.create.l HWIO_BAM_IRQ_SRCS_MSK_EE6_ADDR A:0xfd4c4b04
y.create.l HWIO_BAM_IRQ_SRCS_MSK_EE7_ADDR A:0xfd4c4b84
y.create.l HWIO_BAM_IRQ_SRCS_UNMASKED_EE0_ADDR A:0xfd4c4808
y.create.l HWIO_BAM_IRQ_SRCS_UNMASKED_EE1_ADDR A:0xfd4c4888
y.create.l HWIO_BAM_IRQ_SRCS_UNMASKED_EE2_ADDR A:0xfd4c4908
y.create.l HWIO_BAM_IRQ_SRCS_UNMASKED_EE3_ADDR A:0xfd4c4988
y.create.l HWIO_BAM_IRQ_SRCS_UNMASKED_EE4_ADDR A:0xfd4c4a08
y.create.l HWIO_BAM_IRQ_SRCS_UNMASKED_EE5_ADDR A:0xfd4c4a88
y.create.l HWIO_BAM_IRQ_SRCS_UNMASKED_EE6_ADDR A:0xfd4c4b08
y.create.l HWIO_BAM_IRQ_SRCS_UNMASKED_EE7_ADDR A:0xfd4c4b88
y.create.l HWIO_BAM_PIPE_ATTR_EE0_ADDR A:0xfd4c480c
y.create.l HWIO_BAM_PIPE_ATTR_EE1_ADDR A:0xfd4c488c
y.create.l HWIO_BAM_PIPE_ATTR_EE2_ADDR A:0xfd4c490c
y.create.l HWIO_BAM_PIPE_ATTR_EE3_ADDR A:0xfd4c498c
y.create.l HWIO_BAM_PIPE_ATTR_EE4_ADDR A:0xfd4c4a0c
y.create.l HWIO_BAM_PIPE_ATTR_EE5_ADDR A:0xfd4c4a8c
y.create.l HWIO_BAM_PIPE_ATTR_EE6_ADDR A:0xfd4c4b0c
y.create.l HWIO_BAM_PIPE_ATTR_EE7_ADDR A:0xfd4c4b8c
y.create.l HWIO_BAM_P_CTRL0_ADDR A:0xfd4c5000
y.create.l HWIO_BAM_P_CTRL1_ADDR A:0xfd4c6000
y.create.l HWIO_BAM_P_CTRL2_ADDR A:0xfd4c7000
y.create.l HWIO_BAM_P_CTRL3_ADDR A:0xfd4c8000
y.create.l HWIO_BAM_P_CTRL4_ADDR A:0xfd4c9000
y.create.l HWIO_BAM_P_CTRL5_ADDR A:0xfd4ca000
y.create.l HWIO_BAM_P_CTRL6_ADDR A:0xfd4cb000
y.create.l HWIO_BAM_P_CTRL7_ADDR A:0xfd4cc000
y.create.l HWIO_BAM_P_CTRL8_ADDR A:0xfd4cd000
y.create.l HWIO_BAM_P_CTRL9_ADDR A:0xfd4ce000
y.create.l HWIO_BAM_P_RST0_ADDR A:0xfd4c5004
y.create.l HWIO_BAM_P_RST1_ADDR A:0xfd4c6004
y.create.l HWIO_BAM_P_RST2_ADDR A:0xfd4c7004
y.create.l HWIO_BAM_P_RST3_ADDR A:0xfd4c8004
y.create.l HWIO_BAM_P_RST4_ADDR A:0xfd4c9004
y.create.l HWIO_BAM_P_RST5_ADDR A:0xfd4ca004
y.create.l HWIO_BAM_P_RST6_ADDR A:0xfd4cb004
y.create.l HWIO_BAM_P_RST7_ADDR A:0xfd4cc004
y.create.l HWIO_BAM_P_RST8_ADDR A:0xfd4cd004
y.create.l HWIO_BAM_P_RST9_ADDR A:0xfd4ce004
y.create.l HWIO_BAM_P_HALT0_ADDR A:0xfd4c5008
y.create.l HWIO_BAM_P_HALT1_ADDR A:0xfd4c6008
y.create.l HWIO_BAM_P_HALT2_ADDR A:0xfd4c7008
y.create.l HWIO_BAM_P_HALT3_ADDR A:0xfd4c8008
y.create.l HWIO_BAM_P_HALT4_ADDR A:0xfd4c9008
y.create.l HWIO_BAM_P_HALT5_ADDR A:0xfd4ca008
y.create.l HWIO_BAM_P_HALT6_ADDR A:0xfd4cb008
y.create.l HWIO_BAM_P_HALT7_ADDR A:0xfd4cc008
y.create.l HWIO_BAM_P_HALT8_ADDR A:0xfd4cd008
y.create.l HWIO_BAM_P_HALT9_ADDR A:0xfd4ce008
y.create.l HWIO_BAM_P_TRUST_REG0_ADDR A:0xfd4c5030
y.create.l HWIO_BAM_P_TRUST_REG1_ADDR A:0xfd4c6030
y.create.l HWIO_BAM_P_TRUST_REG2_ADDR A:0xfd4c7030
y.create.l HWIO_BAM_P_TRUST_REG3_ADDR A:0xfd4c8030
y.create.l HWIO_BAM_P_TRUST_REG4_ADDR A:0xfd4c9030
y.create.l HWIO_BAM_P_TRUST_REG5_ADDR A:0xfd4ca030
y.create.l HWIO_BAM_P_TRUST_REG6_ADDR A:0xfd4cb030
y.create.l HWIO_BAM_P_TRUST_REG7_ADDR A:0xfd4cc030
y.create.l HWIO_BAM_P_TRUST_REG8_ADDR A:0xfd4cd030
y.create.l HWIO_BAM_P_TRUST_REG9_ADDR A:0xfd4ce030
y.create.l HWIO_BAM_P_IRQ_STTS0_ADDR A:0xfd4c5010
y.create.l HWIO_BAM_P_IRQ_STTS1_ADDR A:0xfd4c6010
y.create.l HWIO_BAM_P_IRQ_STTS2_ADDR A:0xfd4c7010
y.create.l HWIO_BAM_P_IRQ_STTS3_ADDR A:0xfd4c8010
y.create.l HWIO_BAM_P_IRQ_STTS4_ADDR A:0xfd4c9010
y.create.l HWIO_BAM_P_IRQ_STTS5_ADDR A:0xfd4ca010
y.create.l HWIO_BAM_P_IRQ_STTS6_ADDR A:0xfd4cb010
y.create.l HWIO_BAM_P_IRQ_STTS7_ADDR A:0xfd4cc010
y.create.l HWIO_BAM_P_IRQ_STTS8_ADDR A:0xfd4cd010
y.create.l HWIO_BAM_P_IRQ_STTS9_ADDR A:0xfd4ce010
y.create.l HWIO_BAM_P_IRQ_CLR0_ADDR A:0xfd4c5014
y.create.l HWIO_BAM_P_IRQ_CLR1_ADDR A:0xfd4c6014
y.create.l HWIO_BAM_P_IRQ_CLR2_ADDR A:0xfd4c7014
y.create.l HWIO_BAM_P_IRQ_CLR3_ADDR A:0xfd4c8014
y.create.l HWIO_BAM_P_IRQ_CLR4_ADDR A:0xfd4c9014
y.create.l HWIO_BAM_P_IRQ_CLR5_ADDR A:0xfd4ca014
y.create.l HWIO_BAM_P_IRQ_CLR6_ADDR A:0xfd4cb014
y.create.l HWIO_BAM_P_IRQ_CLR7_ADDR A:0xfd4cc014
y.create.l HWIO_BAM_P_IRQ_CLR8_ADDR A:0xfd4cd014
y.create.l HWIO_BAM_P_IRQ_CLR9_ADDR A:0xfd4ce014
y.create.l HWIO_BAM_P_IRQ_EN0_ADDR A:0xfd4c5018
y.create.l HWIO_BAM_P_IRQ_EN1_ADDR A:0xfd4c6018
y.create.l HWIO_BAM_P_IRQ_EN2_ADDR A:0xfd4c7018
y.create.l HWIO_BAM_P_IRQ_EN3_ADDR A:0xfd4c8018
y.create.l HWIO_BAM_P_IRQ_EN4_ADDR A:0xfd4c9018
y.create.l HWIO_BAM_P_IRQ_EN5_ADDR A:0xfd4ca018
y.create.l HWIO_BAM_P_IRQ_EN6_ADDR A:0xfd4cb018
y.create.l HWIO_BAM_P_IRQ_EN7_ADDR A:0xfd4cc018
y.create.l HWIO_BAM_P_IRQ_EN8_ADDR A:0xfd4cd018
y.create.l HWIO_BAM_P_IRQ_EN9_ADDR A:0xfd4ce018
y.create.l HWIO_BAM_P_TIMER0_ADDR A:0xfd4c501c
y.create.l HWIO_BAM_P_TIMER1_ADDR A:0xfd4c601c
y.create.l HWIO_BAM_P_TIMER2_ADDR A:0xfd4c701c
y.create.l HWIO_BAM_P_TIMER3_ADDR A:0xfd4c801c
y.create.l HWIO_BAM_P_TIMER4_ADDR A:0xfd4c901c
y.create.l HWIO_BAM_P_TIMER5_ADDR A:0xfd4ca01c
y.create.l HWIO_BAM_P_TIMER6_ADDR A:0xfd4cb01c
y.create.l HWIO_BAM_P_TIMER7_ADDR A:0xfd4cc01c
y.create.l HWIO_BAM_P_TIMER8_ADDR A:0xfd4cd01c
y.create.l HWIO_BAM_P_TIMER9_ADDR A:0xfd4ce01c
y.create.l HWIO_BAM_P_TIMER_CTRL0_ADDR A:0xfd4c5020
y.create.l HWIO_BAM_P_TIMER_CTRL1_ADDR A:0xfd4c6020
y.create.l HWIO_BAM_P_TIMER_CTRL2_ADDR A:0xfd4c7020
y.create.l HWIO_BAM_P_TIMER_CTRL3_ADDR A:0xfd4c8020
y.create.l HWIO_BAM_P_TIMER_CTRL4_ADDR A:0xfd4c9020
y.create.l HWIO_BAM_P_TIMER_CTRL5_ADDR A:0xfd4ca020
y.create.l HWIO_BAM_P_TIMER_CTRL6_ADDR A:0xfd4cb020
y.create.l HWIO_BAM_P_TIMER_CTRL7_ADDR A:0xfd4cc020
y.create.l HWIO_BAM_P_TIMER_CTRL8_ADDR A:0xfd4cd020
y.create.l HWIO_BAM_P_TIMER_CTRL9_ADDR A:0xfd4ce020
y.create.l HWIO_BAM_P_PRDCR_SDBND0_ADDR A:0xfd4c5024
y.create.l HWIO_BAM_P_PRDCR_SDBND1_ADDR A:0xfd4c6024
y.create.l HWIO_BAM_P_PRDCR_SDBND2_ADDR A:0xfd4c7024
y.create.l HWIO_BAM_P_PRDCR_SDBND3_ADDR A:0xfd4c8024
y.create.l HWIO_BAM_P_PRDCR_SDBND4_ADDR A:0xfd4c9024
y.create.l HWIO_BAM_P_PRDCR_SDBND5_ADDR A:0xfd4ca024
y.create.l HWIO_BAM_P_PRDCR_SDBND6_ADDR A:0xfd4cb024
y.create.l HWIO_BAM_P_PRDCR_SDBND7_ADDR A:0xfd4cc024
y.create.l HWIO_BAM_P_PRDCR_SDBND8_ADDR A:0xfd4cd024
y.create.l HWIO_BAM_P_PRDCR_SDBND9_ADDR A:0xfd4ce024
y.create.l HWIO_BAM_P_CNSMR_SDBND0_ADDR A:0xfd4c5028
y.create.l HWIO_BAM_P_CNSMR_SDBND1_ADDR A:0xfd4c6028
y.create.l HWIO_BAM_P_CNSMR_SDBND2_ADDR A:0xfd4c7028
y.create.l HWIO_BAM_P_CNSMR_SDBND3_ADDR A:0xfd4c8028
y.create.l HWIO_BAM_P_CNSMR_SDBND4_ADDR A:0xfd4c9028
y.create.l HWIO_BAM_P_CNSMR_SDBND5_ADDR A:0xfd4ca028
y.create.l HWIO_BAM_P_CNSMR_SDBND6_ADDR A:0xfd4cb028
y.create.l HWIO_BAM_P_CNSMR_SDBND7_ADDR A:0xfd4cc028
y.create.l HWIO_BAM_P_CNSMR_SDBND8_ADDR A:0xfd4cd028
y.create.l HWIO_BAM_P_CNSMR_SDBND9_ADDR A:0xfd4ce028
y.create.l HWIO_BAM_P_EVNT_DEST_ADDR0_ADDR A:0xfd4c582c
y.create.l HWIO_BAM_P_EVNT_DEST_ADDR1_ADDR A:0xfd4c682c
y.create.l HWIO_BAM_P_EVNT_DEST_ADDR2_ADDR A:0xfd4c782c
y.create.l HWIO_BAM_P_EVNT_DEST_ADDR3_ADDR A:0xfd4c882c
y.create.l HWIO_BAM_P_EVNT_DEST_ADDR4_ADDR A:0xfd4c982c
y.create.l HWIO_BAM_P_EVNT_DEST_ADDR5_ADDR A:0xfd4ca82c
y.create.l HWIO_BAM_P_EVNT_DEST_ADDR6_ADDR A:0xfd4cb82c
y.create.l HWIO_BAM_P_EVNT_DEST_ADDR7_ADDR A:0xfd4cc82c
y.create.l HWIO_BAM_P_EVNT_DEST_ADDR8_ADDR A:0xfd4cd82c
y.create.l HWIO_BAM_P_EVNT_DEST_ADDR9_ADDR A:0xfd4ce82c
y.create.l HWIO_BAM_P_EVNT_DEST_ADDR_LSB0_ADDR A:0xfd4c5930
y.create.l HWIO_BAM_P_EVNT_DEST_ADDR_LSB1_ADDR A:0xfd4c6930
y.create.l HWIO_BAM_P_EVNT_DEST_ADDR_LSB2_ADDR A:0xfd4c7930
y.create.l HWIO_BAM_P_EVNT_DEST_ADDR_LSB3_ADDR A:0xfd4c8930
y.create.l HWIO_BAM_P_EVNT_DEST_ADDR_LSB4_ADDR A:0xfd4c9930
y.create.l HWIO_BAM_P_EVNT_DEST_ADDR_LSB5_ADDR A:0xfd4ca930
y.create.l HWIO_BAM_P_EVNT_DEST_ADDR_LSB6_ADDR A:0xfd4cb930
y.create.l HWIO_BAM_P_EVNT_DEST_ADDR_LSB7_ADDR A:0xfd4cc930
y.create.l HWIO_BAM_P_EVNT_DEST_ADDR_LSB8_ADDR A:0xfd4cd930
y.create.l HWIO_BAM_P_EVNT_DEST_ADDR_LSB9_ADDR A:0xfd4ce930
y.create.l HWIO_BAM_P_EVNT_DEST_ADDR_MSB0_ADDR A:0xfd4c5934
y.create.l HWIO_BAM_P_EVNT_DEST_ADDR_MSB1_ADDR A:0xfd4c6934
y.create.l HWIO_BAM_P_EVNT_DEST_ADDR_MSB2_ADDR A:0xfd4c7934
y.create.l HWIO_BAM_P_EVNT_DEST_ADDR_MSB3_ADDR A:0xfd4c8934
y.create.l HWIO_BAM_P_EVNT_DEST_ADDR_MSB4_ADDR A:0xfd4c9934
y.create.l HWIO_BAM_P_EVNT_DEST_ADDR_MSB5_ADDR A:0xfd4ca934
y.create.l HWIO_BAM_P_EVNT_DEST_ADDR_MSB6_ADDR A:0xfd4cb934
y.create.l HWIO_BAM_P_EVNT_DEST_ADDR_MSB7_ADDR A:0xfd4cc934
y.create.l HWIO_BAM_P_EVNT_DEST_ADDR_MSB8_ADDR A:0xfd4cd934
y.create.l HWIO_BAM_P_EVNT_DEST_ADDR_MSB9_ADDR A:0xfd4ce934
y.create.l HWIO_BAM_P_EVNT_REG0_ADDR A:0xfd4c5818
y.create.l HWIO_BAM_P_EVNT_REG1_ADDR A:0xfd4c6818
y.create.l HWIO_BAM_P_EVNT_REG2_ADDR A:0xfd4c7818
y.create.l HWIO_BAM_P_EVNT_REG3_ADDR A:0xfd4c8818
y.create.l HWIO_BAM_P_EVNT_REG4_ADDR A:0xfd4c9818
y.create.l HWIO_BAM_P_EVNT_REG5_ADDR A:0xfd4ca818
y.create.l HWIO_BAM_P_EVNT_REG6_ADDR A:0xfd4cb818
y.create.l HWIO_BAM_P_EVNT_REG7_ADDR A:0xfd4cc818
y.create.l HWIO_BAM_P_EVNT_REG8_ADDR A:0xfd4cd818
y.create.l HWIO_BAM_P_EVNT_REG9_ADDR A:0xfd4ce818
y.create.l HWIO_BAM_P_SW_OFSTS0_ADDR A:0xfd4c5800
y.create.l HWIO_BAM_P_SW_OFSTS1_ADDR A:0xfd4c6800
y.create.l HWIO_BAM_P_SW_OFSTS2_ADDR A:0xfd4c7800
y.create.l HWIO_BAM_P_SW_OFSTS3_ADDR A:0xfd4c8800
y.create.l HWIO_BAM_P_SW_OFSTS4_ADDR A:0xfd4c9800
y.create.l HWIO_BAM_P_SW_OFSTS5_ADDR A:0xfd4ca800
y.create.l HWIO_BAM_P_SW_OFSTS6_ADDR A:0xfd4cb800
y.create.l HWIO_BAM_P_SW_OFSTS7_ADDR A:0xfd4cc800
y.create.l HWIO_BAM_P_SW_OFSTS8_ADDR A:0xfd4cd800
y.create.l HWIO_BAM_P_SW_OFSTS9_ADDR A:0xfd4ce800
y.create.l HWIO_BAM_P_DATA_FIFO_ADDR0_ADDR A:0xfd4c5824
y.create.l HWIO_BAM_P_DATA_FIFO_ADDR1_ADDR A:0xfd4c6824
y.create.l HWIO_BAM_P_DATA_FIFO_ADDR2_ADDR A:0xfd4c7824
y.create.l HWIO_BAM_P_DATA_FIFO_ADDR3_ADDR A:0xfd4c8824
y.create.l HWIO_BAM_P_DATA_FIFO_ADDR4_ADDR A:0xfd4c9824
y.create.l HWIO_BAM_P_DATA_FIFO_ADDR5_ADDR A:0xfd4ca824
y.create.l HWIO_BAM_P_DATA_FIFO_ADDR6_ADDR A:0xfd4cb824
y.create.l HWIO_BAM_P_DATA_FIFO_ADDR7_ADDR A:0xfd4cc824
y.create.l HWIO_BAM_P_DATA_FIFO_ADDR8_ADDR A:0xfd4cd824
y.create.l HWIO_BAM_P_DATA_FIFO_ADDR9_ADDR A:0xfd4ce824
y.create.l HWIO_BAM_P_DATA_FIFO_ADDR_LSB0_ADDR A:0xfd4c5920
y.create.l HWIO_BAM_P_DATA_FIFO_ADDR_LSB1_ADDR A:0xfd4c6920
y.create.l HWIO_BAM_P_DATA_FIFO_ADDR_LSB2_ADDR A:0xfd4c7920
y.create.l HWIO_BAM_P_DATA_FIFO_ADDR_LSB3_ADDR A:0xfd4c8920
y.create.l HWIO_BAM_P_DATA_FIFO_ADDR_LSB4_ADDR A:0xfd4c9920
y.create.l HWIO_BAM_P_DATA_FIFO_ADDR_LSB5_ADDR A:0xfd4ca920
y.create.l HWIO_BAM_P_DATA_FIFO_ADDR_LSB6_ADDR A:0xfd4cb920
y.create.l HWIO_BAM_P_DATA_FIFO_ADDR_LSB7_ADDR A:0xfd4cc920
y.create.l HWIO_BAM_P_DATA_FIFO_ADDR_LSB8_ADDR A:0xfd4cd920
y.create.l HWIO_BAM_P_DATA_FIFO_ADDR_LSB9_ADDR A:0xfd4ce920
y.create.l HWIO_BAM_P_DATA_FIFO_ADDR_MSB0_ADDR A:0xfd4c5924
y.create.l HWIO_BAM_P_DATA_FIFO_ADDR_MSB1_ADDR A:0xfd4c6924
y.create.l HWIO_BAM_P_DATA_FIFO_ADDR_MSB2_ADDR A:0xfd4c7924
y.create.l HWIO_BAM_P_DATA_FIFO_ADDR_MSB3_ADDR A:0xfd4c8924
y.create.l HWIO_BAM_P_DATA_FIFO_ADDR_MSB4_ADDR A:0xfd4c9924
y.create.l HWIO_BAM_P_DATA_FIFO_ADDR_MSB5_ADDR A:0xfd4ca924
y.create.l HWIO_BAM_P_DATA_FIFO_ADDR_MSB6_ADDR A:0xfd4cb924
y.create.l HWIO_BAM_P_DATA_FIFO_ADDR_MSB7_ADDR A:0xfd4cc924
y.create.l HWIO_BAM_P_DATA_FIFO_ADDR_MSB8_ADDR A:0xfd4cd924
y.create.l HWIO_BAM_P_DATA_FIFO_ADDR_MSB9_ADDR A:0xfd4ce924
y.create.l HWIO_BAM_P_DESC_FIFO_ADDR0_ADDR A:0xfd4c581c
y.create.l HWIO_BAM_P_DESC_FIFO_ADDR1_ADDR A:0xfd4c681c
y.create.l HWIO_BAM_P_DESC_FIFO_ADDR2_ADDR A:0xfd4c781c
y.create.l HWIO_BAM_P_DESC_FIFO_ADDR3_ADDR A:0xfd4c881c
y.create.l HWIO_BAM_P_DESC_FIFO_ADDR4_ADDR A:0xfd4c981c
y.create.l HWIO_BAM_P_DESC_FIFO_ADDR5_ADDR A:0xfd4ca81c
y.create.l HWIO_BAM_P_DESC_FIFO_ADDR6_ADDR A:0xfd4cb81c
y.create.l HWIO_BAM_P_DESC_FIFO_ADDR7_ADDR A:0xfd4cc81c
y.create.l HWIO_BAM_P_DESC_FIFO_ADDR8_ADDR A:0xfd4cd81c
y.create.l HWIO_BAM_P_DESC_FIFO_ADDR9_ADDR A:0xfd4ce81c
y.create.l HWIO_BAM_P_DESC_FIFO_ADDR_LSB0_ADDR A:0xfd4c5910
y.create.l HWIO_BAM_P_DESC_FIFO_ADDR_LSB1_ADDR A:0xfd4c6910
y.create.l HWIO_BAM_P_DESC_FIFO_ADDR_LSB2_ADDR A:0xfd4c7910
y.create.l HWIO_BAM_P_DESC_FIFO_ADDR_LSB3_ADDR A:0xfd4c8910
y.create.l HWIO_BAM_P_DESC_FIFO_ADDR_LSB4_ADDR A:0xfd4c9910
y.create.l HWIO_BAM_P_DESC_FIFO_ADDR_LSB5_ADDR A:0xfd4ca910
y.create.l HWIO_BAM_P_DESC_FIFO_ADDR_LSB6_ADDR A:0xfd4cb910
y.create.l HWIO_BAM_P_DESC_FIFO_ADDR_LSB7_ADDR A:0xfd4cc910
y.create.l HWIO_BAM_P_DESC_FIFO_ADDR_LSB8_ADDR A:0xfd4cd910
y.create.l HWIO_BAM_P_DESC_FIFO_ADDR_LSB9_ADDR A:0xfd4ce910
y.create.l HWIO_BAM_P_DESC_FIFO_ADDR_MSB0_ADDR A:0xfd4c5914
y.create.l HWIO_BAM_P_DESC_FIFO_ADDR_MSB1_ADDR A:0xfd4c6914
y.create.l HWIO_BAM_P_DESC_FIFO_ADDR_MSB2_ADDR A:0xfd4c7914
y.create.l HWIO_BAM_P_DESC_FIFO_ADDR_MSB3_ADDR A:0xfd4c8914
y.create.l HWIO_BAM_P_DESC_FIFO_ADDR_MSB4_ADDR A:0xfd4c9914
y.create.l HWIO_BAM_P_DESC_FIFO_ADDR_MSB5_ADDR A:0xfd4ca914
y.create.l HWIO_BAM_P_DESC_FIFO_ADDR_MSB6_ADDR A:0xfd4cb914
y.create.l HWIO_BAM_P_DESC_FIFO_ADDR_MSB7_ADDR A:0xfd4cc914
y.create.l HWIO_BAM_P_DESC_FIFO_ADDR_MSB8_ADDR A:0xfd4cd914
y.create.l HWIO_BAM_P_DESC_FIFO_ADDR_MSB9_ADDR A:0xfd4ce914
y.create.l HWIO_BAM_P_EVNT_GEN_TRSHLD0_ADDR A:0xfd4c5828
y.create.l HWIO_BAM_P_EVNT_GEN_TRSHLD1_ADDR A:0xfd4c6828
y.create.l HWIO_BAM_P_EVNT_GEN_TRSHLD2_ADDR A:0xfd4c7828
y.create.l HWIO_BAM_P_EVNT_GEN_TRSHLD3_ADDR A:0xfd4c8828
y.create.l HWIO_BAM_P_EVNT_GEN_TRSHLD4_ADDR A:0xfd4c9828
y.create.l HWIO_BAM_P_EVNT_GEN_TRSHLD5_ADDR A:0xfd4ca828
y.create.l HWIO_BAM_P_EVNT_GEN_TRSHLD6_ADDR A:0xfd4cb828
y.create.l HWIO_BAM_P_EVNT_GEN_TRSHLD7_ADDR A:0xfd4cc828
y.create.l HWIO_BAM_P_EVNT_GEN_TRSHLD8_ADDR A:0xfd4cd828
y.create.l HWIO_BAM_P_EVNT_GEN_TRSHLD9_ADDR A:0xfd4ce828
y.create.l HWIO_BAM_P_FIFO_SIZES0_ADDR A:0xfd4c5820
y.create.l HWIO_BAM_P_FIFO_SIZES1_ADDR A:0xfd4c6820
y.create.l HWIO_BAM_P_FIFO_SIZES2_ADDR A:0xfd4c7820
y.create.l HWIO_BAM_P_FIFO_SIZES3_ADDR A:0xfd4c8820
y.create.l HWIO_BAM_P_FIFO_SIZES4_ADDR A:0xfd4c9820
y.create.l HWIO_BAM_P_FIFO_SIZES5_ADDR A:0xfd4ca820
y.create.l HWIO_BAM_P_FIFO_SIZES6_ADDR A:0xfd4cb820
y.create.l HWIO_BAM_P_FIFO_SIZES7_ADDR A:0xfd4cc820
y.create.l HWIO_BAM_P_FIFO_SIZES8_ADDR A:0xfd4cd820
y.create.l HWIO_BAM_P_FIFO_SIZES9_ADDR A:0xfd4ce820
y.create.l HWIO_BAM_P_RETR_CNTXT_0_ADDR A:0xfd4c5834
y.create.l HWIO_BAM_P_RETR_CNTXT_1_ADDR A:0xfd4c6834
y.create.l HWIO_BAM_P_RETR_CNTXT_2_ADDR A:0xfd4c7834
y.create.l HWIO_BAM_P_RETR_CNTXT_3_ADDR A:0xfd4c8834
y.create.l HWIO_BAM_P_RETR_CNTXT_4_ADDR A:0xfd4c9834
y.create.l HWIO_BAM_P_RETR_CNTXT_5_ADDR A:0xfd4ca834
y.create.l HWIO_BAM_P_RETR_CNTXT_6_ADDR A:0xfd4cb834
y.create.l HWIO_BAM_P_RETR_CNTXT_7_ADDR A:0xfd4cc834
y.create.l HWIO_BAM_P_RETR_CNTXT_8_ADDR A:0xfd4cd834
y.create.l HWIO_BAM_P_RETR_CNTXT_9_ADDR A:0xfd4ce834
y.create.l HWIO_BAM_P_SI_CNTXT_0_ADDR A:0xfd4c5838
y.create.l HWIO_BAM_P_SI_CNTXT_1_ADDR A:0xfd4c6838
y.create.l HWIO_BAM_P_SI_CNTXT_2_ADDR A:0xfd4c7838
y.create.l HWIO_BAM_P_SI_CNTXT_3_ADDR A:0xfd4c8838
y.create.l HWIO_BAM_P_SI_CNTXT_4_ADDR A:0xfd4c9838
y.create.l HWIO_BAM_P_SI_CNTXT_5_ADDR A:0xfd4ca838
y.create.l HWIO_BAM_P_SI_CNTXT_6_ADDR A:0xfd4cb838
y.create.l HWIO_BAM_P_SI_CNTXT_7_ADDR A:0xfd4cc838
y.create.l HWIO_BAM_P_SI_CNTXT_8_ADDR A:0xfd4cd838
y.create.l HWIO_BAM_P_SI_CNTXT_9_ADDR A:0xfd4ce838
y.create.l HWIO_BAM_P_DF_CNTXT_0_ADDR A:0xfd4c5830
y.create.l HWIO_BAM_P_DF_CNTXT_1_ADDR A:0xfd4c6830
y.create.l HWIO_BAM_P_DF_CNTXT_2_ADDR A:0xfd4c7830
y.create.l HWIO_BAM_P_DF_CNTXT_3_ADDR A:0xfd4c8830
y.create.l HWIO_BAM_P_DF_CNTXT_4_ADDR A:0xfd4c9830
y.create.l HWIO_BAM_P_DF_CNTXT_5_ADDR A:0xfd4ca830
y.create.l HWIO_BAM_P_DF_CNTXT_6_ADDR A:0xfd4cb830
y.create.l HWIO_BAM_P_DF_CNTXT_7_ADDR A:0xfd4cc830
y.create.l HWIO_BAM_P_DF_CNTXT_8_ADDR A:0xfd4cd830
y.create.l HWIO_BAM_P_DF_CNTXT_9_ADDR A:0xfd4ce830
y.create.l HWIO_BAM_P_AU_PSM_CNTXT_1_0_ADDR A:0xfd4c5804
y.create.l HWIO_BAM_P_AU_PSM_CNTXT_1_1_ADDR A:0xfd4c6804
y.create.l HWIO_BAM_P_AU_PSM_CNTXT_1_2_ADDR A:0xfd4c7804
y.create.l HWIO_BAM_P_AU_PSM_CNTXT_1_3_ADDR A:0xfd4c8804
y.create.l HWIO_BAM_P_AU_PSM_CNTXT_1_4_ADDR A:0xfd4c9804
y.create.l HWIO_BAM_P_AU_PSM_CNTXT_1_5_ADDR A:0xfd4ca804
y.create.l HWIO_BAM_P_AU_PSM_CNTXT_1_6_ADDR A:0xfd4cb804
y.create.l HWIO_BAM_P_AU_PSM_CNTXT_1_7_ADDR A:0xfd4cc804
y.create.l HWIO_BAM_P_AU_PSM_CNTXT_1_8_ADDR A:0xfd4cd804
y.create.l HWIO_BAM_P_AU_PSM_CNTXT_1_9_ADDR A:0xfd4ce804
y.create.l HWIO_BAM_P_PSM_CNTXT_2_0_ADDR A:0xfd4c5808
y.create.l HWIO_BAM_P_PSM_CNTXT_2_1_ADDR A:0xfd4c6808
y.create.l HWIO_BAM_P_PSM_CNTXT_2_2_ADDR A:0xfd4c7808
y.create.l HWIO_BAM_P_PSM_CNTXT_2_3_ADDR A:0xfd4c8808
y.create.l HWIO_BAM_P_PSM_CNTXT_2_4_ADDR A:0xfd4c9808
y.create.l HWIO_BAM_P_PSM_CNTXT_2_5_ADDR A:0xfd4ca808
y.create.l HWIO_BAM_P_PSM_CNTXT_2_6_ADDR A:0xfd4cb808
y.create.l HWIO_BAM_P_PSM_CNTXT_2_7_ADDR A:0xfd4cc808
y.create.l HWIO_BAM_P_PSM_CNTXT_2_8_ADDR A:0xfd4cd808
y.create.l HWIO_BAM_P_PSM_CNTXT_2_9_ADDR A:0xfd4ce808
y.create.l HWIO_BAM_P_PSM_CNTXT_3_0_ADDR A:0xfd4c580c
y.create.l HWIO_BAM_P_PSM_CNTXT_3_1_ADDR A:0xfd4c680c
y.create.l HWIO_BAM_P_PSM_CNTXT_3_2_ADDR A:0xfd4c780c
y.create.l HWIO_BAM_P_PSM_CNTXT_3_3_ADDR A:0xfd4c880c
y.create.l HWIO_BAM_P_PSM_CNTXT_3_4_ADDR A:0xfd4c980c
y.create.l HWIO_BAM_P_PSM_CNTXT_3_5_ADDR A:0xfd4ca80c
y.create.l HWIO_BAM_P_PSM_CNTXT_3_6_ADDR A:0xfd4cb80c
y.create.l HWIO_BAM_P_PSM_CNTXT_3_7_ADDR A:0xfd4cc80c
y.create.l HWIO_BAM_P_PSM_CNTXT_3_8_ADDR A:0xfd4cd80c
y.create.l HWIO_BAM_P_PSM_CNTXT_3_9_ADDR A:0xfd4ce80c
y.create.l HWIO_BAM_P_PSM_CNTXT_3_LSB0_ADDR A:0xfd4c5900
y.create.l HWIO_BAM_P_PSM_CNTXT_3_LSB1_ADDR A:0xfd4c6900
y.create.l HWIO_BAM_P_PSM_CNTXT_3_LSB2_ADDR A:0xfd4c7900
y.create.l HWIO_BAM_P_PSM_CNTXT_3_LSB3_ADDR A:0xfd4c8900
y.create.l HWIO_BAM_P_PSM_CNTXT_3_LSB4_ADDR A:0xfd4c9900
y.create.l HWIO_BAM_P_PSM_CNTXT_3_LSB5_ADDR A:0xfd4ca900
y.create.l HWIO_BAM_P_PSM_CNTXT_3_LSB6_ADDR A:0xfd4cb900
y.create.l HWIO_BAM_P_PSM_CNTXT_3_LSB7_ADDR A:0xfd4cc900
y.create.l HWIO_BAM_P_PSM_CNTXT_3_LSB8_ADDR A:0xfd4cd900
y.create.l HWIO_BAM_P_PSM_CNTXT_3_LSB9_ADDR A:0xfd4ce900
y.create.l HWIO_BAM_P_PSM_CNTXT_3_MSB0_ADDR A:0xfd4c5904
y.create.l HWIO_BAM_P_PSM_CNTXT_3_MSB1_ADDR A:0xfd4c6904
y.create.l HWIO_BAM_P_PSM_CNTXT_3_MSB2_ADDR A:0xfd4c7904
y.create.l HWIO_BAM_P_PSM_CNTXT_3_MSB3_ADDR A:0xfd4c8904
y.create.l HWIO_BAM_P_PSM_CNTXT_3_MSB4_ADDR A:0xfd4c9904
y.create.l HWIO_BAM_P_PSM_CNTXT_3_MSB5_ADDR A:0xfd4ca904
y.create.l HWIO_BAM_P_PSM_CNTXT_3_MSB6_ADDR A:0xfd4cb904
y.create.l HWIO_BAM_P_PSM_CNTXT_3_MSB7_ADDR A:0xfd4cc904
y.create.l HWIO_BAM_P_PSM_CNTXT_3_MSB8_ADDR A:0xfd4cd904
y.create.l HWIO_BAM_P_PSM_CNTXT_3_MSB9_ADDR A:0xfd4ce904
y.create.l HWIO_BAM_P_PSM_CNTXT_4_0_ADDR A:0xfd4c5810
y.create.l HWIO_BAM_P_PSM_CNTXT_4_1_ADDR A:0xfd4c6810
y.create.l HWIO_BAM_P_PSM_CNTXT_4_2_ADDR A:0xfd4c7810
y.create.l HWIO_BAM_P_PSM_CNTXT_4_3_ADDR A:0xfd4c8810
y.create.l HWIO_BAM_P_PSM_CNTXT_4_4_ADDR A:0xfd4c9810
y.create.l HWIO_BAM_P_PSM_CNTXT_4_5_ADDR A:0xfd4ca810
y.create.l HWIO_BAM_P_PSM_CNTXT_4_6_ADDR A:0xfd4cb810
y.create.l HWIO_BAM_P_PSM_CNTXT_4_7_ADDR A:0xfd4cc810
y.create.l HWIO_BAM_P_PSM_CNTXT_4_8_ADDR A:0xfd4cd810
y.create.l HWIO_BAM_P_PSM_CNTXT_4_9_ADDR A:0xfd4ce810
y.create.l HWIO_BAM_P_PSM_CNTXT_5_0_ADDR A:0xfd4c5814
y.create.l HWIO_BAM_P_PSM_CNTXT_5_1_ADDR A:0xfd4c6814
y.create.l HWIO_BAM_P_PSM_CNTXT_5_2_ADDR A:0xfd4c7814
y.create.l HWIO_BAM_P_PSM_CNTXT_5_3_ADDR A:0xfd4c8814
y.create.l HWIO_BAM_P_PSM_CNTXT_5_4_ADDR A:0xfd4c9814
y.create.l HWIO_BAM_P_PSM_CNTXT_5_5_ADDR A:0xfd4ca814
y.create.l HWIO_BAM_P_PSM_CNTXT_5_6_ADDR A:0xfd4cb814
y.create.l HWIO_BAM_P_PSM_CNTXT_5_7_ADDR A:0xfd4cc814
y.create.l HWIO_BAM_P_PSM_CNTXT_5_8_ADDR A:0xfd4cd814
y.create.l HWIO_BAM_P_PSM_CNTXT_5_9_ADDR A:0xfd4ce814
y.create.l HWIO_XPU_SCR_ADDR A:0xfd4c2000
y.create.l HWIO_XPU_SWDR_ADDR A:0xfd4c2004
y.create.l HWIO_XPU_SEAR0_ADDR A:0xfd4c2040
y.create.l HWIO_XPU_SESR_ADDR A:0xfd4c2048
y.create.l HWIO_XPU_SESRRESTORE_ADDR A:0xfd4c204c
y.create.l HWIO_XPU_SESYNR0_ADDR A:0xfd4c2050
y.create.l HWIO_XPU_SESYNR1_ADDR A:0xfd4c2054
y.create.l HWIO_XPU_SESYNR2_ADDR A:0xfd4c2058
y.create.l HWIO_XPU_MCR_ADDR A:0xfd4c2100
y.create.l HWIO_XPU_MEAR0_ADDR A:0xfd4c2140
y.create.l HWIO_XPU_MESR_ADDR A:0xfd4c2148
y.create.l HWIO_XPU_MESRRESTORE_ADDR A:0xfd4c214c
y.create.l HWIO_XPU_MESYNR0_ADDR A:0xfd4c2150
y.create.l HWIO_XPU_MESYNR1_ADDR A:0xfd4c2154
y.create.l HWIO_XPU_MESYNR2_ADDR A:0xfd4c2158
y.create.l HWIO_XPU_CR_ADDR A:0xfd4c2080
y.create.l HWIO_XPU_RPU_ACR0_ADDR A:0xfd4c20a0
y.create.l HWIO_XPU_EAR0_ADDR A:0xfd4c20c0
y.create.l HWIO_XPU_ESR_ADDR A:0xfd4c20c8
y.create.l HWIO_XPU_ESRRESTORE_ADDR A:0xfd4c20cc
y.create.l HWIO_XPU_ESYNR0_ADDR A:0xfd4c20d0
y.create.l HWIO_XPU_ESYNR1_ADDR A:0xfd4c20d4
y.create.l HWIO_XPU_ESYNR2_ADDR A:0xfd4c20d8
y.create.l HWIO_XPU_IDR0_ADDR A:0xfd4c2074
y.create.l HWIO_XPU_IDR1_ADDR A:0xfd4c2078
y.create.l HWIO_XPU_REV_ADDR A:0xfd4c207c
y.create.l HWIO_XPU_RG0_RACR0_ADDR A:0xfd4c2200
y.create.l HWIO_XPU_RG1_RACR0_ADDR A:0xfd4c2280
y.create.l HWIO_XPU_RG2_RACR0_ADDR A:0xfd4c2300
y.create.l HWIO_XPU_RG3_RACR0_ADDR A:0xfd4c2380
y.create.l HWIO_XPU_RG4_RACR0_ADDR A:0xfd4c2400
y.create.l HWIO_XPU_RG5_RACR0_ADDR A:0xfd4c2480
y.create.l HWIO_XPU_RG6_RACR0_ADDR A:0xfd4c2500
y.create.l HWIO_XPU_RG7_RACR0_ADDR A:0xfd4c2580
y.create.l HWIO_XPU_RG8_RACR0_ADDR A:0xfd4c2600
y.create.l HWIO_XPU_RG9_RACR0_ADDR A:0xfd4c2680
y.create.l HWIO_XPU_RG0_SCR_ADDR A:0xfd4c2250
y.create.l HWIO_XPU_RG1_SCR_ADDR A:0xfd4c22d0
y.create.l HWIO_XPU_RG2_SCR_ADDR A:0xfd4c2350
y.create.l HWIO_XPU_RG3_SCR_ADDR A:0xfd4c23d0
y.create.l HWIO_XPU_RG4_SCR_ADDR A:0xfd4c2450
y.create.l HWIO_XPU_RG5_SCR_ADDR A:0xfd4c24d0
y.create.l HWIO_XPU_RG6_SCR_ADDR A:0xfd4c2550
y.create.l HWIO_XPU_RG7_SCR_ADDR A:0xfd4c25d0
y.create.l HWIO_XPU_RG8_SCR_ADDR A:0xfd4c2650
y.create.l HWIO_XPU_RG9_SCR_ADDR A:0xfd4c26d0
y.create.l HWIO_XPU_RG0_MCR_ADDR A:0xfd4c2254
y.create.l HWIO_XPU_RG1_MCR_ADDR A:0xfd4c22d4
y.create.l HWIO_XPU_RG2_MCR_ADDR A:0xfd4c2354
y.create.l HWIO_XPU_RG3_MCR_ADDR A:0xfd4c23d4
y.create.l HWIO_XPU_RG4_MCR_ADDR A:0xfd4c2454
y.create.l HWIO_XPU_RG5_MCR_ADDR A:0xfd4c24d4
y.create.l HWIO_XPU_RG6_MCR_ADDR A:0xfd4c2554
y.create.l HWIO_XPU_RG7_MCR_ADDR A:0xfd4c25d4
y.create.l HWIO_XPU_RG8_MCR_ADDR A:0xfd4c2654
y.create.l HWIO_XPU_RG9_MCR_ADDR A:0xfd4c26d4
y.create.l HWIO_IPA_VMIDMT_SCR0_ADDR A:0xfd4d9000
y.create.l HWIO_IPA_VMIDMT_SCR1_ADDR A:0xfd4d9004
y.create.l HWIO_IPA_VMIDMT_SCR2_ADDR A:0xfd4d9008
y.create.l HWIO_IPA_VMIDMT_SACR_ADDR A:0xfd4d9010
y.create.l HWIO_IPA_VMIDMT_SIDR0_ADDR A:0xfd4d9020
y.create.l HWIO_IPA_VMIDMT_SIDR1_ADDR A:0xfd4d9024
y.create.l HWIO_IPA_VMIDMT_SIDR2_ADDR A:0xfd4d9028
y.create.l HWIO_IPA_VMIDMT_SIDR4_ADDR A:0xfd4d9030
y.create.l HWIO_IPA_VMIDMT_SIDR5_ADDR A:0xfd4d9034
y.create.l HWIO_IPA_VMIDMT_SIDR7_ADDR A:0xfd4d903c
y.create.l HWIO_IPA_VMIDMT_SGFAR0_ADDR A:0xfd4d9040
y.create.l HWIO_IPA_VMIDMT_SGFSR_ADDR A:0xfd4d9048
y.create.l HWIO_IPA_VMIDMT_SGFSRRESTORE_ADDR A:0xfd4d904c
y.create.l HWIO_IPA_VMIDMT_SGFSYNDR0_ADDR A:0xfd4d9050
y.create.l HWIO_IPA_VMIDMT_SGFSYNDR1_ADDR A:0xfd4d9054
y.create.l HWIO_IPA_VMIDMT_SGFSYNDR2_ADDR A:0xfd4d9058
y.create.l HWIO_IPA_VMIDMT_VMIDMTSCR0_ADDR A:0xfd4d9090
y.create.l HWIO_IPA_VMIDMT_CR0_ADDR A:0xfd4d9000
y.create.l HWIO_IPA_VMIDMT_CR2_ADDR A:0xfd4d9008
y.create.l HWIO_IPA_VMIDMT_ACR_ADDR A:0xfd4d9010
y.create.l HWIO_IPA_VMIDMT_IDR0_ADDR A:0xfd4d9020
y.create.l HWIO_IPA_VMIDMT_IDR1_ADDR A:0xfd4d9024
y.create.l HWIO_IPA_VMIDMT_IDR2_ADDR A:0xfd4d9028
y.create.l HWIO_IPA_VMIDMT_IDR4_ADDR A:0xfd4d9030
y.create.l HWIO_IPA_VMIDMT_IDR5_ADDR A:0xfd4d9034
y.create.l HWIO_IPA_VMIDMT_IDR7_ADDR A:0xfd4d903c
y.create.l HWIO_IPA_VMIDMT_GFAR0_ADDR A:0xfd4d9040
y.create.l HWIO_IPA_VMIDMT_GFSR_ADDR A:0xfd4d9048
y.create.l HWIO_IPA_VMIDMT_GFSRRESTORE_ADDR A:0xfd4d904c
y.create.l HWIO_IPA_VMIDMT_GFSYNDR0_ADDR A:0xfd4d9050
y.create.l HWIO_IPA_VMIDMT_GFSYNDR1_ADDR A:0xfd4d9054
y.create.l HWIO_IPA_VMIDMT_GFSYNDR2_ADDR A:0xfd4d9058
y.create.l HWIO_IPA_VMIDMT_VMIDMTCR0_ADDR A:0xfd4d9090
y.create.l HWIO_IPA_VMIDMT_VMIDMTACR_ADDR A:0xfd4d909c
y.create.l HWIO_IPA_VMIDMT_NSCR0_ADDR A:0xfd4d9400
y.create.l HWIO_IPA_VMIDMT_NSCR2_ADDR A:0xfd4d9408
y.create.l HWIO_IPA_VMIDMT_NSACR_ADDR A:0xfd4d9410
y.create.l HWIO_IPA_VMIDMT_NSGFAR0_ADDR A:0xfd4d9440
y.create.l HWIO_IPA_VMIDMT_NSGFSR_ADDR A:0xfd4d9448
y.create.l HWIO_IPA_VMIDMT_NSGFSRRESTORE_ADDR A:0xfd4d944c
y.create.l HWIO_IPA_VMIDMT_NSGFSYNDR0_ADDR A:0xfd4d9450
y.create.l HWIO_IPA_VMIDMT_NSGFSYNDR1_ADDR A:0xfd4d9454
y.create.l HWIO_IPA_VMIDMT_NSGFSYNDR2_ADDR A:0xfd4d9458
y.create.l HWIO_IPA_VMIDMT_NSVMIDMTCR0_ADDR A:0xfd4d9490
y.create.l HWIO_IPA_VMIDMT_SSDR0_ADDR A:0xfd4d9080
y.create.l HWIO_IPA_VMIDMT_MSDR0_ADDR A:0xfd4d9480
y.create.l HWIO_IPA_VMIDMT_MCR_ADDR A:0xfd4d9494
y.create.l HWIO_IPA_VMIDMT_S2VR0_ADDR A:0xfd4d9c00
y.create.l HWIO_IPA_VMIDMT_S2VR1_ADDR A:0xfd4d9c04
y.create.l HWIO_IPA_VMIDMT_S2VR2_ADDR A:0xfd4d9c08
y.create.l HWIO_IPA_VMIDMT_S2VR3_ADDR A:0xfd4d9c0c
y.create.l HWIO_IPA_VMIDMT_S2VR4_ADDR A:0xfd4d9c10
y.create.l HWIO_IPA_VMIDMT_S2VR5_ADDR A:0xfd4d9c14
y.create.l HWIO_IPA_VMIDMT_S2VR6_ADDR A:0xfd4d9c18
y.create.l HWIO_IPA_VMIDMT_S2VR7_ADDR A:0xfd4d9c1c
y.create.l HWIO_IPA_VMIDMT_S2VR8_ADDR A:0xfd4d9c20
y.create.l HWIO_IPA_VMIDMT_S2VR9_ADDR A:0xfd4d9c24
y.create.l HWIO_IPA_VMIDMT_AS2VR0_ADDR A:0xfd4d9e00
y.create.l HWIO_IPA_VMIDMT_AS2VR1_ADDR A:0xfd4d9e04
y.create.l HWIO_IPA_VMIDMT_AS2VR2_ADDR A:0xfd4d9e08
y.create.l HWIO_IPA_VMIDMT_AS2VR3_ADDR A:0xfd4d9e0c
y.create.l HWIO_IPA_VMIDMT_AS2VR4_ADDR A:0xfd4d9e10
y.create.l HWIO_IPA_VMIDMT_AS2VR5_ADDR A:0xfd4d9e14
y.create.l HWIO_IPA_VMIDMT_AS2VR6_ADDR A:0xfd4d9e18
y.create.l HWIO_IPA_VMIDMT_AS2VR7_ADDR A:0xfd4d9e1c
y.create.l HWIO_IPA_VMIDMT_AS2VR8_ADDR A:0xfd4d9e20
y.create.l HWIO_IPA_VMIDMT_AS2VR9_ADDR A:0xfd4d9e24
y.create.l HWIO_IPA_VMIDMT_SMR0_ADDR A:0xfd4d9800
y.create.l HWIO_IPA_VMIDMT_SMR1_ADDR A:0xfd4d9804
y.create.l HWIO_IPA_VMIDMT_SMR2_ADDR A:0xfd4d9808
y.create.l HWIO_IPA_VMIDMT_SMR3_ADDR A:0xfd4d980c
y.create.l HWIO_IPA_VMIDMT_SMR4_ADDR A:0xfd4d9810
y.create.l HWIO_IPA_VMIDMT_SMR5_ADDR A:0xfd4d9814
y.create.l HWIO_IPA_VMIDMT_SMR6_ADDR A:0xfd4d9818
y.create.l HWIO_IPA_VMIDMT_SMR7_ADDR A:0xfd4d981c
y.create.l HWIO_IPA_VMIDMT_SMR8_ADDR A:0xfd4d9820
y.create.l HWIO_IPA_VMIDMT_SMR9_ADDR A:0xfd4d9824
y.create.l HWIO_IPA_IRQ_SRCS_EE_0_ADDR A:0xfd4e1000
y.create.l HWIO_IPA_IRQ_SRCS_EE_1_ADDR A:0xfd4e2000
y.create.l HWIO_IPA_IRQ_SRCS_EE_2_ADDR A:0xfd4e3000
y.create.l HWIO_IPA_IRQ_SRCS_EE_3_ADDR A:0xfd4e4000
y.create.l HWIO_IPA_IRQ_SRCS_MSK_EE_0_ADDR A:0xfd4e1004
y.create.l HWIO_IPA_IRQ_SRCS_MSK_EE_1_ADDR A:0xfd4e2004
y.create.l HWIO_IPA_IRQ_SRCS_MSK_EE_2_ADDR A:0xfd4e3004
y.create.l HWIO_IPA_IRQ_SRCS_MSK_EE_3_ADDR A:0xfd4e4004
y.create.l HWIO_IPA_IRQ_STTS_EE_0_ADDR A:0xfd4e1008
y.create.l HWIO_IPA_IRQ_STTS_EE_1_ADDR A:0xfd4e2008
y.create.l HWIO_IPA_IRQ_STTS_EE_2_ADDR A:0xfd4e3008
y.create.l HWIO_IPA_IRQ_STTS_EE_3_ADDR A:0xfd4e4008
y.create.l HWIO_IPA_IRQ_EN_EE_0_ADDR A:0xfd4e100c
y.create.l HWIO_IPA_IRQ_EN_EE_1_ADDR A:0xfd4e200c
y.create.l HWIO_IPA_IRQ_EN_EE_2_ADDR A:0xfd4e300c
y.create.l HWIO_IPA_IRQ_EN_EE_3_ADDR A:0xfd4e400c
y.create.l HWIO_IPA_IRQ_CLR_EE_0_ADDR A:0xfd4e1010
y.create.l HWIO_IPA_IRQ_CLR_EE_1_ADDR A:0xfd4e2010
y.create.l HWIO_IPA_IRQ_CLR_EE_2_ADDR A:0xfd4e3010
y.create.l HWIO_IPA_IRQ_CLR_EE_3_ADDR A:0xfd4e4010
y.create.l HWIO_IPA_IRQ_EOT_COAL_CFG_EE_0_ADDR A:0xfd4e1014
y.create.l HWIO_IPA_IRQ_EOT_COAL_CFG_EE_1_ADDR A:0xfd4e2014
y.create.l HWIO_IPA_IRQ_EOT_COAL_CFG_EE_2_ADDR A:0xfd4e3014
y.create.l HWIO_IPA_IRQ_EOT_COAL_CFG_EE_3_ADDR A:0xfd4e4014
y.create.l HWIO_IPA_SNOC_FEC_EE_0_ADDR A:0xfd4e1018
y.create.l HWIO_IPA_SNOC_FEC_EE_1_ADDR A:0xfd4e2018
y.create.l HWIO_IPA_SNOC_FEC_EE_2_ADDR A:0xfd4e3018
y.create.l HWIO_IPA_SNOC_FEC_EE_3_ADDR A:0xfd4e4018
y.create.l HWIO_IPA_SET_UC_IRQ_EE_0_ADDR A:0xfd4e4028
y.create.l HWIO_IPA_SET_UC_IRQ_EE_1_ADDR A:0xfd4e402c
y.create.l HWIO_IPA_SET_UC_IRQ_EE_2_ADDR A:0xfd4e4030
y.create.l HWIO_IPA_SET_UC_IRQ_EE_3_ADDR A:0xfd4e4034
y.create.l HWIO_IPA_SET_UC_IRQ_ALL_EES_ADDR A:0xfd4e4038
y.create.l HWIO_IPA_IRQ_EE_UC_0_ADDR A:0xfd4e101c
y.create.l HWIO_IPA_IRQ_EE_UC_1_ADDR A:0xfd4e201c
y.create.l HWIO_IPA_IRQ_EE_UC_2_ADDR A:0xfd4e301c
y.create.l HWIO_IPA_IRQ_EE_UC_3_ADDR A:0xfd4e401c
y.create.l HWIO_IPA_FEC_ADDR_EE_0_ADDR A:0xfd4e1020
y.create.l HWIO_IPA_FEC_ADDR_EE_1_ADDR A:0xfd4e2020
y.create.l HWIO_IPA_FEC_ADDR_EE_2_ADDR A:0xfd4e3020
y.create.l HWIO_IPA_FEC_ADDR_EE_3_ADDR A:0xfd4e4020
y.create.l HWIO_IPA_FEC_ATTR_EE_0_ADDR A:0xfd4e1024
y.create.l HWIO_IPA_FEC_ATTR_EE_1_ADDR A:0xfd4e2024
y.create.l HWIO_IPA_FEC_ATTR_EE_2_ADDR A:0xfd4e3024
y.create.l HWIO_IPA_FEC_ATTR_EE_3_ADDR A:0xfd4e4024
y.create.l HWIO_IPA_SUSPEND_IRQ_INFO_EE_0_ADDR A:0xfd4e1098
y.create.l HWIO_IPA_SUSPEND_IRQ_INFO_EE_1_ADDR A:0xfd4e2098
y.create.l HWIO_IPA_SUSPEND_IRQ_INFO_EE_2_ADDR A:0xfd4e3098
y.create.l HWIO_IPA_SUSPEND_IRQ_INFO_EE_3_ADDR A:0xfd4e4098
y.create.l HWIO_IPA_HOLB_DROP_IRQ_INFO_EE_0_ADDR A:0xfd4e109c
y.create.l HWIO_IPA_HOLB_DROP_IRQ_INFO_EE_1_ADDR A:0xfd4e209c
y.create.l HWIO_IPA_HOLB_DROP_IRQ_INFO_EE_2_ADDR A:0xfd4e309c
y.create.l HWIO_IPA_HOLB_DROP_IRQ_INFO_EE_3_ADDR A:0xfd4e409c
y.create.l HWIO_IPA_COMP_HW_VERSION_ADDR A:0xfd4e0030
y.create.l HWIO_IPA_VERSION_ADDR A:0xfd4e0034
y.create.l HWIO_IPA_COMP_CFG_ADDR A:0xfd4e0038
y.create.l HWIO_IPA_COMP_SW_RESET_ADDR A:0xfd4e003c
y.create.l HWIO_IPA_CLKON_CFG_ADDR A:0xfd4e0040
y.create.l HWIO_IPA_ROUTE_ADDR A:0xfd4e0044
y.create.l HWIO_IPA_FILTER_ADDR A:0xfd4e0048
y.create.l HWIO_IPA_MASTER_PRIORITY_ADDR A:0xfd4e004c
y.create.l HWIO_IPA_SHARED_MEM_SIZE_ADDR A:0xfd4e0050
y.create.l HWIO_IPA_NAT_TIMER_ADDR A:0xfd4e0054
y.create.l HWIO_IPA_NAT_TIMER_RESET_ADDR A:0xfd4e0058
y.create.l HWIO_IPA_TAG_TIMER_ADDR A:0xfd4e005c
y.create.l HWIO_IPA_QCNCM_ADDR A:0xfd4e0060
y.create.l HWIO_IPA_SINGLE_NDP_MODE_ADDR A:0xfd4e0064
y.create.l HWIO_IPA_FRAG_RULES_CLR_ADDR A:0xfd4e0068
y.create.l HWIO_IPA_PROC_IPH_CFG_ADDR A:0xfd4e006c
y.create.l HWIO_IPA_QSB_MAX_WRITES_ADDR A:0xfd4e0520
y.create.l HWIO_IPA_QSB_MAX_READS_ADDR A:0xfd4e0524
y.create.l HWIO_IPA_QSB_READ_CFG_ADDR A:0xfd4e0528
y.create.l HWIO_IPA_STATE_ADDR A:0xfd4e052c
y.create.l HWIO_IPA_STATE_RX_ACTIVE_ADDR A:0xfd4e0530
y.create.l HWIO_IPA_STATE_TX_ACTIVE_ADDR A:0xfd4e0534
y.create.l HWIO_IPA_STATE_AGGR_ACTIVE_ADDR A:0xfd4e0538
y.create.l HWIO_IPA_ENDP_INIT_CTRL_0_ADDR A:0xfd4e0070
y.create.l HWIO_IPA_ENDP_INIT_CTRL_1_ADDR A:0xfd4e0074
y.create.l HWIO_IPA_ENDP_INIT_CTRL_2_ADDR A:0xfd4e0078
y.create.l HWIO_IPA_ENDP_INIT_CTRL_3_ADDR A:0xfd4e007c
y.create.l HWIO_IPA_ENDP_INIT_CTRL_4_ADDR A:0xfd4e0080
y.create.l HWIO_IPA_ENDP_INIT_CTRL_5_ADDR A:0xfd4e0084
y.create.l HWIO_IPA_ENDP_INIT_CTRL_6_ADDR A:0xfd4e0088
y.create.l HWIO_IPA_ENDP_INIT_CTRL_7_ADDR A:0xfd4e008c
y.create.l HWIO_IPA_ENDP_INIT_CTRL_8_ADDR A:0xfd4e0090
y.create.l HWIO_IPA_ENDP_INIT_CTRL_9_ADDR A:0xfd4e0094
y.create.l HWIO_IPA_ENDP_INIT_CFG_0_ADDR A:0xfd4e00c0
y.create.l HWIO_IPA_ENDP_INIT_CFG_1_ADDR A:0xfd4e00c4
y.create.l HWIO_IPA_ENDP_INIT_CFG_2_ADDR A:0xfd4e00c8
y.create.l HWIO_IPA_ENDP_INIT_CFG_3_ADDR A:0xfd4e00cc
y.create.l HWIO_IPA_ENDP_INIT_CFG_4_ADDR A:0xfd4e00d0
y.create.l HWIO_IPA_ENDP_INIT_CFG_5_ADDR A:0xfd4e00d4
y.create.l HWIO_IPA_ENDP_INIT_CFG_6_ADDR A:0xfd4e00d8
y.create.l HWIO_IPA_ENDP_INIT_CFG_7_ADDR A:0xfd4e00dc
y.create.l HWIO_IPA_ENDP_INIT_CFG_8_ADDR A:0xfd4e00e0
y.create.l HWIO_IPA_ENDP_INIT_CFG_9_ADDR A:0xfd4e00e4
y.create.l HWIO_IPA_ENDP_INIT_NAT_0_ADDR A:0xfd4e0120
y.create.l HWIO_IPA_ENDP_INIT_NAT_1_ADDR A:0xfd4e0124
y.create.l HWIO_IPA_ENDP_INIT_NAT_2_ADDR A:0xfd4e0128
y.create.l HWIO_IPA_ENDP_INIT_NAT_3_ADDR A:0xfd4e012c
y.create.l HWIO_IPA_ENDP_INIT_NAT_4_ADDR A:0xfd4e0130
y.create.l HWIO_IPA_ENDP_INIT_NAT_5_ADDR A:0xfd4e0134
y.create.l HWIO_IPA_ENDP_INIT_NAT_6_ADDR A:0xfd4e0138
y.create.l HWIO_IPA_ENDP_INIT_NAT_7_ADDR A:0xfd4e013c
y.create.l HWIO_IPA_ENDP_INIT_NAT_8_ADDR A:0xfd4e0140
y.create.l HWIO_IPA_ENDP_INIT_NAT_9_ADDR A:0xfd4e0144
y.create.l HWIO_IPA_ENDP_INIT_HDR_0_ADDR A:0xfd4e0170
y.create.l HWIO_IPA_ENDP_INIT_HDR_1_ADDR A:0xfd4e0174
y.create.l HWIO_IPA_ENDP_INIT_HDR_2_ADDR A:0xfd4e0178
y.create.l HWIO_IPA_ENDP_INIT_HDR_3_ADDR A:0xfd4e017c
y.create.l HWIO_IPA_ENDP_INIT_HDR_4_ADDR A:0xfd4e0180
y.create.l HWIO_IPA_ENDP_INIT_HDR_5_ADDR A:0xfd4e0184
y.create.l HWIO_IPA_ENDP_INIT_HDR_6_ADDR A:0xfd4e0188
y.create.l HWIO_IPA_ENDP_INIT_HDR_7_ADDR A:0xfd4e018c
y.create.l HWIO_IPA_ENDP_INIT_HDR_8_ADDR A:0xfd4e0190
y.create.l HWIO_IPA_ENDP_INIT_HDR_9_ADDR A:0xfd4e0194
y.create.l HWIO_IPA_ENDP_INIT_HDR_EXT_0_ADDR A:0xfd4e01c0
y.create.l HWIO_IPA_ENDP_INIT_HDR_EXT_1_ADDR A:0xfd4e01c4
y.create.l HWIO_IPA_ENDP_INIT_HDR_EXT_2_ADDR A:0xfd4e01c8
y.create.l HWIO_IPA_ENDP_INIT_HDR_EXT_3_ADDR A:0xfd4e01cc
y.create.l HWIO_IPA_ENDP_INIT_HDR_EXT_4_ADDR A:0xfd4e01d0
y.create.l HWIO_IPA_ENDP_INIT_HDR_EXT_5_ADDR A:0xfd4e01d4
y.create.l HWIO_IPA_ENDP_INIT_HDR_EXT_6_ADDR A:0xfd4e01d8
y.create.l HWIO_IPA_ENDP_INIT_HDR_EXT_7_ADDR A:0xfd4e01dc
y.create.l HWIO_IPA_ENDP_INIT_HDR_EXT_8_ADDR A:0xfd4e01e0
y.create.l HWIO_IPA_ENDP_INIT_HDR_EXT_9_ADDR A:0xfd4e01e4
y.create.l HWIO_IPA_ENDP_INIT_HDR_METADATA_MASK_0_ADDR A:0xfd4e0220
y.create.l HWIO_IPA_ENDP_INIT_HDR_METADATA_MASK_1_ADDR A:0xfd4e0224
y.create.l HWIO_IPA_ENDP_INIT_HDR_METADATA_MASK_2_ADDR A:0xfd4e0228
y.create.l HWIO_IPA_ENDP_INIT_HDR_METADATA_MASK_3_ADDR A:0xfd4e022c
y.create.l HWIO_IPA_ENDP_INIT_HDR_METADATA_MASK_4_ADDR A:0xfd4e0230
y.create.l HWIO_IPA_ENDP_INIT_HDR_METADATA_MASK_5_ADDR A:0xfd4e0234
y.create.l HWIO_IPA_ENDP_INIT_HDR_METADATA_MASK_6_ADDR A:0xfd4e0238
y.create.l HWIO_IPA_ENDP_INIT_HDR_METADATA_MASK_7_ADDR A:0xfd4e023c
y.create.l HWIO_IPA_ENDP_INIT_HDR_METADATA_MASK_8_ADDR A:0xfd4e0240
y.create.l HWIO_IPA_ENDP_INIT_HDR_METADATA_MASK_9_ADDR A:0xfd4e0244
y.create.l HWIO_IPA_ENDP_INIT_HDR_METADATA_0_ADDR A:0xfd4e0270
y.create.l HWIO_IPA_ENDP_INIT_HDR_METADATA_1_ADDR A:0xfd4e0274
y.create.l HWIO_IPA_ENDP_INIT_HDR_METADATA_2_ADDR A:0xfd4e0278
y.create.l HWIO_IPA_ENDP_INIT_HDR_METADATA_3_ADDR A:0xfd4e027c
y.create.l HWIO_IPA_ENDP_INIT_HDR_METADATA_4_ADDR A:0xfd4e0280
y.create.l HWIO_IPA_ENDP_INIT_HDR_METADATA_5_ADDR A:0xfd4e0284
y.create.l HWIO_IPA_ENDP_INIT_HDR_METADATA_6_ADDR A:0xfd4e0288
y.create.l HWIO_IPA_ENDP_INIT_HDR_METADATA_7_ADDR A:0xfd4e028c
y.create.l HWIO_IPA_ENDP_INIT_HDR_METADATA_8_ADDR A:0xfd4e0290
y.create.l HWIO_IPA_ENDP_INIT_HDR_METADATA_9_ADDR A:0xfd4e0294
y.create.l HWIO_IPA_ENDP_INIT_MODE_0_ADDR A:0xfd4e02c0
y.create.l HWIO_IPA_ENDP_INIT_MODE_1_ADDR A:0xfd4e02c4
y.create.l HWIO_IPA_ENDP_INIT_MODE_2_ADDR A:0xfd4e02c8
y.create.l HWIO_IPA_ENDP_INIT_MODE_3_ADDR A:0xfd4e02cc
y.create.l HWIO_IPA_ENDP_INIT_MODE_4_ADDR A:0xfd4e02d0
y.create.l HWIO_IPA_ENDP_INIT_MODE_5_ADDR A:0xfd4e02d4
y.create.l HWIO_IPA_ENDP_INIT_MODE_6_ADDR A:0xfd4e02d8
y.create.l HWIO_IPA_ENDP_INIT_MODE_7_ADDR A:0xfd4e02dc
y.create.l HWIO_IPA_ENDP_INIT_MODE_8_ADDR A:0xfd4e02e0
y.create.l HWIO_IPA_ENDP_INIT_MODE_9_ADDR A:0xfd4e02e4
y.create.l HWIO_IPA_ENDP_INIT_AGGR_0_ADDR A:0xfd4e0320
y.create.l HWIO_IPA_ENDP_INIT_AGGR_1_ADDR A:0xfd4e0324
y.create.l HWIO_IPA_ENDP_INIT_AGGR_2_ADDR A:0xfd4e0328
y.create.l HWIO_IPA_ENDP_INIT_AGGR_3_ADDR A:0xfd4e032c
y.create.l HWIO_IPA_ENDP_INIT_AGGR_4_ADDR A:0xfd4e0330
y.create.l HWIO_IPA_ENDP_INIT_AGGR_5_ADDR A:0xfd4e0334
y.create.l HWIO_IPA_ENDP_INIT_AGGR_6_ADDR A:0xfd4e0338
y.create.l HWIO_IPA_ENDP_INIT_AGGR_7_ADDR A:0xfd4e033c
y.create.l HWIO_IPA_ENDP_INIT_AGGR_8_ADDR A:0xfd4e0340
y.create.l HWIO_IPA_ENDP_INIT_AGGR_9_ADDR A:0xfd4e0344
y.create.l HWIO_IPA_ENDP_INIT_ROUTE_0_ADDR A:0xfd4e0370
y.create.l HWIO_IPA_ENDP_INIT_ROUTE_1_ADDR A:0xfd4e0374
y.create.l HWIO_IPA_ENDP_INIT_ROUTE_2_ADDR A:0xfd4e0378
y.create.l HWIO_IPA_ENDP_INIT_ROUTE_3_ADDR A:0xfd4e037c
y.create.l HWIO_IPA_ENDP_INIT_ROUTE_4_ADDR A:0xfd4e0380
y.create.l HWIO_IPA_ENDP_INIT_ROUTE_5_ADDR A:0xfd4e0384
y.create.l HWIO_IPA_ENDP_INIT_ROUTE_6_ADDR A:0xfd4e0388
y.create.l HWIO_IPA_ENDP_INIT_ROUTE_7_ADDR A:0xfd4e038c
y.create.l HWIO_IPA_ENDP_INIT_ROUTE_8_ADDR A:0xfd4e0390
y.create.l HWIO_IPA_ENDP_INIT_ROUTE_9_ADDR A:0xfd4e0394
y.create.l HWIO_IPA_ENDP_INIT_HOL_BLOCK_EN_0_ADDR A:0xfd4e03c0
y.create.l HWIO_IPA_ENDP_INIT_HOL_BLOCK_EN_1_ADDR A:0xfd4e03c4
y.create.l HWIO_IPA_ENDP_INIT_HOL_BLOCK_EN_2_ADDR A:0xfd4e03c8
y.create.l HWIO_IPA_ENDP_INIT_HOL_BLOCK_EN_3_ADDR A:0xfd4e03cc
y.create.l HWIO_IPA_ENDP_INIT_HOL_BLOCK_EN_4_ADDR A:0xfd4e03d0
y.create.l HWIO_IPA_ENDP_INIT_HOL_BLOCK_EN_5_ADDR A:0xfd4e03d4
y.create.l HWIO_IPA_ENDP_INIT_HOL_BLOCK_EN_6_ADDR A:0xfd4e03d8
y.create.l HWIO_IPA_ENDP_INIT_HOL_BLOCK_EN_7_ADDR A:0xfd4e03dc
y.create.l HWIO_IPA_ENDP_INIT_HOL_BLOCK_EN_8_ADDR A:0xfd4e03e0
y.create.l HWIO_IPA_ENDP_INIT_HOL_BLOCK_EN_9_ADDR A:0xfd4e03e4
y.create.l HWIO_IPA_ENDP_INIT_HOL_BLOCK_TIMER_0_ADDR A:0xfd4e0420
y.create.l HWIO_IPA_ENDP_INIT_HOL_BLOCK_TIMER_1_ADDR A:0xfd4e0424
y.create.l HWIO_IPA_ENDP_INIT_HOL_BLOCK_TIMER_2_ADDR A:0xfd4e0428
y.create.l HWIO_IPA_ENDP_INIT_HOL_BLOCK_TIMER_3_ADDR A:0xfd4e042c
y.create.l HWIO_IPA_ENDP_INIT_HOL_BLOCK_TIMER_4_ADDR A:0xfd4e0430
y.create.l HWIO_IPA_ENDP_INIT_HOL_BLOCK_TIMER_5_ADDR A:0xfd4e0434
y.create.l HWIO_IPA_ENDP_INIT_HOL_BLOCK_TIMER_6_ADDR A:0xfd4e0438
y.create.l HWIO_IPA_ENDP_INIT_HOL_BLOCK_TIMER_7_ADDR A:0xfd4e043c
y.create.l HWIO_IPA_ENDP_INIT_HOL_BLOCK_TIMER_8_ADDR A:0xfd4e0440
y.create.l HWIO_IPA_ENDP_INIT_HOL_BLOCK_TIMER_9_ADDR A:0xfd4e0444
y.create.l HWIO_IPA_ENDP_INIT_DEAGGR_0_ADDR A:0xfd4e0470
y.create.l HWIO_IPA_ENDP_INIT_DEAGGR_1_ADDR A:0xfd4e0474
y.create.l HWIO_IPA_ENDP_INIT_DEAGGR_2_ADDR A:0xfd4e0478
y.create.l HWIO_IPA_ENDP_INIT_DEAGGR_3_ADDR A:0xfd4e047c
y.create.l HWIO_IPA_ENDP_INIT_DEAGGR_4_ADDR A:0xfd4e0480
y.create.l HWIO_IPA_ENDP_INIT_DEAGGR_5_ADDR A:0xfd4e0484
y.create.l HWIO_IPA_ENDP_INIT_DEAGGR_6_ADDR A:0xfd4e0488
y.create.l HWIO_IPA_ENDP_INIT_DEAGGR_7_ADDR A:0xfd4e048c
y.create.l HWIO_IPA_ENDP_INIT_DEAGGR_8_ADDR A:0xfd4e0490
y.create.l HWIO_IPA_ENDP_INIT_DEAGGR_9_ADDR A:0xfd4e0494
y.create.l HWIO_IPA_ENDP_STATUS_0_ADDR A:0xfd4e04c0
y.create.l HWIO_IPA_ENDP_STATUS_1_ADDR A:0xfd4e04c4
y.create.l HWIO_IPA_ENDP_STATUS_2_ADDR A:0xfd4e04c8
y.create.l HWIO_IPA_ENDP_STATUS_3_ADDR A:0xfd4e04cc
y.create.l HWIO_IPA_ENDP_STATUS_4_ADDR A:0xfd4e04d0
y.create.l HWIO_IPA_ENDP_STATUS_5_ADDR A:0xfd4e04d4
y.create.l HWIO_IPA_ENDP_STATUS_6_ADDR A:0xfd4e04d8
y.create.l HWIO_IPA_ENDP_STATUS_7_ADDR A:0xfd4e04dc
y.create.l HWIO_IPA_ENDP_STATUS_8_ADDR A:0xfd4e04e0
y.create.l HWIO_IPA_ENDP_STATUS_9_ADDR A:0xfd4e04e4
y.create.l HWIO_IPA_DEBUG_CNT_REG_0_ADDR A:0xfd4e0600
y.create.l HWIO_IPA_DEBUG_CNT_REG_1_ADDR A:0xfd4e0604
y.create.l HWIO_IPA_DEBUG_CNT_REG_2_ADDR A:0xfd4e0608
y.create.l HWIO_IPA_DEBUG_CNT_REG_3_ADDR A:0xfd4e060c
y.create.l HWIO_IPA_DEBUG_CNT_REG_4_ADDR A:0xfd4e0610
y.create.l HWIO_IPA_DEBUG_CNT_REG_5_ADDR A:0xfd4e0614
y.create.l HWIO_IPA_DEBUG_CNT_REG_6_ADDR A:0xfd4e0618
y.create.l HWIO_IPA_DEBUG_CNT_REG_7_ADDR A:0xfd4e061c
y.create.l HWIO_IPA_DEBUG_CNT_REG_8_ADDR A:0xfd4e0620
y.create.l HWIO_IPA_DEBUG_CNT_REG_9_ADDR A:0xfd4e0624
y.create.l HWIO_IPA_DEBUG_CNT_CTRL_0_ADDR A:0xfd4e0640
y.create.l HWIO_IPA_DEBUG_CNT_CTRL_1_ADDR A:0xfd4e0644
y.create.l HWIO_IPA_DEBUG_CNT_CTRL_2_ADDR A:0xfd4e0648
y.create.l HWIO_IPA_DEBUG_CNT_CTRL_3_ADDR A:0xfd4e064c
y.create.l HWIO_IPA_DEBUG_CNT_CTRL_4_ADDR A:0xfd4e0650
y.create.l HWIO_IPA_DEBUG_CNT_CTRL_5_ADDR A:0xfd4e0654
y.create.l HWIO_IPA_DEBUG_CNT_CTRL_6_ADDR A:0xfd4e0658
y.create.l HWIO_IPA_DEBUG_CNT_CTRL_7_ADDR A:0xfd4e065c
y.create.l HWIO_IPA_DEBUG_CNT_CTRL_8_ADDR A:0xfd4e0660
y.create.l HWIO_IPA_DEBUG_CNT_CTRL_9_ADDR A:0xfd4e0664
y.create.l HWIO_IPA_DEBUG_DATA_SEL_ADDR A:0xfd4e3028
y.create.l HWIO_IPA_DEBUG_DATA_ADDR A:0xfd4e302c
y.create.l HWIO_IPA_TESTBUS_SEL_ADDR A:0xfd4e3030
y.create.l HWIO_IPA_RX_PROC_CMDQ_CMD_ADDR A:0xfd4e3034
y.create.l HWIO_IPA_RX_PROC_CMDQ_CFG_ADDR A:0xfd4e3038
y.create.l HWIO_IPA_RX_PROC_CMDQ_DATA_WR_0_ADDR A:0xfd4e303c
y.create.l HWIO_IPA_RX_PROC_CMDQ_DATA_WR_1_ADDR A:0xfd4e3040
y.create.l HWIO_IPA_RX_PROC_CMDQ_DATA_WR_2_ADDR A:0xfd4e3044
y.create.l HWIO_IPA_RX_PROC_CMDQ_DATA_RD_0_ADDR A:0xfd4e3048
y.create.l HWIO_IPA_RX_PROC_CMDQ_DATA_RD_1_ADDR A:0xfd4e304c
y.create.l HWIO_IPA_RX_PROC_CMDQ_DATA_RD_2_ADDR A:0xfd4e3050
y.create.l HWIO_IPA_RX_PROC_CMDQ_STATUS_ADDR A:0xfd4e3054
y.create.l HWIO_IPA_PROC_TX_CMDQ_CMD_ADDR A:0xfd4e3058
y.create.l HWIO_IPA_PROC_TX_CMDQ_CFG_ADDR A:0xfd4e305c
y.create.l HWIO_IPA_PROC_TX_CMDQ_DATA_WR_0_ADDR A:0xfd4e3060
y.create.l HWIO_IPA_PROC_TX_CMDQ_DATA_WR_1_ADDR A:0xfd4e3064
y.create.l HWIO_IPA_PROC_TX_CMDQ_DATA_RD_0_ADDR A:0xfd4e3068
y.create.l HWIO_IPA_PROC_TX_CMDQ_DATA_RD_1_ADDR A:0xfd4e306c
y.create.l HWIO_IPA_PROC_TX_CMDQ_STATUS_ADDR A:0xfd4e3070
y.create.l HWIO_IPA_PROC_RX_ACKQ_CMD_ADDR A:0xfd4e3100
y.create.l HWIO_IPA_PROC_RX_ACKQ_CFG_ADDR A:0xfd4e3104
y.create.l HWIO_IPA_PROC_RX_ACKQ_DATA_WR_0_ADDR A:0xfd4e3108
y.create.l HWIO_IPA_PROC_RX_ACKQ_DATA_RD_0_ADDR A:0xfd4e310c
y.create.l HWIO_IPA_PROC_RX_ACKQ_STATUS_ADDR A:0xfd4e3110
y.create.l HWIO_IPA_TX_PROC_ACKQ_CMD_ADDR A:0xfd4e3114
y.create.l HWIO_IPA_TX_PROC_ACKQ_CFG_ADDR A:0xfd4e3118
y.create.l HWIO_IPA_TX_PROC_ACKQ_DATA_WR_0_ADDR A:0xfd4e311c
y.create.l HWIO_IPA_TX_PROC_ACKQ_DATA_RD_0_ADDR A:0xfd4e3120
y.create.l HWIO_IPA_TX_PROC_ACKQ_STATUS_ADDR A:0xfd4e3124
y.create.l HWIO_IPA_UC_PROC_RX_CMDQ_CMD_ADDR A:0xfd4e3128
y.create.l HWIO_IPA_UC_PROC_RX_CMDQ_CFG_ADDR A:0xfd4e312c
y.create.l HWIO_IPA_UC_PROC_RX_CMDQ_DATA_WR_0_ADDR A:0xfd4e3130
y.create.l HWIO_IPA_UC_PROC_RX_CMDQ_DATA_WR_1_ADDR A:0xfd4e3134
y.create.l HWIO_IPA_UC_PROC_RX_CMDQ_DATA_WR_2_ADDR A:0xfd4e3138
y.create.l HWIO_IPA_UC_PROC_RX_CMDQ_DATA_RD_0_ADDR A:0xfd4e313c
y.create.l HWIO_IPA_UC_PROC_RX_CMDQ_DATA_RD_1_ADDR A:0xfd4e3140
y.create.l HWIO_IPA_UC_PROC_RX_CMDQ_DATA_RD_2_ADDR A:0xfd4e3144
y.create.l HWIO_IPA_UC_PROC_RX_CMDQ_STATUS_ADDR A:0xfd4e3148
y.create.l HWIO_IPA_UC_PROC_TX_CMDQ_CMD_ADDR A:0xfd4e314c
y.create.l HWIO_IPA_UC_PROC_TX_CMDQ_CFG_ADDR A:0xfd4e3150
y.create.l HWIO_IPA_UC_PROC_TX_CMDQ_DATA_WR_0_ADDR A:0xfd4e3154
y.create.l HWIO_IPA_UC_PROC_TX_CMDQ_DATA_WR_1_ADDR A:0xfd4e3158
y.create.l HWIO_IPA_UC_PROC_TX_CMDQ_DATA_RD_0_ADDR A:0xfd4e315c
y.create.l HWIO_IPA_UC_PROC_TX_CMDQ_DATA_RD_1_ADDR A:0xfd4e3160
y.create.l HWIO_IPA_UC_PROC_TX_CMDQ_STATUS_ADDR A:0xfd4e3164
y.create.l HWIO_IPA_PROC_UC_CMDQ_CMD_ADDR A:0xfd4e3168
y.create.l HWIO_IPA_PROC_UC_CMDQ_CFG_ADDR A:0xfd4e316c
y.create.l HWIO_IPA_PROC_UC_CMDQ_DATA_WR_0_ADDR A:0xfd4e3170
y.create.l HWIO_IPA_PROC_UC_CMDQ_DATA_WR_1_ADDR A:0xfd4e3174
y.create.l HWIO_IPA_PROC_UC_CMDQ_DATA_RD_0_ADDR A:0xfd4e3178
y.create.l HWIO_IPA_PROC_UC_CMDQ_DATA_RD_1_ADDR A:0xfd4e317c
y.create.l HWIO_IPA_PROC_UC_CMDQ_STATUS_ADDR A:0xfd4e3180
y.create.l HWIO_IPA_UC_PROC_ACKQ_CMD_ADDR A:0xfd4e3184
y.create.l HWIO_IPA_UC_PROC_ACKQ_CFG_ADDR A:0xfd4e3188
y.create.l HWIO_IPA_UC_PROC_ACKQ_DATA_WR_0_ADDR A:0xfd4e318c
y.create.l HWIO_IPA_UC_PROC_ACKQ_DATA_RD_0_ADDR A:0xfd4e3190
y.create.l HWIO_IPA_UC_PROC_ACKQ_STATUS_ADDR A:0xfd4e3194
y.create.l HWIO_IPA_PROC_UC_ACKQ_CMD_ADDR A:0xfd4e3198
y.create.l HWIO_IPA_PROC_UC_ACKQ_CFG_ADDR A:0xfd4e319c
y.create.l HWIO_IPA_PROC_UC_ACKQ_DATA_WR_0_ADDR A:0xfd4e31a0
y.create.l HWIO_IPA_PROC_UC_ACKQ_DATA_RD_0_ADDR A:0xfd4e31a4
y.create.l HWIO_IPA_PROC_UC_ACKQ_STATUS_ADDR A:0xfd4e31a8
y.create.l HWIO_IPA_STEP_MODE_BREAKPOINTS_ADDR A:0xfd4e3074
y.create.l HWIO_IPA_STEP_MODE_STATUS_ADDR A:0xfd4e3078
y.create.l HWIO_IPA_STEP_MODE_GO_ADDR A:0xfd4e307c
y.create.l HWIO_IPA_HW_EVENTS_CFG_ADDR A:0xfd4e3084
y.create.l HWIO_IPA_REPLICATE_ADDR A:0xfd4e3088
y.create.l HWIO_IPA_LOG_BUF_STATUS_ADDR_ADDR A:0xfd4e20a0
y.create.l HWIO_IPA_LOG_BUF_STATUS_WRITE_PTR_ADDR A:0xfd4e20a4
y.create.l HWIO_IPA_LOG_BUF_STATUS_CFG_ADDR A:0xfd4e20a8
y.create.l HWIO_IPA_LOG_BUF_STATUS_RAM_PTR_ADDR A:0xfd4e20ac
y.create.l HWIO_IPA_LOG_BUF_HW_CMD_ADDR_ADDR A:0xfd4e30ac
y.create.l HWIO_IPA_LOG_BUF_HW_CMD_WRITE_PTR_ADDR A:0xfd4e30b0
y.create.l HWIO_IPA_LOG_BUF_HW_CMD_CFG_ADDR A:0xfd4e30b4
y.create.l HWIO_IPA_LOG_BUF_HW_CMD_RAM_PTR_ADDR A:0xfd4e30b8
y.create.l HWIO_IPA_SPARE_REG_1_ADDR A:0xfd4e3090
y.create.l HWIO_IPA_SPARE_REG_2_ADDR A:0xfd4e3094
y.create.l HWIO_IPA_SRAM_DIRECT_ACCESS_0_ADDR A:0xfd4e5000
y.create.l HWIO_IPA_SRAM_DIRECT_ACCESS_1_ADDR A:0xfd4e5004
y.create.l HWIO_IPA_SRAM_DIRECT_ACCESS_2_ADDR A:0xfd4e5008
y.create.l HWIO_IPA_SRAM_DIRECT_ACCESS_3_ADDR A:0xfd4e500c
y.create.l HWIO_IPA_SRAM_DIRECT_ACCESS_4_ADDR A:0xfd4e5010
y.create.l HWIO_IPA_SRAM_DIRECT_ACCESS_5_ADDR A:0xfd4e5014
y.create.l HWIO_IPA_SRAM_DIRECT_ACCESS_6_ADDR A:0xfd4e5018
y.create.l HWIO_IPA_SRAM_DIRECT_ACCESS_7_ADDR A:0xfd4e501c
y.create.l HWIO_IPA_SRAM_DIRECT_ACCESS_8_ADDR A:0xfd4e5020
y.create.l HWIO_IPA_SRAM_DIRECT_ACCESS_9_ADDR A:0xfd4e5024
y.create.l HWIO_IPA_UC_IRAM_START_ADDR A:0xfd4f0000
y.create.l HWIO_IPA_UC_DRAM_START_ADDR A:0xfd4f4000
y.create.l HWIO_IPA_UC_STATUS_ADDR A:0xfd4f8000
y.create.l HWIO_IPA_UC_CONTROL_ADDR A:0xfd4f8004
y.create.l HWIO_IPA_UC_BASE_ADDR_ADDR A:0xfd4f8008
y.create.l HWIO_IPA_UC_SYS_BUS_ATTRIB_ADDR A:0xfd4f800c
y.create.l HWIO_IPA_UC_QMB_SYS_ADDR_ADDR A:0xfd4f8100
y.create.l HWIO_IPA_UC_QMB_LOCAL_ADDR_ADDR A:0xfd4f8104
y.create.l HWIO_IPA_UC_QMB_LENGTH_ADDR A:0xfd4f8108
y.create.l HWIO_IPA_UC_QMB_TRIGGER_ADDR A:0xfd4f810c
y.create.l HWIO_IPA_UC_QMB_PENDING_TID_ADDR A:0xfd4f8110
y.create.l HWIO_IPA_UC_QMB_COMPLETED_RD_FIFO_ADDR A:0xfd4f8114
y.create.l HWIO_IPA_UC_QMB_COMPLETED_RD_FIFO_PEEK_ADDR A:0xfd4f8118
y.create.l HWIO_IPA_UC_QMB_COMPLETED_WR_FIFO_ADDR A:0xfd4f811c
y.create.l HWIO_IPA_UC_QMB_COMPLETED_WR_FIFO_PEEK_ADDR A:0xfd4f8120
y.create.l HWIO_IPA_UC_QMB_MISC_ADDR A:0xfd4f8124
y.create.l HWIO_IPA_UC_QMB_STATUS_ADDR A:0xfd4f8128
y.create.l HWIO_IPA_UC_QMB_BUS_ATTRIB_ADDR A:0xfd4f812c
y.create.l HWIO_IPA_UC_MBOX_INT_STTS_0_ADDR A:0xfd4f8200
y.create.l HWIO_IPA_UC_MBOX_INT_STTS_1_ADDR A:0xfd4f8210
y.create.l HWIO_IPA_UC_MBOX_INT_STTS_2_ADDR A:0xfd4f8220
y.create.l HWIO_IPA_UC_MBOX_INT_STTS_3_ADDR A:0xfd4f8230
y.create.l HWIO_IPA_UC_MBOX_INT_EN_0_ADDR A:0xfd4f8204
y.create.l HWIO_IPA_UC_MBOX_INT_EN_1_ADDR A:0xfd4f8214
y.create.l HWIO_IPA_UC_MBOX_INT_EN_2_ADDR A:0xfd4f8224
y.create.l HWIO_IPA_UC_MBOX_INT_EN_3_ADDR A:0xfd4f8234
y.create.l HWIO_IPA_UC_MBOX_INT_CLR_0_ADDR A:0xfd4f8208
y.create.l HWIO_IPA_UC_MBOX_INT_CLR_1_ADDR A:0xfd4f8218
y.create.l HWIO_IPA_UC_MBOX_INT_CLR_2_ADDR A:0xfd4f8228
y.create.l HWIO_IPA_UC_MBOX_INT_CLR_3_ADDR A:0xfd4f8238
y.create.l HWIO_IPA_UC_IPA_INT_STTS_0_ADDR A:0xfd4f8300
y.create.l HWIO_IPA_UC_IPA_INT_STTS_1_ADDR A:0xfd4f8310
y.create.l HWIO_IPA_UC_IPA_INT_STTS_2_ADDR A:0xfd4f8320
y.create.l HWIO_IPA_UC_IPA_INT_STTS_3_ADDR A:0xfd4f8330
y.create.l HWIO_IPA_UC_IPA_INT_EN_0_ADDR A:0xfd4f8304
y.create.l HWIO_IPA_UC_IPA_INT_EN_1_ADDR A:0xfd4f8314
y.create.l HWIO_IPA_UC_IPA_INT_EN_2_ADDR A:0xfd4f8324
y.create.l HWIO_IPA_UC_IPA_INT_EN_3_ADDR A:0xfd4f8334
y.create.l HWIO_IPA_UC_IPA_INT_CLR_0_ADDR A:0xfd4f8308
y.create.l HWIO_IPA_UC_IPA_INT_CLR_1_ADDR A:0xfd4f8318
y.create.l HWIO_IPA_UC_IPA_INT_CLR_2_ADDR A:0xfd4f8328
y.create.l HWIO_IPA_UC_IPA_INT_CLR_3_ADDR A:0xfd4f8338
y.create.l HWIO_IPA_UC_HWEV_INT_STTS_ADDR A:0xfd4f8400
y.create.l HWIO_IPA_UC_HWEV_INT_EN_ADDR A:0xfd4f8404
y.create.l HWIO_IPA_UC_HWEV_INT_CLR_ADDR A:0xfd4f8408
y.create.l HWIO_IPA_UC_SWEV_INT_STTS_ADDR A:0xfd4f8410
y.create.l HWIO_IPA_UC_SWEV_INT_EN_ADDR A:0xfd4f8414
y.create.l HWIO_IPA_UC_SWEV_INT_CLR_ADDR A:0xfd4f8418
y.create.l HWIO_IPA_UC_TIMER_CTRL_0_ADDR A:0xfd4f8500
y.create.l HWIO_IPA_UC_TIMER_CTRL_1_ADDR A:0xfd4f8510
y.create.l HWIO_IPA_UC_TIMER_CTRL_2_ADDR A:0xfd4f8520
y.create.l HWIO_IPA_UC_TIMER_CTRL_3_ADDR A:0xfd4f8530
y.create.l HWIO_IPA_UC_TIMER_CTRL_R_0_ADDR A:0xfd4f8504
y.create.l HWIO_IPA_UC_TIMER_CTRL_R_1_ADDR A:0xfd4f8514
y.create.l HWIO_IPA_UC_TIMER_CTRL_R_2_ADDR A:0xfd4f8524
y.create.l HWIO_IPA_UC_TIMER_CTRL_R_3_ADDR A:0xfd4f8534
y.create.l HWIO_IPA_UC_TIMER_STATUS_0_ADDR A:0xfd4f8508
y.create.l HWIO_IPA_UC_TIMER_STATUS_1_ADDR A:0xfd4f8518
y.create.l HWIO_IPA_UC_TIMER_STATUS_2_ADDR A:0xfd4f8528
y.create.l HWIO_IPA_UC_TIMER_STATUS_3_ADDR A:0xfd4f8538
y.create.l HWIO_IPA_UC_EVENTS_ADDR A:0xfd4f8600
y.create.l HWIO_IPA_UC_SPARE_ADDR A:0xfd4f9ffc
y.create.l HWIO_IPA_UC_MAILBOX_0_0_ADDR A:0xfd4fa000
y.create.l HWIO_IPA_UC_MAILBOX_0_1_ADDR A:0xfd4fa004
y.create.l HWIO_IPA_UC_MAILBOX_0_2_ADDR A:0xfd4fa008
y.create.l HWIO_IPA_UC_MAILBOX_0_3_ADDR A:0xfd4fa00c
y.create.l HWIO_IPA_UC_MAILBOX_1_0_ADDR A:0xfd4fa080
y.create.l HWIO_IPA_UC_MAILBOX_1_1_ADDR A:0xfd4fa084
y.create.l HWIO_IPA_UC_MAILBOX_1_2_ADDR A:0xfd4fa088
y.create.l HWIO_IPA_UC_MAILBOX_1_3_ADDR A:0xfd4fa08c
y.create.l HWIO_LPASS_LPAAUDIO_PLL_MODE_ADDR A:0xfe000000
y.create.l HWIO_LPASS_LPAAUDIO_PLL_L_VAL_ADDR A:0xfe000004
y.create.l HWIO_LPASS_LPAAUDIO_PLL_ALPHA_VAL_ADDR A:0xfe000008
y.create.l HWIO_LPASS_LPAAUDIO_PLL_ALPHA_VAL_U_ADDR A:0xfe00000c
y.create.l HWIO_LPASS_LPAAUDIO_PLL_USER_CTL_ADDR A:0xfe000010
y.create.l HWIO_LPASS_LPAAUDIO_PLL_USER_CTL_U_ADDR A:0xfe000014
y.create.l HWIO_LPASS_LPAAUDIO_PLL_CONFIG_CTL_ADDR A:0xfe000018
y.create.l HWIO_LPASS_LPAAUDIO_PLL_TEST_CTL_ADDR A:0xfe00001c
y.create.l HWIO_LPASS_LPAAUDIO_PLL_TEST_CTL_U_ADDR A:0xfe000020
y.create.l HWIO_LPASS_LPAAUDIO_PLL_STATUS_ADDR A:0xfe000024
y.create.l HWIO_LPASS_LPAAUDIO_PLL_FREQ_CTL_ADDR A:0xfe000028
y.create.l HWIO_LPASS_LPAAUDIO_PLL_CLK_SRC_SEL_ADDR A:0xfe00002c
y.create.l HWIO_LPASS_LPAAUDIO_PLL_CLK_DIV_ADDR A:0xfe000030
y.create.l HWIO_LPASS_LPAAUDIO_PRIUS_PLL_L_VAL_ADDR A:0xfe001004
y.create.l HWIO_LPASS_LPAAUDIO_PRIUS_PLL_ALPHA_VAL_ADDR A:0xfe001008
y.create.l HWIO_LPASS_LPAAUDIO_PRIUS_PLL_ALPHA_VAL_U_ADDR A:0xfe00100c
y.create.l HWIO_LPASS_LPAAUDIO_PRIUS_PLL_USER_CTL_ADDR A:0xfe001010
y.create.l HWIO_LPASS_LPAAUDIO_PRIUS_PLL_USER_CTL_U_ADDR A:0xfe001014
y.create.l HWIO_LPASS_LPAAUDIO_PRIUS_PLL_CONFIG_CTL_ADDR A:0xfe001018
y.create.l HWIO_LPASS_LPAAUDIO_PRIUS_PLL_TEST_CTL_ADDR A:0xfe00101c
y.create.l HWIO_LPASS_LPAAUDIO_PRIUS_PLL_TEST_CTL_U_ADDR A:0xfe001020
y.create.l HWIO_LPASS_LPAAUDIO_PRIUS_PLL_MODE_ADDR A:0xfe001000
y.create.l HWIO_LPASS_LPAAUDIO_PRIUS_PLL_STATUS_ADDR A:0xfe001024
y.create.l HWIO_LPASS_LPAAUDIO_PRIUS_PLL_FREQ_CTL_ADDR A:0xfe001028
y.create.l HWIO_LPASS_LPAAUDIO_PRIUS_PLL_CLK_SRC_SEL_ADDR A:0xfe00102c
y.create.l HWIO_LPASS_LPAAUDIO_PRIUS_PLL_CLK_DIV_ADDR A:0xfe001030
y.create.l HWIO_LPASS_LPA_PLL_VOTE_APPS_ADDR A:0xfe002000
y.create.l HWIO_LPASS_LPA_PLL_VOTE_LPASSQ6_ADDR A:0xfe003000
y.create.l HWIO_LPASS_AUDIO_CORE_BCR_ADDR A:0xfe004000
y.create.l HWIO_LPASS_AUDIO_CORE_BCR_SLP_CBCR_ADDR A:0xfe004004
y.create.l HWIO_LPASS_AUDIO_WRAPPER_BCR_ADDR A:0xfe005000
y.create.l HWIO_LPASS_Q6SS_BCR_ADDR A:0xfe006000
y.create.l HWIO_LPASS_Q6SS_BCR_SLP_CBCR_ADDR A:0xfe006004
y.create.l HWIO_LPASS_Q6SS_PLL_CLK_SRC_SEL_ADDR A:0xfe006008
y.create.l HWIO_LPASS_AUDIO_CORE_GDSCR_ADDR A:0xfe007000
y.create.l HWIO_LPASS_AUDIO_CORE_GDSC_XO_CBCR_ADDR A:0xfe007004
y.create.l HWIO_LPASS_MIDI_CMD_RCGR_ADDR A:0xfe008000
y.create.l HWIO_LPASS_MIDI_CFG_RCGR_ADDR A:0xfe008004
y.create.l HWIO_LPASS_AUDIO_CORE_MIDI_CORE_CBCR_ADDR A:0xfe008014
y.create.l HWIO_LPASS_AUDIO_CORE_MIDI_LFABIF_CBCR_ADDR A:0xfe008018
y.create.l HWIO_LPASS_AUDIO_CORE_LPAIF_DMA_CBCR_ADDR A:0xfe009000
y.create.l HWIO_LPASS_AUDIO_CORE_LPAIF_CSR_CBCR_ADDR A:0xfe009004
y.create.l HWIO_LPASS_LPAIF_SPKR_CMD_RCGR_ADDR A:0xfe00a000
y.create.l HWIO_LPASS_LPAIF_SPKR_CFG_RCGR_ADDR A:0xfe00a004
y.create.l HWIO_LPASS_LPAIF_SPKR_M_ADDR A:0xfe00a008
y.create.l HWIO_LPASS_LPAIF_SPKR_N_ADDR A:0xfe00a00c
y.create.l HWIO_LPASS_LPAIF_SPKR_D_ADDR A:0xfe00a010
y.create.l HWIO_LPASS_AUDIO_CORE_LPAIF_CODEC_SPKR_OSR_CBCR_ADDR A:0xfe00a014
y.create.l HWIO_LPASS_AUDIO_CORE_LPAIF_CODEC_SPKR_IBIT_CBCR_ADDR A:0xfe00a018
y.create.l HWIO_LPASS_AUDIO_CORE_LPAIF_CODEC_SPKR_EBIT_CBCR_ADDR A:0xfe00a01c
y.create.l HWIO_LPASS_LPAIF_PRI_CMD_RCGR_ADDR A:0xfe00b000
y.create.l HWIO_LPASS_LPAIF_PRI_CFG_RCGR_ADDR A:0xfe00b004
y.create.l HWIO_LPASS_LPAIF_PRI_M_ADDR A:0xfe00b008
y.create.l HWIO_LPASS_LPAIF_PRI_N_ADDR A:0xfe00b00c
y.create.l HWIO_LPASS_LPAIF_PRI_D_ADDR A:0xfe00b010
y.create.l HWIO_LPASS_AUDIO_CORE_LPAIF_PRI_OSR_CBCR_ADDR A:0xfe00b014
y.create.l HWIO_LPASS_AUDIO_CORE_LPAIF_PRI_IBIT_CBCR_ADDR A:0xfe00b018
y.create.l HWIO_LPASS_AUDIO_CORE_LPAIF_PRI_EBIT_CBCR_ADDR A:0xfe00b01c
y.create.l HWIO_LPASS_LPAIF_SEC_CMD_RCGR_ADDR A:0xfe00c000
y.create.l HWIO_LPASS_LPAIF_SEC_CFG_RCGR_ADDR A:0xfe00c004
y.create.l HWIO_LPASS_LPAIF_SEC_M_ADDR A:0xfe00c008
y.create.l HWIO_LPASS_LPAIF_SEC_N_ADDR A:0xfe00c00c
y.create.l HWIO_LPASS_LPAIF_SEC_D_ADDR A:0xfe00c010
y.create.l HWIO_LPASS_AUDIO_CORE_LPAIF_SEC_OSR_CBCR_ADDR A:0xfe00c014
y.create.l HWIO_LPASS_AUDIO_CORE_LPAIF_SEC_IBIT_CBCR_ADDR A:0xfe00c018
y.create.l HWIO_LPASS_AUDIO_CORE_LPAIF_SEC_EBIT_CBCR_ADDR A:0xfe00c01c
y.create.l HWIO_LPASS_LPAIF_TER_CMD_RCGR_ADDR A:0xfe00d000
y.create.l HWIO_LPASS_LPAIF_TER_CFG_RCGR_ADDR A:0xfe00d004
y.create.l HWIO_LPASS_LPAIF_TER_M_ADDR A:0xfe00d008
y.create.l HWIO_LPASS_LPAIF_TER_N_ADDR A:0xfe00d00c
y.create.l HWIO_LPASS_LPAIF_TER_D_ADDR A:0xfe00d010
y.create.l HWIO_LPASS_AUDIO_CORE_LPAIF_TER_OSR_CBCR_ADDR A:0xfe00d014
y.create.l HWIO_LPASS_AUDIO_CORE_LPAIF_TER_IBIT_CBCR_ADDR A:0xfe00d018
y.create.l HWIO_LPASS_AUDIO_CORE_LPAIF_TER_EBIT_CBCR_ADDR A:0xfe00d01c
y.create.l HWIO_LPASS_LPAIF_QUAD_CMD_RCGR_ADDR A:0xfe00e000
y.create.l HWIO_LPASS_LPAIF_QUAD_CFG_RCGR_ADDR A:0xfe00e004
y.create.l HWIO_LPASS_LPAIF_QUAD_M_ADDR A:0xfe00e008
y.create.l HWIO_LPASS_LPAIF_QUAD_N_ADDR A:0xfe00e00c
y.create.l HWIO_LPASS_LPAIF_QUAD_D_ADDR A:0xfe00e010
y.create.l HWIO_LPASS_AUDIO_CORE_LPAIF_QUAD_OSR_CBCR_ADDR A:0xfe00e014
y.create.l HWIO_LPASS_AUDIO_CORE_LPAIF_QUAD_IBIT_CBCR_ADDR A:0xfe00e018
y.create.l HWIO_LPASS_AUDIO_CORE_LPAIF_QUAD_EBIT_CBCR_ADDR A:0xfe00e01c
y.create.l HWIO_LPASS_LPAIF_PCM0_CMD_RCGR_ADDR A:0xfe00f000
y.create.l HWIO_LPASS_LPAIF_PCM0_CFG_RCGR_ADDR A:0xfe00f004
y.create.l HWIO_LPASS_LPAIF_PCM0_M_ADDR A:0xfe00f008
y.create.l HWIO_LPASS_LPAIF_PCM0_N_ADDR A:0xfe00f00c
y.create.l HWIO_LPASS_LPAIF_PCM0_D_ADDR A:0xfe00f010
y.create.l HWIO_LPASS_AUDIO_CORE_LPAIF_PCM0_IBIT_CBCR_ADDR A:0xfe00f014
y.create.l HWIO_LPASS_AUDIO_CORE_LPAIF_PCM0_EBIT_CBCR_ADDR A:0xfe00f018
y.create.l HWIO_LPASS_LPAIF_PCM1_CMD_RCGR_ADDR A:0xfe010000
y.create.l HWIO_LPASS_LPAIF_PCM1_CFG_RCGR_ADDR A:0xfe010004
y.create.l HWIO_LPASS_LPAIF_PCM1_M_ADDR A:0xfe010008
y.create.l HWIO_LPASS_LPAIF_PCM1_N_ADDR A:0xfe01000c
y.create.l HWIO_LPASS_LPAIF_PCM1_D_ADDR A:0xfe010010
y.create.l HWIO_LPASS_AUDIO_CORE_LPAIF_PCM1_IBIT_CBCR_ADDR A:0xfe010014
y.create.l HWIO_LPASS_AUDIO_CORE_LPAIF_PCM1_EBIT_CBCR_ADDR A:0xfe010018
y.create.l HWIO_LPASS_RESAMPLER_CMD_RCGR_ADDR A:0xfe011000
y.create.l HWIO_LPASS_RESAMPLER_CFG_RCGR_ADDR A:0xfe011004
y.create.l HWIO_LPASS_RESAMPLER_M_ADDR A:0xfe011008
y.create.l HWIO_LPASS_RESAMPLER_N_ADDR A:0xfe01100c
y.create.l HWIO_LPASS_RESAMPLER_D_ADDR A:0xfe011010
y.create.l HWIO_LPASS_AUDIO_CORE_RESAMPLER_CORE_CBCR_ADDR A:0xfe011014
y.create.l HWIO_LPASS_AUDIO_CORE_RESAMPLER_LFABIF_CBCR_ADDR A:0xfe011018
y.create.l HWIO_LPASS_SLIMBUS_CMD_RCGR_ADDR A:0xfe012000
y.create.l HWIO_LPASS_SLIMBUS_CFG_RCGR_ADDR A:0xfe012004
y.create.l HWIO_LPASS_SLIMBUS_M_ADDR A:0xfe012008
y.create.l HWIO_LPASS_SLIMBUS_N_ADDR A:0xfe01200c
y.create.l HWIO_LPASS_SLIMBUS_D_ADDR A:0xfe012010
y.create.l HWIO_LPASS_AUDIO_CORE_SLIMBUS_CORE_CBCR_ADDR A:0xfe012014
y.create.l HWIO_LPASS_AUDIO_CORE_SLIMBUS_LFABIF_CBCR_ADDR A:0xfe012018
y.create.l HWIO_LPASS_LPAIF_PCMOE_CMD_RCGR_ADDR A:0xfe013000
y.create.l HWIO_LPASS_LPAIF_PCMOE_CFG_RCGR_ADDR A:0xfe013004
y.create.l HWIO_LPASS_LPAIF_PCMOE_M_ADDR A:0xfe013008
y.create.l HWIO_LPASS_LPAIF_PCMOE_N_ADDR A:0xfe01300c
y.create.l HWIO_LPASS_LPAIF_PCMOE_D_ADDR A:0xfe013010
y.create.l HWIO_LPASS_AUDIO_CORE_LPAIF_PCM_DATA_OE_CBCR_ADDR A:0xfe013014
y.create.l HWIO_LPASS_Q6CORE_CMD_RCGR_ADDR A:0xfe014000
y.create.l HWIO_LPASS_Q6CORE_CFG_RCGR_ADDR A:0xfe014004
y.create.l HWIO_LPASS_Q6CORE_M_ADDR A:0xfe014008
y.create.l HWIO_LPASS_Q6CORE_N_ADDR A:0xfe01400c
y.create.l HWIO_LPASS_Q6CORE_D_ADDR A:0xfe014010
y.create.l HWIO_LPASS_SLEEP_CMD_RCGR_ADDR A:0xfe015000
y.create.l HWIO_LPASS_SLEEP_CFG_RCGR_ADDR A:0xfe015004
y.create.l HWIO_LPASS_Q6_SPDM_CMD_RCGR_ADDR A:0xfe016000
y.create.l HWIO_LPASS_SPDM_CMD_RCGR_ADDR A:0xfe016000
y.create.l HWIO_LPASS_Q6_SPDM_CFG_RCGR_ADDR A:0xfe016004
y.create.l HWIO_LPASS_SPDM_CFG_RCGR_ADDR A:0xfe016004
y.create.l HWIO_LPASS_Q6_SPDM_CBCR_ADDR A:0xfe016014
y.create.l HWIO_LPASS_AUDIO_WRAPPER_SPDM_CBCR_ADDR A:0xfe016014
y.create.l HWIO_LPASS_AHB_SPDM_CBCR_ADDR A:0xfe016018
y.create.l HWIO_LPASS_XO_CMD_RCGR_ADDR A:0xfe017000
y.create.l HWIO_LPASS_XO_CFG_RCGR_ADDR A:0xfe017004
y.create.l HWIO_LPASS_AHBFABRIC_CMD_RCGR_ADDR A:0xfe018000
y.create.l HWIO_LPASS_AHBFABRIC_CFG_RCGR_ADDR A:0xfe018004
y.create.l HWIO_LPASS_AHBFABRIC_M_ADDR A:0xfe018008
y.create.l HWIO_LPASS_AHBFABRIC_N_ADDR A:0xfe01800c
y.create.l HWIO_LPASS_AHBFABRIC_D_ADDR A:0xfe018010
y.create.l HWIO_LPASS_AUDIO_CORE_LPM_CBCR_ADDR A:0xfe019000
y.create.l HWIO_LPASS_AUDIO_CORE_LPM_MEM0_CBCR_ADDR A:0xfe019004
y.create.l HWIO_LPASS_AUDIO_CORE_LPM_MEM1_CBCR_ADDR A:0xfe019008
y.create.l HWIO_LPASS_AUDIO_CORE_LPM_MEM2_CBCR_ADDR A:0xfe01900c
y.create.l HWIO_LPASS_AUDIO_CORE_LPM_MEM3_CBCR_ADDR A:0xfe019010
y.create.l HWIO_LPASS_AUDIO_CORE_AVSYNC_CSR_CBCR_ADDR A:0xfe01a000
y.create.l HWIO_LPASS_AUDIO_CORE_BSTC_CBCR_ADDR A:0xfe01a004
y.create.l HWIO_LPASS_AUDIO_CORE_AVSYNC_XO_CBCR_ADDR A:0xfe01a008
y.create.l HWIO_LPASS_AUDIO_CORE_AVSYNC_BT_XO_CBCR_ADDR A:0xfe01a00c
y.create.l HWIO_LPASS_AUDIO_CORE_AVSYNC_FM_XO_CBCR_ADDR A:0xfe01a010
y.create.l HWIO_LPASS_AUDIO_CORE_AVSYNC_AVTIMER_XO_CBCR_ADDR A:0xfe01a014
y.create.l HWIO_LPASS_AUDIO_CORE_IXFABRIC_CBCR_ADDR A:0xfe01b000
y.create.l HWIO_LPASS_AUDIO_WRAPPER_EFABRIC_CBCR_ADDR A:0xfe01b004
y.create.l HWIO_LPASS_Q6SS_TCM_SLAVE_CBCR_ADDR A:0xfe01c000
y.create.l HWIO_LPASS_AUDIO_CORE_CSR_CBCR_ADDR A:0xfe01d000
y.create.l HWIO_LPASS_AUDIO_CORE_DML_CBCR_ADDR A:0xfe01e000
y.create.l HWIO_LPASS_AUDIO_CORE_SYSNOC_CBCR_ADDR A:0xfe01f000
y.create.l HWIO_LPASS_AUDIO_WRAPPER_SYSNOC_MPORT_CBCR_ADDR A:0xfe01f000
y.create.l HWIO_LPASS_AUDIO_WRAPPER_SYSNOC_SWAY_CBCR_ADDR A:0xfe01f004
y.create.l HWIO_LPASS_AUDIO_CORE_TIMEOUT_CBCR_ADDR A:0xfe020000
y.create.l HWIO_LPASS_AUDIO_WRAPPER_TIMEOUT_CBCR_ADDR A:0xfe020004
y.create.l HWIO_LPASS_AUDIO_CORE_SECURITY_CBCR_ADDR A:0xfe021000
y.create.l HWIO_LPASS_AUDIO_WRAPPER_SECURITY_CBCR_ADDR A:0xfe021004
y.create.l HWIO_LPASS_Q6SS_AHB_LFABIF_CBCR_ADDR A:0xfe022000
y.create.l HWIO_LPASS_Q6SS_AHBM_CBCR_ADDR A:0xfe022004
y.create.l HWIO_LPASS_AUDIO_WRAPPER_LCC_CSR_CBCR_ADDR A:0xfe023000
y.create.l HWIO_LPASS_AUDIO_WRAPPER_BR_CBCR_ADDR A:0xfe024000
y.create.l HWIO_LPASS_AUDIO_WRAPPER_SMEM_CBCR_ADDR A:0xfe025000
y.create.l HWIO_LPASS_Q6SS_XO_CBCR_ADDR A:0xfe026000
y.create.l HWIO_LPASS_Q6SS_SLP_CBCR_ADDR A:0xfe026004
y.create.l HWIO_LPASS_AUDIO_WRAPPER_STM_XO_CBCR_ADDR A:0xfe027000
y.create.l HWIO_LPASS_AUDIO_CORE_IXFABRIC_SPDMTM_CSR_CBCR_ADDR A:0xfe028000
y.create.l HWIO_LPASS_AUDIO_WRAPPER_EFABRIC_SPDMTM_CSR_CBCR_ADDR A:0xfe028004
y.create.l HWIO_LPASS_SPDIFTX_BMC_CMD_RCGR_ADDR A:0xfe029000
y.create.l HWIO_LPASS_SPDIFTX_BMC_CFG_RCGR_ADDR A:0xfe029004
y.create.l HWIO_LPASS_SPDIFTX_BMC_M_ADDR A:0xfe029008
y.create.l HWIO_LPASS_SPDIFTX_BMC_N_ADDR A:0xfe02900c
y.create.l HWIO_LPASS_SPDIFTX_BMC_D_ADDR A:0xfe029010
y.create.l HWIO_LPASS_SPDIFTX_BMC_CBCR_ADDR A:0xfe029014
y.create.l HWIO_LPASS_SPDIFTX_AHBS_CBCR_ADDR A:0xfe029018
y.create.l HWIO_LPASS_SPDIFTX_AHBM_CBCR_ADDR A:0xfe02901c
y.create.l HWIO_LPASS_SIF_CBCR_ADDR A:0xfe02a000
y.create.l HWIO_LPASS_SIF_AHB_CBCR_ADDR A:0xfe02a004
y.create.l HWIO_LPASS_HDMIRX_AHB_CBCR_ADDR A:0xfe02b000
y.create.l HWIO_LPASS_DIGCODEC_CMD_RCGR_ADDR A:0xfe02c000
y.create.l HWIO_LPASS_DIGCODEC_CFG_RCGR_ADDR A:0xfe02c004
y.create.l HWIO_LPASS_DIGCODEC_M_ADDR A:0xfe02c008
y.create.l HWIO_LPASS_DIGCODEC_N_ADDR A:0xfe02c00c
y.create.l HWIO_LPASS_DIGCODEC_D_ADDR A:0xfe02c010
y.create.l HWIO_LPASS_DIGCODEC_CBCR_ADDR A:0xfe02c014
y.create.l HWIO_LPASS_DIGCODEC_AHB_CBCR_ADDR A:0xfe02c018
y.create.l HWIO_LPASS_CORE_SMMU_CFG_CLK_CBCR_ADDR A:0xfe02d000
y.create.l HWIO_LPASS_Q6_SMMU_CFG_CLK_CBCR_ADDR A:0xfe02d004
y.create.l HWIO_LPASS_ATIME_CMD_RCGR_ADDR A:0xfe02e000
y.create.l HWIO_LPASS_ATIME_CFG_RCGR_ADDR A:0xfe02e004
y.create.l HWIO_LPASS_ATIME_M_ADDR A:0xfe02e008
y.create.l HWIO_LPASS_ATIME_N_ADDR A:0xfe02e00c
y.create.l HWIO_LPASS_ATIME_D_ADDR A:0xfe02e010
y.create.l HWIO_LPASS_AUDIO_CORE_AVSYNC_ATIME_XO_CBCR_ADDR A:0xfe02e014
y.create.l HWIO_LPASS_AUDIO_CORE_AON_CLK_CBCR_ADDR A:0xfe02f000
y.create.l HWIO_LPASS_AUDIO_WRAPPER_AON_CLK_CBCR_ADDR A:0xfe02f004
y.create.l HWIO_LPASS_LPAAUDIO_PLL_MODE_Q6_CTL_ADDR A:0xfe030000
y.create.l HWIO_LPASS_LPAAUDIO_PLL_L_Q6_DELTA_ADDR A:0xfe030004
y.create.l HWIO_LPASS_LPAAUDIO_PLL_M_Q6_DELTA_ADDR A:0xfe030008
y.create.l HWIO_LPASS_LPAAUDIO_PLL_N_Q6_DELTA_ADDR A:0xfe03000c
y.create.l HWIO_LPASS_LPAAUDIO_PLL_L_Q6_READBACK_ADDR A:0xfe030010
y.create.l HWIO_LPASS_LPAAUDIO_PLL_M_Q6_READBACK_ADDR A:0xfe030014
y.create.l HWIO_LPASS_LPAAUDIO_PLL_N_Q6_READBACK_ADDR A:0xfe030018
y.create.l HWIO_LPASS_LPA_PLL_VOTE_LPASS_HW_ADDR A:0xfe031000
y.create.l HWIO_LPASS_DBG_CLK_ADDR A:0xfe032000
y.create.l HWIO_LPASS_AUDIO_CORE_LPAIF_CODEC_SPKR_MODE_MUXSEL_ADDR A:0xfe033000
y.create.l HWIO_LPASS_AUDIO_CORE_LPAIF_PRI_MODE_MUXSEL_ADDR A:0xfe034000
y.create.l HWIO_LPASS_AUDIO_CORE_LPAIF_SEC_MODE_MUXSEL_ADDR A:0xfe035000
y.create.l HWIO_LPASS_AUDIO_CORE_LPAIF_TER_MODE_MUXSEL_ADDR A:0xfe036000
y.create.l HWIO_LPASS_AUDIO_CORE_LPAIF_QUAD_MODE_MUXSEL_ADDR A:0xfe037000
y.create.l HWIO_LPASS_AUDIO_CORE_LPAIF_PCM0_MODE_MUXSEL_ADDR A:0xfe038000
y.create.l HWIO_LPASS_AUDIO_CORE_LPAIF_PCM1_MODE_MUXSEL_ADDR A:0xfe039000
y.create.l HWIO_LPASS_AUDIO_CORE_XFABRIC_SPDMTM_CGC_ADDR A:0xfe03a000
y.create.l HWIO_LPASS_AUDIO_CORE_IFABRIC_SPDMTM_CGC_ADDR A:0xfe03a004
y.create.l HWIO_LPASS_AUDIO_WRAPPER_EFABRIC_SPDMTM_CGC_ADDR A:0xfe03a008
y.create.l HWIO_LPASS_Q6SS_RST_EVB_SEL_ADDR A:0xfe03b000
y.create.l HWIO_LPASS_Q6SS_RST_EVB_ADDR A:0xfe03b004
y.create.l HWIO_LPASS_VFR_IRQ_MUX_CTL_ADDR A:0xfe03c000
y.create.l HWIO_LPASS_VFR_STC_MSB_ADDR A:0xfe03c004
y.create.l HWIO_LPASS_VFR_STC_LSB_ADDR A:0xfe03c008
y.create.l HWIO_LPASS_SYSNOC_HYSTERESIS_CLK_GRP_0_ADDR A:0xfe03d000
y.create.l HWIO_LPASS_SYSNOC_HYSTERESIS_CLK_GRP_1_ADDR A:0xfe03d004
y.create.l HWIO_LPASS_SYSNOC_HYSTERESIS_CLK_GRP_2_ADDR A:0xfe03d008
y.create.l HWIO_LPASS_SYSNOC_HYSTERESIS_CLK_GRP_3_ADDR A:0xfe03d00c
y.create.l HWIO_LPASS_Q6SS_HYSTERESIS_CLK_GRP_0_ADDR A:0xfe03d020
y.create.l HWIO_LPASS_Q6SS_HYSTERESIS_CLK_GRP_1_ADDR A:0xfe03d024
y.create.l HWIO_LPASS_Q6SS_HYSTERESIS_CLK_GRP_2_ADDR A:0xfe03d028
y.create.l HWIO_LPASS_Q6SS_HYSTERESIS_CLK_GRP_3_ADDR A:0xfe03d02c
y.create.l HWIO_LPASS_AUDIO_CORE_CLAMP_DELAY_ADDR A:0xfe03d100
y.create.l HWIO_LPASS_STM_MUXSEL_0_ADDR A:0xfe03e000
y.create.l HWIO_LPASS_STM_MUXSEL_1_ADDR A:0xfe03e004
y.create.l HWIO_LPASS_STM_MUXSEL_2_ADDR A:0xfe03e008
y.create.l HWIO_LPASS_STM_MUXSEL_3_ADDR A:0xfe03e00c
y.create.l HWIO_LPASS_STM_MUXSEL_4_ADDR A:0xfe03e010
y.create.l HWIO_LPASS_STM_MUXSEL_5_ADDR A:0xfe03e014
y.create.l HWIO_LPASS_STM_MUXSEL_6_ADDR A:0xfe03e018
y.create.l HWIO_LPASS_STM_MUXSEL_7_ADDR A:0xfe03e01c
y.create.l HWIO_LPASS_STM_MUXSEL_8_ADDR A:0xfe03e020
y.create.l HWIO_LPASS_STM_MUXSEL_9_ADDR A:0xfe03e024
y.create.l HWIO_LPASS_AUDIO_WRAPPER_SMMU_BYPASS_ADDR A:0xfe03f000
y.create.l HWIO_LPASS_AUDIO_CORE_DIG_CODEC_CLK_SEL_ADDR A:0xfe03f004
y.create.l HWIO_LPASS_VFR_IRQ_MUX_CTL_1_ADDR A:0xfe040000
y.create.l HWIO_LPASS_VFR_STC_MSB_1_ADDR A:0xfe040004
y.create.l HWIO_LPASS_VFR_STC_LSB_1_ADDR A:0xfe040008
y.create.l HWIO_LPASS_SENSOR_IRQ_TS_MUX_CTL_ADDR A:0xfe041000
y.create.l HWIO_LPASS_SENSOR_IRQ_STC_MSB_ADDR A:0xfe041004
y.create.l HWIO_LPASS_SENSOR_IRQ_STC_LSB_ADDR A:0xfe041008
y.create.l HWIO_LPASS_GP_IRQ_TS_MUX_CTL_0_ADDR A:0xfe042000
y.create.l HWIO_LPASS_GP_IRQ_STC_MSB_0_ADDR A:0xfe042004
y.create.l HWIO_LPASS_GP_IRQ_STC_LSB_0_ADDR A:0xfe042008
y.create.l HWIO_LPASS_GP_IRQ_TS_MUX_CTL_1_ADDR A:0xfe043000
y.create.l HWIO_LPASS_GP_IRQ_STC_MSB_1_ADDR A:0xfe043004
y.create.l HWIO_LPASS_GP_IRQ_STC_LSB_1_ADDR A:0xfe043008
y.create.l HWIO_LPASS_SB_VFR_IRQ_CTL_ADDR A:0xfe044000
y.create.l HWIO_LPASS_LPAIF_VFR_IRQ_CTL_ADDR A:0xfe044004
y.create.l HWIO_LPASS_WCN_VFR_IRQ_CTL_ADDR A:0xfe044008
y.create.l HWIO_LPASS_AVT_VFR_IRQ_CTL_ADDR A:0xfe04400c
y.create.l HWIO_LPASS_HW_VERSION_ADDR A:0xfe04f000
y.create.l HWIO_LPASS_TCSR_DEBUG_CTL_ADDR A:0xfe04f004
y.create.l HWIO_LPASS_TCSR_MAXLIM_CTL_ADDR A:0xfe04f008
y.create.l HWIO_LPASS_AHBE_CFG_ADDR A:0xfe04f100
y.create.l HWIO_LPASS_AHBE_LOCK_CTL_ADDR A:0xfe04f104
y.create.l HWIO_LPASS_AHBE_STATUS_ADDR A:0xfe04f108
y.create.l HWIO_LPASS_AHBE_ACK_ADDR A:0xfe04f10c
y.create.l HWIO_LPASS_AHBE_SPARE_ADDR A:0xfe04f110
y.create.l HWIO_LPASS_AHBE_ABT_HW_VERSION_ADDR A:0xfe071000
y.create.l HWIO_LPASS_AHBE_ABT_INST_ID_ADDR A:0xfe071004
y.create.l HWIO_LPASS_AHBE_ABT_NUM_SLAVES_ADDR A:0xfe071008
y.create.l HWIO_LPASS_AHBE_ABT_TIMER_LOADVAL_ADDR A:0xfe07100c
y.create.l HWIO_LPASS_AHBE_ABT_TIMER_MODE_ADDR A:0xfe071010
y.create.l HWIO_LPASS_AHBE_ABT_INTR_STATUS_ADDR A:0xfe071014
y.create.l HWIO_LPASS_AHBE_ABT_INTR_CLEAR_ADDR A:0xfe071018
y.create.l HWIO_LPASS_AHBE_ABT_INTR_ENABLE_ADDR A:0xfe07101c
y.create.l HWIO_LPASS_AHBE_ABT_SYND_VALID_ADDR A:0xfe071020
y.create.l HWIO_LPASS_AHBE_ABT_SYND_CLEAR_ADDR A:0xfe071024
y.create.l HWIO_LPASS_AHBE_ABT_SYND_ID_ADDR A:0xfe071028
y.create.l HWIO_LPASS_AHBE_ABT_SYND_ADDR0_ADDR A:0xfe07102c
y.create.l HWIO_LPASS_AHBE_ABT_SYND_ADDR1_ADDR A:0xfe071030
y.create.l HWIO_LPASS_AHBE_ABT_SYND_HREADY_ADDR A:0xfe071034
y.create.l HWIO_LPASS_Q6AHB_VMIDMT_SCR0_ADDR A:0xfe072000
y.create.l HWIO_LPASS_Q6AHB_VMIDMT_SCR1_ADDR A:0xfe072004
y.create.l HWIO_LPASS_Q6AHB_VMIDMT_SCR2_ADDR A:0xfe072008
y.create.l HWIO_LPASS_Q6AHB_VMIDMT_SACR_ADDR A:0xfe072010
y.create.l HWIO_LPASS_Q6AHB_VMIDMT_SIDR0_ADDR A:0xfe072020
y.create.l HWIO_LPASS_Q6AHB_VMIDMT_SIDR1_ADDR A:0xfe072024
y.create.l HWIO_LPASS_Q6AHB_VMIDMT_SIDR2_ADDR A:0xfe072028
y.create.l HWIO_LPASS_Q6AHB_VMIDMT_SIDR4_ADDR A:0xfe072030
y.create.l HWIO_LPASS_Q6AHB_VMIDMT_SIDR5_ADDR A:0xfe072034
y.create.l HWIO_LPASS_Q6AHB_VMIDMT_SIDR7_ADDR A:0xfe07203c
y.create.l HWIO_LPASS_Q6AHB_VMIDMT_SGFAR0_ADDR A:0xfe072040
y.create.l HWIO_LPASS_Q6AHB_VMIDMT_SGFSR_ADDR A:0xfe072048
y.create.l HWIO_LPASS_Q6AHB_VMIDMT_SGFSRRESTORE_ADDR A:0xfe07204c
y.create.l HWIO_LPASS_Q6AHB_VMIDMT_SGFSYNDR0_ADDR A:0xfe072050
y.create.l HWIO_LPASS_Q6AHB_VMIDMT_SGFSYNDR1_ADDR A:0xfe072054
y.create.l HWIO_LPASS_Q6AHB_VMIDMT_SGFSYNDR2_ADDR A:0xfe072058
y.create.l HWIO_LPASS_Q6AHB_VMIDMT_VMIDMTSCR0_ADDR A:0xfe072090
y.create.l HWIO_LPASS_Q6AHB_VMIDMT_CR0_ADDR A:0xfe072000
y.create.l HWIO_LPASS_Q6AHB_VMIDMT_CR2_ADDR A:0xfe072008
y.create.l HWIO_LPASS_Q6AHB_VMIDMT_ACR_ADDR A:0xfe072010
y.create.l HWIO_LPASS_Q6AHB_VMIDMT_IDR0_ADDR A:0xfe072020
y.create.l HWIO_LPASS_Q6AHB_VMIDMT_IDR1_ADDR A:0xfe072024
y.create.l HWIO_LPASS_Q6AHB_VMIDMT_IDR2_ADDR A:0xfe072028
y.create.l HWIO_LPASS_Q6AHB_VMIDMT_IDR4_ADDR A:0xfe072030
y.create.l HWIO_LPASS_Q6AHB_VMIDMT_IDR5_ADDR A:0xfe072034
y.create.l HWIO_LPASS_Q6AHB_VMIDMT_IDR7_ADDR A:0xfe07203c
y.create.l HWIO_LPASS_Q6AHB_VMIDMT_GFAR0_ADDR A:0xfe072040
y.create.l HWIO_LPASS_Q6AHB_VMIDMT_GFSR_ADDR A:0xfe072048
y.create.l HWIO_LPASS_Q6AHB_VMIDMT_GFSRRESTORE_ADDR A:0xfe07204c
y.create.l HWIO_LPASS_Q6AHB_VMIDMT_GFSYNDR0_ADDR A:0xfe072050
y.create.l HWIO_LPASS_Q6AHB_VMIDMT_GFSYNDR1_ADDR A:0xfe072054
y.create.l HWIO_LPASS_Q6AHB_VMIDMT_GFSYNDR2_ADDR A:0xfe072058
y.create.l HWIO_LPASS_Q6AHB_VMIDMT_VMIDMTCR0_ADDR A:0xfe072090
y.create.l HWIO_LPASS_Q6AHB_VMIDMT_VMIDMTACR_ADDR A:0xfe07209c
y.create.l HWIO_LPASS_Q6AHB_VMIDMT_NSCR0_ADDR A:0xfe072400
y.create.l HWIO_LPASS_Q6AHB_VMIDMT_NSCR2_ADDR A:0xfe072408
y.create.l HWIO_LPASS_Q6AHB_VMIDMT_NSACR_ADDR A:0xfe072410
y.create.l HWIO_LPASS_Q6AHB_VMIDMT_NSGFAR0_ADDR A:0xfe072440
y.create.l HWIO_LPASS_Q6AHB_VMIDMT_NSGFSR_ADDR A:0xfe072448
y.create.l HWIO_LPASS_Q6AHB_VMIDMT_NSGFSRRESTORE_ADDR A:0xfe07244c
y.create.l HWIO_LPASS_Q6AHB_VMIDMT_NSGFSYNDR0_ADDR A:0xfe072450
y.create.l HWIO_LPASS_Q6AHB_VMIDMT_NSGFSYNDR1_ADDR A:0xfe072454
y.create.l HWIO_LPASS_Q6AHB_VMIDMT_NSGFSYNDR2_ADDR A:0xfe072458
y.create.l HWIO_LPASS_Q6AHB_VMIDMT_NSVMIDMTCR0_ADDR A:0xfe072490
y.create.l HWIO_LPASS_Q6AHB_VMIDMT_SSDR0_ADDR A:0xfe072080
y.create.l HWIO_LPASS_Q6AHB_VMIDMT_MSDR0_ADDR A:0xfe072480
y.create.l HWIO_LPASS_Q6AHB_VMIDMT_MCR_ADDR A:0xfe072494
y.create.l HWIO_LPASS_Q6AHB_VMIDMT_S2VR0_ADDR A:0xfe072c00
y.create.l HWIO_LPASS_Q6AHB_VMIDMT_AS2VR0_ADDR A:0xfe072e00
y.create.l HWIO_LPASS_Q6AXI_VMIDMT_SCR0_ADDR A:0xfe073000
y.create.l HWIO_LPASS_Q6AXI_VMIDMT_SCR1_ADDR A:0xfe073004
y.create.l HWIO_LPASS_Q6AXI_VMIDMT_SCR2_ADDR A:0xfe073008
y.create.l HWIO_LPASS_Q6AXI_VMIDMT_SACR_ADDR A:0xfe073010
y.create.l HWIO_LPASS_Q6AXI_VMIDMT_SIDR0_ADDR A:0xfe073020
y.create.l HWIO_LPASS_Q6AXI_VMIDMT_SIDR1_ADDR A:0xfe073024
y.create.l HWIO_LPASS_Q6AXI_VMIDMT_SIDR2_ADDR A:0xfe073028
y.create.l HWIO_LPASS_Q6AXI_VMIDMT_SIDR4_ADDR A:0xfe073030
y.create.l HWIO_LPASS_Q6AXI_VMIDMT_SIDR5_ADDR A:0xfe073034
y.create.l HWIO_LPASS_Q6AXI_VMIDMT_SIDR7_ADDR A:0xfe07303c
y.create.l HWIO_LPASS_Q6AXI_VMIDMT_SGFAR0_ADDR A:0xfe073040
y.create.l HWIO_LPASS_Q6AXI_VMIDMT_SGFSR_ADDR A:0xfe073048
y.create.l HWIO_LPASS_Q6AXI_VMIDMT_SGFSRRESTORE_ADDR A:0xfe07304c
y.create.l HWIO_LPASS_Q6AXI_VMIDMT_SGFSYNDR0_ADDR A:0xfe073050
y.create.l HWIO_LPASS_Q6AXI_VMIDMT_SGFSYNDR1_ADDR A:0xfe073054
y.create.l HWIO_LPASS_Q6AXI_VMIDMT_SGFSYNDR2_ADDR A:0xfe073058
y.create.l HWIO_LPASS_Q6AXI_VMIDMT_VMIDMTSCR0_ADDR A:0xfe073090
y.create.l HWIO_LPASS_Q6AXI_VMIDMT_CR0_ADDR A:0xfe073000
y.create.l HWIO_LPASS_Q6AXI_VMIDMT_CR2_ADDR A:0xfe073008
y.create.l HWIO_LPASS_Q6AXI_VMIDMT_ACR_ADDR A:0xfe073010
y.create.l HWIO_LPASS_Q6AXI_VMIDMT_IDR0_ADDR A:0xfe073020
y.create.l HWIO_LPASS_Q6AXI_VMIDMT_IDR1_ADDR A:0xfe073024
y.create.l HWIO_LPASS_Q6AXI_VMIDMT_IDR2_ADDR A:0xfe073028
y.create.l HWIO_LPASS_Q6AXI_VMIDMT_IDR4_ADDR A:0xfe073030
y.create.l HWIO_LPASS_Q6AXI_VMIDMT_IDR5_ADDR A:0xfe073034
y.create.l HWIO_LPASS_Q6AXI_VMIDMT_IDR7_ADDR A:0xfe07303c
y.create.l HWIO_LPASS_Q6AXI_VMIDMT_GFAR0_ADDR A:0xfe073040
y.create.l HWIO_LPASS_Q6AXI_VMIDMT_GFSR_ADDR A:0xfe073048
y.create.l HWIO_LPASS_Q6AXI_VMIDMT_GFSRRESTORE_ADDR A:0xfe07304c
y.create.l HWIO_LPASS_Q6AXI_VMIDMT_GFSYNDR0_ADDR A:0xfe073050
y.create.l HWIO_LPASS_Q6AXI_VMIDMT_GFSYNDR1_ADDR A:0xfe073054
y.create.l HWIO_LPASS_Q6AXI_VMIDMT_GFSYNDR2_ADDR A:0xfe073058
y.create.l HWIO_LPASS_Q6AXI_VMIDMT_VMIDMTCR0_ADDR A:0xfe073090
y.create.l HWIO_LPASS_Q6AXI_VMIDMT_VMIDMTACR_ADDR A:0xfe07309c
y.create.l HWIO_LPASS_Q6AXI_VMIDMT_NSCR0_ADDR A:0xfe073400
y.create.l HWIO_LPASS_Q6AXI_VMIDMT_NSCR2_ADDR A:0xfe073408
y.create.l HWIO_LPASS_Q6AXI_VMIDMT_NSACR_ADDR A:0xfe073410
y.create.l HWIO_LPASS_Q6AXI_VMIDMT_NSGFAR0_ADDR A:0xfe073440
y.create.l HWIO_LPASS_Q6AXI_VMIDMT_NSGFSR_ADDR A:0xfe073448
y.create.l HWIO_LPASS_Q6AXI_VMIDMT_NSGFSRRESTORE_ADDR A:0xfe07344c
y.create.l HWIO_LPASS_Q6AXI_VMIDMT_NSGFSYNDR0_ADDR A:0xfe073450
y.create.l HWIO_LPASS_Q6AXI_VMIDMT_NSGFSYNDR1_ADDR A:0xfe073454
y.create.l HWIO_LPASS_Q6AXI_VMIDMT_NSGFSYNDR2_ADDR A:0xfe073458
y.create.l HWIO_LPASS_Q6AXI_VMIDMT_NSVMIDMTCR0_ADDR A:0xfe073490
y.create.l HWIO_LPASS_Q6AXI_VMIDMT_SSDR0_ADDR A:0xfe073080
y.create.l HWIO_LPASS_Q6AXI_VMIDMT_MSDR0_ADDR A:0xfe073480
y.create.l HWIO_LPASS_Q6AXI_VMIDMT_MCR_ADDR A:0xfe073494
y.create.l HWIO_LPASS_Q6AXI_VMIDMT_S2VR0_ADDR A:0xfe073c00
y.create.l HWIO_LPASS_Q6AXI_VMIDMT_S2VR1_ADDR A:0xfe073c04
y.create.l HWIO_LPASS_Q6AXI_VMIDMT_S2VR2_ADDR A:0xfe073c08
y.create.l HWIO_LPASS_Q6AXI_VMIDMT_S2VR3_ADDR A:0xfe073c0c
y.create.l HWIO_LPASS_Q6AXI_VMIDMT_S2VR4_ADDR A:0xfe073c10
y.create.l HWIO_LPASS_Q6AXI_VMIDMT_S2VR5_ADDR A:0xfe073c14
y.create.l HWIO_LPASS_Q6AXI_VMIDMT_S2VR6_ADDR A:0xfe073c18
y.create.l HWIO_LPASS_Q6AXI_VMIDMT_S2VR7_ADDR A:0xfe073c1c
y.create.l HWIO_LPASS_Q6AXI_VMIDMT_AS2VR0_ADDR A:0xfe073e00
y.create.l HWIO_LPASS_Q6AXI_VMIDMT_AS2VR1_ADDR A:0xfe073e04
y.create.l HWIO_LPASS_Q6AXI_VMIDMT_AS2VR2_ADDR A:0xfe073e08
y.create.l HWIO_LPASS_Q6AXI_VMIDMT_AS2VR3_ADDR A:0xfe073e0c
y.create.l HWIO_LPASS_Q6AXI_VMIDMT_AS2VR4_ADDR A:0xfe073e10
y.create.l HWIO_LPASS_Q6AXI_VMIDMT_AS2VR5_ADDR A:0xfe073e14
y.create.l HWIO_LPASS_Q6AXI_VMIDMT_AS2VR6_ADDR A:0xfe073e18
y.create.l HWIO_LPASS_Q6AXI_VMIDMT_AS2VR7_ADDR A:0xfe073e1c
y.create.l HWIO_LPASS_LCC_XPU_SCR_ADDR A:0xfe084000
y.create.l HWIO_LPASS_LCC_XPU_SWDR_ADDR A:0xfe084004
y.create.l HWIO_LPASS_LCC_XPU_SEAR0_ADDR A:0xfe084040
y.create.l HWIO_LPASS_LCC_XPU_SESR_ADDR A:0xfe084048
y.create.l HWIO_LPASS_LCC_XPU_SESRRESTORE_ADDR A:0xfe08404c
y.create.l HWIO_LPASS_LCC_XPU_SESYNR0_ADDR A:0xfe084050
y.create.l HWIO_LPASS_LCC_XPU_SESYNR1_ADDR A:0xfe084054
y.create.l HWIO_LPASS_LCC_XPU_SESYNR2_ADDR A:0xfe084058
y.create.l HWIO_LPASS_LCC_XPU_MCR_ADDR A:0xfe084100
y.create.l HWIO_LPASS_LCC_XPU_MEAR0_ADDR A:0xfe084140
y.create.l HWIO_LPASS_LCC_XPU_MESR_ADDR A:0xfe084148
y.create.l HWIO_LPASS_LCC_XPU_MESRRESTORE_ADDR A:0xfe08414c
y.create.l HWIO_LPASS_LCC_XPU_MESYNR0_ADDR A:0xfe084150
y.create.l HWIO_LPASS_LCC_XPU_MESYNR1_ADDR A:0xfe084154
y.create.l HWIO_LPASS_LCC_XPU_MESYNR2_ADDR A:0xfe084158
y.create.l HWIO_LPASS_LCC_XPU_CR_ADDR A:0xfe084080
y.create.l HWIO_LPASS_LCC_XPU_RPU_ACR0_ADDR A:0xfe0840a0
y.create.l HWIO_LPASS_LCC_XPU_EAR0_ADDR A:0xfe0840c0
y.create.l HWIO_LPASS_LCC_XPU_ESR_ADDR A:0xfe0840c8
y.create.l HWIO_LPASS_LCC_XPU_ESRRESTORE_ADDR A:0xfe0840cc
y.create.l HWIO_LPASS_LCC_XPU_ESYNR0_ADDR A:0xfe0840d0
y.create.l HWIO_LPASS_LCC_XPU_ESYNR1_ADDR A:0xfe0840d4
y.create.l HWIO_LPASS_LCC_XPU_ESYNR2_ADDR A:0xfe0840d8
y.create.l HWIO_LPASS_LCC_XPU_IDR0_ADDR A:0xfe084074
y.create.l HWIO_LPASS_LCC_XPU_IDR1_ADDR A:0xfe084078
y.create.l HWIO_LPASS_LCC_XPU_REV_ADDR A:0xfe08407c
y.create.l HWIO_LPASS_LCC_XPU_RG0_RACR0_ADDR A:0xfe084200
y.create.l HWIO_LPASS_LCC_XPU_RG1_RACR0_ADDR A:0xfe084280
y.create.l HWIO_LPASS_LCC_XPU_RG2_RACR0_ADDR A:0xfe084300
y.create.l HWIO_LPASS_LCC_XPU_RG3_RACR0_ADDR A:0xfe084380
y.create.l HWIO_LPASS_LCC_XPU_RG4_RACR0_ADDR A:0xfe084400
y.create.l HWIO_LPASS_LCC_XPU_RG5_RACR0_ADDR A:0xfe084480
y.create.l HWIO_LPASS_LCC_XPU_RG6_RACR0_ADDR A:0xfe084500
y.create.l HWIO_LPASS_LCC_XPU_RG7_RACR0_ADDR A:0xfe084580
y.create.l HWIO_LPASS_LCC_XPU_RG8_RACR0_ADDR A:0xfe084600
y.create.l HWIO_LPASS_LCC_XPU_RG9_RACR0_ADDR A:0xfe084680
y.create.l HWIO_LPASS_LCC_XPU_RG0_WACR0_ADDR A:0xfe084220
y.create.l HWIO_LPASS_LCC_XPU_RG1_WACR0_ADDR A:0xfe0842a0
y.create.l HWIO_LPASS_LCC_XPU_RG2_WACR0_ADDR A:0xfe084320
y.create.l HWIO_LPASS_LCC_XPU_RG3_WACR0_ADDR A:0xfe0843a0
y.create.l HWIO_LPASS_LCC_XPU_RG4_WACR0_ADDR A:0xfe084420
y.create.l HWIO_LPASS_LCC_XPU_RG5_WACR0_ADDR A:0xfe0844a0
y.create.l HWIO_LPASS_LCC_XPU_RG6_WACR0_ADDR A:0xfe084520
y.create.l HWIO_LPASS_LCC_XPU_RG7_WACR0_ADDR A:0xfe0845a0
y.create.l HWIO_LPASS_LCC_XPU_RG8_WACR0_ADDR A:0xfe084620
y.create.l HWIO_LPASS_LCC_XPU_RG9_WACR0_ADDR A:0xfe0846a0
y.create.l HWIO_LPASS_LCC_XPU_RG0_SCR_ADDR A:0xfe084250
y.create.l HWIO_LPASS_LCC_XPU_RG1_SCR_ADDR A:0xfe0842d0
y.create.l HWIO_LPASS_LCC_XPU_RG2_SCR_ADDR A:0xfe084350
y.create.l HWIO_LPASS_LCC_XPU_RG3_SCR_ADDR A:0xfe0843d0
y.create.l HWIO_LPASS_LCC_XPU_RG4_SCR_ADDR A:0xfe084450
y.create.l HWIO_LPASS_LCC_XPU_RG5_SCR_ADDR A:0xfe0844d0
y.create.l HWIO_LPASS_LCC_XPU_RG6_SCR_ADDR A:0xfe084550
y.create.l HWIO_LPASS_LCC_XPU_RG7_SCR_ADDR A:0xfe0845d0
y.create.l HWIO_LPASS_LCC_XPU_RG8_SCR_ADDR A:0xfe084650
y.create.l HWIO_LPASS_LCC_XPU_RG9_SCR_ADDR A:0xfe0846d0
y.create.l HWIO_LPASS_LCC_XPU_RG0_MCR_ADDR A:0xfe084254
y.create.l HWIO_LPASS_LCC_XPU_RG1_MCR_ADDR A:0xfe0842d4
y.create.l HWIO_LPASS_LCC_XPU_RG2_MCR_ADDR A:0xfe084354
y.create.l HWIO_LPASS_LCC_XPU_RG3_MCR_ADDR A:0xfe0843d4
y.create.l HWIO_LPASS_LCC_XPU_RG4_MCR_ADDR A:0xfe084454
y.create.l HWIO_LPASS_LCC_XPU_RG5_MCR_ADDR A:0xfe0844d4
y.create.l HWIO_LPASS_LCC_XPU_RG6_MCR_ADDR A:0xfe084554
y.create.l HWIO_LPASS_LCC_XPU_RG7_MCR_ADDR A:0xfe0845d4
y.create.l HWIO_LPASS_LCC_XPU_RG8_MCR_ADDR A:0xfe084654
y.create.l HWIO_LPASS_LCC_XPU_RG9_MCR_ADDR A:0xfe0846d4
y.create.l HWIO_LPASS_TOP_XPU_SCR_ADDR A:0xfe088000
y.create.l HWIO_LPASS_TOP_XPU_SWDR_ADDR A:0xfe088004
y.create.l HWIO_LPASS_TOP_XPU_SEAR0_ADDR A:0xfe088040
y.create.l HWIO_LPASS_TOP_XPU_SESR_ADDR A:0xfe088048
y.create.l HWIO_LPASS_TOP_XPU_SESRRESTORE_ADDR A:0xfe08804c
y.create.l HWIO_LPASS_TOP_XPU_SESYNR0_ADDR A:0xfe088050
y.create.l HWIO_LPASS_TOP_XPU_SESYNR1_ADDR A:0xfe088054
y.create.l HWIO_LPASS_TOP_XPU_SESYNR2_ADDR A:0xfe088058
y.create.l HWIO_LPASS_TOP_XPU_MCR_ADDR A:0xfe088100
y.create.l HWIO_LPASS_TOP_XPU_MEAR0_ADDR A:0xfe088140
y.create.l HWIO_LPASS_TOP_XPU_MESR_ADDR A:0xfe088148
y.create.l HWIO_LPASS_TOP_XPU_MESRRESTORE_ADDR A:0xfe08814c
y.create.l HWIO_LPASS_TOP_XPU_MESYNR0_ADDR A:0xfe088150
y.create.l HWIO_LPASS_TOP_XPU_MESYNR1_ADDR A:0xfe088154
y.create.l HWIO_LPASS_TOP_XPU_MESYNR2_ADDR A:0xfe088158
y.create.l HWIO_LPASS_TOP_XPU_CR_ADDR A:0xfe088080
y.create.l HWIO_LPASS_TOP_XPU_RPU_ACR0_ADDR A:0xfe0880a0
y.create.l HWIO_LPASS_TOP_XPU_EAR0_ADDR A:0xfe0880c0
y.create.l HWIO_LPASS_TOP_XPU_ESR_ADDR A:0xfe0880c8
y.create.l HWIO_LPASS_TOP_XPU_ESRRESTORE_ADDR A:0xfe0880cc
y.create.l HWIO_LPASS_TOP_XPU_ESYNR0_ADDR A:0xfe0880d0
y.create.l HWIO_LPASS_TOP_XPU_ESYNR1_ADDR A:0xfe0880d4
y.create.l HWIO_LPASS_TOP_XPU_ESYNR2_ADDR A:0xfe0880d8
y.create.l HWIO_LPASS_TOP_XPU_IDR0_ADDR A:0xfe088074
y.create.l HWIO_LPASS_TOP_XPU_IDR1_ADDR A:0xfe088078
y.create.l HWIO_LPASS_TOP_XPU_REV_ADDR A:0xfe08807c
y.create.l HWIO_LPASS_TOP_XPU_RG0_RACR0_ADDR A:0xfe088200
y.create.l HWIO_LPASS_TOP_XPU_RG1_RACR0_ADDR A:0xfe088280
y.create.l HWIO_LPASS_TOP_XPU_RG2_RACR0_ADDR A:0xfe088300
y.create.l HWIO_LPASS_TOP_XPU_RG3_RACR0_ADDR A:0xfe088380
y.create.l HWIO_LPASS_TOP_XPU_RG4_RACR0_ADDR A:0xfe088400
y.create.l HWIO_LPASS_TOP_XPU_RG0_SCR_ADDR A:0xfe088250
y.create.l HWIO_LPASS_TOP_XPU_RG1_SCR_ADDR A:0xfe0882d0
y.create.l HWIO_LPASS_TOP_XPU_RG2_SCR_ADDR A:0xfe088350
y.create.l HWIO_LPASS_TOP_XPU_RG3_SCR_ADDR A:0xfe0883d0
y.create.l HWIO_LPASS_TOP_XPU_RG4_SCR_ADDR A:0xfe088450
y.create.l HWIO_LPASS_TOP_XPU_RG0_MCR_ADDR A:0xfe088254
y.create.l HWIO_LPASS_TOP_XPU_RG1_MCR_ADDR A:0xfe0882d4
y.create.l HWIO_LPASS_TOP_XPU_RG2_MCR_ADDR A:0xfe088354
y.create.l HWIO_LPASS_TOP_XPU_RG3_MCR_ADDR A:0xfe0883d4
y.create.l HWIO_LPASS_TOP_XPU_RG4_MCR_ADDR A:0xfe088454
y.create.l HWIO_LPASS_CSR_GP_CTL_ADDR A:0xfe0b0000
y.create.l HWIO_LPASS_CSR_MEMTYPE_CTL_ADDR A:0xfe0b0004
y.create.l HWIO_LPASS_CSR_DEBUG_CTL_ADDR A:0xfe0b0010
y.create.l HWIO_LPASS_CSR_DEBUG_BUS_ADDR A:0xfe0b0014
y.create.l HWIO_LPASS_AHBI_CFG_ADDR A:0xfe0b1004
y.create.l HWIO_LPASS_AHBI_LOCK_CTL_ADDR A:0xfe0b1008
y.create.l HWIO_LPASS_AHBI_CFG_EXT_ADDR A:0xfe0b100c
y.create.l HWIO_LPASS_AHBX_CFG_ADDR A:0xfe0b1020
y.create.l HWIO_LPASS_AHBX_LOCK_CTL_ADDR A:0xfe0b1024
y.create.l HWIO_LPASS_AHBIX_STATUS_ADDR A:0xfe0b1030
y.create.l HWIO_LPASS_AHBIX_ACK_ADDR A:0xfe0b1034
y.create.l HWIO_LPASS_DML_CTL_ADDR A:0xfe0b2000
y.create.l HWIO_LPASS_DML_SRC_ADDR A:0xfe0b2004
y.create.l HWIO_LPASS_DML_DST_ADDR A:0xfe0b2008
y.create.l HWIO_LPASS_DML_TRAN_ADDR A:0xfe0b200c
y.create.l HWIO_LPASS_DML_STATUS_ADDR A:0xfe0b2010
y.create.l HWIO_LPASS_DML_ACK_ADDR A:0xfe0b2014
y.create.l HWIO_LPASS_LPM_CTL_ADDR A:0xfe0b3000
y.create.l HWIO_LPASS_RESAMPLER_CTL_ADDR A:0xfe0b4000
y.create.l HWIO_LPASS_MIDI_CTL_ADDR A:0xfe0b5000
y.create.l HWIO_LPASS_SPDIFTX_CTL_ADDR A:0xfe0b7000
y.create.l HWIO_LPASS_SPDIFTX_STAT_ADDR A:0xfe0b7004
y.create.l HWIO_LPASS_LPAIF_CTL_ADDR A:0xfe0b6000
y.create.l HWIO_LPASS_HDMIRX_CTL_ADDR A:0xfe0b8000
y.create.l HWIO_LPASS_HDMIRX_STAT_ADDR A:0xfe0b8004
y.create.l HWIO_LPASS_AHBTM_CFG_ADDR A:0xfe0c7000
y.create.l HWIO_LPASS_AHBTM_C0_CFG0_ADDR A:0xfe0c7020
y.create.l HWIO_LPASS_AHBTM_C1_CFG0_ADDR A:0xfe0c7040
y.create.l HWIO_LPASS_AHBTM_C2_CFG0_ADDR A:0xfe0c7060
y.create.l HWIO_LPASS_AHBTM_C3_CFG0_ADDR A:0xfe0c7080
y.create.l HWIO_LPASS_AHBTM_C4_CFG0_ADDR A:0xfe0c70a0
y.create.l HWIO_LPASS_AHBTM_C5_CFG0_ADDR A:0xfe0c70c0
y.create.l HWIO_LPASS_AHBTM_C6_CFG0_ADDR A:0xfe0c70e0
y.create.l HWIO_LPASS_AHBTM_C7_CFG0_ADDR A:0xfe0c7100
y.create.l HWIO_LPASS_AHBTM_C0_CFG1_ADDR A:0xfe0c7024
y.create.l HWIO_LPASS_AHBTM_C1_CFG1_ADDR A:0xfe0c7044
y.create.l HWIO_LPASS_AHBTM_C2_CFG1_ADDR A:0xfe0c7064
y.create.l HWIO_LPASS_AHBTM_C3_CFG1_ADDR A:0xfe0c7084
y.create.l HWIO_LPASS_AHBTM_C4_CFG1_ADDR A:0xfe0c70a4
y.create.l HWIO_LPASS_AHBTM_C5_CFG1_ADDR A:0xfe0c70c4
y.create.l HWIO_LPASS_AHBTM_C6_CFG1_ADDR A:0xfe0c70e4
y.create.l HWIO_LPASS_AHBTM_C7_CFG1_ADDR A:0xfe0c7104
y.create.l HWIO_LPASS_AHBTM_C0_CFG2_ADDR A:0xfe0c7028
y.create.l HWIO_LPASS_AHBTM_C1_CFG2_ADDR A:0xfe0c7048
y.create.l HWIO_LPASS_AHBTM_C2_CFG2_ADDR A:0xfe0c7068
y.create.l HWIO_LPASS_AHBTM_C3_CFG2_ADDR A:0xfe0c7088
y.create.l HWIO_LPASS_AHBTM_C4_CFG2_ADDR A:0xfe0c70a8
y.create.l HWIO_LPASS_AHBTM_C5_CFG2_ADDR A:0xfe0c70c8
y.create.l HWIO_LPASS_AHBTM_C6_CFG2_ADDR A:0xfe0c70e8
y.create.l HWIO_LPASS_AHBTM_C7_CFG2_ADDR A:0xfe0c7108
y.create.l HWIO_LPASS_AHBTM_C0_CFG3_ADDR A:0xfe0c702c
y.create.l HWIO_LPASS_AHBTM_C1_CFG3_ADDR A:0xfe0c704c
y.create.l HWIO_LPASS_AHBTM_C2_CFG3_ADDR A:0xfe0c706c
y.create.l HWIO_LPASS_AHBTM_C3_CFG3_ADDR A:0xfe0c708c
y.create.l HWIO_LPASS_AHBTM_C4_CFG3_ADDR A:0xfe0c70ac
y.create.l HWIO_LPASS_AHBTM_C5_CFG3_ADDR A:0xfe0c70cc
y.create.l HWIO_LPASS_AHBTM_C6_CFG3_ADDR A:0xfe0c70ec
y.create.l HWIO_LPASS_AHBTM_C7_CFG3_ADDR A:0xfe0c710c
y.create.l HWIO_LPASS_AHBTM_C0_CFG4_ADDR A:0xfe0c7030
y.create.l HWIO_LPASS_AHBTM_C1_CFG4_ADDR A:0xfe0c7050
y.create.l HWIO_LPASS_AHBTM_C2_CFG4_ADDR A:0xfe0c7070
y.create.l HWIO_LPASS_AHBTM_C3_CFG4_ADDR A:0xfe0c7090
y.create.l HWIO_LPASS_AHBTM_C4_CFG4_ADDR A:0xfe0c70b0
y.create.l HWIO_LPASS_AHBTM_C5_CFG4_ADDR A:0xfe0c70d0
y.create.l HWIO_LPASS_AHBTM_C6_CFG4_ADDR A:0xfe0c70f0
y.create.l HWIO_LPASS_AHBTM_C7_CFG4_ADDR A:0xfe0c7110
y.create.l HWIO_LPASS_AHBTM_C0_CFG5_ADDR A:0xfe0c7034
y.create.l HWIO_LPASS_AHBTM_C1_CFG5_ADDR A:0xfe0c7054
y.create.l HWIO_LPASS_AHBTM_C2_CFG5_ADDR A:0xfe0c7074
y.create.l HWIO_LPASS_AHBTM_C3_CFG5_ADDR A:0xfe0c7094
y.create.l HWIO_LPASS_AHBTM_C4_CFG5_ADDR A:0xfe0c70b4
y.create.l HWIO_LPASS_AHBTM_C5_CFG5_ADDR A:0xfe0c70d4
y.create.l HWIO_LPASS_AHBTM_C6_CFG5_ADDR A:0xfe0c70f4
y.create.l HWIO_LPASS_AHBTM_C7_CFG5_ADDR A:0xfe0c7114
y.create.l HWIO_LPASS_AHBTM_C0_CFG6_ADDR A:0xfe0c7038
y.create.l HWIO_LPASS_AHBTM_C1_CFG6_ADDR A:0xfe0c7058
y.create.l HWIO_LPASS_AHBTM_C2_CFG6_ADDR A:0xfe0c7078
y.create.l HWIO_LPASS_AHBTM_C3_CFG6_ADDR A:0xfe0c7098
y.create.l HWIO_LPASS_AHBTM_C4_CFG6_ADDR A:0xfe0c70b8
y.create.l HWIO_LPASS_AHBTM_C5_CFG6_ADDR A:0xfe0c70d8
y.create.l HWIO_LPASS_AHBTM_C6_CFG6_ADDR A:0xfe0c70f8
y.create.l HWIO_LPASS_AHBTM_C7_CFG6_ADDR A:0xfe0c7118
y.create.l HWIO_LPASS_AHBI_ABT_HW_VERSION_ADDR A:0xfe0c8000
y.create.l HWIO_LPASS_AHBI_ABT_INST_ID_ADDR A:0xfe0c8004
y.create.l HWIO_LPASS_AHBI_ABT_NUM_SLAVES_ADDR A:0xfe0c8008
y.create.l HWIO_LPASS_AHBI_ABT_TIMER_LOADVAL_ADDR A:0xfe0c800c
y.create.l HWIO_LPASS_AHBI_ABT_TIMER_MODE_ADDR A:0xfe0c8010
y.create.l HWIO_LPASS_AHBI_ABT_INTR_STATUS_ADDR A:0xfe0c8014
y.create.l HWIO_LPASS_AHBI_ABT_INTR_CLEAR_ADDR A:0xfe0c8018
y.create.l HWIO_LPASS_AHBI_ABT_INTR_ENABLE_ADDR A:0xfe0c801c
y.create.l HWIO_LPASS_AHBI_ABT_SYND_VALID_ADDR A:0xfe0c8020
y.create.l HWIO_LPASS_AHBI_ABT_SYND_CLEAR_ADDR A:0xfe0c8024
y.create.l HWIO_LPASS_AHBI_ABT_SYND_ID_ADDR A:0xfe0c8028
y.create.l HWIO_LPASS_AHBI_ABT_SYND_ADDR0_ADDR A:0xfe0c802c
y.create.l HWIO_LPASS_AHBI_ABT_SYND_ADDR1_ADDR A:0xfe0c8030
y.create.l HWIO_LPASS_AHBI_ABT_SYND_HREADY_ADDR A:0xfe0c8034
y.create.l HWIO_LPASS_AVTIMER_HW_VERSION_ADDR A:0xfe0c9000
y.create.l HWIO_LPASS_AVTIMER_CTL_ADDR A:0xfe0c9004
y.create.l HWIO_LPASS_AVTIMER_RESMOD_ADDR A:0xfe0c9008
y.create.l HWIO_LPASS_AVTIMER_TIMER_LSB_ADDR A:0xfe0c900c
y.create.l HWIO_LPASS_AVTIMER_TIMER_MSB_ADDR A:0xfe0c9010
y.create.l HWIO_LPASS_AVTIMER_INT0_LSB_ADDR A:0xfe0c9014
y.create.l HWIO_LPASS_AVTIMER_INT0_MSB_ADDR A:0xfe0c9018
y.create.l HWIO_LPASS_AVTIMER_INT1_LSB_ADDR A:0xfe0c901c
y.create.l HWIO_LPASS_AVTIMER_INT1_MSB_ADDR A:0xfe0c9020
y.create.l HWIO_LPASS_AVTIMER_TIMEOUT_VAL_ADDR A:0xfe0c9024
y.create.l HWIO_LPASS_AVTIMER_L0_VAL_NEXT_ADDR A:0xfe0c9028
y.create.l HWIO_LPASS_AVTIMER_M0_VAL_NEXT_ADDR A:0xfe0c902c
y.create.l HWIO_LPASS_AVTIMER_N0_VAL_NEXT_ADDR A:0xfe0c9030
y.create.l HWIO_LPASS_AVTIMER_L0_VAL_CURR_ADDR A:0xfe0c9034
y.create.l HWIO_LPASS_AVTIMER_M0_VAL_CURR_ADDR A:0xfe0c9038
y.create.l HWIO_LPASS_AVTIMER_N0_VAL_CURR_ADDR A:0xfe0c903c
y.create.l HWIO_LPASS_AVTIMER_MODE_CTL_ADDR A:0xfe0c9040
y.create.l HWIO_LPASS_AVTIMER_LMN_DWT_ADDR A:0xfe0c9044
y.create.l HWIO_LPASS_AVTIMER_LTIME_LSB_ADDR A:0xfe0c9048
y.create.l HWIO_LPASS_AVTIMER_LTIME_MSB_ADDR A:0xfe0c904c
y.create.l HWIO_LPASS_AVTIMER_EXT_STC_LSB_ADDR A:0xfe0c9050
y.create.l HWIO_LPASS_AVTIMER_EXT_STC_MSB_ADDR A:0xfe0c9054
y.create.l HWIO_LPASS_AVTIMER_RTIME_LSB_ADDR A:0xfe0c9058
y.create.l HWIO_LPASS_AVTIMER_RTIME_MSB_ADDR A:0xfe0c905c
y.create.l HWIO_LPASS_AVTIMER_RTIME_CTL_ADDR A:0xfe0c9060
y.create.l HWIO_LPASS_AVTIMER_TIME_CTL_ADDR A:0xfe0c9064
y.create.l HWIO_LPASS_AVTIMER_TIMER_LOAD_LSB_NEXT_ADDR A:0xfe0c9068
y.create.l HWIO_LPASS_AVTIMER_TIMER_LOAD_MSB_NEXT_ADDR A:0xfe0c906c
y.create.l HWIO_LPASS_AVTIMER_TIMER_LOAD_LSB_CURR_ADDR A:0xfe0c9070
y.create.l HWIO_LPASS_AVTIMER_TIMER_LOAD_MSB_CURR_ADDR A:0xfe0c9074
y.create.l HWIO_LPASS_AVTIMER_TIMER_LOAD_DWT_ADDR A:0xfe0c9078
y.create.l HWIO_LPASS_AVTIMER_INT1_ST_ADDR A:0xfe0c907c
y.create.l HWIO_LPASS_AVTIMER_INT0_ST_ADDR A:0xfe0c9080
y.create.l HWIO_LPASS_AVTIMER_INT1_CTL_ADDR A:0xfe0c9084
y.create.l HWIO_LPASS_AVTIMER_INT0_CTL_ADDR A:0xfe0c9088
y.create.l HWIO_LPASS_AVTIMER_INT_ON_ADDR A:0xfe0c908c
y.create.l HWIO_LPASS_AVTIMER_TICK_DIV_ADDR A:0xfe0c9090
y.create.l HWIO_LPASS_AUD_SYNC_CTL_ADDR A:0xfe0c9200
y.create.l HWIO_LPASS_AUD_SYNC_STATUS_ADDR A:0xfe0c9204
y.create.l HWIO_LPASS_AUD_SYNC_BT_REF_INC_ADDR A:0xfe0c9208
y.create.l HWIO_LPASS_AUD_SYNC_BT_XO_DIV_MOD_ADDR A:0xfe0c920c
y.create.l HWIO_LPASS_AUD_SYNC_BT_PHASE_CHK_XO1_ADDR A:0xfe0c9210
y.create.l HWIO_LPASS_AUD_SYNC_BT_PHASE_CHK_REF1_ADDR A:0xfe0c9214
y.create.l HWIO_LPASS_AUD_SYNC_BT_VFR_TIMESTAMP_ADDR A:0xfe0c9218
y.create.l HWIO_LPASS_AUD_SYNC_BT_COUNT_LOAD_XO1_ADDR A:0xfe0c921c
y.create.l HWIO_LPASS_AUD_SYNC_BT_COUNT_LOAD_REF1_ADDR A:0xfe0c9220
y.create.l HWIO_LPASS_AUD_SYNC_BT_PHASE_CHK_XO2_ADDR A:0xfe0c9224
y.create.l HWIO_LPASS_AUD_SYNC_BT_PHASE_CHK_REF2_ADDR A:0xfe0c9228
y.create.l HWIO_LPASS_AUD_SYNC_BT_COUNT_LOAD_XO2_ADDR A:0xfe0c922c
y.create.l HWIO_LPASS_AUD_SYNC_BT_COUNT_LOAD_REF2_ADDR A:0xfe0c9230
y.create.l HWIO_LPASS_AUD_SYNC_FM_REF_INC_ADDR A:0xfe0c9234
y.create.l HWIO_LPASS_AUD_SYNC_FM_XO_DIV_MOD_ADDR A:0xfe0c9238
y.create.l HWIO_LPASS_AUD_SYNC_FM_PHASE_CHK_XO_ADDR A:0xfe0c923c
y.create.l HWIO_LPASS_AUD_SYNC_FM_PHASE_CHK_REF_ADDR A:0xfe0c9240
y.create.l HWIO_LPASS_AUD_SYNC_FM_VFR_TIMESTAMP_ADDR A:0xfe0c9244
y.create.l HWIO_LPASS_AUD_SYNC_FM_COUNT_LOAD_XO_ADDR A:0xfe0c9248
y.create.l HWIO_LPASS_AUD_SYNC_FM_COUNT_LOAD_REF_ADDR A:0xfe0c924c
y.create.l HWIO_LPASS_DM_VMIDMT_SCR0_ADDR A:0xfe0cc000
y.create.l HWIO_LPASS_DM_VMIDMT_SCR1_ADDR A:0xfe0cc004
y.create.l HWIO_LPASS_DM_VMIDMT_SCR2_ADDR A:0xfe0cc008
y.create.l HWIO_LPASS_DM_VMIDMT_SACR_ADDR A:0xfe0cc010
y.create.l HWIO_LPASS_DM_VMIDMT_SIDR0_ADDR A:0xfe0cc020
y.create.l HWIO_LPASS_DM_VMIDMT_SIDR1_ADDR A:0xfe0cc024
y.create.l HWIO_LPASS_DM_VMIDMT_SIDR2_ADDR A:0xfe0cc028
y.create.l HWIO_LPASS_DM_VMIDMT_SIDR4_ADDR A:0xfe0cc030
y.create.l HWIO_LPASS_DM_VMIDMT_SIDR5_ADDR A:0xfe0cc034
y.create.l HWIO_LPASS_DM_VMIDMT_SIDR7_ADDR A:0xfe0cc03c
y.create.l HWIO_LPASS_DM_VMIDMT_SGFAR0_ADDR A:0xfe0cc040
y.create.l HWIO_LPASS_DM_VMIDMT_SGFSR_ADDR A:0xfe0cc048
y.create.l HWIO_LPASS_DM_VMIDMT_SGFSRRESTORE_ADDR A:0xfe0cc04c
y.create.l HWIO_LPASS_DM_VMIDMT_SGFSYNDR0_ADDR A:0xfe0cc050
y.create.l HWIO_LPASS_DM_VMIDMT_SGFSYNDR1_ADDR A:0xfe0cc054
y.create.l HWIO_LPASS_DM_VMIDMT_SGFSYNDR2_ADDR A:0xfe0cc058
y.create.l HWIO_LPASS_DM_VMIDMT_VMIDMTSCR0_ADDR A:0xfe0cc090
y.create.l HWIO_LPASS_DM_VMIDMT_CR0_ADDR A:0xfe0cc000
y.create.l HWIO_LPASS_DM_VMIDMT_CR2_ADDR A:0xfe0cc008
y.create.l HWIO_LPASS_DM_VMIDMT_ACR_ADDR A:0xfe0cc010
y.create.l HWIO_LPASS_DM_VMIDMT_IDR0_ADDR A:0xfe0cc020
y.create.l HWIO_LPASS_DM_VMIDMT_IDR1_ADDR A:0xfe0cc024
y.create.l HWIO_LPASS_DM_VMIDMT_IDR2_ADDR A:0xfe0cc028
y.create.l HWIO_LPASS_DM_VMIDMT_IDR4_ADDR A:0xfe0cc030
y.create.l HWIO_LPASS_DM_VMIDMT_IDR5_ADDR A:0xfe0cc034
y.create.l HWIO_LPASS_DM_VMIDMT_IDR7_ADDR A:0xfe0cc03c
y.create.l HWIO_LPASS_DM_VMIDMT_GFAR0_ADDR A:0xfe0cc040
y.create.l HWIO_LPASS_DM_VMIDMT_GFSR_ADDR A:0xfe0cc048
y.create.l HWIO_LPASS_DM_VMIDMT_GFSRRESTORE_ADDR A:0xfe0cc04c
y.create.l HWIO_LPASS_DM_VMIDMT_GFSYNDR0_ADDR A:0xfe0cc050
y.create.l HWIO_LPASS_DM_VMIDMT_GFSYNDR1_ADDR A:0xfe0cc054
y.create.l HWIO_LPASS_DM_VMIDMT_GFSYNDR2_ADDR A:0xfe0cc058
y.create.l HWIO_LPASS_DM_VMIDMT_VMIDMTCR0_ADDR A:0xfe0cc090
y.create.l HWIO_LPASS_DM_VMIDMT_VMIDMTACR_ADDR A:0xfe0cc09c
y.create.l HWIO_LPASS_DM_VMIDMT_NSCR0_ADDR A:0xfe0cc400
y.create.l HWIO_LPASS_DM_VMIDMT_NSCR2_ADDR A:0xfe0cc408
y.create.l HWIO_LPASS_DM_VMIDMT_NSACR_ADDR A:0xfe0cc410
y.create.l HWIO_LPASS_DM_VMIDMT_NSGFAR0_ADDR A:0xfe0cc440
y.create.l HWIO_LPASS_DM_VMIDMT_NSGFSR_ADDR A:0xfe0cc448
y.create.l HWIO_LPASS_DM_VMIDMT_NSGFSRRESTORE_ADDR A:0xfe0cc44c
y.create.l HWIO_LPASS_DM_VMIDMT_NSGFSYNDR0_ADDR A:0xfe0cc450
y.create.l HWIO_LPASS_DM_VMIDMT_NSGFSYNDR1_ADDR A:0xfe0cc454
y.create.l HWIO_LPASS_DM_VMIDMT_NSGFSYNDR2_ADDR A:0xfe0cc458
y.create.l HWIO_LPASS_DM_VMIDMT_NSVMIDMTCR0_ADDR A:0xfe0cc490
y.create.l HWIO_LPASS_DM_VMIDMT_SSDR0_ADDR A:0xfe0cc080
y.create.l HWIO_LPASS_DM_VMIDMT_MSDR0_ADDR A:0xfe0cc480
y.create.l HWIO_LPASS_DM_VMIDMT_MCR_ADDR A:0xfe0cc494
y.create.l HWIO_LPASS_DM_VMIDMT_S2VR0_ADDR A:0xfe0ccc00
y.create.l HWIO_LPASS_DM_VMIDMT_AS2VR0_ADDR A:0xfe0cce00
y.create.l HWIO_LPASS_DM_VMIDMT_SMR0_ADDR A:0xfe0cc800
y.create.l HWIO_LPASS_LPAIF_VMIDMT_SCR0_ADDR A:0xfe0cd000
y.create.l HWIO_LPASS_LPAIF_VMIDMT_SCR1_ADDR A:0xfe0cd004
y.create.l HWIO_LPASS_LPAIF_VMIDMT_SCR2_ADDR A:0xfe0cd008
y.create.l HWIO_LPASS_LPAIF_VMIDMT_SACR_ADDR A:0xfe0cd010
y.create.l HWIO_LPASS_LPAIF_VMIDMT_SIDR0_ADDR A:0xfe0cd020
y.create.l HWIO_LPASS_LPAIF_VMIDMT_SIDR1_ADDR A:0xfe0cd024
y.create.l HWIO_LPASS_LPAIF_VMIDMT_SIDR2_ADDR A:0xfe0cd028
y.create.l HWIO_LPASS_LPAIF_VMIDMT_SIDR4_ADDR A:0xfe0cd030
y.create.l HWIO_LPASS_LPAIF_VMIDMT_SIDR5_ADDR A:0xfe0cd034
y.create.l HWIO_LPASS_LPAIF_VMIDMT_SIDR7_ADDR A:0xfe0cd03c
y.create.l HWIO_LPASS_LPAIF_VMIDMT_SGFAR0_ADDR A:0xfe0cd040
y.create.l HWIO_LPASS_LPAIF_VMIDMT_SGFSR_ADDR A:0xfe0cd048
y.create.l HWIO_LPASS_LPAIF_VMIDMT_SGFSRRESTORE_ADDR A:0xfe0cd04c
y.create.l HWIO_LPASS_LPAIF_VMIDMT_SGFSYNDR0_ADDR A:0xfe0cd050
y.create.l HWIO_LPASS_LPAIF_VMIDMT_SGFSYNDR1_ADDR A:0xfe0cd054
y.create.l HWIO_LPASS_LPAIF_VMIDMT_SGFSYNDR2_ADDR A:0xfe0cd058
y.create.l HWIO_LPASS_LPAIF_VMIDMT_VMIDMTSCR0_ADDR A:0xfe0cd090
y.create.l HWIO_LPASS_LPAIF_VMIDMT_CR0_ADDR A:0xfe0cd000
y.create.l HWIO_LPASS_LPAIF_VMIDMT_CR2_ADDR A:0xfe0cd008
y.create.l HWIO_LPASS_LPAIF_VMIDMT_ACR_ADDR A:0xfe0cd010
y.create.l HWIO_LPASS_LPAIF_VMIDMT_IDR0_ADDR A:0xfe0cd020
y.create.l HWIO_LPASS_LPAIF_VMIDMT_IDR1_ADDR A:0xfe0cd024
y.create.l HWIO_LPASS_LPAIF_VMIDMT_IDR2_ADDR A:0xfe0cd028
y.create.l HWIO_LPASS_LPAIF_VMIDMT_IDR4_ADDR A:0xfe0cd030
y.create.l HWIO_LPASS_LPAIF_VMIDMT_IDR5_ADDR A:0xfe0cd034
y.create.l HWIO_LPASS_LPAIF_VMIDMT_IDR7_ADDR A:0xfe0cd03c
y.create.l HWIO_LPASS_LPAIF_VMIDMT_GFAR0_ADDR A:0xfe0cd040
y.create.l HWIO_LPASS_LPAIF_VMIDMT_GFSR_ADDR A:0xfe0cd048
y.create.l HWIO_LPASS_LPAIF_VMIDMT_GFSRRESTORE_ADDR A:0xfe0cd04c
y.create.l HWIO_LPASS_LPAIF_VMIDMT_GFSYNDR0_ADDR A:0xfe0cd050
y.create.l HWIO_LPASS_LPAIF_VMIDMT_GFSYNDR1_ADDR A:0xfe0cd054
y.create.l HWIO_LPASS_LPAIF_VMIDMT_GFSYNDR2_ADDR A:0xfe0cd058
y.create.l HWIO_LPASS_LPAIF_VMIDMT_VMIDMTCR0_ADDR A:0xfe0cd090
y.create.l HWIO_LPASS_LPAIF_VMIDMT_VMIDMTACR_ADDR A:0xfe0cd09c
y.create.l HWIO_LPASS_LPAIF_VMIDMT_NSCR0_ADDR A:0xfe0cd400
y.create.l HWIO_LPASS_LPAIF_VMIDMT_NSCR2_ADDR A:0xfe0cd408
y.create.l HWIO_LPASS_LPAIF_VMIDMT_NSACR_ADDR A:0xfe0cd410
y.create.l HWIO_LPASS_LPAIF_VMIDMT_NSGFAR0_ADDR A:0xfe0cd440
y.create.l HWIO_LPASS_LPAIF_VMIDMT_NSGFSR_ADDR A:0xfe0cd448
y.create.l HWIO_LPASS_LPAIF_VMIDMT_NSGFSRRESTORE_ADDR A:0xfe0cd44c
y.create.l HWIO_LPASS_LPAIF_VMIDMT_NSGFSYNDR0_ADDR A:0xfe0cd450
y.create.l HWIO_LPASS_LPAIF_VMIDMT_NSGFSYNDR1_ADDR A:0xfe0cd454
y.create.l HWIO_LPASS_LPAIF_VMIDMT_NSGFSYNDR2_ADDR A:0xfe0cd458
y.create.l HWIO_LPASS_LPAIF_VMIDMT_NSVMIDMTCR0_ADDR A:0xfe0cd490
y.create.l HWIO_LPASS_LPAIF_VMIDMT_SSDR0_ADDR A:0xfe0cd080
y.create.l HWIO_LPASS_LPAIF_VMIDMT_MSDR0_ADDR A:0xfe0cd480
y.create.l HWIO_LPASS_LPAIF_VMIDMT_MCR_ADDR A:0xfe0cd494
y.create.l HWIO_LPASS_LPAIF_VMIDMT_S2VR0_ADDR A:0xfe0cdc00
y.create.l HWIO_LPASS_LPAIF_VMIDMT_S2VR1_ADDR A:0xfe0cdc04
y.create.l HWIO_LPASS_LPAIF_VMIDMT_S2VR2_ADDR A:0xfe0cdc08
y.create.l HWIO_LPASS_LPAIF_VMIDMT_S2VR3_ADDR A:0xfe0cdc0c
y.create.l HWIO_LPASS_LPAIF_VMIDMT_S2VR4_ADDR A:0xfe0cdc10
y.create.l HWIO_LPASS_LPAIF_VMIDMT_S2VR5_ADDR A:0xfe0cdc14
y.create.l HWIO_LPASS_LPAIF_VMIDMT_S2VR6_ADDR A:0xfe0cdc18
y.create.l HWIO_LPASS_LPAIF_VMIDMT_S2VR7_ADDR A:0xfe0cdc1c
y.create.l HWIO_LPASS_LPAIF_VMIDMT_S2VR8_ADDR A:0xfe0cdc20
y.create.l HWIO_LPASS_LPAIF_VMIDMT_AS2VR0_ADDR A:0xfe0cde00
y.create.l HWIO_LPASS_LPAIF_VMIDMT_AS2VR1_ADDR A:0xfe0cde04
y.create.l HWIO_LPASS_LPAIF_VMIDMT_AS2VR2_ADDR A:0xfe0cde08
y.create.l HWIO_LPASS_LPAIF_VMIDMT_AS2VR3_ADDR A:0xfe0cde0c
y.create.l HWIO_LPASS_LPAIF_VMIDMT_AS2VR4_ADDR A:0xfe0cde10
y.create.l HWIO_LPASS_LPAIF_VMIDMT_AS2VR5_ADDR A:0xfe0cde14
y.create.l HWIO_LPASS_LPAIF_VMIDMT_AS2VR6_ADDR A:0xfe0cde18
y.create.l HWIO_LPASS_LPAIF_VMIDMT_AS2VR7_ADDR A:0xfe0cde1c
y.create.l HWIO_LPASS_LPAIF_VMIDMT_AS2VR8_ADDR A:0xfe0cde20
y.create.l HWIO_LPASS_LPAIF_VMIDMT_SMR0_ADDR A:0xfe0cd800
y.create.l HWIO_LPASS_LPAIF_VMIDMT_SMR1_ADDR A:0xfe0cd804
y.create.l HWIO_LPASS_LPAIF_VMIDMT_SMR2_ADDR A:0xfe0cd808
y.create.l HWIO_LPASS_LPAIF_VMIDMT_SMR3_ADDR A:0xfe0cd80c
y.create.l HWIO_LPASS_LPAIF_VMIDMT_SMR4_ADDR A:0xfe0cd810
y.create.l HWIO_LPASS_LPAIF_VMIDMT_SMR5_ADDR A:0xfe0cd814
y.create.l HWIO_LPASS_LPAIF_VMIDMT_SMR6_ADDR A:0xfe0cd818
y.create.l HWIO_LPASS_LPAIF_VMIDMT_SMR7_ADDR A:0xfe0cd81c
y.create.l HWIO_LPASS_LPAIF_VMIDMT_SMR8_ADDR A:0xfe0cd820
y.create.l HWIO_LPASS_LPM_XPU_SCR_ADDR A:0xfe0db000
y.create.l HWIO_LPASS_LPM_XPU_SWDR_ADDR A:0xfe0db004
y.create.l HWIO_LPASS_LPM_XPU_PRTN_RACR_SSHADOW_ADDR A:0xfe0db008
y.create.l HWIO_LPASS_LPM_XPU_PRTN_WACR_SSHADOW_ADDR A:0xfe0db00c
y.create.l HWIO_LPASS_LPM_XPU_PRTN_START_SSHADOW0_ADDR A:0xfe0db010
y.create.l HWIO_LPASS_LPM_XPU_PRTN_END_SSHADOW0_ADDR A:0xfe0db018
y.create.l HWIO_LPASS_LPM_XPU_SEAR0_ADDR A:0xfe0db040
y.create.l HWIO_LPASS_LPM_XPU_SESR_ADDR A:0xfe0db048
y.create.l HWIO_LPASS_LPM_XPU_SESRRESTORE_ADDR A:0xfe0db04c
y.create.l HWIO_LPASS_LPM_XPU_SESYNR0_ADDR A:0xfe0db050
y.create.l HWIO_LPASS_LPM_XPU_SESYNR1_ADDR A:0xfe0db054
y.create.l HWIO_LPASS_LPM_XPU_SESYNR2_ADDR A:0xfe0db058
y.create.l HWIO_LPASS_LPM_XPU_MCR_ADDR A:0xfe0db100
y.create.l HWIO_LPASS_LPM_XPU_MEAR0_ADDR A:0xfe0db140
y.create.l HWIO_LPASS_LPM_XPU_MESR_ADDR A:0xfe0db148
y.create.l HWIO_LPASS_LPM_XPU_MESRRESTORE_ADDR A:0xfe0db14c
y.create.l HWIO_LPASS_LPM_XPU_MESYNR0_ADDR A:0xfe0db150
y.create.l HWIO_LPASS_LPM_XPU_MESYNR1_ADDR A:0xfe0db154
y.create.l HWIO_LPASS_LPM_XPU_MESYNR2_ADDR A:0xfe0db158
y.create.l HWIO_LPASS_LPM_XPU_CR_ADDR A:0xfe0db080
y.create.l HWIO_LPASS_LPM_XPU_PRTN_RACR_SHADOW_ADDR A:0xfe0db088
y.create.l HWIO_LPASS_LPM_XPU_PRTN_WACR_SHADOW_ADDR A:0xfe0db08c
y.create.l HWIO_LPASS_LPM_XPU_PRTN_START_SHADOW0_ADDR A:0xfe0db090
y.create.l HWIO_LPASS_LPM_XPU_PRTN_END_SHADOW0_ADDR A:0xfe0db098
y.create.l HWIO_LPASS_LPM_XPU_RPU_ACR0_ADDR A:0xfe0db0a0
y.create.l HWIO_LPASS_LPM_XPU_EAR0_ADDR A:0xfe0db0c0
y.create.l HWIO_LPASS_LPM_XPU_ESR_ADDR A:0xfe0db0c8
y.create.l HWIO_LPASS_LPM_XPU_ESRRESTORE_ADDR A:0xfe0db0cc
y.create.l HWIO_LPASS_LPM_XPU_ESYNR0_ADDR A:0xfe0db0d0
y.create.l HWIO_LPASS_LPM_XPU_ESYNR1_ADDR A:0xfe0db0d4
y.create.l HWIO_LPASS_LPM_XPU_ESYNR2_ADDR A:0xfe0db0d8
y.create.l HWIO_LPASS_LPM_XPU_UMR_RACR_ADDR A:0xfe0db0e0
y.create.l HWIO_LPASS_LPM_XPU_UMR_WACR_ADDR A:0xfe0db0e4
y.create.l HWIO_LPASS_LPM_XPU_IDR0_ADDR A:0xfe0db074
y.create.l HWIO_LPASS_LPM_XPU_IDR1_ADDR A:0xfe0db078
y.create.l HWIO_LPASS_LPM_XPU_REV_ADDR A:0xfe0db07c
y.create.l HWIO_LPASS_LPM_XPU_PRT0_RACR0_ADDR A:0xfe0db200
y.create.l HWIO_LPASS_LPM_XPU_PRT1_RACR0_ADDR A:0xfe0db280
y.create.l HWIO_LPASS_LPM_XPU_PRT2_RACR0_ADDR A:0xfe0db300
y.create.l HWIO_LPASS_LPM_XPU_PRT3_RACR0_ADDR A:0xfe0db380
y.create.l HWIO_LPASS_LPM_XPU_PRT4_RACR0_ADDR A:0xfe0db400
y.create.l HWIO_LPASS_LPM_XPU_PRT5_RACR0_ADDR A:0xfe0db480
y.create.l HWIO_LPASS_LPM_XPU_PRT6_RACR0_ADDR A:0xfe0db500
y.create.l HWIO_LPASS_LPM_XPU_PRT7_RACR0_ADDR A:0xfe0db580
y.create.l HWIO_LPASS_LPM_XPU_PRT8_RACR0_ADDR A:0xfe0db600
y.create.l HWIO_LPASS_LPM_XPU_PRT9_RACR0_ADDR A:0xfe0db680
y.create.l HWIO_LPASS_LPM_XPU_PRT0_WACR0_ADDR A:0xfe0db220
y.create.l HWIO_LPASS_LPM_XPU_PRT1_WACR0_ADDR A:0xfe0db2a0
y.create.l HWIO_LPASS_LPM_XPU_PRT2_WACR0_ADDR A:0xfe0db320
y.create.l HWIO_LPASS_LPM_XPU_PRT3_WACR0_ADDR A:0xfe0db3a0
y.create.l HWIO_LPASS_LPM_XPU_PRT4_WACR0_ADDR A:0xfe0db420
y.create.l HWIO_LPASS_LPM_XPU_PRT5_WACR0_ADDR A:0xfe0db4a0
y.create.l HWIO_LPASS_LPM_XPU_PRT6_WACR0_ADDR A:0xfe0db520
y.create.l HWIO_LPASS_LPM_XPU_PRT7_WACR0_ADDR A:0xfe0db5a0
y.create.l HWIO_LPASS_LPM_XPU_PRT8_WACR0_ADDR A:0xfe0db620
y.create.l HWIO_LPASS_LPM_XPU_PRT9_WACR0_ADDR A:0xfe0db6a0
y.create.l HWIO_LPASS_LPM_XPU_PRT0_START0_ADDR A:0xfe0db240
y.create.l HWIO_LPASS_LPM_XPU_PRT1_START0_ADDR A:0xfe0db2c0
y.create.l HWIO_LPASS_LPM_XPU_PRT2_START0_ADDR A:0xfe0db340
y.create.l HWIO_LPASS_LPM_XPU_PRT3_START0_ADDR A:0xfe0db3c0
y.create.l HWIO_LPASS_LPM_XPU_PRT4_START0_ADDR A:0xfe0db440
y.create.l HWIO_LPASS_LPM_XPU_PRT5_START0_ADDR A:0xfe0db4c0
y.create.l HWIO_LPASS_LPM_XPU_PRT6_START0_ADDR A:0xfe0db540
y.create.l HWIO_LPASS_LPM_XPU_PRT7_START0_ADDR A:0xfe0db5c0
y.create.l HWIO_LPASS_LPM_XPU_PRT8_START0_ADDR A:0xfe0db640
y.create.l HWIO_LPASS_LPM_XPU_PRT9_START0_ADDR A:0xfe0db6c0
y.create.l HWIO_LPASS_LPM_XPU_PRT0_END0_ADDR A:0xfe0db248
y.create.l HWIO_LPASS_LPM_XPU_PRT1_END0_ADDR A:0xfe0db2c8
y.create.l HWIO_LPASS_LPM_XPU_PRT2_END0_ADDR A:0xfe0db348
y.create.l HWIO_LPASS_LPM_XPU_PRT3_END0_ADDR A:0xfe0db3c8
y.create.l HWIO_LPASS_LPM_XPU_PRT4_END0_ADDR A:0xfe0db448
y.create.l HWIO_LPASS_LPM_XPU_PRT5_END0_ADDR A:0xfe0db4c8
y.create.l HWIO_LPASS_LPM_XPU_PRT6_END0_ADDR A:0xfe0db548
y.create.l HWIO_LPASS_LPM_XPU_PRT7_END0_ADDR A:0xfe0db5c8
y.create.l HWIO_LPASS_LPM_XPU_PRT8_END0_ADDR A:0xfe0db648
y.create.l HWIO_LPASS_LPM_XPU_PRT9_END0_ADDR A:0xfe0db6c8
y.create.l HWIO_LPASS_LPM_XPU_PRT0_SCR_ADDR A:0xfe0db250
y.create.l HWIO_LPASS_LPM_XPU_PRT1_SCR_ADDR A:0xfe0db2d0
y.create.l HWIO_LPASS_LPM_XPU_PRT2_SCR_ADDR A:0xfe0db350
y.create.l HWIO_LPASS_LPM_XPU_PRT3_SCR_ADDR A:0xfe0db3d0
y.create.l HWIO_LPASS_LPM_XPU_PRT4_SCR_ADDR A:0xfe0db450
y.create.l HWIO_LPASS_LPM_XPU_PRT5_SCR_ADDR A:0xfe0db4d0
y.create.l HWIO_LPASS_LPM_XPU_PRT6_SCR_ADDR A:0xfe0db550
y.create.l HWIO_LPASS_LPM_XPU_PRT7_SCR_ADDR A:0xfe0db5d0
y.create.l HWIO_LPASS_LPM_XPU_PRT8_SCR_ADDR A:0xfe0db650
y.create.l HWIO_LPASS_LPM_XPU_PRT9_SCR_ADDR A:0xfe0db6d0
y.create.l HWIO_LPASS_LPM_XPU_RG0_MCR_ADDR A:0xfe0db254
y.create.l HWIO_LPASS_LPM_XPU_RG1_MCR_ADDR A:0xfe0db2d4
y.create.l HWIO_LPASS_LPM_XPU_RG2_MCR_ADDR A:0xfe0db354
y.create.l HWIO_LPASS_LPM_XPU_RG3_MCR_ADDR A:0xfe0db3d4
y.create.l HWIO_LPASS_LPM_XPU_RG4_MCR_ADDR A:0xfe0db454
y.create.l HWIO_LPASS_LPM_XPU_RG5_MCR_ADDR A:0xfe0db4d4
y.create.l HWIO_LPASS_LPM_XPU_RG6_MCR_ADDR A:0xfe0db554
y.create.l HWIO_LPASS_LPM_XPU_RG7_MCR_ADDR A:0xfe0db5d4
y.create.l HWIO_LPASS_LPM_XPU_RG8_MCR_ADDR A:0xfe0db654
y.create.l HWIO_LPASS_LPM_XPU_RG9_MCR_ADDR A:0xfe0db6d4
y.create.l HWIO_LPASS_LPM_XPU_PRT0_CNTL0_ADDR A:0xfe0db258
y.create.l HWIO_LPASS_LPM_XPU_PRT1_CNTL0_ADDR A:0xfe0db2d8
y.create.l HWIO_LPASS_LPM_XPU_PRT2_CNTL0_ADDR A:0xfe0db358
y.create.l HWIO_LPASS_LPM_XPU_PRT3_CNTL0_ADDR A:0xfe0db3d8
y.create.l HWIO_LPASS_LPM_XPU_PRT4_CNTL0_ADDR A:0xfe0db458
y.create.l HWIO_LPASS_LPM_XPU_PRT5_CNTL0_ADDR A:0xfe0db4d8
y.create.l HWIO_LPASS_LPM_XPU_PRT6_CNTL0_ADDR A:0xfe0db558
y.create.l HWIO_LPASS_LPM_XPU_PRT7_CNTL0_ADDR A:0xfe0db5d8
y.create.l HWIO_LPASS_LPM_XPU_PRT8_CNTL0_ADDR A:0xfe0db658
y.create.l HWIO_LPASS_LPM_XPU_PRT9_CNTL0_ADDR A:0xfe0db6d8
y.create.l HWIO_LPASS_LPM_XPU_PRT0_CNTL1_ADDR A:0xfe0db25c
y.create.l HWIO_LPASS_LPM_XPU_PRT1_CNTL1_ADDR A:0xfe0db2dc
y.create.l HWIO_LPASS_LPM_XPU_PRT2_CNTL1_ADDR A:0xfe0db35c
y.create.l HWIO_LPASS_LPM_XPU_PRT3_CNTL1_ADDR A:0xfe0db3dc
y.create.l HWIO_LPASS_LPM_XPU_PRT4_CNTL1_ADDR A:0xfe0db45c
y.create.l HWIO_LPASS_LPM_XPU_PRT5_CNTL1_ADDR A:0xfe0db4dc
y.create.l HWIO_LPASS_LPM_XPU_PRT6_CNTL1_ADDR A:0xfe0db55c
y.create.l HWIO_LPASS_LPM_XPU_PRT7_CNTL1_ADDR A:0xfe0db5dc
y.create.l HWIO_LPASS_LPM_XPU_PRT8_CNTL1_ADDR A:0xfe0db65c
y.create.l HWIO_LPASS_LPM_XPU_PRT9_CNTL1_ADDR A:0xfe0db6dc
y.create.l HWIO_LPASS_CSR_XPU_SCR_ADDR A:0xfe0dc000
y.create.l HWIO_LPASS_CSR_XPU_SWDR_ADDR A:0xfe0dc004
y.create.l HWIO_LPASS_CSR_XPU_SEAR0_ADDR A:0xfe0dc040
y.create.l HWIO_LPASS_CSR_XPU_SESR_ADDR A:0xfe0dc048
y.create.l HWIO_LPASS_CSR_XPU_SESRRESTORE_ADDR A:0xfe0dc04c
y.create.l HWIO_LPASS_CSR_XPU_SESYNR0_ADDR A:0xfe0dc050
y.create.l HWIO_LPASS_CSR_XPU_SESYNR1_ADDR A:0xfe0dc054
y.create.l HWIO_LPASS_CSR_XPU_SESYNR2_ADDR A:0xfe0dc058
y.create.l HWIO_LPASS_CSR_XPU_MCR_ADDR A:0xfe0dc100
y.create.l HWIO_LPASS_CSR_XPU_MEAR0_ADDR A:0xfe0dc140
y.create.l HWIO_LPASS_CSR_XPU_MESR_ADDR A:0xfe0dc148
y.create.l HWIO_LPASS_CSR_XPU_MESRRESTORE_ADDR A:0xfe0dc14c
y.create.l HWIO_LPASS_CSR_XPU_MESYNR0_ADDR A:0xfe0dc150
y.create.l HWIO_LPASS_CSR_XPU_MESYNR1_ADDR A:0xfe0dc154
y.create.l HWIO_LPASS_CSR_XPU_MESYNR2_ADDR A:0xfe0dc158
y.create.l HWIO_LPASS_CSR_XPU_CR_ADDR A:0xfe0dc080
y.create.l HWIO_LPASS_CSR_XPU_RPU_ACR0_ADDR A:0xfe0dc0a0
y.create.l HWIO_LPASS_CSR_XPU_EAR0_ADDR A:0xfe0dc0c0
y.create.l HWIO_LPASS_CSR_XPU_ESR_ADDR A:0xfe0dc0c8
y.create.l HWIO_LPASS_CSR_XPU_ESRRESTORE_ADDR A:0xfe0dc0cc
y.create.l HWIO_LPASS_CSR_XPU_ESYNR0_ADDR A:0xfe0dc0d0
y.create.l HWIO_LPASS_CSR_XPU_ESYNR1_ADDR A:0xfe0dc0d4
y.create.l HWIO_LPASS_CSR_XPU_ESYNR2_ADDR A:0xfe0dc0d8
y.create.l HWIO_LPASS_CSR_XPU_IDR0_ADDR A:0xfe0dc074
y.create.l HWIO_LPASS_CSR_XPU_IDR1_ADDR A:0xfe0dc078
y.create.l HWIO_LPASS_CSR_XPU_REV_ADDR A:0xfe0dc07c
y.create.l HWIO_LPASS_CSR_XPU_RG0_RACR0_ADDR A:0xfe0dc200
y.create.l HWIO_LPASS_CSR_XPU_RG1_RACR0_ADDR A:0xfe0dc280
y.create.l HWIO_LPASS_CSR_XPU_RG2_RACR0_ADDR A:0xfe0dc300
y.create.l HWIO_LPASS_CSR_XPU_RG3_RACR0_ADDR A:0xfe0dc380
y.create.l HWIO_LPASS_CSR_XPU_RG4_RACR0_ADDR A:0xfe0dc400
y.create.l HWIO_LPASS_CSR_XPU_RG5_RACR0_ADDR A:0xfe0dc480
y.create.l HWIO_LPASS_CSR_XPU_RG6_RACR0_ADDR A:0xfe0dc500
y.create.l HWIO_LPASS_CSR_XPU_RG7_RACR0_ADDR A:0xfe0dc580
y.create.l HWIO_LPASS_CSR_XPU_RG8_RACR0_ADDR A:0xfe0dc600
y.create.l HWIO_LPASS_CSR_XPU_RG0_WACR0_ADDR A:0xfe0dc220
y.create.l HWIO_LPASS_CSR_XPU_RG1_WACR0_ADDR A:0xfe0dc2a0
y.create.l HWIO_LPASS_CSR_XPU_RG2_WACR0_ADDR A:0xfe0dc320
y.create.l HWIO_LPASS_CSR_XPU_RG3_WACR0_ADDR A:0xfe0dc3a0
y.create.l HWIO_LPASS_CSR_XPU_RG4_WACR0_ADDR A:0xfe0dc420
y.create.l HWIO_LPASS_CSR_XPU_RG5_WACR0_ADDR A:0xfe0dc4a0
y.create.l HWIO_LPASS_CSR_XPU_RG6_WACR0_ADDR A:0xfe0dc520
y.create.l HWIO_LPASS_CSR_XPU_RG7_WACR0_ADDR A:0xfe0dc5a0
y.create.l HWIO_LPASS_CSR_XPU_RG8_WACR0_ADDR A:0xfe0dc620
y.create.l HWIO_LPASS_CSR_XPU_RG0_SCR_ADDR A:0xfe0dc250
y.create.l HWIO_LPASS_CSR_XPU_RG1_SCR_ADDR A:0xfe0dc2d0
y.create.l HWIO_LPASS_CSR_XPU_RG2_SCR_ADDR A:0xfe0dc350
y.create.l HWIO_LPASS_CSR_XPU_RG3_SCR_ADDR A:0xfe0dc3d0
y.create.l HWIO_LPASS_CSR_XPU_RG4_SCR_ADDR A:0xfe0dc450
y.create.l HWIO_LPASS_CSR_XPU_RG5_SCR_ADDR A:0xfe0dc4d0
y.create.l HWIO_LPASS_CSR_XPU_RG6_SCR_ADDR A:0xfe0dc550
y.create.l HWIO_LPASS_CSR_XPU_RG7_SCR_ADDR A:0xfe0dc5d0
y.create.l HWIO_LPASS_CSR_XPU_RG8_SCR_ADDR A:0xfe0dc650
y.create.l HWIO_LPASS_CSR_XPU_RG0_MCR_ADDR A:0xfe0dc254
y.create.l HWIO_LPASS_CSR_XPU_RG1_MCR_ADDR A:0xfe0dc2d4
y.create.l HWIO_LPASS_CSR_XPU_RG2_MCR_ADDR A:0xfe0dc354
y.create.l HWIO_LPASS_CSR_XPU_RG3_MCR_ADDR A:0xfe0dc3d4
y.create.l HWIO_LPASS_CSR_XPU_RG4_MCR_ADDR A:0xfe0dc454
y.create.l HWIO_LPASS_CSR_XPU_RG5_MCR_ADDR A:0xfe0dc4d4
y.create.l HWIO_LPASS_CSR_XPU_RG6_MCR_ADDR A:0xfe0dc554
y.create.l HWIO_LPASS_CSR_XPU_RG7_MCR_ADDR A:0xfe0dc5d4
y.create.l HWIO_LPASS_CSR_XPU_RG8_MCR_ADDR A:0xfe0dc654
y.create.l HWIO_LPASS_CMN_XPU_SCR_ADDR A:0xfe0dd000
y.create.l HWIO_LPASS_CMN_XPU_SWDR_ADDR A:0xfe0dd004
y.create.l HWIO_LPASS_CMN_XPU_SEAR0_ADDR A:0xfe0dd040
y.create.l HWIO_LPASS_CMN_XPU_SESR_ADDR A:0xfe0dd048
y.create.l HWIO_LPASS_CMN_XPU_SESRRESTORE_ADDR A:0xfe0dd04c
y.create.l HWIO_LPASS_CMN_XPU_SESYNR0_ADDR A:0xfe0dd050
y.create.l HWIO_LPASS_CMN_XPU_SESYNR1_ADDR A:0xfe0dd054
y.create.l HWIO_LPASS_CMN_XPU_SESYNR2_ADDR A:0xfe0dd058
y.create.l HWIO_LPASS_CMN_XPU_MCR_ADDR A:0xfe0dd100
y.create.l HWIO_LPASS_CMN_XPU_MEAR0_ADDR A:0xfe0dd140
y.create.l HWIO_LPASS_CMN_XPU_MESR_ADDR A:0xfe0dd148
y.create.l HWIO_LPASS_CMN_XPU_MESRRESTORE_ADDR A:0xfe0dd14c
y.create.l HWIO_LPASS_CMN_XPU_MESYNR0_ADDR A:0xfe0dd150
y.create.l HWIO_LPASS_CMN_XPU_MESYNR1_ADDR A:0xfe0dd154
y.create.l HWIO_LPASS_CMN_XPU_MESYNR2_ADDR A:0xfe0dd158
y.create.l HWIO_LPASS_CMN_XPU_CR_ADDR A:0xfe0dd080
y.create.l HWIO_LPASS_CMN_XPU_RPU_ACR0_ADDR A:0xfe0dd0a0
y.create.l HWIO_LPASS_CMN_XPU_EAR0_ADDR A:0xfe0dd0c0
y.create.l HWIO_LPASS_CMN_XPU_ESR_ADDR A:0xfe0dd0c8
y.create.l HWIO_LPASS_CMN_XPU_ESRRESTORE_ADDR A:0xfe0dd0cc
y.create.l HWIO_LPASS_CMN_XPU_ESYNR0_ADDR A:0xfe0dd0d0
y.create.l HWIO_LPASS_CMN_XPU_ESYNR1_ADDR A:0xfe0dd0d4
y.create.l HWIO_LPASS_CMN_XPU_ESYNR2_ADDR A:0xfe0dd0d8
y.create.l HWIO_LPASS_CMN_XPU_IDR0_ADDR A:0xfe0dd074
y.create.l HWIO_LPASS_CMN_XPU_IDR1_ADDR A:0xfe0dd078
y.create.l HWIO_LPASS_CMN_XPU_REV_ADDR A:0xfe0dd07c
y.create.l HWIO_LPASS_CMN_XPU_RG0_RACR0_ADDR A:0xfe0dd200
y.create.l HWIO_LPASS_CMN_XPU_RG1_RACR0_ADDR A:0xfe0dd280
y.create.l HWIO_LPASS_CMN_XPU_RG2_RACR0_ADDR A:0xfe0dd300
y.create.l HWIO_LPASS_CMN_XPU_RG3_RACR0_ADDR A:0xfe0dd380
y.create.l HWIO_LPASS_CMN_XPU_RG4_RACR0_ADDR A:0xfe0dd400
y.create.l HWIO_LPASS_CMN_XPU_RG5_RACR0_ADDR A:0xfe0dd480
y.create.l HWIO_LPASS_CMN_XPU_RG6_RACR0_ADDR A:0xfe0dd500
y.create.l HWIO_LPASS_CMN_XPU_RG0_SCR_ADDR A:0xfe0dd250
y.create.l HWIO_LPASS_CMN_XPU_RG1_SCR_ADDR A:0xfe0dd2d0
y.create.l HWIO_LPASS_CMN_XPU_RG2_SCR_ADDR A:0xfe0dd350
y.create.l HWIO_LPASS_CMN_XPU_RG3_SCR_ADDR A:0xfe0dd3d0
y.create.l HWIO_LPASS_CMN_XPU_RG4_SCR_ADDR A:0xfe0dd450
y.create.l HWIO_LPASS_CMN_XPU_RG5_SCR_ADDR A:0xfe0dd4d0
y.create.l HWIO_LPASS_CMN_XPU_RG6_SCR_ADDR A:0xfe0dd550
y.create.l HWIO_LPASS_CMN_XPU_RG0_MCR_ADDR A:0xfe0dd254
y.create.l HWIO_LPASS_CMN_XPU_RG1_MCR_ADDR A:0xfe0dd2d4
y.create.l HWIO_LPASS_CMN_XPU_RG2_MCR_ADDR A:0xfe0dd354
y.create.l HWIO_LPASS_CMN_XPU_RG3_MCR_ADDR A:0xfe0dd3d4
y.create.l HWIO_LPASS_CMN_XPU_RG4_MCR_ADDR A:0xfe0dd454
y.create.l HWIO_LPASS_CMN_XPU_RG5_MCR_ADDR A:0xfe0dd4d4
y.create.l HWIO_LPASS_CMN_XPU_RG6_MCR_ADDR A:0xfe0dd554
y.create.l HWIO_LPASS_LPAIF_XPU_SCR_ADDR A:0xfe0ec000
y.create.l HWIO_LPASS_LPAIF_XPU_SWDR_ADDR A:0xfe0ec004
y.create.l HWIO_LPASS_LPAIF_XPU_SEAR0_ADDR A:0xfe0ec040
y.create.l HWIO_LPASS_LPAIF_XPU_SESR_ADDR A:0xfe0ec048
y.create.l HWIO_LPASS_LPAIF_XPU_SESRRESTORE_ADDR A:0xfe0ec04c
y.create.l HWIO_LPASS_LPAIF_XPU_SESYNR0_ADDR A:0xfe0ec050
y.create.l HWIO_LPASS_LPAIF_XPU_SESYNR1_ADDR A:0xfe0ec054
y.create.l HWIO_LPASS_LPAIF_XPU_SESYNR2_ADDR A:0xfe0ec058
y.create.l HWIO_LPASS_LPAIF_XPU_MCR_ADDR A:0xfe0ec100
y.create.l HWIO_LPASS_LPAIF_XPU_MEAR0_ADDR A:0xfe0ec140
y.create.l HWIO_LPASS_LPAIF_XPU_MESR_ADDR A:0xfe0ec148
y.create.l HWIO_LPASS_LPAIF_XPU_MESRRESTORE_ADDR A:0xfe0ec14c
y.create.l HWIO_LPASS_LPAIF_XPU_MESYNR0_ADDR A:0xfe0ec150
y.create.l HWIO_LPASS_LPAIF_XPU_MESYNR1_ADDR A:0xfe0ec154
y.create.l HWIO_LPASS_LPAIF_XPU_MESYNR2_ADDR A:0xfe0ec158
y.create.l HWIO_LPASS_LPAIF_XPU_CR_ADDR A:0xfe0ec080
y.create.l HWIO_LPASS_LPAIF_XPU_RPU_ACR0_ADDR A:0xfe0ec0a0
y.create.l HWIO_LPASS_LPAIF_XPU_EAR0_ADDR A:0xfe0ec0c0
y.create.l HWIO_LPASS_LPAIF_XPU_ESR_ADDR A:0xfe0ec0c8
y.create.l HWIO_LPASS_LPAIF_XPU_ESRRESTORE_ADDR A:0xfe0ec0cc
y.create.l HWIO_LPASS_LPAIF_XPU_ESYNR0_ADDR A:0xfe0ec0d0
y.create.l HWIO_LPASS_LPAIF_XPU_ESYNR1_ADDR A:0xfe0ec0d4
y.create.l HWIO_LPASS_LPAIF_XPU_ESYNR2_ADDR A:0xfe0ec0d8
y.create.l HWIO_LPASS_LPAIF_XPU_IDR0_ADDR A:0xfe0ec074
y.create.l HWIO_LPASS_LPAIF_XPU_IDR1_ADDR A:0xfe0ec078
y.create.l HWIO_LPASS_LPAIF_XPU_REV_ADDR A:0xfe0ec07c
y.create.l HWIO_LPASS_LPAIF_XPU_RG0_RACR0_ADDR A:0xfe0ec200
y.create.l HWIO_LPASS_LPAIF_XPU_RG1_RACR0_ADDR A:0xfe0ec280
y.create.l HWIO_LPASS_LPAIF_XPU_RG2_RACR0_ADDR A:0xfe0ec300
y.create.l HWIO_LPASS_LPAIF_XPU_RG3_RACR0_ADDR A:0xfe0ec380
y.create.l HWIO_LPASS_LPAIF_XPU_RG4_RACR0_ADDR A:0xfe0ec400
y.create.l HWIO_LPASS_LPAIF_XPU_RG5_RACR0_ADDR A:0xfe0ec480
y.create.l HWIO_LPASS_LPAIF_XPU_RG6_RACR0_ADDR A:0xfe0ec500
y.create.l HWIO_LPASS_LPAIF_XPU_RG7_RACR0_ADDR A:0xfe0ec580
y.create.l HWIO_LPASS_LPAIF_XPU_RG8_RACR0_ADDR A:0xfe0ec600
y.create.l HWIO_LPASS_LPAIF_XPU_RG9_RACR0_ADDR A:0xfe0ec680
y.create.l HWIO_LPASS_LPAIF_XPU_RG0_WACR0_ADDR A:0xfe0ec220
y.create.l HWIO_LPASS_LPAIF_XPU_RG1_WACR0_ADDR A:0xfe0ec2a0
y.create.l HWIO_LPASS_LPAIF_XPU_RG2_WACR0_ADDR A:0xfe0ec320
y.create.l HWIO_LPASS_LPAIF_XPU_RG3_WACR0_ADDR A:0xfe0ec3a0
y.create.l HWIO_LPASS_LPAIF_XPU_RG4_WACR0_ADDR A:0xfe0ec420
y.create.l HWIO_LPASS_LPAIF_XPU_RG5_WACR0_ADDR A:0xfe0ec4a0
y.create.l HWIO_LPASS_LPAIF_XPU_RG6_WACR0_ADDR A:0xfe0ec520
y.create.l HWIO_LPASS_LPAIF_XPU_RG7_WACR0_ADDR A:0xfe0ec5a0
y.create.l HWIO_LPASS_LPAIF_XPU_RG8_WACR0_ADDR A:0xfe0ec620
y.create.l HWIO_LPASS_LPAIF_XPU_RG9_WACR0_ADDR A:0xfe0ec6a0
y.create.l HWIO_LPASS_LPAIF_XPU_RG0_SCR_ADDR A:0xfe0ec250
y.create.l HWIO_LPASS_LPAIF_XPU_RG1_SCR_ADDR A:0xfe0ec2d0
y.create.l HWIO_LPASS_LPAIF_XPU_RG2_SCR_ADDR A:0xfe0ec350
y.create.l HWIO_LPASS_LPAIF_XPU_RG3_SCR_ADDR A:0xfe0ec3d0
y.create.l HWIO_LPASS_LPAIF_XPU_RG4_SCR_ADDR A:0xfe0ec450
y.create.l HWIO_LPASS_LPAIF_XPU_RG5_SCR_ADDR A:0xfe0ec4d0
y.create.l HWIO_LPASS_LPAIF_XPU_RG6_SCR_ADDR A:0xfe0ec550
y.create.l HWIO_LPASS_LPAIF_XPU_RG7_SCR_ADDR A:0xfe0ec5d0
y.create.l HWIO_LPASS_LPAIF_XPU_RG8_SCR_ADDR A:0xfe0ec650
y.create.l HWIO_LPASS_LPAIF_XPU_RG9_SCR_ADDR A:0xfe0ec6d0
y.create.l HWIO_LPASS_LPAIF_XPU_RG0_MCR_ADDR A:0xfe0ec254
y.create.l HWIO_LPASS_LPAIF_XPU_RG1_MCR_ADDR A:0xfe0ec2d4
y.create.l HWIO_LPASS_LPAIF_XPU_RG2_MCR_ADDR A:0xfe0ec354
y.create.l HWIO_LPASS_LPAIF_XPU_RG3_MCR_ADDR A:0xfe0ec3d4
y.create.l HWIO_LPASS_LPAIF_XPU_RG4_MCR_ADDR A:0xfe0ec454
y.create.l HWIO_LPASS_LPAIF_XPU_RG5_MCR_ADDR A:0xfe0ec4d4
y.create.l HWIO_LPASS_LPAIF_XPU_RG6_MCR_ADDR A:0xfe0ec554
y.create.l HWIO_LPASS_LPAIF_XPU_RG7_MCR_ADDR A:0xfe0ec5d4
y.create.l HWIO_LPASS_LPAIF_XPU_RG8_MCR_ADDR A:0xfe0ec654
y.create.l HWIO_LPASS_LPAIF_XPU_RG9_MCR_ADDR A:0xfe0ec6d4
y.create.l HWIO_LPASS_LPAIF_VERSION_ADDR A:0xfe140000
y.create.l HWIO_LPASS_LPAIF_PCM_CTL0_ADDR A:0xfe140010
y.create.l HWIO_LPASS_LPAIF_PCM_CTL1_ADDR A:0xfe141010
y.create.l HWIO_LPASS_LPAIF_PCM_SLOT_CTL0_ADDR A:0xfe140014
y.create.l HWIO_LPASS_LPAIF_PCM_SLOT_CTL1_ADDR A:0xfe141014
y.create.l HWIO_LPASS_LPAIF_I2S_CTL0_ADDR A:0xfe144000
y.create.l HWIO_LPASS_LPAIF_I2S_CTL1_ADDR A:0xfe145000
y.create.l HWIO_LPASS_LPAIF_DMIC_CTL_ADDR A:0xfe14c000
y.create.l HWIO_LPASS_LPAIF_DMIC_VOL_CTL0_ADDR A:0xfe14c010
y.create.l HWIO_LPASS_LPAIF_DMIC_VOL_CTL1_ADDR A:0xfe14c014
y.create.l HWIO_LPASS_LPAIF_WRDMA_LPBK_MIX_ADDR A:0xfe14d000
y.create.l HWIO_LPASS_LPAIF_MIXER_CTL_ADDR A:0xfe14e000
y.create.l HWIO_LPASS_LPAIF_IRQ_EN0_ADDR A:0xfe14f000
y.create.l HWIO_LPASS_LPAIF_IRQ_EN1_ADDR A:0xfe150000
y.create.l HWIO_LPASS_LPAIF_IRQ_EN2_ADDR A:0xfe151000
y.create.l HWIO_LPASS_LPAIF_IRQ_STAT0_ADDR A:0xfe14f004
y.create.l HWIO_LPASS_LPAIF_IRQ_STAT1_ADDR A:0xfe150004
y.create.l HWIO_LPASS_LPAIF_IRQ_STAT2_ADDR A:0xfe151004
y.create.l HWIO_LPASS_LPAIF_IRQ_RAW_STAT0_ADDR A:0xfe14f008
y.create.l HWIO_LPASS_LPAIF_IRQ_RAW_STAT1_ADDR A:0xfe150008
y.create.l HWIO_LPASS_LPAIF_IRQ_RAW_STAT2_ADDR A:0xfe151008
y.create.l HWIO_LPASS_LPAIF_IRQ_CLEAR0_ADDR A:0xfe14f00c
y.create.l HWIO_LPASS_LPAIF_IRQ_CLEAR1_ADDR A:0xfe15000c
y.create.l HWIO_LPASS_LPAIF_IRQ_CLEAR2_ADDR A:0xfe15100c
y.create.l HWIO_LPASS_LPAIF_IRQ_FORCE0_ADDR A:0xfe14f010
y.create.l HWIO_LPASS_LPAIF_IRQ_FORCE1_ADDR A:0xfe150010
y.create.l HWIO_LPASS_LPAIF_IRQ_FORCE2_ADDR A:0xfe151010
y.create.l HWIO_LPASS_LPAIF_RDDMA_CTL0_ADDR A:0xfe152000
y.create.l HWIO_LPASS_LPAIF_RDDMA_CTL1_ADDR A:0xfe153000
y.create.l HWIO_LPASS_LPAIF_RDDMA_BASE0_ADDR A:0xfe152004
y.create.l HWIO_LPASS_LPAIF_RDDMA_BASE1_ADDR A:0xfe153004
y.create.l HWIO_LPASS_LPAIF_RDDMA_BUFF_LEN0_ADDR A:0xfe152008
y.create.l HWIO_LPASS_LPAIF_RDDMA_BUFF_LEN1_ADDR A:0xfe153008
y.create.l HWIO_LPASS_LPAIF_RDDMA_CURR_ADDR0_ADDR A:0xfe15200c
y.create.l HWIO_LPASS_LPAIF_RDDMA_CURR_ADDR1_ADDR A:0xfe15300c
y.create.l HWIO_LPASS_LPAIF_RDDMA_PER_LEN0_ADDR A:0xfe152010
y.create.l HWIO_LPASS_LPAIF_RDDMA_PER_LEN1_ADDR A:0xfe153010
y.create.l HWIO_LPASS_LPAIF_RDDMA_PER_CNT0_ADDR A:0xfe152014
y.create.l HWIO_LPASS_LPAIF_RDDMA_PER_CNT1_ADDR A:0xfe153014
y.create.l HWIO_LPASS_LPAIF_RDDMA_FRM0_ADDR A:0xfe152018
y.create.l HWIO_LPASS_LPAIF_RDDMA_FRM1_ADDR A:0xfe153018
y.create.l HWIO_LPASS_LPAIF_RDDMA_FRMCLR0_ADDR A:0xfe15201c
y.create.l HWIO_LPASS_LPAIF_RDDMA_FRMCLR1_ADDR A:0xfe15301c
y.create.l HWIO_LPASS_LPAIF_RDDMA_SET_BUFF_CNT0_ADDR A:0xfe152020
y.create.l HWIO_LPASS_LPAIF_RDDMA_SET_BUFF_CNT1_ADDR A:0xfe153020
y.create.l HWIO_LPASS_LPAIF_RDDMA_SET_PER_CNT0_ADDR A:0xfe152024
y.create.l HWIO_LPASS_LPAIF_RDDMA_SET_PER_CNT1_ADDR A:0xfe153024
y.create.l HWIO_LPASS_LPAIF_RDDMA_STC_LSB0_ADDR A:0xfe152028
y.create.l HWIO_LPASS_LPAIF_RDDMA_STC_LSB1_ADDR A:0xfe153028
y.create.l HWIO_LPASS_LPAIF_RDDMA_STC_MSB0_ADDR A:0xfe15202c
y.create.l HWIO_LPASS_LPAIF_RDDMA_STC_MSB1_ADDR A:0xfe15302c
y.create.l HWIO_LPASS_LPAIF_RDDMA_PER0_ADDR A:0xfe152030
y.create.l HWIO_LPASS_LPAIF_RDDMA_PER1_ADDR A:0xfe153030
y.create.l HWIO_LPASS_LPAIF_RDDMA_PERCLR0_ADDR A:0xfe152034
y.create.l HWIO_LPASS_LPAIF_RDDMA_PERCLR1_ADDR A:0xfe153034
y.create.l HWIO_LPASS_LPAIF_WRDMA_CTL0_ADDR A:0xfe158000
y.create.l HWIO_LPASS_LPAIF_WRDMA_CTL1_ADDR A:0xfe159000
y.create.l HWIO_LPASS_LPAIF_WRDMA_BASE0_ADDR A:0xfe158004
y.create.l HWIO_LPASS_LPAIF_WRDMA_BASE1_ADDR A:0xfe159004
y.create.l HWIO_LPASS_LPAIF_WRDMA_BUFF_LEN0_ADDR A:0xfe158008
y.create.l HWIO_LPASS_LPAIF_WRDMA_BUFF_LEN1_ADDR A:0xfe159008
y.create.l HWIO_LPASS_LPAIF_WRDMA_CURR_ADDR0_ADDR A:0xfe15800c
y.create.l HWIO_LPASS_LPAIF_WRDMA_CURR_ADDR1_ADDR A:0xfe15900c
y.create.l HWIO_LPASS_LPAIF_WRDMA_PER_LEN0_ADDR A:0xfe158010
y.create.l HWIO_LPASS_LPAIF_WRDMA_PER_LEN1_ADDR A:0xfe159010
y.create.l HWIO_LPASS_LPAIF_WRDMA_PER_CNT0_ADDR A:0xfe158014
y.create.l HWIO_LPASS_LPAIF_WRDMA_PER_CNT1_ADDR A:0xfe159014
y.create.l HWIO_LPASS_LPAIF_WRDMA_FRM0_ADDR A:0xfe158018
y.create.l HWIO_LPASS_LPAIF_WRDMA_FRM1_ADDR A:0xfe159018
y.create.l HWIO_LPASS_LPAIF_WRDMA_FRMCLR0_ADDR A:0xfe15801c
y.create.l HWIO_LPASS_LPAIF_WRDMA_FRMCLR1_ADDR A:0xfe15901c
y.create.l HWIO_LPASS_LPAIF_WRDMA_SET_BUFF_CNT0_ADDR A:0xfe158020
y.create.l HWIO_LPASS_LPAIF_WRDMA_SET_BUFF_CNT1_ADDR A:0xfe159020
y.create.l HWIO_LPASS_LPAIF_WRDMA_SET_PER_CNT0_ADDR A:0xfe158024
y.create.l HWIO_LPASS_LPAIF_WRDMA_SET_PER_CNT1_ADDR A:0xfe159024
y.create.l HWIO_LPASS_LPAIF_WRDMA_STC_LSB0_ADDR A:0xfe158028
y.create.l HWIO_LPASS_LPAIF_WRDMA_STC_LSB1_ADDR A:0xfe159028
y.create.l HWIO_LPASS_LPAIF_WRDMA_STC_MSB0_ADDR A:0xfe15802c
y.create.l HWIO_LPASS_LPAIF_WRDMA_STC_MSB1_ADDR A:0xfe15902c
y.create.l HWIO_LPASS_LPAIF_WRDMA_PER0_ADDR A:0xfe158030
y.create.l HWIO_LPASS_LPAIF_WRDMA_PER1_ADDR A:0xfe159030
y.create.l HWIO_LPASS_LPAIF_WRDMA_PERCLR0_ADDR A:0xfe158034
y.create.l HWIO_LPASS_LPAIF_WRDMA_PERCLR1_ADDR A:0xfe159034
y.create.l HWIO_LPASS_LPAIF_EXT_VFR_ADDR A:0xfe15e000
y.create.l HWIO_LPASS_LPAIF_DEBUG_CTL_ADDR A:0xfe15e004
y.create.l HWIO_LPASS_LPAIF_SPARE_ADDR A:0xfe15e100
y.create.l HWIO_LPASS_SB_BAM_CTRL_ADDR A:0xfe184000
y.create.l HWIO_LPASS_SB_BAM_REVISION_ADDR A:0xfe184004
y.create.l HWIO_LPASS_SB_BAM_SW_VERSION_ADDR A:0xfe184080
y.create.l HWIO_LPASS_SB_BAM_NUM_PIPES_ADDR A:0xfe18403c
y.create.l HWIO_LPASS_SB_BAM_TIMER_ADDR A:0xfe184040
y.create.l HWIO_LPASS_SB_BAM_TIMER_CTRL_ADDR A:0xfe184044
y.create.l HWIO_LPASS_SB_BAM_DESC_CNT_TRSHLD_ADDR A:0xfe184008
y.create.l HWIO_LPASS_SB_BAM_IRQ_SRCS_ADDR A:0xfe18400c
y.create.l HWIO_LPASS_SB_BAM_IRQ_SRCS_MSK_ADDR A:0xfe184010
y.create.l HWIO_LPASS_SB_BAM_IRQ_SRCS_UNMASKED_ADDR A:0xfe184030
y.create.l HWIO_LPASS_SB_BAM_IRQ_STTS_ADDR A:0xfe184014
y.create.l HWIO_LPASS_SB_BAM_IRQ_CLR_ADDR A:0xfe184018
y.create.l HWIO_LPASS_SB_BAM_IRQ_EN_ADDR A:0xfe18401c
y.create.l HWIO_LPASS_SB_BAM_AHB_MASTER_ERR_CTRLS_ADDR A:0xfe184024
y.create.l HWIO_LPASS_SB_BAM_AHB_MASTER_ERR_ADDR_ADDR A:0xfe184028
y.create.l HWIO_LPASS_SB_BAM_AHB_MASTER_ERR_ADDR_LSB_ADDR A:0xfe184100
y.create.l HWIO_LPASS_SB_BAM_AHB_MASTER_ERR_ADDR_MSB_ADDR A:0xfe184104
y.create.l HWIO_LPASS_SB_BAM_AHB_MASTER_ERR_DATA_ADDR A:0xfe18402c
y.create.l HWIO_LPASS_SB_BAM_TRUST_REG_ADDR A:0xfe184070
y.create.l HWIO_LPASS_SB_BAM_TEST_BUS_SEL_ADDR A:0xfe184074
y.create.l HWIO_LPASS_SB_BAM_TEST_BUS_REG_ADDR A:0xfe184078
y.create.l HWIO_LPASS_SB_BAM_CNFG_BITS_ADDR A:0xfe18407c
y.create.l HWIO_LPASS_SB_BAM_IRQ_SRCS_EE0_ADDR A:0xfe184800
y.create.l HWIO_LPASS_SB_BAM_IRQ_SRCS_EE1_ADDR A:0xfe184880
y.create.l HWIO_LPASS_SB_BAM_IRQ_SRCS_EE2_ADDR A:0xfe184900
y.create.l HWIO_LPASS_SB_BAM_IRQ_SRCS_EE3_ADDR A:0xfe184980
y.create.l HWIO_LPASS_SB_BAM_IRQ_SRCS_EE4_ADDR A:0xfe184a00
y.create.l HWIO_LPASS_SB_BAM_IRQ_SRCS_EE5_ADDR A:0xfe184a80
y.create.l HWIO_LPASS_SB_BAM_IRQ_SRCS_EE6_ADDR A:0xfe184b00
y.create.l HWIO_LPASS_SB_BAM_IRQ_SRCS_EE7_ADDR A:0xfe184b80
y.create.l HWIO_LPASS_SB_BAM_IRQ_SRCS_MSK_EE0_ADDR A:0xfe184804
y.create.l HWIO_LPASS_SB_BAM_IRQ_SRCS_MSK_EE1_ADDR A:0xfe184884
y.create.l HWIO_LPASS_SB_BAM_IRQ_SRCS_MSK_EE2_ADDR A:0xfe184904
y.create.l HWIO_LPASS_SB_BAM_IRQ_SRCS_MSK_EE3_ADDR A:0xfe184984
y.create.l HWIO_LPASS_SB_BAM_IRQ_SRCS_MSK_EE4_ADDR A:0xfe184a04
y.create.l HWIO_LPASS_SB_BAM_IRQ_SRCS_MSK_EE5_ADDR A:0xfe184a84
y.create.l HWIO_LPASS_SB_BAM_IRQ_SRCS_MSK_EE6_ADDR A:0xfe184b04
y.create.l HWIO_LPASS_SB_BAM_IRQ_SRCS_MSK_EE7_ADDR A:0xfe184b84
y.create.l HWIO_LPASS_SB_BAM_IRQ_SRCS_UNMASKED_EE0_ADDR A:0xfe184808
y.create.l HWIO_LPASS_SB_BAM_IRQ_SRCS_UNMASKED_EE1_ADDR A:0xfe184888
y.create.l HWIO_LPASS_SB_BAM_IRQ_SRCS_UNMASKED_EE2_ADDR A:0xfe184908
y.create.l HWIO_LPASS_SB_BAM_IRQ_SRCS_UNMASKED_EE3_ADDR A:0xfe184988
y.create.l HWIO_LPASS_SB_BAM_IRQ_SRCS_UNMASKED_EE4_ADDR A:0xfe184a08
y.create.l HWIO_LPASS_SB_BAM_IRQ_SRCS_UNMASKED_EE5_ADDR A:0xfe184a88
y.create.l HWIO_LPASS_SB_BAM_IRQ_SRCS_UNMASKED_EE6_ADDR A:0xfe184b08
y.create.l HWIO_LPASS_SB_BAM_IRQ_SRCS_UNMASKED_EE7_ADDR A:0xfe184b88
y.create.l HWIO_LPASS_SB_BAM_PIPE_ATTR_EE0_ADDR A:0xfe18480c
y.create.l HWIO_LPASS_SB_BAM_PIPE_ATTR_EE1_ADDR A:0xfe18488c
y.create.l HWIO_LPASS_SB_BAM_PIPE_ATTR_EE2_ADDR A:0xfe18490c
y.create.l HWIO_LPASS_SB_BAM_PIPE_ATTR_EE3_ADDR A:0xfe18498c
y.create.l HWIO_LPASS_SB_BAM_PIPE_ATTR_EE4_ADDR A:0xfe184a0c
y.create.l HWIO_LPASS_SB_BAM_PIPE_ATTR_EE5_ADDR A:0xfe184a8c
y.create.l HWIO_LPASS_SB_BAM_PIPE_ATTR_EE6_ADDR A:0xfe184b0c
y.create.l HWIO_LPASS_SB_BAM_PIPE_ATTR_EE7_ADDR A:0xfe184b8c
y.create.l HWIO_LPASS_SB_BAM_P_CTRL0_ADDR A:0xfe185000
y.create.l HWIO_LPASS_SB_BAM_P_CTRL1_ADDR A:0xfe186000
y.create.l HWIO_LPASS_SB_BAM_P_CTRL2_ADDR A:0xfe187000
y.create.l HWIO_LPASS_SB_BAM_P_CTRL3_ADDR A:0xfe188000
y.create.l HWIO_LPASS_SB_BAM_P_CTRL4_ADDR A:0xfe189000
y.create.l HWIO_LPASS_SB_BAM_P_CTRL5_ADDR A:0xfe18a000
y.create.l HWIO_LPASS_SB_BAM_P_CTRL6_ADDR A:0xfe18b000
y.create.l HWIO_LPASS_SB_BAM_P_CTRL7_ADDR A:0xfe18c000
y.create.l HWIO_LPASS_SB_BAM_P_CTRL8_ADDR A:0xfe18d000
y.create.l HWIO_LPASS_SB_BAM_P_CTRL9_ADDR A:0xfe18e000
y.create.l HWIO_LPASS_SB_BAM_P_RST0_ADDR A:0xfe185004
y.create.l HWIO_LPASS_SB_BAM_P_RST1_ADDR A:0xfe186004
y.create.l HWIO_LPASS_SB_BAM_P_RST2_ADDR A:0xfe187004
y.create.l HWIO_LPASS_SB_BAM_P_RST3_ADDR A:0xfe188004
y.create.l HWIO_LPASS_SB_BAM_P_RST4_ADDR A:0xfe189004
y.create.l HWIO_LPASS_SB_BAM_P_RST5_ADDR A:0xfe18a004
y.create.l HWIO_LPASS_SB_BAM_P_RST6_ADDR A:0xfe18b004
y.create.l HWIO_LPASS_SB_BAM_P_RST7_ADDR A:0xfe18c004
y.create.l HWIO_LPASS_SB_BAM_P_RST8_ADDR A:0xfe18d004
y.create.l HWIO_LPASS_SB_BAM_P_RST9_ADDR A:0xfe18e004
y.create.l HWIO_LPASS_SB_BAM_P_HALT0_ADDR A:0xfe185008
y.create.l HWIO_LPASS_SB_BAM_P_HALT1_ADDR A:0xfe186008
y.create.l HWIO_LPASS_SB_BAM_P_HALT2_ADDR A:0xfe187008
y.create.l HWIO_LPASS_SB_BAM_P_HALT3_ADDR A:0xfe188008
y.create.l HWIO_LPASS_SB_BAM_P_HALT4_ADDR A:0xfe189008
y.create.l HWIO_LPASS_SB_BAM_P_HALT5_ADDR A:0xfe18a008
y.create.l HWIO_LPASS_SB_BAM_P_HALT6_ADDR A:0xfe18b008
y.create.l HWIO_LPASS_SB_BAM_P_HALT7_ADDR A:0xfe18c008
y.create.l HWIO_LPASS_SB_BAM_P_HALT8_ADDR A:0xfe18d008
y.create.l HWIO_LPASS_SB_BAM_P_HALT9_ADDR A:0xfe18e008
y.create.l HWIO_LPASS_SB_BAM_P_TRUST_REG0_ADDR A:0xfe185030
y.create.l HWIO_LPASS_SB_BAM_P_TRUST_REG1_ADDR A:0xfe186030
y.create.l HWIO_LPASS_SB_BAM_P_TRUST_REG2_ADDR A:0xfe187030
y.create.l HWIO_LPASS_SB_BAM_P_TRUST_REG3_ADDR A:0xfe188030
y.create.l HWIO_LPASS_SB_BAM_P_TRUST_REG4_ADDR A:0xfe189030
y.create.l HWIO_LPASS_SB_BAM_P_TRUST_REG5_ADDR A:0xfe18a030
y.create.l HWIO_LPASS_SB_BAM_P_TRUST_REG6_ADDR A:0xfe18b030
y.create.l HWIO_LPASS_SB_BAM_P_TRUST_REG7_ADDR A:0xfe18c030
y.create.l HWIO_LPASS_SB_BAM_P_TRUST_REG8_ADDR A:0xfe18d030
y.create.l HWIO_LPASS_SB_BAM_P_TRUST_REG9_ADDR A:0xfe18e030
y.create.l HWIO_LPASS_SB_BAM_P_IRQ_STTS0_ADDR A:0xfe185010
y.create.l HWIO_LPASS_SB_BAM_P_IRQ_STTS1_ADDR A:0xfe186010
y.create.l HWIO_LPASS_SB_BAM_P_IRQ_STTS2_ADDR A:0xfe187010
y.create.l HWIO_LPASS_SB_BAM_P_IRQ_STTS3_ADDR A:0xfe188010
y.create.l HWIO_LPASS_SB_BAM_P_IRQ_STTS4_ADDR A:0xfe189010
y.create.l HWIO_LPASS_SB_BAM_P_IRQ_STTS5_ADDR A:0xfe18a010
y.create.l HWIO_LPASS_SB_BAM_P_IRQ_STTS6_ADDR A:0xfe18b010
y.create.l HWIO_LPASS_SB_BAM_P_IRQ_STTS7_ADDR A:0xfe18c010
y.create.l HWIO_LPASS_SB_BAM_P_IRQ_STTS8_ADDR A:0xfe18d010
y.create.l HWIO_LPASS_SB_BAM_P_IRQ_STTS9_ADDR A:0xfe18e010
y.create.l HWIO_LPASS_SB_BAM_P_IRQ_CLR0_ADDR A:0xfe185014
y.create.l HWIO_LPASS_SB_BAM_P_IRQ_CLR1_ADDR A:0xfe186014
y.create.l HWIO_LPASS_SB_BAM_P_IRQ_CLR2_ADDR A:0xfe187014
y.create.l HWIO_LPASS_SB_BAM_P_IRQ_CLR3_ADDR A:0xfe188014
y.create.l HWIO_LPASS_SB_BAM_P_IRQ_CLR4_ADDR A:0xfe189014
y.create.l HWIO_LPASS_SB_BAM_P_IRQ_CLR5_ADDR A:0xfe18a014
y.create.l HWIO_LPASS_SB_BAM_P_IRQ_CLR6_ADDR A:0xfe18b014
y.create.l HWIO_LPASS_SB_BAM_P_IRQ_CLR7_ADDR A:0xfe18c014
y.create.l HWIO_LPASS_SB_BAM_P_IRQ_CLR8_ADDR A:0xfe18d014
y.create.l HWIO_LPASS_SB_BAM_P_IRQ_CLR9_ADDR A:0xfe18e014
y.create.l HWIO_LPASS_SB_BAM_P_IRQ_EN0_ADDR A:0xfe185018
y.create.l HWIO_LPASS_SB_BAM_P_IRQ_EN1_ADDR A:0xfe186018
y.create.l HWIO_LPASS_SB_BAM_P_IRQ_EN2_ADDR A:0xfe187018
y.create.l HWIO_LPASS_SB_BAM_P_IRQ_EN3_ADDR A:0xfe188018
y.create.l HWIO_LPASS_SB_BAM_P_IRQ_EN4_ADDR A:0xfe189018
y.create.l HWIO_LPASS_SB_BAM_P_IRQ_EN5_ADDR A:0xfe18a018
y.create.l HWIO_LPASS_SB_BAM_P_IRQ_EN6_ADDR A:0xfe18b018
y.create.l HWIO_LPASS_SB_BAM_P_IRQ_EN7_ADDR A:0xfe18c018
y.create.l HWIO_LPASS_SB_BAM_P_IRQ_EN8_ADDR A:0xfe18d018
y.create.l HWIO_LPASS_SB_BAM_P_IRQ_EN9_ADDR A:0xfe18e018
y.create.l HWIO_LPASS_SB_BAM_P_TIMER0_ADDR A:0xfe18501c
y.create.l HWIO_LPASS_SB_BAM_P_TIMER1_ADDR A:0xfe18601c
y.create.l HWIO_LPASS_SB_BAM_P_TIMER2_ADDR A:0xfe18701c
y.create.l HWIO_LPASS_SB_BAM_P_TIMER3_ADDR A:0xfe18801c
y.create.l HWIO_LPASS_SB_BAM_P_TIMER4_ADDR A:0xfe18901c
y.create.l HWIO_LPASS_SB_BAM_P_TIMER5_ADDR A:0xfe18a01c
y.create.l HWIO_LPASS_SB_BAM_P_TIMER6_ADDR A:0xfe18b01c
y.create.l HWIO_LPASS_SB_BAM_P_TIMER7_ADDR A:0xfe18c01c
y.create.l HWIO_LPASS_SB_BAM_P_TIMER8_ADDR A:0xfe18d01c
y.create.l HWIO_LPASS_SB_BAM_P_TIMER9_ADDR A:0xfe18e01c
y.create.l HWIO_LPASS_SB_BAM_P_TIMER_CTRL0_ADDR A:0xfe185020
y.create.l HWIO_LPASS_SB_BAM_P_TIMER_CTRL1_ADDR A:0xfe186020
y.create.l HWIO_LPASS_SB_BAM_P_TIMER_CTRL2_ADDR A:0xfe187020
y.create.l HWIO_LPASS_SB_BAM_P_TIMER_CTRL3_ADDR A:0xfe188020
y.create.l HWIO_LPASS_SB_BAM_P_TIMER_CTRL4_ADDR A:0xfe189020
y.create.l HWIO_LPASS_SB_BAM_P_TIMER_CTRL5_ADDR A:0xfe18a020
y.create.l HWIO_LPASS_SB_BAM_P_TIMER_CTRL6_ADDR A:0xfe18b020
y.create.l HWIO_LPASS_SB_BAM_P_TIMER_CTRL7_ADDR A:0xfe18c020
y.create.l HWIO_LPASS_SB_BAM_P_TIMER_CTRL8_ADDR A:0xfe18d020
y.create.l HWIO_LPASS_SB_BAM_P_TIMER_CTRL9_ADDR A:0xfe18e020
y.create.l HWIO_LPASS_SB_BAM_P_PRDCR_SDBND0_ADDR A:0xfe185024
y.create.l HWIO_LPASS_SB_BAM_P_PRDCR_SDBND1_ADDR A:0xfe186024
y.create.l HWIO_LPASS_SB_BAM_P_PRDCR_SDBND2_ADDR A:0xfe187024
y.create.l HWIO_LPASS_SB_BAM_P_PRDCR_SDBND3_ADDR A:0xfe188024
y.create.l HWIO_LPASS_SB_BAM_P_PRDCR_SDBND4_ADDR A:0xfe189024
y.create.l HWIO_LPASS_SB_BAM_P_PRDCR_SDBND5_ADDR A:0xfe18a024
y.create.l HWIO_LPASS_SB_BAM_P_PRDCR_SDBND6_ADDR A:0xfe18b024
y.create.l HWIO_LPASS_SB_BAM_P_PRDCR_SDBND7_ADDR A:0xfe18c024
y.create.l HWIO_LPASS_SB_BAM_P_PRDCR_SDBND8_ADDR A:0xfe18d024
y.create.l HWIO_LPASS_SB_BAM_P_PRDCR_SDBND9_ADDR A:0xfe18e024
y.create.l HWIO_LPASS_SB_BAM_P_CNSMR_SDBND0_ADDR A:0xfe185028
y.create.l HWIO_LPASS_SB_BAM_P_CNSMR_SDBND1_ADDR A:0xfe186028
y.create.l HWIO_LPASS_SB_BAM_P_CNSMR_SDBND2_ADDR A:0xfe187028
y.create.l HWIO_LPASS_SB_BAM_P_CNSMR_SDBND3_ADDR A:0xfe188028
y.create.l HWIO_LPASS_SB_BAM_P_CNSMR_SDBND4_ADDR A:0xfe189028
y.create.l HWIO_LPASS_SB_BAM_P_CNSMR_SDBND5_ADDR A:0xfe18a028
y.create.l HWIO_LPASS_SB_BAM_P_CNSMR_SDBND6_ADDR A:0xfe18b028
y.create.l HWIO_LPASS_SB_BAM_P_CNSMR_SDBND7_ADDR A:0xfe18c028
y.create.l HWIO_LPASS_SB_BAM_P_CNSMR_SDBND8_ADDR A:0xfe18d028
y.create.l HWIO_LPASS_SB_BAM_P_CNSMR_SDBND9_ADDR A:0xfe18e028
y.create.l HWIO_LPASS_SB_BAM_P_EVNT_DEST_ADDR0_ADDR A:0xfe18582c
y.create.l HWIO_LPASS_SB_BAM_P_EVNT_DEST_ADDR1_ADDR A:0xfe18682c
y.create.l HWIO_LPASS_SB_BAM_P_EVNT_DEST_ADDR2_ADDR A:0xfe18782c
y.create.l HWIO_LPASS_SB_BAM_P_EVNT_DEST_ADDR3_ADDR A:0xfe18882c
y.create.l HWIO_LPASS_SB_BAM_P_EVNT_DEST_ADDR4_ADDR A:0xfe18982c
y.create.l HWIO_LPASS_SB_BAM_P_EVNT_DEST_ADDR5_ADDR A:0xfe18a82c
y.create.l HWIO_LPASS_SB_BAM_P_EVNT_DEST_ADDR6_ADDR A:0xfe18b82c
y.create.l HWIO_LPASS_SB_BAM_P_EVNT_DEST_ADDR7_ADDR A:0xfe18c82c
y.create.l HWIO_LPASS_SB_BAM_P_EVNT_DEST_ADDR8_ADDR A:0xfe18d82c
y.create.l HWIO_LPASS_SB_BAM_P_EVNT_DEST_ADDR9_ADDR A:0xfe18e82c
y.create.l HWIO_LPASS_SB_BAM_P_EVNT_DEST_ADDR_LSB0_ADDR A:0xfe185930
y.create.l HWIO_LPASS_SB_BAM_P_EVNT_DEST_ADDR_LSB1_ADDR A:0xfe186930
y.create.l HWIO_LPASS_SB_BAM_P_EVNT_DEST_ADDR_LSB2_ADDR A:0xfe187930
y.create.l HWIO_LPASS_SB_BAM_P_EVNT_DEST_ADDR_LSB3_ADDR A:0xfe188930
y.create.l HWIO_LPASS_SB_BAM_P_EVNT_DEST_ADDR_LSB4_ADDR A:0xfe189930
y.create.l HWIO_LPASS_SB_BAM_P_EVNT_DEST_ADDR_LSB5_ADDR A:0xfe18a930
y.create.l HWIO_LPASS_SB_BAM_P_EVNT_DEST_ADDR_LSB6_ADDR A:0xfe18b930
y.create.l HWIO_LPASS_SB_BAM_P_EVNT_DEST_ADDR_LSB7_ADDR A:0xfe18c930
y.create.l HWIO_LPASS_SB_BAM_P_EVNT_DEST_ADDR_LSB8_ADDR A:0xfe18d930
y.create.l HWIO_LPASS_SB_BAM_P_EVNT_DEST_ADDR_LSB9_ADDR A:0xfe18e930
y.create.l HWIO_LPASS_SB_BAM_P_EVNT_DEST_ADDR_MSB0_ADDR A:0xfe185934
y.create.l HWIO_LPASS_SB_BAM_P_EVNT_DEST_ADDR_MSB1_ADDR A:0xfe186934
y.create.l HWIO_LPASS_SB_BAM_P_EVNT_DEST_ADDR_MSB2_ADDR A:0xfe187934
y.create.l HWIO_LPASS_SB_BAM_P_EVNT_DEST_ADDR_MSB3_ADDR A:0xfe188934
y.create.l HWIO_LPASS_SB_BAM_P_EVNT_DEST_ADDR_MSB4_ADDR A:0xfe189934
y.create.l HWIO_LPASS_SB_BAM_P_EVNT_DEST_ADDR_MSB5_ADDR A:0xfe18a934
y.create.l HWIO_LPASS_SB_BAM_P_EVNT_DEST_ADDR_MSB6_ADDR A:0xfe18b934
y.create.l HWIO_LPASS_SB_BAM_P_EVNT_DEST_ADDR_MSB7_ADDR A:0xfe18c934
y.create.l HWIO_LPASS_SB_BAM_P_EVNT_DEST_ADDR_MSB8_ADDR A:0xfe18d934
y.create.l HWIO_LPASS_SB_BAM_P_EVNT_DEST_ADDR_MSB9_ADDR A:0xfe18e934
y.create.l HWIO_LPASS_SB_BAM_P_EVNT_REG0_ADDR A:0xfe185818
y.create.l HWIO_LPASS_SB_BAM_P_EVNT_REG1_ADDR A:0xfe186818
y.create.l HWIO_LPASS_SB_BAM_P_EVNT_REG2_ADDR A:0xfe187818
y.create.l HWIO_LPASS_SB_BAM_P_EVNT_REG3_ADDR A:0xfe188818
y.create.l HWIO_LPASS_SB_BAM_P_EVNT_REG4_ADDR A:0xfe189818
y.create.l HWIO_LPASS_SB_BAM_P_EVNT_REG5_ADDR A:0xfe18a818
y.create.l HWIO_LPASS_SB_BAM_P_EVNT_REG6_ADDR A:0xfe18b818
y.create.l HWIO_LPASS_SB_BAM_P_EVNT_REG7_ADDR A:0xfe18c818
y.create.l HWIO_LPASS_SB_BAM_P_EVNT_REG8_ADDR A:0xfe18d818
y.create.l HWIO_LPASS_SB_BAM_P_EVNT_REG9_ADDR A:0xfe18e818
y.create.l HWIO_LPASS_SB_BAM_P_SW_OFSTS0_ADDR A:0xfe185800
y.create.l HWIO_LPASS_SB_BAM_P_SW_OFSTS1_ADDR A:0xfe186800
y.create.l HWIO_LPASS_SB_BAM_P_SW_OFSTS2_ADDR A:0xfe187800
y.create.l HWIO_LPASS_SB_BAM_P_SW_OFSTS3_ADDR A:0xfe188800
y.create.l HWIO_LPASS_SB_BAM_P_SW_OFSTS4_ADDR A:0xfe189800
y.create.l HWIO_LPASS_SB_BAM_P_SW_OFSTS5_ADDR A:0xfe18a800
y.create.l HWIO_LPASS_SB_BAM_P_SW_OFSTS6_ADDR A:0xfe18b800
y.create.l HWIO_LPASS_SB_BAM_P_SW_OFSTS7_ADDR A:0xfe18c800
y.create.l HWIO_LPASS_SB_BAM_P_SW_OFSTS8_ADDR A:0xfe18d800
y.create.l HWIO_LPASS_SB_BAM_P_SW_OFSTS9_ADDR A:0xfe18e800
y.create.l HWIO_LPASS_SB_BAM_P_DATA_FIFO_ADDR0_ADDR A:0xfe185824
y.create.l HWIO_LPASS_SB_BAM_P_DATA_FIFO_ADDR1_ADDR A:0xfe186824
y.create.l HWIO_LPASS_SB_BAM_P_DATA_FIFO_ADDR2_ADDR A:0xfe187824
y.create.l HWIO_LPASS_SB_BAM_P_DATA_FIFO_ADDR3_ADDR A:0xfe188824
y.create.l HWIO_LPASS_SB_BAM_P_DATA_FIFO_ADDR4_ADDR A:0xfe189824
y.create.l HWIO_LPASS_SB_BAM_P_DATA_FIFO_ADDR5_ADDR A:0xfe18a824
y.create.l HWIO_LPASS_SB_BAM_P_DATA_FIFO_ADDR6_ADDR A:0xfe18b824
y.create.l HWIO_LPASS_SB_BAM_P_DATA_FIFO_ADDR7_ADDR A:0xfe18c824
y.create.l HWIO_LPASS_SB_BAM_P_DATA_FIFO_ADDR8_ADDR A:0xfe18d824
y.create.l HWIO_LPASS_SB_BAM_P_DATA_FIFO_ADDR9_ADDR A:0xfe18e824
y.create.l HWIO_LPASS_SB_BAM_P_DATA_FIFO_ADDR_LSB0_ADDR A:0xfe185920
y.create.l HWIO_LPASS_SB_BAM_P_DATA_FIFO_ADDR_LSB1_ADDR A:0xfe186920
y.create.l HWIO_LPASS_SB_BAM_P_DATA_FIFO_ADDR_LSB2_ADDR A:0xfe187920
y.create.l HWIO_LPASS_SB_BAM_P_DATA_FIFO_ADDR_LSB3_ADDR A:0xfe188920
y.create.l HWIO_LPASS_SB_BAM_P_DATA_FIFO_ADDR_LSB4_ADDR A:0xfe189920
y.create.l HWIO_LPASS_SB_BAM_P_DATA_FIFO_ADDR_LSB5_ADDR A:0xfe18a920
y.create.l HWIO_LPASS_SB_BAM_P_DATA_FIFO_ADDR_LSB6_ADDR A:0xfe18b920
y.create.l HWIO_LPASS_SB_BAM_P_DATA_FIFO_ADDR_LSB7_ADDR A:0xfe18c920
y.create.l HWIO_LPASS_SB_BAM_P_DATA_FIFO_ADDR_LSB8_ADDR A:0xfe18d920
y.create.l HWIO_LPASS_SB_BAM_P_DATA_FIFO_ADDR_LSB9_ADDR A:0xfe18e920
y.create.l HWIO_LPASS_SB_BAM_P_DATA_FIFO_ADDR_MSB0_ADDR A:0xfe185924
y.create.l HWIO_LPASS_SB_BAM_P_DATA_FIFO_ADDR_MSB1_ADDR A:0xfe186924
y.create.l HWIO_LPASS_SB_BAM_P_DATA_FIFO_ADDR_MSB2_ADDR A:0xfe187924
y.create.l HWIO_LPASS_SB_BAM_P_DATA_FIFO_ADDR_MSB3_ADDR A:0xfe188924
y.create.l HWIO_LPASS_SB_BAM_P_DATA_FIFO_ADDR_MSB4_ADDR A:0xfe189924
y.create.l HWIO_LPASS_SB_BAM_P_DATA_FIFO_ADDR_MSB5_ADDR A:0xfe18a924
y.create.l HWIO_LPASS_SB_BAM_P_DATA_FIFO_ADDR_MSB6_ADDR A:0xfe18b924
y.create.l HWIO_LPASS_SB_BAM_P_DATA_FIFO_ADDR_MSB7_ADDR A:0xfe18c924
y.create.l HWIO_LPASS_SB_BAM_P_DATA_FIFO_ADDR_MSB8_ADDR A:0xfe18d924
y.create.l HWIO_LPASS_SB_BAM_P_DATA_FIFO_ADDR_MSB9_ADDR A:0xfe18e924
y.create.l HWIO_LPASS_SB_BAM_P_DESC_FIFO_ADDR0_ADDR A:0xfe18581c
y.create.l HWIO_LPASS_SB_BAM_P_DESC_FIFO_ADDR1_ADDR A:0xfe18681c
y.create.l HWIO_LPASS_SB_BAM_P_DESC_FIFO_ADDR2_ADDR A:0xfe18781c
y.create.l HWIO_LPASS_SB_BAM_P_DESC_FIFO_ADDR3_ADDR A:0xfe18881c
y.create.l HWIO_LPASS_SB_BAM_P_DESC_FIFO_ADDR4_ADDR A:0xfe18981c
y.create.l HWIO_LPASS_SB_BAM_P_DESC_FIFO_ADDR5_ADDR A:0xfe18a81c
y.create.l HWIO_LPASS_SB_BAM_P_DESC_FIFO_ADDR6_ADDR A:0xfe18b81c
y.create.l HWIO_LPASS_SB_BAM_P_DESC_FIFO_ADDR7_ADDR A:0xfe18c81c
y.create.l HWIO_LPASS_SB_BAM_P_DESC_FIFO_ADDR8_ADDR A:0xfe18d81c
y.create.l HWIO_LPASS_SB_BAM_P_DESC_FIFO_ADDR9_ADDR A:0xfe18e81c
y.create.l HWIO_LPASS_SB_BAM_P_DESC_FIFO_ADDR_LSB0_ADDR A:0xfe185910
y.create.l HWIO_LPASS_SB_BAM_P_DESC_FIFO_ADDR_LSB1_ADDR A:0xfe186910
y.create.l HWIO_LPASS_SB_BAM_P_DESC_FIFO_ADDR_LSB2_ADDR A:0xfe187910
y.create.l HWIO_LPASS_SB_BAM_P_DESC_FIFO_ADDR_LSB3_ADDR A:0xfe188910
y.create.l HWIO_LPASS_SB_BAM_P_DESC_FIFO_ADDR_LSB4_ADDR A:0xfe189910
y.create.l HWIO_LPASS_SB_BAM_P_DESC_FIFO_ADDR_LSB5_ADDR A:0xfe18a910
y.create.l HWIO_LPASS_SB_BAM_P_DESC_FIFO_ADDR_LSB6_ADDR A:0xfe18b910
y.create.l HWIO_LPASS_SB_BAM_P_DESC_FIFO_ADDR_LSB7_ADDR A:0xfe18c910
y.create.l HWIO_LPASS_SB_BAM_P_DESC_FIFO_ADDR_LSB8_ADDR A:0xfe18d910
y.create.l HWIO_LPASS_SB_BAM_P_DESC_FIFO_ADDR_LSB9_ADDR A:0xfe18e910
y.create.l HWIO_LPASS_SB_BAM_P_DESC_FIFO_ADDR_MSB0_ADDR A:0xfe185914
y.create.l HWIO_LPASS_SB_BAM_P_DESC_FIFO_ADDR_MSB1_ADDR A:0xfe186914
y.create.l HWIO_LPASS_SB_BAM_P_DESC_FIFO_ADDR_MSB2_ADDR A:0xfe187914
y.create.l HWIO_LPASS_SB_BAM_P_DESC_FIFO_ADDR_MSB3_ADDR A:0xfe188914
y.create.l HWIO_LPASS_SB_BAM_P_DESC_FIFO_ADDR_MSB4_ADDR A:0xfe189914
y.create.l HWIO_LPASS_SB_BAM_P_DESC_FIFO_ADDR_MSB5_ADDR A:0xfe18a914
y.create.l HWIO_LPASS_SB_BAM_P_DESC_FIFO_ADDR_MSB6_ADDR A:0xfe18b914
y.create.l HWIO_LPASS_SB_BAM_P_DESC_FIFO_ADDR_MSB7_ADDR A:0xfe18c914
y.create.l HWIO_LPASS_SB_BAM_P_DESC_FIFO_ADDR_MSB8_ADDR A:0xfe18d914
y.create.l HWIO_LPASS_SB_BAM_P_DESC_FIFO_ADDR_MSB9_ADDR A:0xfe18e914
y.create.l HWIO_LPASS_SB_BAM_P_EVNT_GEN_TRSHLD0_ADDR A:0xfe185828
y.create.l HWIO_LPASS_SB_BAM_P_EVNT_GEN_TRSHLD1_ADDR A:0xfe186828
y.create.l HWIO_LPASS_SB_BAM_P_EVNT_GEN_TRSHLD2_ADDR A:0xfe187828
y.create.l HWIO_LPASS_SB_BAM_P_EVNT_GEN_TRSHLD3_ADDR A:0xfe188828
y.create.l HWIO_LPASS_SB_BAM_P_EVNT_GEN_TRSHLD4_ADDR A:0xfe189828
y.create.l HWIO_LPASS_SB_BAM_P_EVNT_GEN_TRSHLD5_ADDR A:0xfe18a828
y.create.l HWIO_LPASS_SB_BAM_P_EVNT_GEN_TRSHLD6_ADDR A:0xfe18b828
y.create.l HWIO_LPASS_SB_BAM_P_EVNT_GEN_TRSHLD7_ADDR A:0xfe18c828
y.create.l HWIO_LPASS_SB_BAM_P_EVNT_GEN_TRSHLD8_ADDR A:0xfe18d828
y.create.l HWIO_LPASS_SB_BAM_P_EVNT_GEN_TRSHLD9_ADDR A:0xfe18e828
y.create.l HWIO_LPASS_SB_BAM_P_FIFO_SIZES0_ADDR A:0xfe185820
y.create.l HWIO_LPASS_SB_BAM_P_FIFO_SIZES1_ADDR A:0xfe186820
y.create.l HWIO_LPASS_SB_BAM_P_FIFO_SIZES2_ADDR A:0xfe187820
y.create.l HWIO_LPASS_SB_BAM_P_FIFO_SIZES3_ADDR A:0xfe188820
y.create.l HWIO_LPASS_SB_BAM_P_FIFO_SIZES4_ADDR A:0xfe189820
y.create.l HWIO_LPASS_SB_BAM_P_FIFO_SIZES5_ADDR A:0xfe18a820
y.create.l HWIO_LPASS_SB_BAM_P_FIFO_SIZES6_ADDR A:0xfe18b820
y.create.l HWIO_LPASS_SB_BAM_P_FIFO_SIZES7_ADDR A:0xfe18c820
y.create.l HWIO_LPASS_SB_BAM_P_FIFO_SIZES8_ADDR A:0xfe18d820
y.create.l HWIO_LPASS_SB_BAM_P_FIFO_SIZES9_ADDR A:0xfe18e820
y.create.l HWIO_LPASS_SB_BAM_P_RETR_CNTXT_0_ADDR A:0xfe185834
y.create.l HWIO_LPASS_SB_BAM_P_RETR_CNTXT_1_ADDR A:0xfe186834
y.create.l HWIO_LPASS_SB_BAM_P_RETR_CNTXT_2_ADDR A:0xfe187834
y.create.l HWIO_LPASS_SB_BAM_P_RETR_CNTXT_3_ADDR A:0xfe188834
y.create.l HWIO_LPASS_SB_BAM_P_RETR_CNTXT_4_ADDR A:0xfe189834
y.create.l HWIO_LPASS_SB_BAM_P_RETR_CNTXT_5_ADDR A:0xfe18a834
y.create.l HWIO_LPASS_SB_BAM_P_RETR_CNTXT_6_ADDR A:0xfe18b834
y.create.l HWIO_LPASS_SB_BAM_P_RETR_CNTXT_7_ADDR A:0xfe18c834
y.create.l HWIO_LPASS_SB_BAM_P_RETR_CNTXT_8_ADDR A:0xfe18d834
y.create.l HWIO_LPASS_SB_BAM_P_RETR_CNTXT_9_ADDR A:0xfe18e834
y.create.l HWIO_LPASS_SB_BAM_P_SI_CNTXT_0_ADDR A:0xfe185838
y.create.l HWIO_LPASS_SB_BAM_P_SI_CNTXT_1_ADDR A:0xfe186838
y.create.l HWIO_LPASS_SB_BAM_P_SI_CNTXT_2_ADDR A:0xfe187838
y.create.l HWIO_LPASS_SB_BAM_P_SI_CNTXT_3_ADDR A:0xfe188838
y.create.l HWIO_LPASS_SB_BAM_P_SI_CNTXT_4_ADDR A:0xfe189838
y.create.l HWIO_LPASS_SB_BAM_P_SI_CNTXT_5_ADDR A:0xfe18a838
y.create.l HWIO_LPASS_SB_BAM_P_SI_CNTXT_6_ADDR A:0xfe18b838
y.create.l HWIO_LPASS_SB_BAM_P_SI_CNTXT_7_ADDR A:0xfe18c838
y.create.l HWIO_LPASS_SB_BAM_P_SI_CNTXT_8_ADDR A:0xfe18d838
y.create.l HWIO_LPASS_SB_BAM_P_SI_CNTXT_9_ADDR A:0xfe18e838
y.create.l HWIO_LPASS_SB_BAM_P_DF_CNTXT_0_ADDR A:0xfe185830
y.create.l HWIO_LPASS_SB_BAM_P_DF_CNTXT_1_ADDR A:0xfe186830
y.create.l HWIO_LPASS_SB_BAM_P_DF_CNTXT_2_ADDR A:0xfe187830
y.create.l HWIO_LPASS_SB_BAM_P_DF_CNTXT_3_ADDR A:0xfe188830
y.create.l HWIO_LPASS_SB_BAM_P_DF_CNTXT_4_ADDR A:0xfe189830
y.create.l HWIO_LPASS_SB_BAM_P_DF_CNTXT_5_ADDR A:0xfe18a830
y.create.l HWIO_LPASS_SB_BAM_P_DF_CNTXT_6_ADDR A:0xfe18b830
y.create.l HWIO_LPASS_SB_BAM_P_DF_CNTXT_7_ADDR A:0xfe18c830
y.create.l HWIO_LPASS_SB_BAM_P_DF_CNTXT_8_ADDR A:0xfe18d830
y.create.l HWIO_LPASS_SB_BAM_P_DF_CNTXT_9_ADDR A:0xfe18e830
y.create.l HWIO_LPASS_SB_BAM_P_AU_PSM_CNTXT_1_0_ADDR A:0xfe185804
y.create.l HWIO_LPASS_SB_BAM_P_AU_PSM_CNTXT_1_1_ADDR A:0xfe186804
y.create.l HWIO_LPASS_SB_BAM_P_AU_PSM_CNTXT_1_2_ADDR A:0xfe187804
y.create.l HWIO_LPASS_SB_BAM_P_AU_PSM_CNTXT_1_3_ADDR A:0xfe188804
y.create.l HWIO_LPASS_SB_BAM_P_AU_PSM_CNTXT_1_4_ADDR A:0xfe189804
y.create.l HWIO_LPASS_SB_BAM_P_AU_PSM_CNTXT_1_5_ADDR A:0xfe18a804
y.create.l HWIO_LPASS_SB_BAM_P_AU_PSM_CNTXT_1_6_ADDR A:0xfe18b804
y.create.l HWIO_LPASS_SB_BAM_P_AU_PSM_CNTXT_1_7_ADDR A:0xfe18c804
y.create.l HWIO_LPASS_SB_BAM_P_AU_PSM_CNTXT_1_8_ADDR A:0xfe18d804
y.create.l HWIO_LPASS_SB_BAM_P_AU_PSM_CNTXT_1_9_ADDR A:0xfe18e804
y.create.l HWIO_LPASS_SB_BAM_P_PSM_CNTXT_2_0_ADDR A:0xfe185808
y.create.l HWIO_LPASS_SB_BAM_P_PSM_CNTXT_2_1_ADDR A:0xfe186808
y.create.l HWIO_LPASS_SB_BAM_P_PSM_CNTXT_2_2_ADDR A:0xfe187808
y.create.l HWIO_LPASS_SB_BAM_P_PSM_CNTXT_2_3_ADDR A:0xfe188808
y.create.l HWIO_LPASS_SB_BAM_P_PSM_CNTXT_2_4_ADDR A:0xfe189808
y.create.l HWIO_LPASS_SB_BAM_P_PSM_CNTXT_2_5_ADDR A:0xfe18a808
y.create.l HWIO_LPASS_SB_BAM_P_PSM_CNTXT_2_6_ADDR A:0xfe18b808
y.create.l HWIO_LPASS_SB_BAM_P_PSM_CNTXT_2_7_ADDR A:0xfe18c808
y.create.l HWIO_LPASS_SB_BAM_P_PSM_CNTXT_2_8_ADDR A:0xfe18d808
y.create.l HWIO_LPASS_SB_BAM_P_PSM_CNTXT_2_9_ADDR A:0xfe18e808
y.create.l HWIO_LPASS_SB_BAM_P_PSM_CNTXT_3_0_ADDR A:0xfe18580c
y.create.l HWIO_LPASS_SB_BAM_P_PSM_CNTXT_3_1_ADDR A:0xfe18680c
y.create.l HWIO_LPASS_SB_BAM_P_PSM_CNTXT_3_2_ADDR A:0xfe18780c
y.create.l HWIO_LPASS_SB_BAM_P_PSM_CNTXT_3_3_ADDR A:0xfe18880c
y.create.l HWIO_LPASS_SB_BAM_P_PSM_CNTXT_3_4_ADDR A:0xfe18980c
y.create.l HWIO_LPASS_SB_BAM_P_PSM_CNTXT_3_5_ADDR A:0xfe18a80c
y.create.l HWIO_LPASS_SB_BAM_P_PSM_CNTXT_3_6_ADDR A:0xfe18b80c
y.create.l HWIO_LPASS_SB_BAM_P_PSM_CNTXT_3_7_ADDR A:0xfe18c80c
y.create.l HWIO_LPASS_SB_BAM_P_PSM_CNTXT_3_8_ADDR A:0xfe18d80c
y.create.l HWIO_LPASS_SB_BAM_P_PSM_CNTXT_3_9_ADDR A:0xfe18e80c
y.create.l HWIO_LPASS_SB_BAM_P_PSM_CNTXT_3_LSB0_ADDR A:0xfe185900
y.create.l HWIO_LPASS_SB_BAM_P_PSM_CNTXT_3_LSB1_ADDR A:0xfe186900
y.create.l HWIO_LPASS_SB_BAM_P_PSM_CNTXT_3_LSB2_ADDR A:0xfe187900
y.create.l HWIO_LPASS_SB_BAM_P_PSM_CNTXT_3_LSB3_ADDR A:0xfe188900
y.create.l HWIO_LPASS_SB_BAM_P_PSM_CNTXT_3_LSB4_ADDR A:0xfe189900
y.create.l HWIO_LPASS_SB_BAM_P_PSM_CNTXT_3_LSB5_ADDR A:0xfe18a900
y.create.l HWIO_LPASS_SB_BAM_P_PSM_CNTXT_3_LSB6_ADDR A:0xfe18b900
y.create.l HWIO_LPASS_SB_BAM_P_PSM_CNTXT_3_LSB7_ADDR A:0xfe18c900
y.create.l HWIO_LPASS_SB_BAM_P_PSM_CNTXT_3_LSB8_ADDR A:0xfe18d900
y.create.l HWIO_LPASS_SB_BAM_P_PSM_CNTXT_3_LSB9_ADDR A:0xfe18e900
y.create.l HWIO_LPASS_SB_BAM_P_PSM_CNTXT_3_MSB0_ADDR A:0xfe185904
y.create.l HWIO_LPASS_SB_BAM_P_PSM_CNTXT_3_MSB1_ADDR A:0xfe186904
y.create.l HWIO_LPASS_SB_BAM_P_PSM_CNTXT_3_MSB2_ADDR A:0xfe187904
y.create.l HWIO_LPASS_SB_BAM_P_PSM_CNTXT_3_MSB3_ADDR A:0xfe188904
y.create.l HWIO_LPASS_SB_BAM_P_PSM_CNTXT_3_MSB4_ADDR A:0xfe189904
y.create.l HWIO_LPASS_SB_BAM_P_PSM_CNTXT_3_MSB5_ADDR A:0xfe18a904
y.create.l HWIO_LPASS_SB_BAM_P_PSM_CNTXT_3_MSB6_ADDR A:0xfe18b904
y.create.l HWIO_LPASS_SB_BAM_P_PSM_CNTXT_3_MSB7_ADDR A:0xfe18c904
y.create.l HWIO_LPASS_SB_BAM_P_PSM_CNTXT_3_MSB8_ADDR A:0xfe18d904
y.create.l HWIO_LPASS_SB_BAM_P_PSM_CNTXT_3_MSB9_ADDR A:0xfe18e904
y.create.l HWIO_LPASS_SB_BAM_P_PSM_CNTXT_4_0_ADDR A:0xfe185810
y.create.l HWIO_LPASS_SB_BAM_P_PSM_CNTXT_4_1_ADDR A:0xfe186810
y.create.l HWIO_LPASS_SB_BAM_P_PSM_CNTXT_4_2_ADDR A:0xfe187810
y.create.l HWIO_LPASS_SB_BAM_P_PSM_CNTXT_4_3_ADDR A:0xfe188810
y.create.l HWIO_LPASS_SB_BAM_P_PSM_CNTXT_4_4_ADDR A:0xfe189810
y.create.l HWIO_LPASS_SB_BAM_P_PSM_CNTXT_4_5_ADDR A:0xfe18a810
y.create.l HWIO_LPASS_SB_BAM_P_PSM_CNTXT_4_6_ADDR A:0xfe18b810
y.create.l HWIO_LPASS_SB_BAM_P_PSM_CNTXT_4_7_ADDR A:0xfe18c810
y.create.l HWIO_LPASS_SB_BAM_P_PSM_CNTXT_4_8_ADDR A:0xfe18d810
y.create.l HWIO_LPASS_SB_BAM_P_PSM_CNTXT_4_9_ADDR A:0xfe18e810
y.create.l HWIO_LPASS_SB_BAM_P_PSM_CNTXT_5_0_ADDR A:0xfe185814
y.create.l HWIO_LPASS_SB_BAM_P_PSM_CNTXT_5_1_ADDR A:0xfe186814
y.create.l HWIO_LPASS_SB_BAM_P_PSM_CNTXT_5_2_ADDR A:0xfe187814
y.create.l HWIO_LPASS_SB_BAM_P_PSM_CNTXT_5_3_ADDR A:0xfe188814
y.create.l HWIO_LPASS_SB_BAM_P_PSM_CNTXT_5_4_ADDR A:0xfe189814
y.create.l HWIO_LPASS_SB_BAM_P_PSM_CNTXT_5_5_ADDR A:0xfe18a814
y.create.l HWIO_LPASS_SB_BAM_P_PSM_CNTXT_5_6_ADDR A:0xfe18b814
y.create.l HWIO_LPASS_SB_BAM_P_PSM_CNTXT_5_7_ADDR A:0xfe18c814
y.create.l HWIO_LPASS_SB_BAM_P_PSM_CNTXT_5_8_ADDR A:0xfe18d814
y.create.l HWIO_LPASS_SB_BAM_P_PSM_CNTXT_5_9_ADDR A:0xfe18e814
y.create.l HWIO_LPASS_SB_XPU_SCR_ADDR A:0xfe182000
y.create.l HWIO_LPASS_SB_XPU_SWDR_ADDR A:0xfe182004
y.create.l HWIO_LPASS_SB_XPU_SEAR0_ADDR A:0xfe182040
y.create.l HWIO_LPASS_SB_XPU_SESR_ADDR A:0xfe182048
y.create.l HWIO_LPASS_SB_XPU_SESRRESTORE_ADDR A:0xfe18204c
y.create.l HWIO_LPASS_SB_XPU_SESYNR0_ADDR A:0xfe182050
y.create.l HWIO_LPASS_SB_XPU_SESYNR1_ADDR A:0xfe182054
y.create.l HWIO_LPASS_SB_XPU_SESYNR2_ADDR A:0xfe182058
y.create.l HWIO_LPASS_SB_XPU_MCR_ADDR A:0xfe182100
y.create.l HWIO_LPASS_SB_XPU_MEAR0_ADDR A:0xfe182140
y.create.l HWIO_LPASS_SB_XPU_MESR_ADDR A:0xfe182148
y.create.l HWIO_LPASS_SB_XPU_MESRRESTORE_ADDR A:0xfe18214c
y.create.l HWIO_LPASS_SB_XPU_MESYNR0_ADDR A:0xfe182150
y.create.l HWIO_LPASS_SB_XPU_MESYNR1_ADDR A:0xfe182154
y.create.l HWIO_LPASS_SB_XPU_MESYNR2_ADDR A:0xfe182158
y.create.l HWIO_LPASS_SB_XPU_CR_ADDR A:0xfe182080
y.create.l HWIO_LPASS_SB_XPU_RPU_ACR0_ADDR A:0xfe1820a0
y.create.l HWIO_LPASS_SB_XPU_EAR0_ADDR A:0xfe1820c0
y.create.l HWIO_LPASS_SB_XPU_ESR_ADDR A:0xfe1820c8
y.create.l HWIO_LPASS_SB_XPU_ESRRESTORE_ADDR A:0xfe1820cc
y.create.l HWIO_LPASS_SB_XPU_ESYNR0_ADDR A:0xfe1820d0
y.create.l HWIO_LPASS_SB_XPU_ESYNR1_ADDR A:0xfe1820d4
y.create.l HWIO_LPASS_SB_XPU_ESYNR2_ADDR A:0xfe1820d8
y.create.l HWIO_LPASS_SB_XPU_IDR0_ADDR A:0xfe182074
y.create.l HWIO_LPASS_SB_XPU_IDR1_ADDR A:0xfe182078
y.create.l HWIO_LPASS_SB_XPU_REV_ADDR A:0xfe18207c
y.create.l HWIO_LPASS_SB_XPU_RG0_RACR0_ADDR A:0xfe182200
y.create.l HWIO_LPASS_SB_XPU_RG1_RACR0_ADDR A:0xfe182280
y.create.l HWIO_LPASS_SB_XPU_RG2_RACR0_ADDR A:0xfe182300
y.create.l HWIO_LPASS_SB_XPU_RG3_RACR0_ADDR A:0xfe182380
y.create.l HWIO_LPASS_SB_XPU_RG4_RACR0_ADDR A:0xfe182400
y.create.l HWIO_LPASS_SB_XPU_RG5_RACR0_ADDR A:0xfe182480
y.create.l HWIO_LPASS_SB_XPU_RG6_RACR0_ADDR A:0xfe182500
y.create.l HWIO_LPASS_SB_XPU_RG7_RACR0_ADDR A:0xfe182580
y.create.l HWIO_LPASS_SB_XPU_RG8_RACR0_ADDR A:0xfe182600
y.create.l HWIO_LPASS_SB_XPU_RG9_RACR0_ADDR A:0xfe182680
y.create.l HWIO_LPASS_SB_XPU_RG0_SCR_ADDR A:0xfe182250
y.create.l HWIO_LPASS_SB_XPU_RG1_SCR_ADDR A:0xfe1822d0
y.create.l HWIO_LPASS_SB_XPU_RG2_SCR_ADDR A:0xfe182350
y.create.l HWIO_LPASS_SB_XPU_RG3_SCR_ADDR A:0xfe1823d0
y.create.l HWIO_LPASS_SB_XPU_RG4_SCR_ADDR A:0xfe182450
y.create.l HWIO_LPASS_SB_XPU_RG5_SCR_ADDR A:0xfe1824d0
y.create.l HWIO_LPASS_SB_XPU_RG6_SCR_ADDR A:0xfe182550
y.create.l HWIO_LPASS_SB_XPU_RG7_SCR_ADDR A:0xfe1825d0
y.create.l HWIO_LPASS_SB_XPU_RG8_SCR_ADDR A:0xfe182650
y.create.l HWIO_LPASS_SB_XPU_RG9_SCR_ADDR A:0xfe1826d0
y.create.l HWIO_LPASS_SB_XPU_RG0_MCR_ADDR A:0xfe182254
y.create.l HWIO_LPASS_SB_XPU_RG1_MCR_ADDR A:0xfe1822d4
y.create.l HWIO_LPASS_SB_XPU_RG2_MCR_ADDR A:0xfe182354
y.create.l HWIO_LPASS_SB_XPU_RG3_MCR_ADDR A:0xfe1823d4
y.create.l HWIO_LPASS_SB_XPU_RG4_MCR_ADDR A:0xfe182454
y.create.l HWIO_LPASS_SB_XPU_RG5_MCR_ADDR A:0xfe1824d4
y.create.l HWIO_LPASS_SB_XPU_RG6_MCR_ADDR A:0xfe182554
y.create.l HWIO_LPASS_SB_XPU_RG7_MCR_ADDR A:0xfe1825d4
y.create.l HWIO_LPASS_SB_XPU_RG8_MCR_ADDR A:0xfe182654
y.create.l HWIO_LPASS_SB_XPU_RG9_MCR_ADDR A:0xfe1826d4
y.create.l HWIO_LPASS_SB_VMIDMT_SCR0_ADDR A:0xfe180000
y.create.l HWIO_LPASS_SB_VMIDMT_SCR1_ADDR A:0xfe180004
y.create.l HWIO_LPASS_SB_VMIDMT_SCR2_ADDR A:0xfe180008
y.create.l HWIO_LPASS_SB_VMIDMT_SACR_ADDR A:0xfe180010
y.create.l HWIO_LPASS_SB_VMIDMT_SIDR0_ADDR A:0xfe180020
y.create.l HWIO_LPASS_SB_VMIDMT_SIDR1_ADDR A:0xfe180024
y.create.l HWIO_LPASS_SB_VMIDMT_SIDR2_ADDR A:0xfe180028
y.create.l HWIO_LPASS_SB_VMIDMT_SIDR4_ADDR A:0xfe180030
y.create.l HWIO_LPASS_SB_VMIDMT_SIDR5_ADDR A:0xfe180034
y.create.l HWIO_LPASS_SB_VMIDMT_SIDR7_ADDR A:0xfe18003c
y.create.l HWIO_LPASS_SB_VMIDMT_SGFAR0_ADDR A:0xfe180040
y.create.l HWIO_LPASS_SB_VMIDMT_SGFSR_ADDR A:0xfe180048
y.create.l HWIO_LPASS_SB_VMIDMT_SGFSRRESTORE_ADDR A:0xfe18004c
y.create.l HWIO_LPASS_SB_VMIDMT_SGFSYNDR0_ADDR A:0xfe180050
y.create.l HWIO_LPASS_SB_VMIDMT_SGFSYNDR1_ADDR A:0xfe180054
y.create.l HWIO_LPASS_SB_VMIDMT_SGFSYNDR2_ADDR A:0xfe180058
y.create.l HWIO_LPASS_SB_VMIDMT_VMIDMTSCR0_ADDR A:0xfe180090
y.create.l HWIO_LPASS_SB_VMIDMT_CR0_ADDR A:0xfe180000
y.create.l HWIO_LPASS_SB_VMIDMT_CR2_ADDR A:0xfe180008
y.create.l HWIO_LPASS_SB_VMIDMT_ACR_ADDR A:0xfe180010
y.create.l HWIO_LPASS_SB_VMIDMT_IDR0_ADDR A:0xfe180020
y.create.l HWIO_LPASS_SB_VMIDMT_IDR1_ADDR A:0xfe180024
y.create.l HWIO_LPASS_SB_VMIDMT_IDR2_ADDR A:0xfe180028
y.create.l HWIO_LPASS_SB_VMIDMT_IDR4_ADDR A:0xfe180030
y.create.l HWIO_LPASS_SB_VMIDMT_IDR5_ADDR A:0xfe180034
y.create.l HWIO_LPASS_SB_VMIDMT_IDR7_ADDR A:0xfe18003c
y.create.l HWIO_LPASS_SB_VMIDMT_GFAR0_ADDR A:0xfe180040
y.create.l HWIO_LPASS_SB_VMIDMT_GFSR_ADDR A:0xfe180048
y.create.l HWIO_LPASS_SB_VMIDMT_GFSRRESTORE_ADDR A:0xfe18004c
y.create.l HWIO_LPASS_SB_VMIDMT_GFSYNDR0_ADDR A:0xfe180050
y.create.l HWIO_LPASS_SB_VMIDMT_GFSYNDR1_ADDR A:0xfe180054
y.create.l HWIO_LPASS_SB_VMIDMT_GFSYNDR2_ADDR A:0xfe180058
y.create.l HWIO_LPASS_SB_VMIDMT_VMIDMTCR0_ADDR A:0xfe180090
y.create.l HWIO_LPASS_SB_VMIDMT_VMIDMTACR_ADDR A:0xfe18009c
y.create.l HWIO_LPASS_SB_VMIDMT_NSCR0_ADDR A:0xfe180400
y.create.l HWIO_LPASS_SB_VMIDMT_NSCR2_ADDR A:0xfe180408
y.create.l HWIO_LPASS_SB_VMIDMT_NSACR_ADDR A:0xfe180410
y.create.l HWIO_LPASS_SB_VMIDMT_NSGFAR0_ADDR A:0xfe180440
y.create.l HWIO_LPASS_SB_VMIDMT_NSGFSR_ADDR A:0xfe180448
y.create.l HWIO_LPASS_SB_VMIDMT_NSGFSRRESTORE_ADDR A:0xfe18044c
y.create.l HWIO_LPASS_SB_VMIDMT_NSGFSYNDR0_ADDR A:0xfe180450
y.create.l HWIO_LPASS_SB_VMIDMT_NSGFSYNDR1_ADDR A:0xfe180454
y.create.l HWIO_LPASS_SB_VMIDMT_NSGFSYNDR2_ADDR A:0xfe180458
y.create.l HWIO_LPASS_SB_VMIDMT_NSVMIDMTCR0_ADDR A:0xfe180490
y.create.l HWIO_LPASS_SB_VMIDMT_SSDR0_ADDR A:0xfe180080
y.create.l HWIO_LPASS_SB_VMIDMT_MSDR0_ADDR A:0xfe180480
y.create.l HWIO_LPASS_SB_VMIDMT_MCR_ADDR A:0xfe180494
y.create.l HWIO_LPASS_SB_VMIDMT_S2VR0_ADDR A:0xfe180c00
y.create.l HWIO_LPASS_SB_VMIDMT_S2VR1_ADDR A:0xfe180c04
y.create.l HWIO_LPASS_SB_VMIDMT_S2VR2_ADDR A:0xfe180c08
y.create.l HWIO_LPASS_SB_VMIDMT_S2VR3_ADDR A:0xfe180c0c
y.create.l HWIO_LPASS_SB_VMIDMT_S2VR4_ADDR A:0xfe180c10
y.create.l HWIO_LPASS_SB_VMIDMT_S2VR5_ADDR A:0xfe180c14
y.create.l HWIO_LPASS_SB_VMIDMT_S2VR6_ADDR A:0xfe180c18
y.create.l HWIO_LPASS_SB_VMIDMT_S2VR7_ADDR A:0xfe180c1c
y.create.l HWIO_LPASS_SB_VMIDMT_S2VR8_ADDR A:0xfe180c20
y.create.l HWIO_LPASS_SB_VMIDMT_S2VR9_ADDR A:0xfe180c24
y.create.l HWIO_LPASS_SB_VMIDMT_AS2VR0_ADDR A:0xfe180e00
y.create.l HWIO_LPASS_SB_VMIDMT_AS2VR1_ADDR A:0xfe180e04
y.create.l HWIO_LPASS_SB_VMIDMT_AS2VR2_ADDR A:0xfe180e08
y.create.l HWIO_LPASS_SB_VMIDMT_AS2VR3_ADDR A:0xfe180e0c
y.create.l HWIO_LPASS_SB_VMIDMT_AS2VR4_ADDR A:0xfe180e10
y.create.l HWIO_LPASS_SB_VMIDMT_AS2VR5_ADDR A:0xfe180e14
y.create.l HWIO_LPASS_SB_VMIDMT_AS2VR6_ADDR A:0xfe180e18
y.create.l HWIO_LPASS_SB_VMIDMT_AS2VR7_ADDR A:0xfe180e1c
y.create.l HWIO_LPASS_SB_VMIDMT_AS2VR8_ADDR A:0xfe180e20
y.create.l HWIO_LPASS_SB_VMIDMT_AS2VR9_ADDR A:0xfe180e24
y.create.l HWIO_LPASS_SB_VMIDMT_SMR0_ADDR A:0xfe180800
y.create.l HWIO_LPASS_SB_VMIDMT_SMR1_ADDR A:0xfe180804
y.create.l HWIO_LPASS_SB_VMIDMT_SMR2_ADDR A:0xfe180808
y.create.l HWIO_LPASS_SB_VMIDMT_SMR3_ADDR A:0xfe18080c
y.create.l HWIO_LPASS_SB_VMIDMT_SMR4_ADDR A:0xfe180810
y.create.l HWIO_LPASS_SB_VMIDMT_SMR5_ADDR A:0xfe180814
y.create.l HWIO_LPASS_SB_VMIDMT_SMR6_ADDR A:0xfe180818
y.create.l HWIO_LPASS_SB_VMIDMT_SMR7_ADDR A:0xfe18081c
y.create.l HWIO_LPASS_SB_VMIDMT_SMR8_ADDR A:0xfe180820
y.create.l HWIO_LPASS_SB_VMIDMT_SMR9_ADDR A:0xfe180824
y.create.l HWIO_LPASS_SB_COMP_HW_VERSION_ADDR A:0xfe1af000
y.create.l HWIO_LPASS_SB_COMP_CFG_ADDR A:0xfe1af004
y.create.l HWIO_LPASS_SB_SW_RESET_ADDR A:0xfe1af008
y.create.l HWIO_LPASS_SB_COMP_POWER_CFG_ADDR A:0xfe1af00c
y.create.l HWIO_LPASS_SB_COMP_FEATURE_CFG_ADDR A:0xfe1af010
y.create.l HWIO_LPASS_SB_COMP_STATUS_ADDR A:0xfe1af020
y.create.l HWIO_LPASS_SB_COMP_PARAMS_ADDR A:0xfe1af024
y.create.l HWIO_LPASS_SB_COMP_CHAR_CFG_ADDR A:0xfe1af028
y.create.l HWIO_LPASS_SB_COMP_CHAR_DATA_0_ADDR A:0xfe1af02c
y.create.l HWIO_LPASS_SB_COMP_CHAR_DATA_1_ADDR A:0xfe1af030
y.create.l HWIO_LPASS_SB_MGR_CFG_ADDR A:0xfe1af200
y.create.l HWIO_LPASS_SB_MGR_STATUS_ADDR A:0xfe1af204
y.create.l HWIO_LPASS_SB_MGR_RX_MSGQ_CFG_ADDR A:0xfe1af208
y.create.l HWIO_LPASS_SB_MGR_INT_EN_ADDR A:0xfe1af210
y.create.l HWIO_LPASS_SB_MGR_INT_STATUS_ADDR A:0xfe1af214
y.create.l HWIO_LPASS_SB_MGR_INT_CLR_ADDR A:0xfe1af218
y.create.l HWIO_LPASS_SB_MGR_TX_MSG0_ADDR A:0xfe1af230
y.create.l HWIO_LPASS_SB_MGR_TX_MSG1_ADDR A:0xfe1af234
y.create.l HWIO_LPASS_SB_MGR_TX_MSG2_ADDR A:0xfe1af238
y.create.l HWIO_LPASS_SB_MGR_TX_MSG3_ADDR A:0xfe1af23c
y.create.l HWIO_LPASS_SB_MGR_TX_MSG4_ADDR A:0xfe1af240
y.create.l HWIO_LPASS_SB_MGR_TX_MSG5_ADDR A:0xfe1af244
y.create.l HWIO_LPASS_SB_MGR_TX_MSG6_ADDR A:0xfe1af248
y.create.l HWIO_LPASS_SB_MGR_TX_MSG7_ADDR A:0xfe1af24c
y.create.l HWIO_LPASS_SB_MGR_TX_MSG8_ADDR A:0xfe1af250
y.create.l HWIO_LPASS_SB_MGR_TX_MSG9_ADDR A:0xfe1af254
y.create.l HWIO_LPASS_SB_MGR_RX_MSG0_ADDR A:0xfe1af270
y.create.l HWIO_LPASS_SB_MGR_RX_MSG1_ADDR A:0xfe1af274
y.create.l HWIO_LPASS_SB_MGR_RX_MSG2_ADDR A:0xfe1af278
y.create.l HWIO_LPASS_SB_MGR_RX_MSG3_ADDR A:0xfe1af27c
y.create.l HWIO_LPASS_SB_MGR_RX_MSG4_ADDR A:0xfe1af280
y.create.l HWIO_LPASS_SB_MGR_RX_MSG5_ADDR A:0xfe1af284
y.create.l HWIO_LPASS_SB_MGR_RX_MSG6_ADDR A:0xfe1af288
y.create.l HWIO_LPASS_SB_MGR_RX_MSG7_ADDR A:0xfe1af28c
y.create.l HWIO_LPASS_SB_MGR_RX_MSG8_ADDR A:0xfe1af290
y.create.l HWIO_LPASS_SB_MGR_RX_MSG9_ADDR A:0xfe1af294
y.create.l HWIO_LPASS_SB_MGR_IE_STATUS_ADDR A:0xfe1af2f0
y.create.l HWIO_LPASS_SB_MGR_VE_STATUS_ADDR A:0xfe1af300
y.create.l HWIO_LPASS_SB_FRM_CFG_ADDR A:0xfe1af400
y.create.l HWIO_LPASS_SB_FRM_STATUS_ADDR A:0xfe1af404
y.create.l HWIO_LPASS_SB_FRM_INT_EN_ADDR A:0xfe1af410
y.create.l HWIO_LPASS_SB_FRM_INT_STATUS_ADDR A:0xfe1af414
y.create.l HWIO_LPASS_SB_FRM_INT_CLR_ADDR A:0xfe1af418
y.create.l HWIO_LPASS_SB_FRM_WAKEUP_ADDR A:0xfe1af41c
y.create.l HWIO_LPASS_SB_FRM_CLKCTL_DONE_ADDR A:0xfe1af420
y.create.l HWIO_LPASS_SB_FRM_IE_STATUS_ADDR A:0xfe1af430
y.create.l HWIO_LPASS_SB_FRM_VE_STATUS_ADDR A:0xfe1af440
y.create.l HWIO_LPASS_SB_INTF_CFG_ADDR A:0xfe1af600
y.create.l HWIO_LPASS_SB_INTF_STATUS_ADDR A:0xfe1af604
y.create.l HWIO_LPASS_SB_INTF_INT_EN_ADDR A:0xfe1af610
y.create.l HWIO_LPASS_SB_INTF_INT_STATUS_ADDR A:0xfe1af614
y.create.l HWIO_LPASS_SB_INTF_INT_CLR_ADDR A:0xfe1af618
y.create.l HWIO_LPASS_SB_INTF_IE_STATUS_ADDR A:0xfe1af630
y.create.l HWIO_LPASS_SB_INTF_VE_STATUS_ADDR A:0xfe1af640
y.create.l HWIO_LPASS_SB_NGD1_CFG_ADDR A:0xfe1b0000
y.create.l HWIO_LPASS_SB_NGD1_STATUS_ADDR A:0xfe1b0004
y.create.l HWIO_LPASS_SB_NGD1_RX_MSGQ_CFG_ADDR A:0xfe1b0008
y.create.l HWIO_LPASS_SB_NGD1_INT_EN_ADDR A:0xfe1b0010
y.create.l HWIO_LPASS_SB_NGD1_INT_STATUS_ADDR A:0xfe1b0014
y.create.l HWIO_LPASS_SB_NGD1_INT_CLR_ADDR A:0xfe1b0018
y.create.l HWIO_LPASS_SB_NGD1_TX_MSG0_ADDR A:0xfe1b0030
y.create.l HWIO_LPASS_SB_NGD1_TX_MSG1_ADDR A:0xfe1b0034
y.create.l HWIO_LPASS_SB_NGD1_TX_MSG2_ADDR A:0xfe1b0038
y.create.l HWIO_LPASS_SB_NGD1_TX_MSG3_ADDR A:0xfe1b003c
y.create.l HWIO_LPASS_SB_NGD1_TX_MSG4_ADDR A:0xfe1b0040
y.create.l HWIO_LPASS_SB_NGD1_TX_MSG5_ADDR A:0xfe1b0044
y.create.l HWIO_LPASS_SB_NGD1_TX_MSG6_ADDR A:0xfe1b0048
y.create.l HWIO_LPASS_SB_NGD1_TX_MSG7_ADDR A:0xfe1b004c
y.create.l HWIO_LPASS_SB_NGD1_TX_MSG8_ADDR A:0xfe1b0050
y.create.l HWIO_LPASS_SB_NGD1_TX_MSG9_ADDR A:0xfe1b0054
y.create.l HWIO_LPASS_SB_NGD1_RX_MSG0_ADDR A:0xfe1b0070
y.create.l HWIO_LPASS_SB_NGD1_RX_MSG1_ADDR A:0xfe1b0074
y.create.l HWIO_LPASS_SB_NGD1_RX_MSG2_ADDR A:0xfe1b0078
y.create.l HWIO_LPASS_SB_NGD1_RX_MSG3_ADDR A:0xfe1b007c
y.create.l HWIO_LPASS_SB_NGD1_RX_MSG4_ADDR A:0xfe1b0080
y.create.l HWIO_LPASS_SB_NGD1_RX_MSG5_ADDR A:0xfe1b0084
y.create.l HWIO_LPASS_SB_NGD1_RX_MSG6_ADDR A:0xfe1b0088
y.create.l HWIO_LPASS_SB_NGD1_RX_MSG7_ADDR A:0xfe1b008c
y.create.l HWIO_LPASS_SB_NGD1_RX_MSG8_ADDR A:0xfe1b0090
y.create.l HWIO_LPASS_SB_NGD1_RX_MSG9_ADDR A:0xfe1b0094
y.create.l HWIO_LPASS_SB_NGD1_IE_STATUS_ADDR A:0xfe1b00f0
y.create.l HWIO_LPASS_SB_NGD1_VE_STATUS_ADDR A:0xfe1b0100
y.create.l HWIO_LPASS_SB_NGD2_CFG_ADDR A:0xfe1b1000
y.create.l HWIO_LPASS_SB_NGD2_STATUS_ADDR A:0xfe1b1004
y.create.l HWIO_LPASS_SB_NGD2_RX_MSGQ_CFG_ADDR A:0xfe1b1008
y.create.l HWIO_LPASS_SB_NGD2_INT_EN_ADDR A:0xfe1b1010
y.create.l HWIO_LPASS_SB_NGD2_INT_STATUS_ADDR A:0xfe1b1014
y.create.l HWIO_LPASS_SB_NGD2_INT_CLR_ADDR A:0xfe1b1018
y.create.l HWIO_LPASS_SB_NGD2_TX_MSG0_ADDR A:0xfe1b1030
y.create.l HWIO_LPASS_SB_NGD2_TX_MSG1_ADDR A:0xfe1b1034
y.create.l HWIO_LPASS_SB_NGD2_TX_MSG2_ADDR A:0xfe1b1038
y.create.l HWIO_LPASS_SB_NGD2_TX_MSG3_ADDR A:0xfe1b103c
y.create.l HWIO_LPASS_SB_NGD2_TX_MSG4_ADDR A:0xfe1b1040
y.create.l HWIO_LPASS_SB_NGD2_TX_MSG5_ADDR A:0xfe1b1044
y.create.l HWIO_LPASS_SB_NGD2_TX_MSG6_ADDR A:0xfe1b1048
y.create.l HWIO_LPASS_SB_NGD2_TX_MSG7_ADDR A:0xfe1b104c
y.create.l HWIO_LPASS_SB_NGD2_TX_MSG8_ADDR A:0xfe1b1050
y.create.l HWIO_LPASS_SB_NGD2_TX_MSG9_ADDR A:0xfe1b1054
y.create.l HWIO_LPASS_SB_NGD2_RX_MSG0_ADDR A:0xfe1b1070
y.create.l HWIO_LPASS_SB_NGD2_RX_MSG1_ADDR A:0xfe1b1074
y.create.l HWIO_LPASS_SB_NGD2_RX_MSG2_ADDR A:0xfe1b1078
y.create.l HWIO_LPASS_SB_NGD2_RX_MSG3_ADDR A:0xfe1b107c
y.create.l HWIO_LPASS_SB_NGD2_RX_MSG4_ADDR A:0xfe1b1080
y.create.l HWIO_LPASS_SB_NGD2_RX_MSG5_ADDR A:0xfe1b1084
y.create.l HWIO_LPASS_SB_NGD2_RX_MSG6_ADDR A:0xfe1b1088
y.create.l HWIO_LPASS_SB_NGD2_RX_MSG7_ADDR A:0xfe1b108c
y.create.l HWIO_LPASS_SB_NGD2_RX_MSG8_ADDR A:0xfe1b1090
y.create.l HWIO_LPASS_SB_NGD2_RX_MSG9_ADDR A:0xfe1b1094
y.create.l HWIO_LPASS_SB_NGD2_IE_STATUS_ADDR A:0xfe1b10f0
y.create.l HWIO_LPASS_SB_NGD2_VE_STATUS_ADDR A:0xfe1b1100
y.create.l HWIO_LPASS_SB_PGD_CFG_ADDR A:0xfe1af800
y.create.l HWIO_LPASS_SB_PGD_STATUS_ADDR A:0xfe1af804
y.create.l HWIO_LPASS_SB_PGD_DEV_INT_EN_ADDR A:0xfe1af810
y.create.l HWIO_LPASS_SB_PGD_DEV_INT_STATUS_ADDR A:0xfe1af814
y.create.l HWIO_LPASS_SB_PGD_DEV_INT_CLR_ADDR A:0xfe1af818
y.create.l HWIO_LPASS_SB_COMP_TRUST_CFG_ADDR A:0xfe1b2000
y.create.l HWIO_LPASS_SB_COMP_TRUST_DEV1_ADDR A:0xfe1b2004
y.create.l HWIO_LPASS_SB_COMP_TRUST_DEV2_ADDR A:0xfe1b2008
y.create.l HWIO_LPASS_SB_PGD_TRUST_OWN_EE0_ADDR A:0xfe1b200c
y.create.l HWIO_LPASS_SB_PGD_TRUST_OWN_EE1_ADDR A:0xfe1b2010
y.create.l HWIO_LPASS_SB_PGD_TRUST_OWN_EE2_ADDR A:0xfe1b2014
y.create.l HWIO_LPASS_SB_COMP_TEST_ADDR A:0xfe1b3000
y.create.l HWIO_LPASS_SB_COMP_DEBUG_ADDR A:0xfe1b3004
y.create.l HWIO_LPASS_SB_PGD_PORT_INT_EN_EE0_ADDR A:0xfe1b4000
y.create.l HWIO_LPASS_SB_PGD_PORT_INT_EN_EE1_ADDR A:0xfe1b5000
y.create.l HWIO_LPASS_SB_PGD_PORT_INT_EN_EE2_ADDR A:0xfe1b6000
y.create.l HWIO_LPASS_SB_PGD_PORT_INT_STATUS_EE0_ADDR A:0xfe1b4004
y.create.l HWIO_LPASS_SB_PGD_PORT_INT_STATUS_EE1_ADDR A:0xfe1b5004
y.create.l HWIO_LPASS_SB_PGD_PORT_INT_STATUS_EE2_ADDR A:0xfe1b6004
y.create.l HWIO_LPASS_SB_PGD_PORT_INT_CLR_EE0_ADDR A:0xfe1b4008
y.create.l HWIO_LPASS_SB_PGD_PORT_INT_CLR_EE1_ADDR A:0xfe1b5008
y.create.l HWIO_LPASS_SB_PGD_PORT_INT_CLR_EE2_ADDR A:0xfe1b6008
y.create.l HWIO_LPASS_SB_PGD_PORT_CFG0_ADDR A:0xfe1c3000
y.create.l HWIO_LPASS_SB_PGD_PORT_CFG1_ADDR A:0xfe1c4000
y.create.l HWIO_LPASS_SB_PGD_PORT_CFG2_ADDR A:0xfe1c5000
y.create.l HWIO_LPASS_SB_PGD_PORT_CFG3_ADDR A:0xfe1c6000
y.create.l HWIO_LPASS_SB_PGD_PORT_CFG4_ADDR A:0xfe1c7000
y.create.l HWIO_LPASS_SB_PGD_PORT_CFG5_ADDR A:0xfe1c8000
y.create.l HWIO_LPASS_SB_PGD_PORT_CFG6_ADDR A:0xfe1c9000
y.create.l HWIO_LPASS_SB_PGD_PORT_CFG7_ADDR A:0xfe1ca000
y.create.l HWIO_LPASS_SB_PGD_PORT_CFG8_ADDR A:0xfe1cb000
y.create.l HWIO_LPASS_SB_PGD_PORT_CFG9_ADDR A:0xfe1cc000
y.create.l HWIO_LPASS_SB_PGD_PORT_STATUS0_ADDR A:0xfe1c3004
y.create.l HWIO_LPASS_SB_PGD_PORT_STATUS1_ADDR A:0xfe1c4004
y.create.l HWIO_LPASS_SB_PGD_PORT_STATUS2_ADDR A:0xfe1c5004
y.create.l HWIO_LPASS_SB_PGD_PORT_STATUS3_ADDR A:0xfe1c6004
y.create.l HWIO_LPASS_SB_PGD_PORT_STATUS4_ADDR A:0xfe1c7004
y.create.l HWIO_LPASS_SB_PGD_PORT_STATUS5_ADDR A:0xfe1c8004
y.create.l HWIO_LPASS_SB_PGD_PORT_STATUS6_ADDR A:0xfe1c9004
y.create.l HWIO_LPASS_SB_PGD_PORT_STATUS7_ADDR A:0xfe1ca004
y.create.l HWIO_LPASS_SB_PGD_PORT_STATUS8_ADDR A:0xfe1cb004
y.create.l HWIO_LPASS_SB_PGD_PORT_STATUS9_ADDR A:0xfe1cc004
y.create.l HWIO_LPASS_SB_PGD_PORT_PARAM0_ADDR A:0xfe1c3008
y.create.l HWIO_LPASS_SB_PGD_PORT_PARAM1_ADDR A:0xfe1c4008
y.create.l HWIO_LPASS_SB_PGD_PORT_PARAM2_ADDR A:0xfe1c5008
y.create.l HWIO_LPASS_SB_PGD_PORT_PARAM3_ADDR A:0xfe1c6008
y.create.l HWIO_LPASS_SB_PGD_PORT_PARAM4_ADDR A:0xfe1c7008
y.create.l HWIO_LPASS_SB_PGD_PORT_PARAM5_ADDR A:0xfe1c8008
y.create.l HWIO_LPASS_SB_PGD_PORT_PARAM6_ADDR A:0xfe1c9008
y.create.l HWIO_LPASS_SB_PGD_PORT_PARAM7_ADDR A:0xfe1ca008
y.create.l HWIO_LPASS_SB_PGD_PORT_PARAM8_ADDR A:0xfe1cb008
y.create.l HWIO_LPASS_SB_PGD_PORT_PARAM9_ADDR A:0xfe1cc008
y.create.l HWIO_LPASS_SB_PGD_PORT_BLK_SIZE0_ADDR A:0xfe1c300c
y.create.l HWIO_LPASS_SB_PGD_PORT_BLK_SIZE1_ADDR A:0xfe1c400c
y.create.l HWIO_LPASS_SB_PGD_PORT_BLK_SIZE2_ADDR A:0xfe1c500c
y.create.l HWIO_LPASS_SB_PGD_PORT_BLK_SIZE3_ADDR A:0xfe1c600c
y.create.l HWIO_LPASS_SB_PGD_PORT_BLK_SIZE4_ADDR A:0xfe1c700c
y.create.l HWIO_LPASS_SB_PGD_PORT_BLK_SIZE5_ADDR A:0xfe1c800c
y.create.l HWIO_LPASS_SB_PGD_PORT_BLK_SIZE6_ADDR A:0xfe1c900c
y.create.l HWIO_LPASS_SB_PGD_PORT_BLK_SIZE7_ADDR A:0xfe1ca00c
y.create.l HWIO_LPASS_SB_PGD_PORT_BLK_SIZE8_ADDR A:0xfe1cb00c
y.create.l HWIO_LPASS_SB_PGD_PORT_BLK_SIZE9_ADDR A:0xfe1cc00c
y.create.l HWIO_LPASS_SB_PGD_PORT_TRANS_SIZE0_ADDR A:0xfe1c3010
y.create.l HWIO_LPASS_SB_PGD_PORT_TRANS_SIZE1_ADDR A:0xfe1c4010
y.create.l HWIO_LPASS_SB_PGD_PORT_TRANS_SIZE2_ADDR A:0xfe1c5010
y.create.l HWIO_LPASS_SB_PGD_PORT_TRANS_SIZE3_ADDR A:0xfe1c6010
y.create.l HWIO_LPASS_SB_PGD_PORT_TRANS_SIZE4_ADDR A:0xfe1c7010
y.create.l HWIO_LPASS_SB_PGD_PORT_TRANS_SIZE5_ADDR A:0xfe1c8010
y.create.l HWIO_LPASS_SB_PGD_PORT_TRANS_SIZE6_ADDR A:0xfe1c9010
y.create.l HWIO_LPASS_SB_PGD_PORT_TRANS_SIZE7_ADDR A:0xfe1ca010
y.create.l HWIO_LPASS_SB_PGD_PORT_TRANS_SIZE8_ADDR A:0xfe1cb010
y.create.l HWIO_LPASS_SB_PGD_PORT_TRANS_SIZE9_ADDR A:0xfe1cc010
y.create.l HWIO_LPASS_SB_PGD_PORT_MULTI_CHNL0_ADDR A:0xfe1c3014
y.create.l HWIO_LPASS_SB_PGD_PORT_MULTI_CHNL1_ADDR A:0xfe1c4014
y.create.l HWIO_LPASS_SB_PGD_PORT_MULTI_CHNL2_ADDR A:0xfe1c5014
y.create.l HWIO_LPASS_SB_PGD_PORT_MULTI_CHNL3_ADDR A:0xfe1c6014
y.create.l HWIO_LPASS_SB_PGD_PORT_MULTI_CHNL4_ADDR A:0xfe1c7014
y.create.l HWIO_LPASS_SB_PGD_PORT_MULTI_CHNL5_ADDR A:0xfe1c8014
y.create.l HWIO_LPASS_SB_PGD_PORT_MULTI_CHNL6_ADDR A:0xfe1c9014
y.create.l HWIO_LPASS_SB_PGD_PORT_MULTI_CHNL7_ADDR A:0xfe1ca014
y.create.l HWIO_LPASS_SB_PGD_PORT_MULTI_CHNL8_ADDR A:0xfe1cb014
y.create.l HWIO_LPASS_SB_PGD_PORT_MULTI_CHNL9_ADDR A:0xfe1cc014
y.create.l HWIO_LPASS_SB_PGD_PORT_PUSHPULL0_ADDR A:0xfe1c3018
y.create.l HWIO_LPASS_SB_PGD_PORT_PUSHPULL1_ADDR A:0xfe1c4018
y.create.l HWIO_LPASS_SB_PGD_PORT_PUSHPULL2_ADDR A:0xfe1c5018
y.create.l HWIO_LPASS_SB_PGD_PORT_PUSHPULL3_ADDR A:0xfe1c6018
y.create.l HWIO_LPASS_SB_PGD_PORT_PUSHPULL4_ADDR A:0xfe1c7018
y.create.l HWIO_LPASS_SB_PGD_PORT_PUSHPULL5_ADDR A:0xfe1c8018
y.create.l HWIO_LPASS_SB_PGD_PORT_PUSHPULL6_ADDR A:0xfe1c9018
y.create.l HWIO_LPASS_SB_PGD_PORT_PUSHPULL7_ADDR A:0xfe1ca018
y.create.l HWIO_LPASS_SB_PGD_PORT_PUSHPULL8_ADDR A:0xfe1cb018
y.create.l HWIO_LPASS_SB_PGD_PORT_PUSHPULL9_ADDR A:0xfe1cc018
y.create.l HWIO_LPASS_SB_PGD_IE_STATUS_ADDR A:0xfe1af820
y.create.l HWIO_LPASS_SB_PGD_VE_STATUS_ADDR A:0xfe1af830
y.create.l HWIO_LPASS_SB_PGD_PC_CFG0_ADDR A:0xfe1b7000
y.create.l HWIO_LPASS_SB_PGD_PC_CFG1_ADDR A:0xfe1b7800
y.create.l HWIO_LPASS_SB_PGD_PC_CFG2_ADDR A:0xfe1b8000
y.create.l HWIO_LPASS_SB_PGD_PC_CFG3_ADDR A:0xfe1b8800
y.create.l HWIO_LPASS_SB_PGD_PC_CFG4_ADDR A:0xfe1b9000
y.create.l HWIO_LPASS_SB_PGD_PC_CFG5_ADDR A:0xfe1b9800
y.create.l HWIO_LPASS_SB_PGD_PC_CFG6_ADDR A:0xfe1ba000
y.create.l HWIO_LPASS_SB_PGD_PC_CFG7_ADDR A:0xfe1ba800
y.create.l HWIO_LPASS_SB_PGD_PC_CFG8_ADDR A:0xfe1bb000
y.create.l HWIO_LPASS_SB_PGD_PC_CFG9_ADDR A:0xfe1bb800
y.create.l HWIO_LPASS_SB_PGD_PC_VAL0_ADDR A:0xfe1b7004
y.create.l HWIO_LPASS_SB_PGD_PC_VAL1_ADDR A:0xfe1b7804
y.create.l HWIO_LPASS_SB_PGD_PC_VAL2_ADDR A:0xfe1b8004
y.create.l HWIO_LPASS_SB_PGD_PC_VAL3_ADDR A:0xfe1b8804
y.create.l HWIO_LPASS_SB_PGD_PC_VAL4_ADDR A:0xfe1b9004
y.create.l HWIO_LPASS_SB_PGD_PC_VAL5_ADDR A:0xfe1b9804
y.create.l HWIO_LPASS_SB_PGD_PC_VAL6_ADDR A:0xfe1ba004
y.create.l HWIO_LPASS_SB_PGD_PC_VAL7_ADDR A:0xfe1ba804
y.create.l HWIO_LPASS_SB_PGD_PC_VAL8_ADDR A:0xfe1bb004
y.create.l HWIO_LPASS_SB_PGD_PC_VAL9_ADDR A:0xfe1bb804
y.create.l HWIO_LPASS_SB_PGD_PC_VFR_TS0_ADDR A:0xfe1b7008
y.create.l HWIO_LPASS_SB_PGD_PC_VFR_TS1_ADDR A:0xfe1b7808
y.create.l HWIO_LPASS_SB_PGD_PC_VFR_TS2_ADDR A:0xfe1b8008
y.create.l HWIO_LPASS_SB_PGD_PC_VFR_TS3_ADDR A:0xfe1b8808
y.create.l HWIO_LPASS_SB_PGD_PC_VFR_TS4_ADDR A:0xfe1b9008
y.create.l HWIO_LPASS_SB_PGD_PC_VFR_TS5_ADDR A:0xfe1b9808
y.create.l HWIO_LPASS_SB_PGD_PC_VFR_TS6_ADDR A:0xfe1ba008
y.create.l HWIO_LPASS_SB_PGD_PC_VFR_TS7_ADDR A:0xfe1ba808
y.create.l HWIO_LPASS_SB_PGD_PC_VFR_TS8_ADDR A:0xfe1bb008
y.create.l HWIO_LPASS_SB_PGD_PC_VFR_TS9_ADDR A:0xfe1bb808
y.create.l HWIO_LPASS_SB_PGD_PC_VFR_TS_STATUS0_ADDR A:0xfe1b700c
y.create.l HWIO_LPASS_SB_PGD_PC_VFR_TS_STATUS1_ADDR A:0xfe1b780c
y.create.l HWIO_LPASS_SB_PGD_PC_VFR_TS_STATUS2_ADDR A:0xfe1b800c
y.create.l HWIO_LPASS_SB_PGD_PC_VFR_TS_STATUS3_ADDR A:0xfe1b880c
y.create.l HWIO_LPASS_SB_PGD_PC_VFR_TS_STATUS4_ADDR A:0xfe1b900c
y.create.l HWIO_LPASS_SB_PGD_PC_VFR_TS_STATUS5_ADDR A:0xfe1b980c
y.create.l HWIO_LPASS_SB_PGD_PC_VFR_TS_STATUS6_ADDR A:0xfe1ba00c
y.create.l HWIO_LPASS_SB_PGD_PC_VFR_TS_STATUS7_ADDR A:0xfe1ba80c
y.create.l HWIO_LPASS_SB_PGD_PC_VFR_TS_STATUS8_ADDR A:0xfe1bb00c
y.create.l HWIO_LPASS_SB_PGD_PC_VFR_TS_STATUS9_ADDR A:0xfe1bb80c
y.create.l HWIO_LPASS_SB_PGD_PC_VFR_TS_CLR0_ADDR A:0xfe1b7010
y.create.l HWIO_LPASS_SB_PGD_PC_VFR_TS_CLR1_ADDR A:0xfe1b7810
y.create.l HWIO_LPASS_SB_PGD_PC_VFR_TS_CLR2_ADDR A:0xfe1b8010
y.create.l HWIO_LPASS_SB_PGD_PC_VFR_TS_CLR3_ADDR A:0xfe1b8810
y.create.l HWIO_LPASS_SB_PGD_PC_VFR_TS_CLR4_ADDR A:0xfe1b9010
y.create.l HWIO_LPASS_SB_PGD_PC_VFR_TS_CLR5_ADDR A:0xfe1b9810
y.create.l HWIO_LPASS_SB_PGD_PC_VFR_TS_CLR6_ADDR A:0xfe1ba010
y.create.l HWIO_LPASS_SB_PGD_PC_VFR_TS_CLR7_ADDR A:0xfe1ba810
y.create.l HWIO_LPASS_SB_PGD_PC_VFR_TS_CLR8_ADDR A:0xfe1bb010
y.create.l HWIO_LPASS_SB_PGD_PC_VFR_TS_CLR9_ADDR A:0xfe1bb810
y.create.l HWIO_LPASS_SB_PGD_PC_VAL_SHADOW0_ADDR A:0xfe1b7014
y.create.l HWIO_LPASS_SB_PGD_PC_VAL_SHADOW1_ADDR A:0xfe1b7814
y.create.l HWIO_LPASS_SB_PGD_PC_VAL_SHADOW2_ADDR A:0xfe1b8014
y.create.l HWIO_LPASS_SB_PGD_PC_VAL_SHADOW3_ADDR A:0xfe1b8814
y.create.l HWIO_LPASS_SB_PGD_PC_VAL_SHADOW4_ADDR A:0xfe1b9014
y.create.l HWIO_LPASS_SB_PGD_PC_VAL_SHADOW5_ADDR A:0xfe1b9814
y.create.l HWIO_LPASS_SB_PGD_PC_VAL_SHADOW6_ADDR A:0xfe1ba014
y.create.l HWIO_LPASS_SB_PGD_PC_VAL_SHADOW7_ADDR A:0xfe1ba814
y.create.l HWIO_LPASS_SB_PGD_PC_VAL_SHADOW8_ADDR A:0xfe1bb014
y.create.l HWIO_LPASS_SB_PGD_PC_VAL_SHADOW9_ADDR A:0xfe1bb814
y.create.l HWIO_LPASS_SB_PGD_PC_TIMESTAMP_LSB0_ADDR A:0xfe1b7018
y.create.l HWIO_LPASS_SB_PGD_PC_TIMESTAMP_LSB1_ADDR A:0xfe1b7818
y.create.l HWIO_LPASS_SB_PGD_PC_TIMESTAMP_LSB2_ADDR A:0xfe1b8018
y.create.l HWIO_LPASS_SB_PGD_PC_TIMESTAMP_LSB3_ADDR A:0xfe1b8818
y.create.l HWIO_LPASS_SB_PGD_PC_TIMESTAMP_LSB4_ADDR A:0xfe1b9018
y.create.l HWIO_LPASS_SB_PGD_PC_TIMESTAMP_LSB5_ADDR A:0xfe1b9818
y.create.l HWIO_LPASS_SB_PGD_PC_TIMESTAMP_LSB6_ADDR A:0xfe1ba018
y.create.l HWIO_LPASS_SB_PGD_PC_TIMESTAMP_LSB7_ADDR A:0xfe1ba818
y.create.l HWIO_LPASS_SB_PGD_PC_TIMESTAMP_LSB8_ADDR A:0xfe1bb018
y.create.l HWIO_LPASS_SB_PGD_PC_TIMESTAMP_LSB9_ADDR A:0xfe1bb818
y.create.l HWIO_LPASS_SB_PGD_PC_TIMESTAMP_MSB0_ADDR A:0xfe1b701c
y.create.l HWIO_LPASS_SB_PGD_PC_TIMESTAMP_MSB1_ADDR A:0xfe1b781c
y.create.l HWIO_LPASS_SB_PGD_PC_TIMESTAMP_MSB2_ADDR A:0xfe1b801c
y.create.l HWIO_LPASS_SB_PGD_PC_TIMESTAMP_MSB3_ADDR A:0xfe1b881c
y.create.l HWIO_LPASS_SB_PGD_PC_TIMESTAMP_MSB4_ADDR A:0xfe1b901c
y.create.l HWIO_LPASS_SB_PGD_PC_TIMESTAMP_MSB5_ADDR A:0xfe1b981c
y.create.l HWIO_LPASS_SB_PGD_PC_TIMESTAMP_MSB6_ADDR A:0xfe1ba01c
y.create.l HWIO_LPASS_SB_PGD_PC_TIMESTAMP_MSB7_ADDR A:0xfe1ba81c
y.create.l HWIO_LPASS_SB_PGD_PC_TIMESTAMP_MSB8_ADDR A:0xfe1bb01c
y.create.l HWIO_LPASS_SB_PGD_PC_TIMESTAMP_MSB9_ADDR A:0xfe1bb81c
y.create.l HWIO_LPASS_QDSP6SS_VERSION_ADDR A:0xfe200000
y.create.l HWIO_LPASS_QDSP6SS_RST_EVB_ADDR A:0xfe200010
y.create.l HWIO_LPASS_QDSP6SS_RESET_ADDR A:0xfe200014
y.create.l HWIO_LPASS_QDSP6SS_DBG_CFG_ADDR A:0xfe200018
y.create.l HWIO_LPASS_QDSP6SS_RET_CFG_ADDR A:0xfe20001c
y.create.l HWIO_LPASS_QDSP6SS_GFMUX_CTL_ADDR A:0xfe200020
y.create.l HWIO_LPASS_QDSP6SS_GFMUX_STATUS_ADDR A:0xfe200024
y.create.l HWIO_LPASS_QDSP6SS_CORE_CMD_RCGR_ADDR A:0xfe200028
y.create.l HWIO_LPASS_QDSP6SS_CORE_CFG_RCGR_ADDR A:0xfe20002c
y.create.l HWIO_LPASS_QDSP6SS_PWR_CTL_ADDR A:0xfe200030
y.create.l HWIO_LPASS_QDSP6SS_CGC_OVERRIDE_ADDR A:0xfe200034
y.create.l HWIO_LPASS_QDSP6SS_XO_CBCR_ADDR A:0xfe200038
y.create.l HWIO_LPASS_QDSP6SS_SLEEP_CBCR_ADDR A:0xfe20003c
y.create.l HWIO_LPASS_QDSP6SS_NMI_ADDR A:0xfe200040
y.create.l HWIO_LPASS_QDSP6SS_NMI_STATUS_ADDR A:0xfe200044
y.create.l HWIO_LPASS_QDSP6SS_CLOCK_SPDM_MON_ADDR A:0xfe200048
y.create.l HWIO_LPASS_QDSP6SS_LDO_CFG0_ADDR A:0xfe200050
y.create.l HWIO_LPASS_QDSP6SS_LDO_CFG1_ADDR A:0xfe200054
y.create.l HWIO_LPASS_QDSP6SS_LDO_CFG2_ADDR A:0xfe200058
y.create.l HWIO_LPASS_QDSP6SS_LDO_VREF_SET_ADDR A:0xfe20005c
y.create.l HWIO_LPASS_QDSP6SS_LDO_VREF_TEST_CFG_ADDR A:0xfe200060
y.create.l HWIO_LPASS_QDSP6SS_LDO_VREF_CMD_ADDR A:0xfe200064
y.create.l HWIO_LPASS_QDSP6SS_QMC_SVS_CTL_ADDR A:0xfe200068
y.create.l HWIO_LPASS_QDSP6SS_BHS_STATUS_ADDR A:0xfe20006c
y.create.l HWIO_LPASS_QDSP6SS_STRAP_TCM_ADDR A:0xfe200100
y.create.l HWIO_LPASS_QDSP6SS_STRAP_AHBUPPER_ADDR A:0xfe200104
y.create.l HWIO_LPASS_QDSP6SS_STRAP_AHBLOWER_ADDR A:0xfe200108
y.create.l HWIO_LPASS_QDSP6SS_STRAP_ACC_ADDR A:0xfe200110
y.create.l HWIO_LPASS_QDSP6SS_STRAP_QMC_ACC_ADDR A:0xfe200114
y.create.l HWIO_LPASS_QDSP6SS_DCC_CTRL_ADDR A:0xfe200118
y.create.l HWIO_LPASS_QDSP6SS_STRAP_AXIM2UPPER_ADDR A:0xfe20011c
y.create.l HWIO_LPASS_QDSP6SS_STRAP_AXIM2LOWER_ADDR A:0xfe200120
y.create.l HWIO_LPASS_QDSP6SS_PLL_MODE_ADDR A:0xfe200200
y.create.l HWIO_LPASS_QDSP6SS_PLL_L_VAL_ADDR A:0xfe200204
y.create.l HWIO_LPASS_QDSP6SS_PLL_ALPHA_VAL_ADDR A:0xfe200208
y.create.l HWIO_LPASS_QDSP6SS_PLL_ALPHA_VAL_U_ADDR A:0xfe20020c
y.create.l HWIO_LPASS_QDSP6SS_PLL_USER_CTL_ADDR A:0xfe200210
y.create.l HWIO_LPASS_QDSP6SS_PLL_USER_CTL_U_ADDR A:0xfe200214
y.create.l HWIO_LPASS_QDSP6SS_PLL_CONFIG_CTL_ADDR A:0xfe200218
y.create.l HWIO_LPASS_QDSP6SS_PLL_TEST_CTL_ADDR A:0xfe20021c
y.create.l HWIO_LPASS_QDSP6SS_PLL_TEST_CTL_U_ADDR A:0xfe200220
y.create.l HWIO_LPASS_QDSP6SS_PLL_STATUS_ADDR A:0xfe200224
y.create.l HWIO_LPASS_QDSP6SS_PLL_FREQ_CTL_ADDR A:0xfe200228
y.create.l HWIO_LPASS_QDSP6SS_EXT_WAKEUP_ADDR A:0xfe201000
y.create.l HWIO_LPASS_QDSP6SS_EXT_PD_ADDR A:0xfe201004
y.create.l HWIO_LPASS_QDSP6SS_TEST_BUS_CTL_ADDR A:0xfe202000
y.create.l HWIO_LPASS_QDSP6SS_TEST_BUS_VALUE_ADDR A:0xfe202004
y.create.l HWIO_LPASS_QDSP6SS_TEST_BUS_WDATA_ADDR A:0xfe202008
y.create.l HWIO_LPASS_QDSP6SS_PWRDBG_CTL_ADDR A:0xfe20200c
y.create.l HWIO_LPASS_QDSP6SS_TEST_CLK_CTL_ADDR A:0xfe202010
y.create.l HWIO_LPASS_QDSP6SS_PWRDBG_STATUS_ADDR A:0xfe202014
y.create.l HWIO_LPASS_QDSP6SS_ZMEAS_CONFIG_ADDR A:0xfe202018
y.create.l HWIO_LPASS_QDSP6SS_LDO_ATEST_ADDR A:0xfe20201c
y.create.l HWIO_LPASS_QDSP6SS_LDO_DAC_STATUS_LOW_ADDR A:0xfe202020
y.create.l HWIO_LPASS_QDSP6SS_LDO_DAC_STATUS_HIGH_ADDR A:0xfe202024
y.create.l HWIO_LPASS_QDSP6SS_XPU_SCR_ADDR A:0xfe270000
y.create.l HWIO_LPASS_QDSP6SS_XPU_SWDR_ADDR A:0xfe270004
y.create.l HWIO_LPASS_QDSP6SS_XPU_SEAR0_ADDR A:0xfe270040
y.create.l HWIO_LPASS_QDSP6SS_XPU_SESR_ADDR A:0xfe270048
y.create.l HWIO_LPASS_QDSP6SS_XPU_SESRRESTORE_ADDR A:0xfe27004c
y.create.l HWIO_LPASS_QDSP6SS_XPU_SESYNR0_ADDR A:0xfe270050
y.create.l HWIO_LPASS_QDSP6SS_XPU_SESYNR1_ADDR A:0xfe270054
y.create.l HWIO_LPASS_QDSP6SS_XPU_SESYNR2_ADDR A:0xfe270058
y.create.l HWIO_LPASS_QDSP6SS_XPU_MCR_ADDR A:0xfe270100
y.create.l HWIO_LPASS_QDSP6SS_XPU_MEAR0_ADDR A:0xfe270140
y.create.l HWIO_LPASS_QDSP6SS_XPU_MESR_ADDR A:0xfe270148
y.create.l HWIO_LPASS_QDSP6SS_XPU_MESRRESTORE_ADDR A:0xfe27014c
y.create.l HWIO_LPASS_QDSP6SS_XPU_MESYNR0_ADDR A:0xfe270150
y.create.l HWIO_LPASS_QDSP6SS_XPU_MESYNR1_ADDR A:0xfe270154
y.create.l HWIO_LPASS_QDSP6SS_XPU_MESYNR2_ADDR A:0xfe270158
y.create.l HWIO_LPASS_QDSP6SS_XPU_CR_ADDR A:0xfe270080
y.create.l HWIO_LPASS_QDSP6SS_XPU_RPU_ACR0_ADDR A:0xfe2700a0
y.create.l HWIO_LPASS_QDSP6SS_XPU_EAR0_ADDR A:0xfe2700c0
y.create.l HWIO_LPASS_QDSP6SS_XPU_ESR_ADDR A:0xfe2700c8
y.create.l HWIO_LPASS_QDSP6SS_XPU_ESRRESTORE_ADDR A:0xfe2700cc
y.create.l HWIO_LPASS_QDSP6SS_XPU_ESYNR0_ADDR A:0xfe2700d0
y.create.l HWIO_LPASS_QDSP6SS_XPU_ESYNR1_ADDR A:0xfe2700d4
y.create.l HWIO_LPASS_QDSP6SS_XPU_ESYNR2_ADDR A:0xfe2700d8
y.create.l HWIO_LPASS_QDSP6SS_XPU_IDR0_ADDR A:0xfe270074
y.create.l HWIO_LPASS_QDSP6SS_XPU_IDR1_ADDR A:0xfe270078
y.create.l HWIO_LPASS_QDSP6SS_XPU_REV_ADDR A:0xfe27007c
y.create.l HWIO_LPASS_QDSP6SS_XPU_RG0_RACR0_ADDR A:0xfe270200
y.create.l HWIO_LPASS_QDSP6SS_XPU_RG1_RACR0_ADDR A:0xfe270280
y.create.l HWIO_LPASS_QDSP6SS_XPU_RG0_SCR_ADDR A:0xfe270250
y.create.l HWIO_LPASS_QDSP6SS_XPU_RG1_SCR_ADDR A:0xfe2702d0
y.create.l HWIO_LPASS_QDSP6SS_XPU_RG0_MCR_ADDR A:0xfe270254
y.create.l HWIO_LPASS_QDSP6SS_XPU_RG1_MCR_ADDR A:0xfe2702d4
y.create.l HWIO_LPASS_QDSP6SS_INSTANCE_ID_ADDR A:0xfe280000
y.create.l HWIO_LPASS_QDSP6SS_IDLT_MATCH_VAL_ADDR A:0xfe281000
y.create.l HWIO_LPASS_QDSP6SS_IDLT_COUNT_VAL_ADDR A:0xfe281004
y.create.l HWIO_LPASS_QDSP6SS_IDLT_ENABLE_ADDR A:0xfe281008
y.create.l HWIO_LPASS_QDSP6SS_IDLT_SYNC_STATUS_ADDR A:0xfe28100c
y.create.l HWIO_LPASS_QDSP6SS_WDOG_RESET_ADDR A:0xfe282000
y.create.l HWIO_LPASS_QDSP6SS_WDOG_CTL_ADDR A:0xfe282004
y.create.l HWIO_LPASS_QDSP6SS_WDOG_STATUS_ADDR A:0xfe282008
y.create.l HWIO_LPASS_QDSP6SS_WDOG_BARK_TIME_ADDR A:0xfe28200c
y.create.l HWIO_LPASS_QDSP6SS_WDOG_BITE_TIME_ADDR A:0xfe282010
y.create.l HWIO_LPASS_QDSP6SS_WDOG_NMI_TIME_ADDR A:0xfe282014
y.create.l HWIO_LPASS_QDSP6SS_WDOG_TEST_LOAD_ADDR A:0xfe282018
y.create.l HWIO_LPASS_QDSP6SS_WDOG_TEST_ADDR A:0xfe28201c
y.create.l HWIO_LPASS_QDSP6SS_IPC_ADDR A:0xfe285000
y.create.l HWIO_LPASS_QDSP6SS_L1_IRQ_BACKUP_EN_ADDR A:0xfe285010
y.create.l HWIO_LPASS_QDSP6SS_PD_HS_START_ADDR A:0xfe28700c
y.create.l HWIO_LPASS_QDSP6SS_PD_HS_DONE_ADDR A:0xfe287010
y.create.l HWIO_LPASS_QDSP6SS_PU_HS_START_ADDR A:0xfe287014
y.create.l HWIO_LPASS_QDSP6SS_SLPC_CFG_ADDR A:0xfe28701c
y.create.l HWIO_LPASS_QDSP6SS_SLPC_STATUS_ADDR A:0xfe287020
y.create.l HWIO_LPASS_QDSP6SS_SPMCTL_EN_ARES_ADDR A:0xfe287024
y.create.l HWIO_LPASS_QDSP6SS_SPMCTL_EN_CLAMP_ADDR A:0xfe287028
y.create.l HWIO_LPASS_QDSP6SS_SPMCTL_EN_CLK_ADDR A:0xfe28702c
y.create.l HWIO_LPASS_QDSP6SS_SPMCTL_EN_MEM_ADDR A:0xfe287030
y.create.l HWIO_LPASS_QDSP6SS_SPMCTL_EN_BHS_ADDR A:0xfe287034
y.create.l HWIO_LPASS_QDSP6SS_SPMCTL_EN_LDO_ADDR A:0xfe287038
y.create.l HWIO_LPASS_QDSP6SS_SPMCTL_EN_EXT_ADDR A:0xfe28703c
y.create.l HWIO_LPASS_QDSP6SS_SPMCTL_EN_PLL_ADDR A:0xfe287040
y.create.l HWIO_LPASS_QDSP6SS_SPM_EVENT_CTL_ADDR A:0xfe287050
y.create.l HWIO_LPASS_QDSP6SS_MVC_PWR_REQ_ADDR A:0xfe287080
y.create.l HWIO_LPASS_QDSP6SS_L2VIC_VID_ADDR A:0xfe290000
y.create.l HWIO_LPASS_QDSP6SS_L2VIC_INT_ENABLE0_ADDR A:0xfe290100
y.create.l HWIO_LPASS_QDSP6SS_L2VIC_INT_ENABLE1_ADDR A:0xfe290104
y.create.l HWIO_LPASS_QDSP6SS_L2VIC_INT_ENABLE2_ADDR A:0xfe290108
y.create.l HWIO_LPASS_QDSP6SS_L2VIC_INT_ENABLE3_ADDR A:0xfe29010c
y.create.l HWIO_LPASS_QDSP6SS_L2VIC_INT_ENABLE4_ADDR A:0xfe290110
y.create.l HWIO_LPASS_QDSP6SS_L2VIC_INT_ENABLE5_ADDR A:0xfe290114
y.create.l HWIO_LPASS_QDSP6SS_L2VIC_INT_ENABLE6_ADDR A:0xfe290118
y.create.l HWIO_LPASS_QDSP6SS_L2VIC_INT_ENABLE7_ADDR A:0xfe29011c
y.create.l HWIO_LPASS_QDSP6SS_L2VIC_INT_ENABLE8_ADDR A:0xfe290120
y.create.l HWIO_LPASS_QDSP6SS_L2VIC_INT_ENABLE9_ADDR A:0xfe290124
y.create.l HWIO_LPASS_QDSP6SS_L2VIC_INT_ENABLE_CLEAR0_ADDR A:0xfe290180
y.create.l HWIO_LPASS_QDSP6SS_L2VIC_INT_ENABLE_CLEAR1_ADDR A:0xfe290184
y.create.l HWIO_LPASS_QDSP6SS_L2VIC_INT_ENABLE_CLEAR2_ADDR A:0xfe290188
y.create.l HWIO_LPASS_QDSP6SS_L2VIC_INT_ENABLE_CLEAR3_ADDR A:0xfe29018c
y.create.l HWIO_LPASS_QDSP6SS_L2VIC_INT_ENABLE_CLEAR4_ADDR A:0xfe290190
y.create.l HWIO_LPASS_QDSP6SS_L2VIC_INT_ENABLE_CLEAR5_ADDR A:0xfe290194
y.create.l HWIO_LPASS_QDSP6SS_L2VIC_INT_ENABLE_CLEAR6_ADDR A:0xfe290198
y.create.l HWIO_LPASS_QDSP6SS_L2VIC_INT_ENABLE_CLEAR7_ADDR A:0xfe29019c
y.create.l HWIO_LPASS_QDSP6SS_L2VIC_INT_ENABLE_CLEAR8_ADDR A:0xfe2901a0
y.create.l HWIO_LPASS_QDSP6SS_L2VIC_INT_ENABLE_CLEAR9_ADDR A:0xfe2901a4
y.create.l HWIO_LPASS_QDSP6SS_L2VIC_INT_ENABLE_SET0_ADDR A:0xfe290200
y.create.l HWIO_LPASS_QDSP6SS_L2VIC_INT_ENABLE_SET1_ADDR A:0xfe290204
y.create.l HWIO_LPASS_QDSP6SS_L2VIC_INT_ENABLE_SET2_ADDR A:0xfe290208
y.create.l HWIO_LPASS_QDSP6SS_L2VIC_INT_ENABLE_SET3_ADDR A:0xfe29020c
y.create.l HWIO_LPASS_QDSP6SS_L2VIC_INT_ENABLE_SET4_ADDR A:0xfe290210
y.create.l HWIO_LPASS_QDSP6SS_L2VIC_INT_ENABLE_SET5_ADDR A:0xfe290214
y.create.l HWIO_LPASS_QDSP6SS_L2VIC_INT_ENABLE_SET6_ADDR A:0xfe290218
y.create.l HWIO_LPASS_QDSP6SS_L2VIC_INT_ENABLE_SET7_ADDR A:0xfe29021c
y.create.l HWIO_LPASS_QDSP6SS_L2VIC_INT_ENABLE_SET8_ADDR A:0xfe290220
y.create.l HWIO_LPASS_QDSP6SS_L2VIC_INT_ENABLE_SET9_ADDR A:0xfe290224
y.create.l HWIO_LPASS_QDSP6SS_L2VIC_INT_TYPE0_ADDR A:0xfe290280
y.create.l HWIO_LPASS_QDSP6SS_L2VIC_INT_TYPE1_ADDR A:0xfe290284
y.create.l HWIO_LPASS_QDSP6SS_L2VIC_INT_TYPE2_ADDR A:0xfe290288
y.create.l HWIO_LPASS_QDSP6SS_L2VIC_INT_TYPE3_ADDR A:0xfe29028c
y.create.l HWIO_LPASS_QDSP6SS_L2VIC_INT_TYPE4_ADDR A:0xfe290290
y.create.l HWIO_LPASS_QDSP6SS_L2VIC_INT_TYPE5_ADDR A:0xfe290294
y.create.l HWIO_LPASS_QDSP6SS_L2VIC_INT_TYPE6_ADDR A:0xfe290298
y.create.l HWIO_LPASS_QDSP6SS_L2VIC_INT_TYPE7_ADDR A:0xfe29029c
y.create.l HWIO_LPASS_QDSP6SS_L2VIC_INT_TYPE8_ADDR A:0xfe2902a0
y.create.l HWIO_LPASS_QDSP6SS_L2VIC_INT_TYPE9_ADDR A:0xfe2902a4
y.create.l HWIO_LPASS_QDSP6SS_L2VIC_INT_STATUS0_ADDR A:0xfe290380
y.create.l HWIO_LPASS_QDSP6SS_L2VIC_INT_STATUS1_ADDR A:0xfe290384
y.create.l HWIO_LPASS_QDSP6SS_L2VIC_INT_STATUS2_ADDR A:0xfe290388
y.create.l HWIO_LPASS_QDSP6SS_L2VIC_INT_STATUS3_ADDR A:0xfe29038c
y.create.l HWIO_LPASS_QDSP6SS_L2VIC_INT_STATUS4_ADDR A:0xfe290390
y.create.l HWIO_LPASS_QDSP6SS_L2VIC_INT_STATUS5_ADDR A:0xfe290394
y.create.l HWIO_LPASS_QDSP6SS_L2VIC_INT_STATUS6_ADDR A:0xfe290398
y.create.l HWIO_LPASS_QDSP6SS_L2VIC_INT_STATUS7_ADDR A:0xfe29039c
y.create.l HWIO_LPASS_QDSP6SS_L2VIC_INT_STATUS8_ADDR A:0xfe2903a0
y.create.l HWIO_LPASS_QDSP6SS_L2VIC_INT_STATUS9_ADDR A:0xfe2903a4
y.create.l HWIO_LPASS_QDSP6SS_L2VIC_INT_CLEAR0_ADDR A:0xfe290400
y.create.l HWIO_LPASS_QDSP6SS_L2VIC_INT_CLEAR1_ADDR A:0xfe290404
y.create.l HWIO_LPASS_QDSP6SS_L2VIC_INT_CLEAR2_ADDR A:0xfe290408
y.create.l HWIO_LPASS_QDSP6SS_L2VIC_INT_CLEAR3_ADDR A:0xfe29040c
y.create.l HWIO_LPASS_QDSP6SS_L2VIC_INT_CLEAR4_ADDR A:0xfe290410
y.create.l HWIO_LPASS_QDSP6SS_L2VIC_INT_CLEAR5_ADDR A:0xfe290414
y.create.l HWIO_LPASS_QDSP6SS_L2VIC_INT_CLEAR6_ADDR A:0xfe290418
y.create.l HWIO_LPASS_QDSP6SS_L2VIC_INT_CLEAR7_ADDR A:0xfe29041c
y.create.l HWIO_LPASS_QDSP6SS_L2VIC_INT_CLEAR8_ADDR A:0xfe290420
y.create.l HWIO_LPASS_QDSP6SS_L2VIC_INT_CLEAR9_ADDR A:0xfe290424
y.create.l HWIO_LPASS_QDSP6SS_L2VIC_SOFT_INT0_ADDR A:0xfe290480
y.create.l HWIO_LPASS_QDSP6SS_L2VIC_SOFT_INT1_ADDR A:0xfe290484
y.create.l HWIO_LPASS_QDSP6SS_L2VIC_SOFT_INT2_ADDR A:0xfe290488
y.create.l HWIO_LPASS_QDSP6SS_L2VIC_SOFT_INT3_ADDR A:0xfe29048c
y.create.l HWIO_LPASS_QDSP6SS_L2VIC_SOFT_INT4_ADDR A:0xfe290490
y.create.l HWIO_LPASS_QDSP6SS_L2VIC_SOFT_INT5_ADDR A:0xfe290494
y.create.l HWIO_LPASS_QDSP6SS_L2VIC_SOFT_INT6_ADDR A:0xfe290498
y.create.l HWIO_LPASS_QDSP6SS_L2VIC_SOFT_INT7_ADDR A:0xfe29049c
y.create.l HWIO_LPASS_QDSP6SS_L2VIC_SOFT_INT8_ADDR A:0xfe2904a0
y.create.l HWIO_LPASS_QDSP6SS_L2VIC_SOFT_INT9_ADDR A:0xfe2904a4
y.create.l HWIO_LPASS_QDSP6SS_L2VIC_INT_PENDING0_ADDR A:0xfe290500
y.create.l HWIO_LPASS_QDSP6SS_L2VIC_INT_PENDING1_ADDR A:0xfe290504
y.create.l HWIO_LPASS_QDSP6SS_L2VIC_INT_PENDING2_ADDR A:0xfe290508
y.create.l HWIO_LPASS_QDSP6SS_L2VIC_INT_PENDING3_ADDR A:0xfe29050c
y.create.l HWIO_LPASS_QDSP6SS_L2VIC_INT_PENDING4_ADDR A:0xfe290510
y.create.l HWIO_LPASS_QDSP6SS_L2VIC_INT_PENDING5_ADDR A:0xfe290514
y.create.l HWIO_LPASS_QDSP6SS_L2VIC_INT_PENDING6_ADDR A:0xfe290518
y.create.l HWIO_LPASS_QDSP6SS_L2VIC_INT_PENDING7_ADDR A:0xfe29051c
y.create.l HWIO_LPASS_QDSP6SS_L2VIC_INT_PENDING8_ADDR A:0xfe290520
y.create.l HWIO_LPASS_QDSP6SS_L2VIC_INT_PENDING9_ADDR A:0xfe290524
y.create.l HWIO_LPASS_QDSP6SS_QTMR_AC_CNTFRQ_ADDR A:0xfe2a0000
y.create.l HWIO_LPASS_QDSP6SS_QTMR_AC_CNTSR_ADDR A:0xfe2a0004
y.create.l HWIO_LPASS_QDSP6SS_QTMR_AC_CNTTID_ADDR A:0xfe2a0008
y.create.l HWIO_LPASS_QDSP6SS_QTMR_AC_CNTACR_0_ADDR A:0xfe2a0040
y.create.l HWIO_LPASS_QDSP6SS_QTMR_AC_CNTACR_1_ADDR A:0xfe2a0044
y.create.l HWIO_LPASS_QDSP6SS_QTMR_AC_CNTACR_2_ADDR A:0xfe2a0048
y.create.l HWIO_LPASS_QDSP6SS_QTMR_AC_CNTVOFF_LO_0_ADDR A:0xfe2a0080
y.create.l HWIO_LPASS_QDSP6SS_QTMR_AC_CNTVOFF_LO_1_ADDR A:0xfe2a0088
y.create.l HWIO_LPASS_QDSP6SS_QTMR_AC_CNTVOFF_LO_2_ADDR A:0xfe2a0090
y.create.l HWIO_LPASS_QDSP6SS_QTMR_AC_CNTVOFF_HI_0_ADDR A:0xfe2a0084
y.create.l HWIO_LPASS_QDSP6SS_QTMR_AC_CNTVOFF_HI_1_ADDR A:0xfe2a008c
y.create.l HWIO_LPASS_QDSP6SS_QTMR_AC_CNTVOFF_HI_2_ADDR A:0xfe2a0094
y.create.l HWIO_LPASS_QDSP6SS_QTMR_AC_CFG_ADDR A:0xfe2a0fc0
y.create.l HWIO_LPASS_QDSP6SS_QTMR_AC_VERSION_ADDR A:0xfe2a0fd0
y.create.l HWIO_LPASS_QDSP6SS_QTMR_V1_CNTPCT_LO_0_ADDR A:0xfe2a1000
y.create.l HWIO_LPASS_QDSP6SS_QTMR_V1_CNTPCT_HI_0_ADDR A:0xfe2a1004
y.create.l HWIO_LPASS_QDSP6SS_QTMR_V1_CNTVCT_LO_0_ADDR A:0xfe2a1008
y.create.l HWIO_LPASS_QDSP6SS_QTMR_V1_CNTVCT_HI_0_ADDR A:0xfe2a100c
y.create.l HWIO_LPASS_QDSP6SS_QTMR_V1_CNTFRQ_0_ADDR A:0xfe2a1010
y.create.l HWIO_LPASS_QDSP6SS_QTMR_V1_CNTPL0ACR_0_ADDR A:0xfe2a1014
y.create.l HWIO_LPASS_QDSP6SS_QTMR_V1_CNTVOFF_LO_0_ADDR A:0xfe2a1018
y.create.l HWIO_LPASS_QDSP6SS_QTMR_V1_CNTVOFF_HI_0_ADDR A:0xfe2a101c
y.create.l HWIO_LPASS_QDSP6SS_QTMR_V1_CNTP_CVAL_LO_0_ADDR A:0xfe2a1020
y.create.l HWIO_LPASS_QDSP6SS_QTMR_V1_CNTP_CVAL_HI_0_ADDR A:0xfe2a1024
y.create.l HWIO_LPASS_QDSP6SS_QTMR_V1_CNTP_TVAL_0_ADDR A:0xfe2a1028
y.create.l HWIO_LPASS_QDSP6SS_QTMR_V1_CNTP_CTL_0_ADDR A:0xfe2a102c
y.create.l HWIO_LPASS_QDSP6SS_QTMR_V1_CNTV_CVAL_LO_0_ADDR A:0xfe2a1030
y.create.l HWIO_LPASS_QDSP6SS_QTMR_V1_CNTV_CVAL_HI_0_ADDR A:0xfe2a1034
y.create.l HWIO_LPASS_QDSP6SS_QTMR_V1_CNTV_TVAL_0_ADDR A:0xfe2a1038
y.create.l HWIO_LPASS_QDSP6SS_QTMR_V1_CNTV_CTL_0_ADDR A:0xfe2a103c
y.create.l HWIO_LPASS_QDSP6SS_QTMR_V1_VERSION_0_ADDR A:0xfe2a1fd0
y.create.l HWIO_LPASS_QDSP6SS_QTMR_V1_CNTPCT_LO_1_ADDR A:0xfe2a2000
y.create.l HWIO_LPASS_QDSP6SS_QTMR_V1_CNTPCT_HI_1_ADDR A:0xfe2a2004
y.create.l HWIO_LPASS_QDSP6SS_QTMR_V1_CNTVCT_LO_1_ADDR A:0xfe2a2008
y.create.l HWIO_LPASS_QDSP6SS_QTMR_V1_CNTVCT_HI_1_ADDR A:0xfe2a200c
y.create.l HWIO_LPASS_QDSP6SS_QTMR_V1_CNTFRQ_1_ADDR A:0xfe2a2010
y.create.l HWIO_LPASS_QDSP6SS_QTMR_V1_CNTPL0ACR_1_ADDR A:0xfe2a2014
y.create.l HWIO_LPASS_QDSP6SS_QTMR_V1_CNTVOFF_LO_1_ADDR A:0xfe2a2018
y.create.l HWIO_LPASS_QDSP6SS_QTMR_V1_CNTVOFF_HI_1_ADDR A:0xfe2a201c
y.create.l HWIO_LPASS_QDSP6SS_QTMR_V1_CNTP_CVAL_LO_1_ADDR A:0xfe2a2020
y.create.l HWIO_LPASS_QDSP6SS_QTMR_V1_CNTP_CVAL_HI_1_ADDR A:0xfe2a2024
y.create.l HWIO_LPASS_QDSP6SS_QTMR_V1_CNTP_TVAL_1_ADDR A:0xfe2a2028
y.create.l HWIO_LPASS_QDSP6SS_QTMR_V1_CNTP_CTL_1_ADDR A:0xfe2a202c
y.create.l HWIO_LPASS_QDSP6SS_QTMR_V1_CNTV_CVAL_LO_1_ADDR A:0xfe2a2030
y.create.l HWIO_LPASS_QDSP6SS_QTMR_V1_CNTV_CVAL_HI_1_ADDR A:0xfe2a2034
y.create.l HWIO_LPASS_QDSP6SS_QTMR_V1_CNTV_TVAL_1_ADDR A:0xfe2a2038
y.create.l HWIO_LPASS_QDSP6SS_QTMR_V1_CNTV_CTL_1_ADDR A:0xfe2a203c
y.create.l HWIO_LPASS_QDSP6SS_QTMR_V1_VERSION_1_ADDR A:0xfe2a2fd0
y.create.l HWIO_LPASS_QDSP6SS_QTMR_V1_CNTPCT_LO_2_ADDR A:0xfe2a3000
y.create.l HWIO_LPASS_QDSP6SS_QTMR_V1_CNTPCT_HI_2_ADDR A:0xfe2a3004
y.create.l HWIO_LPASS_QDSP6SS_QTMR_V1_CNTVCT_LO_2_ADDR A:0xfe2a3008
y.create.l HWIO_LPASS_QDSP6SS_QTMR_V1_CNTVCT_HI_2_ADDR A:0xfe2a300c
y.create.l HWIO_LPASS_QDSP6SS_QTMR_V1_CNTFRQ_2_ADDR A:0xfe2a3010
y.create.l HWIO_LPASS_QDSP6SS_QTMR_V1_CNTPL0ACR_2_ADDR A:0xfe2a3014
y.create.l HWIO_LPASS_QDSP6SS_QTMR_V1_CNTVOFF_LO_2_ADDR A:0xfe2a3018
y.create.l HWIO_LPASS_QDSP6SS_QTMR_V1_CNTVOFF_HI_2_ADDR A:0xfe2a301c
y.create.l HWIO_LPASS_QDSP6SS_QTMR_V1_CNTP_CVAL_LO_2_ADDR A:0xfe2a3020
y.create.l HWIO_LPASS_QDSP6SS_QTMR_V1_CNTP_CVAL_HI_2_ADDR A:0xfe2a3024
y.create.l HWIO_LPASS_QDSP6SS_QTMR_V1_CNTP_TVAL_2_ADDR A:0xfe2a3028
y.create.l HWIO_LPASS_QDSP6SS_QTMR_V1_CNTP_CTL_2_ADDR A:0xfe2a302c
y.create.l HWIO_LPASS_QDSP6SS_QTMR_V1_CNTV_CVAL_LO_2_ADDR A:0xfe2a3030
y.create.l HWIO_LPASS_QDSP6SS_QTMR_V1_CNTV_CVAL_HI_2_ADDR A:0xfe2a3034
y.create.l HWIO_LPASS_QDSP6SS_QTMR_V1_CNTV_TVAL_2_ADDR A:0xfe2a3038
y.create.l HWIO_LPASS_QDSP6SS_QTMR_V1_CNTV_CTL_2_ADDR A:0xfe2a303c
y.create.l HWIO_LPASS_QDSP6SS_QTMR_V1_VERSION_2_ADDR A:0xfe2a3fd0
y.create.l HWIO_LPASS_QDSP6SS_SAW2_SECURE_ADDR A:0xfe2b0000
y.create.l HWIO_LPASS_QDSP6SS_SAW2_ID_ADDR A:0xfe2b0004
y.create.l HWIO_LPASS_QDSP6SS_SAW2_CFG_ADDR A:0xfe2b0008
y.create.l HWIO_LPASS_QDSP6SS_SAW2_SPM_STS_ADDR A:0xfe2b000c
y.create.l HWIO_LPASS_QDSP6SS_SAW2_AVS_STS_ADDR A:0xfe2b0010
y.create.l HWIO_LPASS_QDSP6SS_SAW2_PMIC_STS_ADDR A:0xfe2b0014
y.create.l HWIO_LPASS_QDSP6SS_SAW2_RST_ADDR A:0xfe2b0018
y.create.l HWIO_LPASS_QDSP6SS_SAW2_VCTL_ADDR A:0xfe2b001c
y.create.l HWIO_LPASS_QDSP6SS_SAW2_AVS_CTL_ADDR A:0xfe2b0020
y.create.l HWIO_LPASS_QDSP6SS_SAW2_AVS_LIMIT_ADDR A:0xfe2b0024
y.create.l HWIO_LPASS_QDSP6SS_SAW2_AVS_DLY_ADDR A:0xfe2b0028
y.create.l HWIO_LPASS_QDSP6SS_SAW2_AVS_HYSTERESIS_ADDR A:0xfe2b002c
y.create.l HWIO_LPASS_QDSP6SS_SAW2_SPM_CTL_ADDR A:0xfe2b0030
y.create.l HWIO_LPASS_QDSP6SS_SAW2_SPM_DLY_ADDR A:0xfe2b0034
y.create.l HWIO_LPASS_QDSP6SS_SAW2_SPM_STS2_ADDR A:0xfe2b0038
y.create.l HWIO_LPASS_QDSP6SS_SAW2_SPM_SLP_SEQ_ENTRY_0_ADDR A:0xfe2b0400
y.create.l HWIO_LPASS_QDSP6SS_SAW2_SPM_SLP_SEQ_ENTRY_1_ADDR A:0xfe2b0404
y.create.l HWIO_LPASS_QDSP6SS_SAW2_SPM_SLP_SEQ_ENTRY_2_ADDR A:0xfe2b0408
y.create.l HWIO_LPASS_QDSP6SS_SAW2_SPM_SLP_SEQ_ENTRY_3_ADDR A:0xfe2b040c
y.create.l HWIO_LPASS_QDSP6SS_SAW2_SPM_SLP_SEQ_ENTRY_4_ADDR A:0xfe2b0410
y.create.l HWIO_LPASS_QDSP6SS_SAW2_SPM_SLP_SEQ_ENTRY_5_ADDR A:0xfe2b0414
y.create.l HWIO_LPASS_QDSP6SS_SAW2_SPM_SLP_SEQ_ENTRY_6_ADDR A:0xfe2b0418
y.create.l HWIO_LPASS_QDSP6SS_SAW2_SPM_SLP_SEQ_ENTRY_7_ADDR A:0xfe2b041c
y.create.l HWIO_LPASS_QDSP6SS_SAW2_SPM_SLP_SEQ_ENTRY_8_ADDR A:0xfe2b0420
y.create.l HWIO_LPASS_QDSP6SS_SAW2_SPM_SLP_SEQ_ENTRY_9_ADDR A:0xfe2b0424
y.create.l HWIO_LPASS_QDSP6SS_SAW2_SPM_PMIC_DATA_0_ADDR A:0xfe2b0040
y.create.l HWIO_LPASS_QDSP6SS_SAW2_SPM_PMIC_DATA_1_ADDR A:0xfe2b0044
y.create.l HWIO_LPASS_QDSP6SS_SAW2_SPM_PMIC_DATA_2_ADDR A:0xfe2b0048
y.create.l HWIO_LPASS_QDSP6SS_SAW2_SPM_PMIC_DATA_3_ADDR A:0xfe2b004c
y.create.l HWIO_LPASS_QDSP6SS_SAW2_VERSION_ADDR A:0xfe2b0fd0
y.create.l HWIO_MSS_MODEM_DTR_PLL1_MODE_ADDR A:0x1:0x0
y.create.l HWIO_MSS_MODEM_DTR_PLL1_L_VAL_ADDR A:0x1:0x8
y.create.l HWIO_MSS_MODEM_DTR_PLL1_ALPHA_VAL_L_ADDR A:0x1:0x10
y.create.l HWIO_MSS_MODEM_DTR_PLL1_ALPHA_VAL_H_ADDR A:0x1:0x18
y.create.l HWIO_MSS_MODEM_DTR_PLL1_USER_CTL_ADDR A:0x1:0x20
y.create.l HWIO_MSS_MODEM_DTR_PLL1_CONFIG_CTL_ADDR A:0x1:0x28
y.create.l HWIO_MSS_MODEM_DTR_PLL1_TEST_CTL_ADDR A:0x1:0x30
y.create.l HWIO_MSS_MODEM_DTR_PLL1_STATUS_ADDR A:0x1:0x38
y.create.l HWIO_MSS_MODEM_DTR_PLL2_MODE_ADDR A:0x1:0x40
y.create.l HWIO_MSS_MODEM_DTR_PLL2_L_VAL_ADDR A:0x1:0x48
y.create.l HWIO_MSS_MODEM_DTR_PLL2_ALPHA_VAL_L_ADDR A:0x1:0x50
y.create.l HWIO_MSS_MODEM_DTR_PLL2_ALPHA_VAL_H_ADDR A:0x1:0x58
y.create.l HWIO_MSS_MODEM_DTR_PLL2_USER_CTL_ADDR A:0x1:0x60
y.create.l HWIO_MSS_MODEM_DTR_PLL2_CONFIG_CTL_ADDR A:0x1:0x68
y.create.l HWIO_MSS_MODEM_DTR_PLL2_TEST_CTL_ADDR A:0x1:0x70
y.create.l HWIO_MSS_MODEM_DTR_PLL2_STATUS_ADDR A:0x1:0x78
y.create.l HWIO_ADC0_CLK_CFG_ADDR A:0x1:0x80
y.create.l HWIO_ADC1_CLK_CFG_ADDR A:0x1:0x88
y.create.l HWIO_ADC2_CLK_CFG_ADDR A:0x1:0x90
y.create.l HWIO_ADC3_CLK_CFG_ADDR A:0x1:0x98
y.create.l HWIO_ADC4_CLK_CFG_ADDR A:0x1:0xa0
y.create.l HWIO_ADC0_TEST1_REG_ADDR A:0x1:0xa8
y.create.l HWIO_ADC1_TEST1_REG_ADDR A:0x1:0xb0
y.create.l HWIO_ADC2_TEST1_REG_ADDR A:0x1:0xb8
y.create.l HWIO_ADC3_TEST1_REG_ADDR A:0x1:0xc0
y.create.l HWIO_ADC4_TEST1_REG_ADDR A:0x1:0xc8
y.create.l HWIO_ADC0_TEST2_REG_ADDR A:0x1:0xd0
y.create.l HWIO_ADC1_TEST2_REG_ADDR A:0x1:0xd8
y.create.l HWIO_ADC2_TEST2_REG_ADDR A:0x1:0xe0
y.create.l HWIO_ADC3_TEST2_REG_ADDR A:0x1:0xe8
y.create.l HWIO_ADC4_TEST2_REG_ADDR A:0x1:0xf0
y.create.l HWIO_ADC0_TEST3_REG_ADDR A:0x1:0xf8
y.create.l HWIO_ADC1_TEST3_REG_ADDR A:0x1:0x100
y.create.l HWIO_ADC2_TEST3_REG_ADDR A:0x1:0x108
y.create.l HWIO_ADC3_TEST3_REG_ADDR A:0x1:0x110
y.create.l HWIO_ADC4_TEST3_REG_ADDR A:0x1:0x118
y.create.l HWIO_ADC0_CONFIG_REG_ADDR A:0x1:0x120
y.create.l HWIO_ADC1_CONFIG_REG_ADDR A:0x1:0x128
y.create.l HWIO_ADC2_CONFIG_REG_ADDR A:0x1:0x130
y.create.l HWIO_ADC3_CONFIG_REG_ADDR A:0x1:0x138
y.create.l HWIO_ADC4_CONFIG_REG_ADDR A:0x1:0x140
y.create.l HWIO_ADC0_CONFIG2_REG_ADDR A:0x1:0x148
y.create.l HWIO_ADC1_CONFIG2_REG_ADDR A:0x1:0x150
y.create.l HWIO_ADC2_CONFIG2_REG_ADDR A:0x1:0x158
y.create.l HWIO_ADC3_CONFIG2_REG_ADDR A:0x1:0x160
y.create.l HWIO_ADC4_CONFIG2_REG_ADDR A:0x1:0x168
y.create.l HWIO_ADC0_CONTROL_REG_ADDR A:0x1:0x170
y.create.l HWIO_ADC1_CONTROL_REG_ADDR A:0x1:0x178
y.create.l HWIO_ADC2_CONTROL_REG_ADDR A:0x1:0x180
y.create.l HWIO_ADC3_CONTROL_REG_ADDR A:0x1:0x188
y.create.l HWIO_ADC4_CONTROL_REG_ADDR A:0x1:0x190
y.create.l HWIO_ADC_TEST_CFG_REG_ADDR A:0x1:0x198
y.create.l HWIO_DAC_CLK_CFG_ADDR A:0x1:0x1a0
y.create.l HWIO_EXT_GPIO_SEL_CFG_ADDR A:0x1:0x1a8
y.create.l HWIO_CLK_XO_GATE_CFG_ADDR A:0x1:0x1b0
y.create.l HWIO_DBG_CLK_SEL_CFG_ADDR A:0x1:0x1b8
y.create.l HWIO_RXFE_ENABLE_ADDR A:0x1:0x10000
y.create.l HWIO_RXFE_ADC0_LOGIC_CFG_ADDR A:0x1:0x10004
y.create.l HWIO_RXFE_ADC1_LOGIC_CFG_ADDR A:0x1:0x10008
y.create.l HWIO_RXFE_ADC2_LOGIC_CFG_ADDR A:0x1:0x1000c
y.create.l HWIO_RXFE_ADC3_LOGIC_CFG_ADDR A:0x1:0x10010
y.create.l HWIO_RXFE_ADC4_LOGIC_CFG_ADDR A:0x1:0x10014
y.create.l HWIO_RXFE_WB0_ADCMUX_CFG_ADDR A:0x1:0x10018
y.create.l HWIO_RXFE_WB1_ADCMUX_CFG_ADDR A:0x1:0x1001c
y.create.l HWIO_RXFE_WB2_ADCMUX_CFG_ADDR A:0x1:0x10020
y.create.l HWIO_RXFE_WB3_ADCMUX_CFG_ADDR A:0x1:0x10024
y.create.l HWIO_RXFE_WB4_ADCMUX_CFG_ADDR A:0x1:0x10028
y.create.l HWIO_RXFE_NB0_WBMUX_CFG_ADDR A:0x1:0x1002c
y.create.l HWIO_RXFE_NB1_WBMUX_CFG_ADDR A:0x1:0x10030
y.create.l HWIO_RXFE_NB2_WBMUX_CFG_ADDR A:0x1:0x10034
y.create.l HWIO_RXFE_NB3_WBMUX_CFG_ADDR A:0x1:0x10038
y.create.l HWIO_RXFE_NB4_WBMUX_CFG_ADDR A:0x1:0x1003c
y.create.l HWIO_RXFE_NB5_WBMUX_CFG_ADDR A:0x1:0x10040
y.create.l HWIO_RXFE_NB6_WBMUX_CFG_ADDR A:0x1:0x10044
y.create.l HWIO_RXFE_NB7_WBMUX_CFG_ADDR A:0x1:0x10048
y.create.l HWIO_RXFE_NB8_WBMUX_CFG_ADDR A:0x1:0x1004c
y.create.l HWIO_RXFE_TOP_STATUS_ADDR A:0x1:0x10054
y.create.l HWIO_RXFE_RFIF_UPDATE_CMD_ADDR A:0x1:0x10058
y.create.l HWIO_RXFE_CMNNOTCH_FILT0_CFG0_ADDR A:0x1:0x1005c
y.create.l HWIO_RXFE_CMNNOTCH_FILT0_CFG1_ADDR A:0x1:0x10060
y.create.l HWIO_RXFE_CMNNOTCH_FILT1_CFG0_ADDR A:0x1:0x10064
y.create.l HWIO_RXFE_CMNNOTCH_FILT1_CFG1_ADDR A:0x1:0x10068
y.create.l HWIO_RXFE_CMNNOTCH_FILT2_CFG0_ADDR A:0x1:0x1006c
y.create.l HWIO_RXFE_CMNNOTCH_FILT2_CFG1_ADDR A:0x1:0x10070
y.create.l HWIO_RXFE_CMNNOTCH_FILT3_CFG0_ADDR A:0x1:0x10074
y.create.l HWIO_RXFE_CMNNOTCH_FILT3_CFG1_ADDR A:0x1:0x10078
y.create.l HWIO_RXFE_CMNNOTCH_FILT01_CFG_ADDR A:0x1:0x1007c
y.create.l HWIO_RXFE_CMNNOTCH_FILT23_CFG_ADDR A:0x1:0x10080
y.create.l HWIO_RXFE_ACI_FILT0_CFG_ADDR A:0x1:0x10084
y.create.l HWIO_RXFE_ACI_FILT1_CFG_ADDR A:0x1:0x10088
y.create.l HWIO_RXFE_DBG_ENABLES_ADDR A:0x1:0x1008c
y.create.l HWIO_RXFE_DBG_PROBE_CTL_ADDR A:0x1:0x10090
y.create.l HWIO_RXFE_DBG_CMD_ADDR A:0x1:0x10094
y.create.l HWIO_RXFE_PBS_CFG_ADDR A:0x1:0x10098
y.create.l HWIO_RXFE_DEC8_FILT0_CFG_ADDR A:0x1:0x1009c
y.create.l HWIO_RXFE_DEC8_FILT1_CFG_ADDR A:0x1:0x100a0
y.create.l HWIO_RXFE_TOP_SPARE_REG_ADDR A:0x1:0x100a4
y.create.l HWIO_RXFE_WB_TOP_CTL_WB0_ADDR A:0x1:0x18000
y.create.l HWIO_RXFE_WB_TOP_CMD_WB0_ADDR A:0x1:0x18004
y.create.l HWIO_RXFE_WB_TOP_STATUS_WB0_ADDR A:0x1:0x18008
y.create.l HWIO_RXFE_WB_STOPGATE_ACTION_SAMPLE_WB0_ADDR A:0x1:0x1800c
y.create.l HWIO_RXFE_WB_TIMINGCTL_STATUS_WB0_ADDR A:0x1:0x18010
y.create.l HWIO_RXFE_WB_MISC_CFG_WB0_ADDR A:0x1:0x18014
y.create.l HWIO_RXFE_WB_WBPWR_CFG_WB0_ADDR A:0x1:0x18018
y.create.l HWIO_RXFE_WB_WBPWR_CMD_WB0_ADDR A:0x1:0x1801c
y.create.l HWIO_RXFE_WB_WBPWR_START_ACTION_SAMPLE_WB0_ADDR A:0x1:0x18020
y.create.l HWIO_RXFE_WB_WBPWR_START_MASK_WB0_ADDR A:0x1:0x18024
y.create.l HWIO_RXFE_WB_WBPWR_STOP_ACTION_SAMPLE_WB0_ADDR A:0x1:0x18028
y.create.l HWIO_RXFE_WB_WBPWR_FINAL_ACC_WB0_ADDR A:0x1:0x1802c
y.create.l HWIO_RXFE_WB_WBPWR_CURR_ACC_WB0_ADDR A:0x1:0x18030
y.create.l HWIO_RXFE_WB_WBPWR_MAX_ACC_WB0_ADDR A:0x1:0x18034
y.create.l HWIO_RXFE_WB_WBDC_CFG_WB0_ADDR A:0x1:0x18038
y.create.l HWIO_RXFE_WB_WBDC_CMD_WB0_ADDR A:0x1:0x1803c
y.create.l HWIO_RXFE_WB_WBDC_START_ACTION_SAMPLE_WB0_ADDR A:0x1:0x18040
y.create.l HWIO_RXFE_WB_WBDC_STOP_ACTION_SAMPLE_WB0_ADDR A:0x1:0x18044
y.create.l HWIO_RXFE_WB_WBDC_UPDATE_ACTION_SAMPLE_WB0_ADDR A:0x1:0x18048
y.create.l HWIO_RXFE_WB_WBDC_UPDATE_DELAY_WB0_ADDR A:0x1:0x1804c
y.create.l HWIO_RXFE_WB_WBDC_OVRD_I_WB0_ADDR A:0x1:0x18050
y.create.l HWIO_RXFE_WB_WBDC_OVRD_Q_WB0_ADDR A:0x1:0x18054
y.create.l HWIO_RXFE_WB_WBDC_EST1_CURR_I_WB0_ADDR A:0x1:0x18058
y.create.l HWIO_RXFE_WB_WBDC_EST1_CURR_Q_WB0_ADDR A:0x1:0x1805c
y.create.l HWIO_RXFE_WB_WBDC_EST1_PREV_I_WB0_ADDR A:0x1:0x18060
y.create.l HWIO_RXFE_WB_WBDC_EST1_PREV_Q_WB0_ADDR A:0x1:0x18064
y.create.l HWIO_RXFE_WB_WBDC_EST1_LOAD_I_WB0_ADDR A:0x1:0x18068
y.create.l HWIO_RXFE_WB_WBDC_EST1_LOAD_Q_WB0_ADDR A:0x1:0x1806c
y.create.l HWIO_RXFE_WB_WBDC_EST2_CURR_I_WB0_ADDR A:0x1:0x18070
y.create.l HWIO_RXFE_WB_WBDC_EST2_CURR_Q_WB0_ADDR A:0x1:0x18074
y.create.l HWIO_RXFE_WB_WBDC_EST2_PREV_I_WB0_ADDR A:0x1:0x18078
y.create.l HWIO_RXFE_WB_WBDC_EST2_PREV_Q_WB0_ADDR A:0x1:0x1807c
y.create.l HWIO_RXFE_WB_WBDC_EST2_LOAD_I_WB0_ADDR A:0x1:0x18080
y.create.l HWIO_RXFE_WB_WBDC_EST2_LOAD_Q_WB0_ADDR A:0x1:0x18084
y.create.l HWIO_RXFE_WB_VSRC_CFG_WB0_ADDR A:0x1:0x18088
y.create.l HWIO_RXFE_WB_VSRC_T2BYT1M1_WB0_ADDR A:0x1:0x1808c
y.create.l HWIO_RXFE_WB_VSRC_CMD_WB0_ADDR A:0x1:0x18090
y.create.l HWIO_RXFE_WB_VSRC_STATUS_WB0_ADDR A:0x1:0x18094
y.create.l HWIO_RXFE_WB_VSRC_UPDT_ACTION_SAMPLE_WB0_ADDR A:0x1:0x18098
y.create.l HWIO_RXFE_WB_VSRC_CURR_T1BYT2_WB0_ADDR A:0x1:0x1809c
y.create.l HWIO_RXFE_WB_VSRC_CURR_T2BYT1M1_WB0_ADDR A:0x1:0x180a0
y.create.l HWIO_RXFE_WB_VSRC_SCTR_LOAD_VALUE_WB0_ADDR A:0x1:0x180a4
y.create.l HWIO_RXFE_WB_VSRC_SCTR_WA_WB0_ADDR A:0x1:0x180a8
y.create.l HWIO_RXFE_WB_VSRC_SCTR_SNAPSHOT_WB0_ADDR A:0x1:0x180ac
y.create.l HWIO_RXFE_WB_VSRC_ACC_SNAPSHOT_WB0_ADDR A:0x1:0x180b0
y.create.l HWIO_RXFE_WB_DEC_FILT_CFG_WB0_ADDR A:0x1:0x180b4
y.create.l HWIO_RXFE_WB_IQMC_CFG0_WB0_ADDR A:0x1:0x180b8
y.create.l HWIO_RXFE_WB_IQMC_CFG1_WB0_ADDR A:0x1:0x180bc
y.create.l HWIO_RXFE_WB_IQMC_CURR_VALS_WB0_ADDR A:0x1:0x180c0
y.create.l HWIO_RXFE_WB_IQMC_UPDT_CMD_WB0_ADDR A:0x1:0x180c4
y.create.l HWIO_RXFE_WB_IQMC_UPDT_ACTION_SAMPLE_WB0_ADDR A:0x1:0x180c8
y.create.l HWIO_RXFE_WB_NOTCH_FILT0_CFG0_WB0_ADDR A:0x1:0x180cc
y.create.l HWIO_RXFE_WB_NOTCH_FILT1_CFG0_WB0_ADDR A:0x1:0x180d0
y.create.l HWIO_RXFE_WB_NOTCH_FILT2_CFG0_WB0_ADDR A:0x1:0x180d4
y.create.l HWIO_RXFE_WB_NOTCH_FILT3_CFG0_WB0_ADDR A:0x1:0x180d8
y.create.l HWIO_RXFE_WB_NOTCH_FILT0_CFG1_WB0_ADDR A:0x1:0x180dc
y.create.l HWIO_RXFE_WB_NOTCH_FILT1_CFG1_WB0_ADDR A:0x1:0x180e0
y.create.l HWIO_RXFE_WB_NOTCH_FILT2_CFG1_WB0_ADDR A:0x1:0x180e4
y.create.l HWIO_RXFE_WB_NOTCH_FILT3_CFG1_WB0_ADDR A:0x1:0x180e8
y.create.l HWIO_RXFE_WB_NOTCH_FILT01_CFG_WB0_ADDR A:0x1:0x180f0
y.create.l HWIO_RXFE_WB_NOTCH_FILT23_CFG_WB0_ADDR A:0x1:0x180f4
y.create.l HWIO_RXFE_WB_SPARE_REG_WB0_ADDR A:0x1:0x180f8
y.create.l HWIO_RXFE_WB_TOP_CTL_WB1_ADDR A:0x1:0x20000
y.create.l HWIO_RXFE_WB_TOP_CMD_WB1_ADDR A:0x1:0x20004
y.create.l HWIO_RXFE_WB_TOP_STATUS_WB1_ADDR A:0x1:0x20008
y.create.l HWIO_RXFE_WB_STOPGATE_ACTION_SAMPLE_WB1_ADDR A:0x1:0x2000c
y.create.l HWIO_RXFE_WB_TIMINGCTL_STATUS_WB1_ADDR A:0x1:0x20010
y.create.l HWIO_RXFE_WB_MISC_CFG_WB1_ADDR A:0x1:0x20014
y.create.l HWIO_RXFE_WB_WBPWR_CFG_WB1_ADDR A:0x1:0x20018
y.create.l HWIO_RXFE_WB_WBPWR_CMD_WB1_ADDR A:0x1:0x2001c
y.create.l HWIO_RXFE_WB_WBPWR_START_ACTION_SAMPLE_WB1_ADDR A:0x1:0x20020
y.create.l HWIO_RXFE_WB_WBPWR_START_MASK_WB1_ADDR A:0x1:0x20024
y.create.l HWIO_RXFE_WB_WBPWR_STOP_ACTION_SAMPLE_WB1_ADDR A:0x1:0x20028
y.create.l HWIO_RXFE_WB_WBPWR_FINAL_ACC_WB1_ADDR A:0x1:0x2002c
y.create.l HWIO_RXFE_WB_WBPWR_CURR_ACC_WB1_ADDR A:0x1:0x20030
y.create.l HWIO_RXFE_WB_WBPWR_MAX_ACC_WB1_ADDR A:0x1:0x20034
y.create.l HWIO_RXFE_WB_WBDC_CFG_WB1_ADDR A:0x1:0x20038
y.create.l HWIO_RXFE_WB_WBDC_CMD_WB1_ADDR A:0x1:0x2003c
y.create.l HWIO_RXFE_WB_WBDC_START_ACTION_SAMPLE_WB1_ADDR A:0x1:0x20040
y.create.l HWIO_RXFE_WB_WBDC_STOP_ACTION_SAMPLE_WB1_ADDR A:0x1:0x20044
y.create.l HWIO_RXFE_WB_WBDC_UPDATE_ACTION_SAMPLE_WB1_ADDR A:0x1:0x20048
y.create.l HWIO_RXFE_WB_WBDC_UPDATE_DELAY_WB1_ADDR A:0x1:0x2004c
y.create.l HWIO_RXFE_WB_WBDC_OVRD_I_WB1_ADDR A:0x1:0x20050
y.create.l HWIO_RXFE_WB_WBDC_OVRD_Q_WB1_ADDR A:0x1:0x20054
y.create.l HWIO_RXFE_WB_WBDC_EST1_CURR_I_WB1_ADDR A:0x1:0x20058
y.create.l HWIO_RXFE_WB_WBDC_EST1_CURR_Q_WB1_ADDR A:0x1:0x2005c
y.create.l HWIO_RXFE_WB_WBDC_EST1_PREV_I_WB1_ADDR A:0x1:0x20060
y.create.l HWIO_RXFE_WB_WBDC_EST1_PREV_Q_WB1_ADDR A:0x1:0x20064
y.create.l HWIO_RXFE_WB_WBDC_EST1_LOAD_I_WB1_ADDR A:0x1:0x20068
y.create.l HWIO_RXFE_WB_WBDC_EST1_LOAD_Q_WB1_ADDR A:0x1:0x2006c
y.create.l HWIO_RXFE_WB_WBDC_EST2_CURR_I_WB1_ADDR A:0x1:0x20070
y.create.l HWIO_RXFE_WB_WBDC_EST2_CURR_Q_WB1_ADDR A:0x1:0x20074
y.create.l HWIO_RXFE_WB_WBDC_EST2_PREV_I_WB1_ADDR A:0x1:0x20078
y.create.l HWIO_RXFE_WB_WBDC_EST2_PREV_Q_WB1_ADDR A:0x1:0x2007c
y.create.l HWIO_RXFE_WB_WBDC_EST2_LOAD_I_WB1_ADDR A:0x1:0x20080
y.create.l HWIO_RXFE_WB_WBDC_EST2_LOAD_Q_WB1_ADDR A:0x1:0x20084
y.create.l HWIO_RXFE_WB_VSRC_CFG_WB1_ADDR A:0x1:0x20088
y.create.l HWIO_RXFE_WB_VSRC_T2BYT1M1_WB1_ADDR A:0x1:0x2008c
y.create.l HWIO_RXFE_WB_VSRC_CMD_WB1_ADDR A:0x1:0x20090
y.create.l HWIO_RXFE_WB_VSRC_STATUS_WB1_ADDR A:0x1:0x20094
y.create.l HWIO_RXFE_WB_VSRC_UPDT_ACTION_SAMPLE_WB1_ADDR A:0x1:0x20098
y.create.l HWIO_RXFE_WB_VSRC_CURR_T1BYT2_WB1_ADDR A:0x1:0x2009c
y.create.l HWIO_RXFE_WB_VSRC_CURR_T2BYT1M1_WB1_ADDR A:0x1:0x200a0
y.create.l HWIO_RXFE_WB_VSRC_SCTR_LOAD_VALUE_WB1_ADDR A:0x1:0x200a4
y.create.l HWIO_RXFE_WB_VSRC_SCTR_WA_WB1_ADDR A:0x1:0x200a8
y.create.l HWIO_RXFE_WB_VSRC_SCTR_SNAPSHOT_WB1_ADDR A:0x1:0x200ac
y.create.l HWIO_RXFE_WB_VSRC_ACC_SNAPSHOT_WB1_ADDR A:0x1:0x200b0
y.create.l HWIO_RXFE_WB_DEC_FILT_CFG_WB1_ADDR A:0x1:0x200b4
y.create.l HWIO_RXFE_WB_IQMC_CFG0_WB1_ADDR A:0x1:0x200b8
y.create.l HWIO_RXFE_WB_IQMC_CFG1_WB1_ADDR A:0x1:0x200bc
y.create.l HWIO_RXFE_WB_IQMC_CURR_VALS_WB1_ADDR A:0x1:0x200c0
y.create.l HWIO_RXFE_WB_IQMC_UPDT_CMD_WB1_ADDR A:0x1:0x200c4
y.create.l HWIO_RXFE_WB_IQMC_UPDT_ACTION_SAMPLE_WB1_ADDR A:0x1:0x200c8
y.create.l HWIO_RXFE_WB_NOTCH_FILT0_CFG0_WB1_ADDR A:0x1:0x200cc
y.create.l HWIO_RXFE_WB_NOTCH_FILT1_CFG0_WB1_ADDR A:0x1:0x200d0
y.create.l HWIO_RXFE_WB_NOTCH_FILT2_CFG0_WB1_ADDR A:0x1:0x200d4
y.create.l HWIO_RXFE_WB_NOTCH_FILT3_CFG0_WB1_ADDR A:0x1:0x200d8
y.create.l HWIO_RXFE_WB_NOTCH_FILT0_CFG1_WB1_ADDR A:0x1:0x200dc
y.create.l HWIO_RXFE_WB_NOTCH_FILT1_CFG1_WB1_ADDR A:0x1:0x200e0
y.create.l HWIO_RXFE_WB_NOTCH_FILT2_CFG1_WB1_ADDR A:0x1:0x200e4
y.create.l HWIO_RXFE_WB_NOTCH_FILT3_CFG1_WB1_ADDR A:0x1:0x200e8
y.create.l HWIO_RXFE_WB_NOTCH_FILT01_CFG_WB1_ADDR A:0x1:0x200f0
y.create.l HWIO_RXFE_WB_NOTCH_FILT23_CFG_WB1_ADDR A:0x1:0x200f4
y.create.l HWIO_RXFE_WB_SPARE_REG_WB1_ADDR A:0x1:0x200f8
y.create.l HWIO_RXFE_WB_TOP_CTL_WB2_ADDR A:0x1:0x28000
y.create.l HWIO_RXFE_WB_TOP_CMD_WB2_ADDR A:0x1:0x28004
y.create.l HWIO_RXFE_WB_TOP_STATUS_WB2_ADDR A:0x1:0x28008
y.create.l HWIO_RXFE_WB_STOPGATE_ACTION_SAMPLE_WB2_ADDR A:0x1:0x2800c
y.create.l HWIO_RXFE_WB_TIMINGCTL_STATUS_WB2_ADDR A:0x1:0x28010
y.create.l HWIO_RXFE_WB_MISC_CFG_WB2_ADDR A:0x1:0x28014
y.create.l HWIO_RXFE_WB_WBPWR_CFG_WB2_ADDR A:0x1:0x28018
y.create.l HWIO_RXFE_WB_WBPWR_CMD_WB2_ADDR A:0x1:0x2801c
y.create.l HWIO_RXFE_WB_WBPWR_START_ACTION_SAMPLE_WB2_ADDR A:0x1:0x28020
y.create.l HWIO_RXFE_WB_WBPWR_START_MASK_WB2_ADDR A:0x1:0x28024
y.create.l HWIO_RXFE_WB_WBPWR_STOP_ACTION_SAMPLE_WB2_ADDR A:0x1:0x28028
y.create.l HWIO_RXFE_WB_WBPWR_FINAL_ACC_WB2_ADDR A:0x1:0x2802c
y.create.l HWIO_RXFE_WB_WBPWR_CURR_ACC_WB2_ADDR A:0x1:0x28030
y.create.l HWIO_RXFE_WB_WBPWR_MAX_ACC_WB2_ADDR A:0x1:0x28034
y.create.l HWIO_RXFE_WB_WBDC_CFG_WB2_ADDR A:0x1:0x28038
y.create.l HWIO_RXFE_WB_WBDC_CMD_WB2_ADDR A:0x1:0x2803c
y.create.l HWIO_RXFE_WB_WBDC_START_ACTION_SAMPLE_WB2_ADDR A:0x1:0x28040
y.create.l HWIO_RXFE_WB_WBDC_STOP_ACTION_SAMPLE_WB2_ADDR A:0x1:0x28044
y.create.l HWIO_RXFE_WB_WBDC_UPDATE_ACTION_SAMPLE_WB2_ADDR A:0x1:0x28048
y.create.l HWIO_RXFE_WB_WBDC_UPDATE_DELAY_WB2_ADDR A:0x1:0x2804c
y.create.l HWIO_RXFE_WB_WBDC_OVRD_I_WB2_ADDR A:0x1:0x28050
y.create.l HWIO_RXFE_WB_WBDC_OVRD_Q_WB2_ADDR A:0x1:0x28054
y.create.l HWIO_RXFE_WB_WBDC_EST1_CURR_I_WB2_ADDR A:0x1:0x28058
y.create.l HWIO_RXFE_WB_WBDC_EST1_CURR_Q_WB2_ADDR A:0x1:0x2805c
y.create.l HWIO_RXFE_WB_WBDC_EST1_PREV_I_WB2_ADDR A:0x1:0x28060
y.create.l HWIO_RXFE_WB_WBDC_EST1_PREV_Q_WB2_ADDR A:0x1:0x28064
y.create.l HWIO_RXFE_WB_WBDC_EST1_LOAD_I_WB2_ADDR A:0x1:0x28068
y.create.l HWIO_RXFE_WB_WBDC_EST1_LOAD_Q_WB2_ADDR A:0x1:0x2806c
y.create.l HWIO_RXFE_WB_WBDC_EST2_CURR_I_WB2_ADDR A:0x1:0x28070
y.create.l HWIO_RXFE_WB_WBDC_EST2_CURR_Q_WB2_ADDR A:0x1:0x28074
y.create.l HWIO_RXFE_WB_WBDC_EST2_PREV_I_WB2_ADDR A:0x1:0x28078
y.create.l HWIO_RXFE_WB_WBDC_EST2_PREV_Q_WB2_ADDR A:0x1:0x2807c
y.create.l HWIO_RXFE_WB_WBDC_EST2_LOAD_I_WB2_ADDR A:0x1:0x28080
y.create.l HWIO_RXFE_WB_WBDC_EST2_LOAD_Q_WB2_ADDR A:0x1:0x28084
y.create.l HWIO_RXFE_WB_VSRC_CFG_WB2_ADDR A:0x1:0x28088
y.create.l HWIO_RXFE_WB_VSRC_T2BYT1M1_WB2_ADDR A:0x1:0x2808c
y.create.l HWIO_RXFE_WB_VSRC_CMD_WB2_ADDR A:0x1:0x28090
y.create.l HWIO_RXFE_WB_VSRC_STATUS_WB2_ADDR A:0x1:0x28094
y.create.l HWIO_RXFE_WB_VSRC_UPDT_ACTION_SAMPLE_WB2_ADDR A:0x1:0x28098
y.create.l HWIO_RXFE_WB_VSRC_CURR_T1BYT2_WB2_ADDR A:0x1:0x2809c
y.create.l HWIO_RXFE_WB_VSRC_CURR_T2BYT1M1_WB2_ADDR A:0x1:0x280a0
y.create.l HWIO_RXFE_WB_VSRC_SCTR_LOAD_VALUE_WB2_ADDR A:0x1:0x280a4
y.create.l HWIO_RXFE_WB_VSRC_SCTR_WA_WB2_ADDR A:0x1:0x280a8
y.create.l HWIO_RXFE_WB_VSRC_SCTR_SNAPSHOT_WB2_ADDR A:0x1:0x280ac
y.create.l HWIO_RXFE_WB_VSRC_ACC_SNAPSHOT_WB2_ADDR A:0x1:0x280b0
y.create.l HWIO_RXFE_WB_DEC_FILT_CFG_WB2_ADDR A:0x1:0x280b4
y.create.l HWIO_RXFE_WB_IQMC_CFG0_WB2_ADDR A:0x1:0x280b8
y.create.l HWIO_RXFE_WB_IQMC_CFG1_WB2_ADDR A:0x1:0x280bc
y.create.l HWIO_RXFE_WB_IQMC_CURR_VALS_WB2_ADDR A:0x1:0x280c0
y.create.l HWIO_RXFE_WB_IQMC_UPDT_CMD_WB2_ADDR A:0x1:0x280c4
y.create.l HWIO_RXFE_WB_IQMC_UPDT_ACTION_SAMPLE_WB2_ADDR A:0x1:0x280c8
y.create.l HWIO_RXFE_WB_NOTCH_FILT0_CFG0_WB2_ADDR A:0x1:0x280cc
y.create.l HWIO_RXFE_WB_NOTCH_FILT1_CFG0_WB2_ADDR A:0x1:0x280d0
y.create.l HWIO_RXFE_WB_NOTCH_FILT2_CFG0_WB2_ADDR A:0x1:0x280d4
y.create.l HWIO_RXFE_WB_NOTCH_FILT3_CFG0_WB2_ADDR A:0x1:0x280d8
y.create.l HWIO_RXFE_WB_NOTCH_FILT0_CFG1_WB2_ADDR A:0x1:0x280dc
y.create.l HWIO_RXFE_WB_NOTCH_FILT1_CFG1_WB2_ADDR A:0x1:0x280e0
y.create.l HWIO_RXFE_WB_NOTCH_FILT2_CFG1_WB2_ADDR A:0x1:0x280e4
y.create.l HWIO_RXFE_WB_NOTCH_FILT3_CFG1_WB2_ADDR A:0x1:0x280e8
y.create.l HWIO_RXFE_WB_NOTCH_FILT01_CFG_WB2_ADDR A:0x1:0x280f0
y.create.l HWIO_RXFE_WB_NOTCH_FILT23_CFG_WB2_ADDR A:0x1:0x280f4
y.create.l HWIO_RXFE_WB_SPARE_REG_WB2_ADDR A:0x1:0x280f8
y.create.l HWIO_RXFE_WB_TOP_CTL_WB3_ADDR A:0x1:0x30000
y.create.l HWIO_RXFE_WB_TOP_CMD_WB3_ADDR A:0x1:0x30004
y.create.l HWIO_RXFE_WB_TOP_STATUS_WB3_ADDR A:0x1:0x30008
y.create.l HWIO_RXFE_WB_STOPGATE_ACTION_SAMPLE_WB3_ADDR A:0x1:0x3000c
y.create.l HWIO_RXFE_WB_TIMINGCTL_STATUS_WB3_ADDR A:0x1:0x30010
y.create.l HWIO_RXFE_WB_MISC_CFG_WB3_ADDR A:0x1:0x30014
y.create.l HWIO_RXFE_WB_WBPWR_CFG_WB3_ADDR A:0x1:0x30018
y.create.l HWIO_RXFE_WB_WBPWR_CMD_WB3_ADDR A:0x1:0x3001c
y.create.l HWIO_RXFE_WB_WBPWR_START_ACTION_SAMPLE_WB3_ADDR A:0x1:0x30020
y.create.l HWIO_RXFE_WB_WBPWR_START_MASK_WB3_ADDR A:0x1:0x30024
y.create.l HWIO_RXFE_WB_WBPWR_STOP_ACTION_SAMPLE_WB3_ADDR A:0x1:0x30028
y.create.l HWIO_RXFE_WB_WBPWR_FINAL_ACC_WB3_ADDR A:0x1:0x3002c
y.create.l HWIO_RXFE_WB_WBPWR_CURR_ACC_WB3_ADDR A:0x1:0x30030
y.create.l HWIO_RXFE_WB_WBPWR_MAX_ACC_WB3_ADDR A:0x1:0x30034
y.create.l HWIO_RXFE_WB_WBDC_CFG_WB3_ADDR A:0x1:0x30038
y.create.l HWIO_RXFE_WB_WBDC_CMD_WB3_ADDR A:0x1:0x3003c
y.create.l HWIO_RXFE_WB_WBDC_START_ACTION_SAMPLE_WB3_ADDR A:0x1:0x30040
y.create.l HWIO_RXFE_WB_WBDC_STOP_ACTION_SAMPLE_WB3_ADDR A:0x1:0x30044
y.create.l HWIO_RXFE_WB_WBDC_UPDATE_ACTION_SAMPLE_WB3_ADDR A:0x1:0x30048
y.create.l HWIO_RXFE_WB_WBDC_UPDATE_DELAY_WB3_ADDR A:0x1:0x3004c
y.create.l HWIO_RXFE_WB_WBDC_OVRD_I_WB3_ADDR A:0x1:0x30050
y.create.l HWIO_RXFE_WB_WBDC_OVRD_Q_WB3_ADDR A:0x1:0x30054
y.create.l HWIO_RXFE_WB_WBDC_EST1_CURR_I_WB3_ADDR A:0x1:0x30058
y.create.l HWIO_RXFE_WB_WBDC_EST1_CURR_Q_WB3_ADDR A:0x1:0x3005c
y.create.l HWIO_RXFE_WB_WBDC_EST1_PREV_I_WB3_ADDR A:0x1:0x30060
y.create.l HWIO_RXFE_WB_WBDC_EST1_PREV_Q_WB3_ADDR A:0x1:0x30064
y.create.l HWIO_RXFE_WB_WBDC_EST1_LOAD_I_WB3_ADDR A:0x1:0x30068
y.create.l HWIO_RXFE_WB_WBDC_EST1_LOAD_Q_WB3_ADDR A:0x1:0x3006c
y.create.l HWIO_RXFE_WB_WBDC_EST2_CURR_I_WB3_ADDR A:0x1:0x30070
y.create.l HWIO_RXFE_WB_WBDC_EST2_CURR_Q_WB3_ADDR A:0x1:0x30074
y.create.l HWIO_RXFE_WB_WBDC_EST2_PREV_I_WB3_ADDR A:0x1:0x30078
y.create.l HWIO_RXFE_WB_WBDC_EST2_PREV_Q_WB3_ADDR A:0x1:0x3007c
y.create.l HWIO_RXFE_WB_WBDC_EST2_LOAD_I_WB3_ADDR A:0x1:0x30080
y.create.l HWIO_RXFE_WB_WBDC_EST2_LOAD_Q_WB3_ADDR A:0x1:0x30084
y.create.l HWIO_RXFE_WB_VSRC_CFG_WB3_ADDR A:0x1:0x30088
y.create.l HWIO_RXFE_WB_VSRC_T2BYT1M1_WB3_ADDR A:0x1:0x3008c
y.create.l HWIO_RXFE_WB_VSRC_CMD_WB3_ADDR A:0x1:0x30090
y.create.l HWIO_RXFE_WB_VSRC_STATUS_WB3_ADDR A:0x1:0x30094
y.create.l HWIO_RXFE_WB_VSRC_UPDT_ACTION_SAMPLE_WB3_ADDR A:0x1:0x30098
y.create.l HWIO_RXFE_WB_VSRC_CURR_T1BYT2_WB3_ADDR A:0x1:0x3009c
y.create.l HWIO_RXFE_WB_VSRC_CURR_T2BYT1M1_WB3_ADDR A:0x1:0x300a0
y.create.l HWIO_RXFE_WB_VSRC_SCTR_LOAD_VALUE_WB3_ADDR A:0x1:0x300a4
y.create.l HWIO_RXFE_WB_VSRC_SCTR_WA_WB3_ADDR A:0x1:0x300a8
y.create.l HWIO_RXFE_WB_VSRC_SCTR_SNAPSHOT_WB3_ADDR A:0x1:0x300ac
y.create.l HWIO_RXFE_WB_VSRC_ACC_SNAPSHOT_WB3_ADDR A:0x1:0x300b0
y.create.l HWIO_RXFE_WB_DEC_FILT_CFG_WB3_ADDR A:0x1:0x300b4
y.create.l HWIO_RXFE_WB_IQMC_CFG0_WB3_ADDR A:0x1:0x300b8
y.create.l HWIO_RXFE_WB_IQMC_CFG1_WB3_ADDR A:0x1:0x300bc
y.create.l HWIO_RXFE_WB_IQMC_CURR_VALS_WB3_ADDR A:0x1:0x300c0
y.create.l HWIO_RXFE_WB_IQMC_UPDT_CMD_WB3_ADDR A:0x1:0x300c4
y.create.l HWIO_RXFE_WB_IQMC_UPDT_ACTION_SAMPLE_WB3_ADDR A:0x1:0x300c8
y.create.l HWIO_RXFE_WB_NOTCH_FILT0_CFG0_WB3_ADDR A:0x1:0x300cc
y.create.l HWIO_RXFE_WB_NOTCH_FILT1_CFG0_WB3_ADDR A:0x1:0x300d0
y.create.l HWIO_RXFE_WB_NOTCH_FILT2_CFG0_WB3_ADDR A:0x1:0x300d4
y.create.l HWIO_RXFE_WB_NOTCH_FILT3_CFG0_WB3_ADDR A:0x1:0x300d8
y.create.l HWIO_RXFE_WB_NOTCH_FILT0_CFG1_WB3_ADDR A:0x1:0x300dc
y.create.l HWIO_RXFE_WB_NOTCH_FILT1_CFG1_WB3_ADDR A:0x1:0x300e0
y.create.l HWIO_RXFE_WB_NOTCH_FILT2_CFG1_WB3_ADDR A:0x1:0x300e4
y.create.l HWIO_RXFE_WB_NOTCH_FILT3_CFG1_WB3_ADDR A:0x1:0x300e8
y.create.l HWIO_RXFE_WB_NOTCH_FILT01_CFG_WB3_ADDR A:0x1:0x300f0
y.create.l HWIO_RXFE_WB_NOTCH_FILT23_CFG_WB3_ADDR A:0x1:0x300f4
y.create.l HWIO_RXFE_WB_SPARE_REG_WB3_ADDR A:0x1:0x300f8
y.create.l HWIO_RXFE_WB_TOP_CTL_WB4_ADDR A:0x1:0x38000
y.create.l HWIO_RXFE_WB_TOP_CMD_WB4_ADDR A:0x1:0x38004
y.create.l HWIO_RXFE_WB_TOP_STATUS_WB4_ADDR A:0x1:0x38008
y.create.l HWIO_RXFE_WB_STOPGATE_ACTION_SAMPLE_WB4_ADDR A:0x1:0x3800c
y.create.l HWIO_RXFE_WB_TIMINGCTL_STATUS_WB4_ADDR A:0x1:0x38010
y.create.l HWIO_RXFE_WB_MISC_CFG_WB4_ADDR A:0x1:0x38014
y.create.l HWIO_RXFE_WB_WBPWR_CFG_WB4_ADDR A:0x1:0x38018
y.create.l HWIO_RXFE_WB_WBPWR_CMD_WB4_ADDR A:0x1:0x3801c
y.create.l HWIO_RXFE_WB_WBPWR_START_ACTION_SAMPLE_WB4_ADDR A:0x1:0x38020
y.create.l HWIO_RXFE_WB_WBPWR_START_MASK_WB4_ADDR A:0x1:0x38024
y.create.l HWIO_RXFE_WB_WBPWR_STOP_ACTION_SAMPLE_WB4_ADDR A:0x1:0x38028
y.create.l HWIO_RXFE_WB_WBPWR_FINAL_ACC_WB4_ADDR A:0x1:0x3802c
y.create.l HWIO_RXFE_WB_WBPWR_CURR_ACC_WB4_ADDR A:0x1:0x38030
y.create.l HWIO_RXFE_WB_WBPWR_MAX_ACC_WB4_ADDR A:0x1:0x38034
y.create.l HWIO_RXFE_WB_WBDC_CFG_WB4_ADDR A:0x1:0x38038
y.create.l HWIO_RXFE_WB_WBDC_CMD_WB4_ADDR A:0x1:0x3803c
y.create.l HWIO_RXFE_WB_WBDC_START_ACTION_SAMPLE_WB4_ADDR A:0x1:0x38040
y.create.l HWIO_RXFE_WB_WBDC_STOP_ACTION_SAMPLE_WB4_ADDR A:0x1:0x38044
y.create.l HWIO_RXFE_WB_WBDC_UPDATE_ACTION_SAMPLE_WB4_ADDR A:0x1:0x38048
y.create.l HWIO_RXFE_WB_WBDC_UPDATE_DELAY_WB4_ADDR A:0x1:0x3804c
y.create.l HWIO_RXFE_WB_WBDC_OVRD_I_WB4_ADDR A:0x1:0x38050
y.create.l HWIO_RXFE_WB_WBDC_OVRD_Q_WB4_ADDR A:0x1:0x38054
y.create.l HWIO_RXFE_WB_WBDC_EST1_CURR_I_WB4_ADDR A:0x1:0x38058
y.create.l HWIO_RXFE_WB_WBDC_EST1_CURR_Q_WB4_ADDR A:0x1:0x3805c
y.create.l HWIO_RXFE_WB_WBDC_EST1_PREV_I_WB4_ADDR A:0x1:0x38060
y.create.l HWIO_RXFE_WB_WBDC_EST1_PREV_Q_WB4_ADDR A:0x1:0x38064
y.create.l HWIO_RXFE_WB_WBDC_EST1_LOAD_I_WB4_ADDR A:0x1:0x38068
y.create.l HWIO_RXFE_WB_WBDC_EST1_LOAD_Q_WB4_ADDR A:0x1:0x3806c
y.create.l HWIO_RXFE_WB_WBDC_EST2_CURR_I_WB4_ADDR A:0x1:0x38070
y.create.l HWIO_RXFE_WB_WBDC_EST2_CURR_Q_WB4_ADDR A:0x1:0x38074
y.create.l HWIO_RXFE_WB_WBDC_EST2_PREV_I_WB4_ADDR A:0x1:0x38078
y.create.l HWIO_RXFE_WB_WBDC_EST2_PREV_Q_WB4_ADDR A:0x1:0x3807c
y.create.l HWIO_RXFE_WB_WBDC_EST2_LOAD_I_WB4_ADDR A:0x1:0x38080
y.create.l HWIO_RXFE_WB_WBDC_EST2_LOAD_Q_WB4_ADDR A:0x1:0x38084
y.create.l HWIO_RXFE_WB_VSRC_CFG_WB4_ADDR A:0x1:0x38088
y.create.l HWIO_RXFE_WB_VSRC_T2BYT1M1_WB4_ADDR A:0x1:0x3808c
y.create.l HWIO_RXFE_WB_VSRC_CMD_WB4_ADDR A:0x1:0x38090
y.create.l HWIO_RXFE_WB_VSRC_STATUS_WB4_ADDR A:0x1:0x38094
y.create.l HWIO_RXFE_WB_VSRC_UPDT_ACTION_SAMPLE_WB4_ADDR A:0x1:0x38098
y.create.l HWIO_RXFE_WB_VSRC_CURR_T1BYT2_WB4_ADDR A:0x1:0x3809c
y.create.l HWIO_RXFE_WB_VSRC_CURR_T2BYT1M1_WB4_ADDR A:0x1:0x380a0
y.create.l HWIO_RXFE_WB_VSRC_SCTR_LOAD_VALUE_WB4_ADDR A:0x1:0x380a4
y.create.l HWIO_RXFE_WB_VSRC_SCTR_WA_WB4_ADDR A:0x1:0x380a8
y.create.l HWIO_RXFE_WB_VSRC_SCTR_SNAPSHOT_WB4_ADDR A:0x1:0x380ac
y.create.l HWIO_RXFE_WB_VSRC_ACC_SNAPSHOT_WB4_ADDR A:0x1:0x380b0
y.create.l HWIO_RXFE_WB_DEC_FILT_CFG_WB4_ADDR A:0x1:0x380b4
y.create.l HWIO_RXFE_WB_IQMC_CFG0_WB4_ADDR A:0x1:0x380b8
y.create.l HWIO_RXFE_WB_IQMC_CFG1_WB4_ADDR A:0x1:0x380bc
y.create.l HWIO_RXFE_WB_IQMC_CURR_VALS_WB4_ADDR A:0x1:0x380c0
y.create.l HWIO_RXFE_WB_IQMC_UPDT_CMD_WB4_ADDR A:0x1:0x380c4
y.create.l HWIO_RXFE_WB_IQMC_UPDT_ACTION_SAMPLE_WB4_ADDR A:0x1:0x380c8
y.create.l HWIO_RXFE_WB_NOTCH_FILT0_CFG0_WB4_ADDR A:0x1:0x380cc
y.create.l HWIO_RXFE_WB_NOTCH_FILT1_CFG0_WB4_ADDR A:0x1:0x380d0
y.create.l HWIO_RXFE_WB_NOTCH_FILT2_CFG0_WB4_ADDR A:0x1:0x380d4
y.create.l HWIO_RXFE_WB_NOTCH_FILT3_CFG0_WB4_ADDR A:0x1:0x380d8
y.create.l HWIO_RXFE_WB_NOTCH_FILT0_CFG1_WB4_ADDR A:0x1:0x380dc
y.create.l HWIO_RXFE_WB_NOTCH_FILT1_CFG1_WB4_ADDR A:0x1:0x380e0
y.create.l HWIO_RXFE_WB_NOTCH_FILT2_CFG1_WB4_ADDR A:0x1:0x380e4
y.create.l HWIO_RXFE_WB_NOTCH_FILT3_CFG1_WB4_ADDR A:0x1:0x380e8
y.create.l HWIO_RXFE_WB_NOTCH_FILT01_CFG_WB4_ADDR A:0x1:0x380f0
y.create.l HWIO_RXFE_WB_NOTCH_FILT23_CFG_WB4_ADDR A:0x1:0x380f4
y.create.l HWIO_RXFE_WB_SPARE_REG_WB4_ADDR A:0x1:0x380f8
y.create.l HWIO_RXFE_NB_TOP_CTL_NB0_ADDR A:0x1:0x48000
y.create.l HWIO_RXFE_NB_GATE_CMD_NB0_ADDR A:0x1:0x48004
y.create.l HWIO_RXFE_NB_GATE_STATUS_NB0_ADDR A:0x1:0x48008
y.create.l HWIO_RXFE_NB_GATE_ACTION_SAMPLE_NB0_ADDR A:0x1:0x4800c
y.create.l HWIO_RXFE_NB_TIMINGCTL_STATUS_NB0_ADDR A:0x1:0x48010
y.create.l HWIO_RXFE_NB_CSR_CFG_NB0_ADDR A:0x1:0x48014
y.create.l HWIO_RXFE_NB_CSR_CMD_NB0_ADDR A:0x1:0x48018
y.create.l HWIO_RXFE_NB_CSR_PHASEUPDT_ACTION_SAMPLE_NB0_ADDR A:0x1:0x4801c
y.create.l HWIO_RXFE_NB_CSR_FREQUPDT_ACTION_SAMPLE_NB0_ADDR A:0x1:0x48020
y.create.l HWIO_RXFE_NB_CSR_PHASE_OFFSET_NB0_ADDR A:0x1:0x48024
y.create.l HWIO_RXFE_NB_CSR_FREQ_OFFSET_NB0_ADDR A:0x1:0x48028
y.create.l HWIO_RXFE_NB_CSR_CURR_PHASE_OFFSET_NB0_ADDR A:0x1:0x4802c
y.create.l HWIO_RXFE_NB_CSR_CURR_FREQ_OFFSET_NB0_ADDR A:0x1:0x48030
y.create.l HWIO_RXFE_NB_FILTERS_CFG_NB0_ADDR A:0x1:0x48034
y.create.l HWIO_RXFE_NB_ICI_COEF0_NB0_ADDR A:0x1:0x4803c
y.create.l HWIO_RXFE_NB_ICI_COEF1_NB0_ADDR A:0x1:0x48040
y.create.l HWIO_RXFE_NB_ICI_COEF2_NB0_ADDR A:0x1:0x48044
y.create.l HWIO_RXFE_NB_ICI_COEF3_NB0_ADDR A:0x1:0x48048
y.create.l HWIO_RXFE_NB_ICI_COEF4_NB0_ADDR A:0x1:0x4804c
y.create.l HWIO_RXFE_NB_ICI_COEF5_NB0_ADDR A:0x1:0x48050
y.create.l HWIO_RXFE_NB_ICI_COEF6_NB0_ADDR A:0x1:0x48054
y.create.l HWIO_RXFE_NB_ICI_COEF7_NB0_ADDR A:0x1:0x48058
y.create.l HWIO_RXFE_NB_ICI_COEF8_NB0_ADDR A:0x1:0x4805c
y.create.l HWIO_RXFE_NB_ICI_COEF9_NB0_ADDR A:0x1:0x48060
y.create.l HWIO_RXFE_NB_GDA_NB0_ADDR A:0x1:0x48068
y.create.l HWIO_RXFE_NB_NBDC_COMPVAL_I_NB0_ADDR A:0x1:0x4806c
y.create.l HWIO_RXFE_NB_NBDC_COMPVAL_Q_NB0_ADDR A:0x1:0x48070
y.create.l HWIO_RXFE_NB_NBPWR_CFG_NB0_ADDR A:0x1:0x48074
y.create.l HWIO_RXFE_NB_NBPWR_CMD_NB0_ADDR A:0x1:0x48078
y.create.l HWIO_RXFE_NB_NBPWR_START_ACTION_SAMPLE_NB0_ADDR A:0x1:0x4807c
y.create.l HWIO_RXFE_NB_NBPWR_START_MASK_NB0_ADDR A:0x1:0x48080
y.create.l HWIO_RXFE_NB_NBPWR_STOP_ACTION_SAMPLE_NB0_ADDR A:0x1:0x48084
y.create.l HWIO_RXFE_NB_NBPWR_FINAL_ACC_NB0_ADDR A:0x1:0x48088
y.create.l HWIO_RXFE_NB_NBPWR_CURR_ACC_NB0_ADDR A:0x1:0x4808c
y.create.l HWIO_RXFE_NB_NBPWR_MAX_ACC_NB0_ADDR A:0x1:0x48090
y.create.l HWIO_RXFE_NB_DVGA_CFG_NB0_ADDR A:0x1:0x48094
y.create.l HWIO_RXFE_NB_DVGA_RXFE_GAIN_NB0_ADDR A:0x1:0x48098
y.create.l HWIO_RXFE_NB_DVGA_OVERRIDE_DVGA_GAIN_NB0_ADDR A:0x1:0x4809c
y.create.l HWIO_RXFE_NB_DVGA_CMD_NB0_ADDR A:0x1:0x480a0
y.create.l HWIO_RXFE_NB_DVGA_UPDT_ACTION_SAMPLE_NB0_ADDR A:0x1:0x480a4
y.create.l HWIO_RXFE_NB_DVGA_UPDT_MASK_NB0_ADDR A:0x1:0x480a8
y.create.l HWIO_RXFE_NB_FINAL_BITWIDTHS_CFG_NB0_ADDR A:0x1:0x480ac
y.create.l HWIO_RXFE_NB_WTR_CFG_NB0_ADDR A:0x1:0x480b0
y.create.l HWIO_RXFE_NB_WTR_FUNC_CFG_NB0_ADDR A:0x1:0x480b4
y.create.l HWIO_RXFE_NB_WTR_DBG_CFG0_NB0_ADDR A:0x1:0x480b8
y.create.l HWIO_RXFE_NB_WTR_DBG_CFG1_NB0_ADDR A:0x1:0x480bc
y.create.l HWIO_RXFE_NB_WTR_CMD_NB0_ADDR A:0x1:0x480c0
y.create.l HWIO_RXFE_NB_WTR_START_ACTION_SAMPLE_NB0_ADDR A:0x1:0x480c4
y.create.l HWIO_RXFE_NB_WTR_STOP_ACTION_SAMPLE_NB0_ADDR A:0x1:0x480c8
y.create.l HWIO_RXFE_NB_WTR_STATUS_NB0_ADDR A:0x1:0x480d0
y.create.l HWIO_RXFE_NB_WTR_ADDR_SNAPSHOT_NB0_ADDR A:0x1:0x480d4
y.create.l HWIO_RXFE_NB_SPARE_REG_NB0_ADDR A:0x1:0x480d8
y.create.l HWIO_RXFE_NB_TOP_CTL_NB1_ADDR A:0x1:0x50000
y.create.l HWIO_RXFE_NB_GATE_CMD_NB1_ADDR A:0x1:0x50004
y.create.l HWIO_RXFE_NB_GATE_STATUS_NB1_ADDR A:0x1:0x50008
y.create.l HWIO_RXFE_NB_GATE_ACTION_SAMPLE_NB1_ADDR A:0x1:0x5000c
y.create.l HWIO_RXFE_NB_TIMINGCTL_STATUS_NB1_ADDR A:0x1:0x50010
y.create.l HWIO_RXFE_NB_CSR_CFG_NB1_ADDR A:0x1:0x50014
y.create.l HWIO_RXFE_NB_CSR_CMD_NB1_ADDR A:0x1:0x50018
y.create.l HWIO_RXFE_NB_CSR_PHASEUPDT_ACTION_SAMPLE_NB1_ADDR A:0x1:0x5001c
y.create.l HWIO_RXFE_NB_CSR_FREQUPDT_ACTION_SAMPLE_NB1_ADDR A:0x1:0x50020
y.create.l HWIO_RXFE_NB_CSR_PHASE_OFFSET_NB1_ADDR A:0x1:0x50024
y.create.l HWIO_RXFE_NB_CSR_FREQ_OFFSET_NB1_ADDR A:0x1:0x50028
y.create.l HWIO_RXFE_NB_CSR_CURR_PHASE_OFFSET_NB1_ADDR A:0x1:0x5002c
y.create.l HWIO_RXFE_NB_CSR_CURR_FREQ_OFFSET_NB1_ADDR A:0x1:0x50030
y.create.l HWIO_RXFE_NB_FILTERS_CFG_NB1_ADDR A:0x1:0x50034
y.create.l HWIO_RXFE_NB_ICI_COEF0_NB1_ADDR A:0x1:0x5003c
y.create.l HWIO_RXFE_NB_ICI_COEF1_NB1_ADDR A:0x1:0x50040
y.create.l HWIO_RXFE_NB_ICI_COEF2_NB1_ADDR A:0x1:0x50044
y.create.l HWIO_RXFE_NB_ICI_COEF3_NB1_ADDR A:0x1:0x50048
y.create.l HWIO_RXFE_NB_ICI_COEF4_NB1_ADDR A:0x1:0x5004c
y.create.l HWIO_RXFE_NB_ICI_COEF5_NB1_ADDR A:0x1:0x50050
y.create.l HWIO_RXFE_NB_ICI_COEF6_NB1_ADDR A:0x1:0x50054
y.create.l HWIO_RXFE_NB_ICI_COEF7_NB1_ADDR A:0x1:0x50058
y.create.l HWIO_RXFE_NB_ICI_COEF8_NB1_ADDR A:0x1:0x5005c
y.create.l HWIO_RXFE_NB_ICI_COEF9_NB1_ADDR A:0x1:0x50060
y.create.l HWIO_RXFE_NB_GDA_NB1_ADDR A:0x1:0x50068
y.create.l HWIO_RXFE_NB_NBDC_COMPVAL_I_NB1_ADDR A:0x1:0x5006c
y.create.l HWIO_RXFE_NB_NBDC_COMPVAL_Q_NB1_ADDR A:0x1:0x50070
y.create.l HWIO_RXFE_NB_NBPWR_CFG_NB1_ADDR A:0x1:0x50074
y.create.l HWIO_RXFE_NB_NBPWR_CMD_NB1_ADDR A:0x1:0x50078
y.create.l HWIO_RXFE_NB_NBPWR_START_ACTION_SAMPLE_NB1_ADDR A:0x1:0x5007c
y.create.l HWIO_RXFE_NB_NBPWR_START_MASK_NB1_ADDR A:0x1:0x50080
y.create.l HWIO_RXFE_NB_NBPWR_STOP_ACTION_SAMPLE_NB1_ADDR A:0x1:0x50084
y.create.l HWIO_RXFE_NB_NBPWR_FINAL_ACC_NB1_ADDR A:0x1:0x50088
y.create.l HWIO_RXFE_NB_NBPWR_CURR_ACC_NB1_ADDR A:0x1:0x5008c
y.create.l HWIO_RXFE_NB_NBPWR_MAX_ACC_NB1_ADDR A:0x1:0x50090
y.create.l HWIO_RXFE_NB_DVGA_CFG_NB1_ADDR A:0x1:0x50094
y.create.l HWIO_RXFE_NB_DVGA_RXFE_GAIN_NB1_ADDR A:0x1:0x50098
y.create.l HWIO_RXFE_NB_DVGA_OVERRIDE_DVGA_GAIN_NB1_ADDR A:0x1:0x5009c
y.create.l HWIO_RXFE_NB_DVGA_CMD_NB1_ADDR A:0x1:0x500a0
y.create.l HWIO_RXFE_NB_DVGA_UPDT_ACTION_SAMPLE_NB1_ADDR A:0x1:0x500a4
y.create.l HWIO_RXFE_NB_DVGA_UPDT_MASK_NB1_ADDR A:0x1:0x500a8
y.create.l HWIO_RXFE_NB_FINAL_BITWIDTHS_CFG_NB1_ADDR A:0x1:0x500ac
y.create.l HWIO_RXFE_NB_WTR_CFG_NB1_ADDR A:0x1:0x500b0
y.create.l HWIO_RXFE_NB_WTR_FUNC_CFG_NB1_ADDR A:0x1:0x500b4
y.create.l HWIO_RXFE_NB_WTR_DBG_CFG0_NB1_ADDR A:0x1:0x500b8
y.create.l HWIO_RXFE_NB_WTR_DBG_CFG1_NB1_ADDR A:0x1:0x500bc
y.create.l HWIO_RXFE_NB_WTR_CMD_NB1_ADDR A:0x1:0x500c0
y.create.l HWIO_RXFE_NB_WTR_START_ACTION_SAMPLE_NB1_ADDR A:0x1:0x500c4
y.create.l HWIO_RXFE_NB_WTR_STOP_ACTION_SAMPLE_NB1_ADDR A:0x1:0x500c8
y.create.l HWIO_RXFE_NB_WTR_STATUS_NB1_ADDR A:0x1:0x500d0
y.create.l HWIO_RXFE_NB_WTR_ADDR_SNAPSHOT_NB1_ADDR A:0x1:0x500d4
y.create.l HWIO_RXFE_NB_SPARE_REG_NB1_ADDR A:0x1:0x500d8
y.create.l HWIO_RXFE_NB_TOP_CTL_NB2_ADDR A:0x1:0x58000
y.create.l HWIO_RXFE_NB_GATE_CMD_NB2_ADDR A:0x1:0x58004
y.create.l HWIO_RXFE_NB_GATE_STATUS_NB2_ADDR A:0x1:0x58008
y.create.l HWIO_RXFE_NB_GATE_ACTION_SAMPLE_NB2_ADDR A:0x1:0x5800c
y.create.l HWIO_RXFE_NB_TIMINGCTL_STATUS_NB2_ADDR A:0x1:0x58010
y.create.l HWIO_RXFE_NB_CSR_CFG_NB2_ADDR A:0x1:0x58014
y.create.l HWIO_RXFE_NB_CSR_CMD_NB2_ADDR A:0x1:0x58018
y.create.l HWIO_RXFE_NB_CSR_PHASEUPDT_ACTION_SAMPLE_NB2_ADDR A:0x1:0x5801c
y.create.l HWIO_RXFE_NB_CSR_FREQUPDT_ACTION_SAMPLE_NB2_ADDR A:0x1:0x58020
y.create.l HWIO_RXFE_NB_CSR_PHASE_OFFSET_NB2_ADDR A:0x1:0x58024
y.create.l HWIO_RXFE_NB_CSR_FREQ_OFFSET_NB2_ADDR A:0x1:0x58028
y.create.l HWIO_RXFE_NB_CSR_CURR_PHASE_OFFSET_NB2_ADDR A:0x1:0x5802c
y.create.l HWIO_RXFE_NB_CSR_CURR_FREQ_OFFSET_NB2_ADDR A:0x1:0x58030
y.create.l HWIO_RXFE_NB_FILTERS_CFG_NB2_ADDR A:0x1:0x58034
y.create.l HWIO_RXFE_NB_ICI_COEF0_NB2_ADDR A:0x1:0x5803c
y.create.l HWIO_RXFE_NB_ICI_COEF1_NB2_ADDR A:0x1:0x58040
y.create.l HWIO_RXFE_NB_ICI_COEF2_NB2_ADDR A:0x1:0x58044
y.create.l HWIO_RXFE_NB_ICI_COEF3_NB2_ADDR A:0x1:0x58048
y.create.l HWIO_RXFE_NB_ICI_COEF4_NB2_ADDR A:0x1:0x5804c
y.create.l HWIO_RXFE_NB_ICI_COEF5_NB2_ADDR A:0x1:0x58050
y.create.l HWIO_RXFE_NB_ICI_COEF6_NB2_ADDR A:0x1:0x58054
y.create.l HWIO_RXFE_NB_ICI_COEF7_NB2_ADDR A:0x1:0x58058
y.create.l HWIO_RXFE_NB_ICI_COEF8_NB2_ADDR A:0x1:0x5805c
y.create.l HWIO_RXFE_NB_ICI_COEF9_NB2_ADDR A:0x1:0x58060
y.create.l HWIO_RXFE_NB_GDA_NB2_ADDR A:0x1:0x58068
y.create.l HWIO_RXFE_NB_NBDC_COMPVAL_I_NB2_ADDR A:0x1:0x5806c
y.create.l HWIO_RXFE_NB_NBDC_COMPVAL_Q_NB2_ADDR A:0x1:0x58070
y.create.l HWIO_RXFE_NB_NBPWR_CFG_NB2_ADDR A:0x1:0x58074
y.create.l HWIO_RXFE_NB_NBPWR_CMD_NB2_ADDR A:0x1:0x58078
y.create.l HWIO_RXFE_NB_NBPWR_START_ACTION_SAMPLE_NB2_ADDR A:0x1:0x5807c
y.create.l HWIO_RXFE_NB_NBPWR_START_MASK_NB2_ADDR A:0x1:0x58080
y.create.l HWIO_RXFE_NB_NBPWR_STOP_ACTION_SAMPLE_NB2_ADDR A:0x1:0x58084
y.create.l HWIO_RXFE_NB_NBPWR_FINAL_ACC_NB2_ADDR A:0x1:0x58088
y.create.l HWIO_RXFE_NB_NBPWR_CURR_ACC_NB2_ADDR A:0x1:0x5808c
y.create.l HWIO_RXFE_NB_NBPWR_MAX_ACC_NB2_ADDR A:0x1:0x58090
y.create.l HWIO_RXFE_NB_DVGA_CFG_NB2_ADDR A:0x1:0x58094
y.create.l HWIO_RXFE_NB_DVGA_RXFE_GAIN_NB2_ADDR A:0x1:0x58098
y.create.l HWIO_RXFE_NB_DVGA_OVERRIDE_DVGA_GAIN_NB2_ADDR A:0x1:0x5809c
y.create.l HWIO_RXFE_NB_DVGA_CMD_NB2_ADDR A:0x1:0x580a0
y.create.l HWIO_RXFE_NB_DVGA_UPDT_ACTION_SAMPLE_NB2_ADDR A:0x1:0x580a4
y.create.l HWIO_RXFE_NB_DVGA_UPDT_MASK_NB2_ADDR A:0x1:0x580a8
y.create.l HWIO_RXFE_NB_FINAL_BITWIDTHS_CFG_NB2_ADDR A:0x1:0x580ac
y.create.l HWIO_RXFE_NB_WTR_CFG_NB2_ADDR A:0x1:0x580b0
y.create.l HWIO_RXFE_NB_WTR_FUNC_CFG_NB2_ADDR A:0x1:0x580b4
y.create.l HWIO_RXFE_NB_WTR_DBG_CFG0_NB2_ADDR A:0x1:0x580b8
y.create.l HWIO_RXFE_NB_WTR_DBG_CFG1_NB2_ADDR A:0x1:0x580bc
y.create.l HWIO_RXFE_NB_WTR_CMD_NB2_ADDR A:0x1:0x580c0
y.create.l HWIO_RXFE_NB_WTR_START_ACTION_SAMPLE_NB2_ADDR A:0x1:0x580c4
y.create.l HWIO_RXFE_NB_WTR_STOP_ACTION_SAMPLE_NB2_ADDR A:0x1:0x580c8
y.create.l HWIO_RXFE_NB_WTR_STATUS_NB2_ADDR A:0x1:0x580d0
y.create.l HWIO_RXFE_NB_WTR_ADDR_SNAPSHOT_NB2_ADDR A:0x1:0x580d4
y.create.l HWIO_RXFE_NB_SPARE_REG_NB2_ADDR A:0x1:0x580d8
y.create.l HWIO_RXFE_NB_TOP_CTL_NB3_ADDR A:0x1:0x60000
y.create.l HWIO_RXFE_NB_GATE_CMD_NB3_ADDR A:0x1:0x60004
y.create.l HWIO_RXFE_NB_GATE_STATUS_NB3_ADDR A:0x1:0x60008
y.create.l HWIO_RXFE_NB_GATE_ACTION_SAMPLE_NB3_ADDR A:0x1:0x6000c
y.create.l HWIO_RXFE_NB_TIMINGCTL_STATUS_NB3_ADDR A:0x1:0x60010
y.create.l HWIO_RXFE_NB_CSR_CFG_NB3_ADDR A:0x1:0x60014
y.create.l HWIO_RXFE_NB_CSR_CMD_NB3_ADDR A:0x1:0x60018
y.create.l HWIO_RXFE_NB_CSR_PHASEUPDT_ACTION_SAMPLE_NB3_ADDR A:0x1:0x6001c
y.create.l HWIO_RXFE_NB_CSR_FREQUPDT_ACTION_SAMPLE_NB3_ADDR A:0x1:0x60020
y.create.l HWIO_RXFE_NB_CSR_PHASE_OFFSET_NB3_ADDR A:0x1:0x60024
y.create.l HWIO_RXFE_NB_CSR_FREQ_OFFSET_NB3_ADDR A:0x1:0x60028
y.create.l HWIO_RXFE_NB_CSR_CURR_PHASE_OFFSET_NB3_ADDR A:0x1:0x6002c
y.create.l HWIO_RXFE_NB_CSR_CURR_FREQ_OFFSET_NB3_ADDR A:0x1:0x60030
y.create.l HWIO_RXFE_NB_FILTERS_CFG_NB3_ADDR A:0x1:0x60034
y.create.l HWIO_RXFE_NB_ICI_COEF0_NB3_ADDR A:0x1:0x6003c
y.create.l HWIO_RXFE_NB_ICI_COEF1_NB3_ADDR A:0x1:0x60040
y.create.l HWIO_RXFE_NB_ICI_COEF2_NB3_ADDR A:0x1:0x60044
y.create.l HWIO_RXFE_NB_ICI_COEF3_NB3_ADDR A:0x1:0x60048
y.create.l HWIO_RXFE_NB_ICI_COEF4_NB3_ADDR A:0x1:0x6004c
y.create.l HWIO_RXFE_NB_ICI_COEF5_NB3_ADDR A:0x1:0x60050
y.create.l HWIO_RXFE_NB_ICI_COEF6_NB3_ADDR A:0x1:0x60054
y.create.l HWIO_RXFE_NB_ICI_COEF7_NB3_ADDR A:0x1:0x60058
y.create.l HWIO_RXFE_NB_ICI_COEF8_NB3_ADDR A:0x1:0x6005c
y.create.l HWIO_RXFE_NB_ICI_COEF9_NB3_ADDR A:0x1:0x60060
y.create.l HWIO_RXFE_NB_GDA_NB3_ADDR A:0x1:0x60068
y.create.l HWIO_RXFE_NB_NBDC_COMPVAL_I_NB3_ADDR A:0x1:0x6006c
y.create.l HWIO_RXFE_NB_NBDC_COMPVAL_Q_NB3_ADDR A:0x1:0x60070
y.create.l HWIO_RXFE_NB_NBPWR_CFG_NB3_ADDR A:0x1:0x60074
y.create.l HWIO_RXFE_NB_NBPWR_CMD_NB3_ADDR A:0x1:0x60078
y.create.l HWIO_RXFE_NB_NBPWR_START_ACTION_SAMPLE_NB3_ADDR A:0x1:0x6007c
y.create.l HWIO_RXFE_NB_NBPWR_START_MASK_NB3_ADDR A:0x1:0x60080
y.create.l HWIO_RXFE_NB_NBPWR_STOP_ACTION_SAMPLE_NB3_ADDR A:0x1:0x60084
y.create.l HWIO_RXFE_NB_NBPWR_FINAL_ACC_NB3_ADDR A:0x1:0x60088
y.create.l HWIO_RXFE_NB_NBPWR_CURR_ACC_NB3_ADDR A:0x1:0x6008c
y.create.l HWIO_RXFE_NB_NBPWR_MAX_ACC_NB3_ADDR A:0x1:0x60090
y.create.l HWIO_RXFE_NB_DVGA_CFG_NB3_ADDR A:0x1:0x60094
y.create.l HWIO_RXFE_NB_DVGA_RXFE_GAIN_NB3_ADDR A:0x1:0x60098
y.create.l HWIO_RXFE_NB_DVGA_OVERRIDE_DVGA_GAIN_NB3_ADDR A:0x1:0x6009c
y.create.l HWIO_RXFE_NB_DVGA_CMD_NB3_ADDR A:0x1:0x600a0
y.create.l HWIO_RXFE_NB_DVGA_UPDT_ACTION_SAMPLE_NB3_ADDR A:0x1:0x600a4
y.create.l HWIO_RXFE_NB_DVGA_UPDT_MASK_NB3_ADDR A:0x1:0x600a8
y.create.l HWIO_RXFE_NB_FINAL_BITWIDTHS_CFG_NB3_ADDR A:0x1:0x600ac
y.create.l HWIO_RXFE_NB_WTR_CFG_NB3_ADDR A:0x1:0x600b0
y.create.l HWIO_RXFE_NB_WTR_FUNC_CFG_NB3_ADDR A:0x1:0x600b4
y.create.l HWIO_RXFE_NB_WTR_DBG_CFG0_NB3_ADDR A:0x1:0x600b8
y.create.l HWIO_RXFE_NB_WTR_DBG_CFG1_NB3_ADDR A:0x1:0x600bc
y.create.l HWIO_RXFE_NB_WTR_CMD_NB3_ADDR A:0x1:0x600c0
y.create.l HWIO_RXFE_NB_WTR_START_ACTION_SAMPLE_NB3_ADDR A:0x1:0x600c4
y.create.l HWIO_RXFE_NB_WTR_STOP_ACTION_SAMPLE_NB3_ADDR A:0x1:0x600c8
y.create.l HWIO_RXFE_NB_WTR_STATUS_NB3_ADDR A:0x1:0x600d0
y.create.l HWIO_RXFE_NB_WTR_ADDR_SNAPSHOT_NB3_ADDR A:0x1:0x600d4
y.create.l HWIO_RXFE_NB_SPARE_REG_NB3_ADDR A:0x1:0x600d8
y.create.l HWIO_RXFE_NB_TOP_CTL_NB4_ADDR A:0x1:0x68000
y.create.l HWIO_RXFE_NB_GATE_CMD_NB4_ADDR A:0x1:0x68004
y.create.l HWIO_RXFE_NB_GATE_STATUS_NB4_ADDR A:0x1:0x68008
y.create.l HWIO_RXFE_NB_GATE_ACTION_SAMPLE_NB4_ADDR A:0x1:0x6800c
y.create.l HWIO_RXFE_NB_TIMINGCTL_STATUS_NB4_ADDR A:0x1:0x68010
y.create.l HWIO_RXFE_NB_CSR_CFG_NB4_ADDR A:0x1:0x68014
y.create.l HWIO_RXFE_NB_CSR_CMD_NB4_ADDR A:0x1:0x68018
y.create.l HWIO_RXFE_NB_CSR_PHASEUPDT_ACTION_SAMPLE_NB4_ADDR A:0x1:0x6801c
y.create.l HWIO_RXFE_NB_CSR_FREQUPDT_ACTION_SAMPLE_NB4_ADDR A:0x1:0x68020
y.create.l HWIO_RXFE_NB_CSR_PHASE_OFFSET_NB4_ADDR A:0x1:0x68024
y.create.l HWIO_RXFE_NB_CSR_FREQ_OFFSET_NB4_ADDR A:0x1:0x68028
y.create.l HWIO_RXFE_NB_CSR_CURR_PHASE_OFFSET_NB4_ADDR A:0x1:0x6802c
y.create.l HWIO_RXFE_NB_CSR_CURR_FREQ_OFFSET_NB4_ADDR A:0x1:0x68030
y.create.l HWIO_RXFE_NB_FILTERS_CFG_NB4_ADDR A:0x1:0x68034
y.create.l HWIO_RXFE_NB_ICI_COEF0_NB4_ADDR A:0x1:0x6803c
y.create.l HWIO_RXFE_NB_ICI_COEF1_NB4_ADDR A:0x1:0x68040
y.create.l HWIO_RXFE_NB_ICI_COEF2_NB4_ADDR A:0x1:0x68044
y.create.l HWIO_RXFE_NB_ICI_COEF3_NB4_ADDR A:0x1:0x68048
y.create.l HWIO_RXFE_NB_ICI_COEF4_NB4_ADDR A:0x1:0x6804c
y.create.l HWIO_RXFE_NB_ICI_COEF5_NB4_ADDR A:0x1:0x68050
y.create.l HWIO_RXFE_NB_ICI_COEF6_NB4_ADDR A:0x1:0x68054
y.create.l HWIO_RXFE_NB_ICI_COEF7_NB4_ADDR A:0x1:0x68058
y.create.l HWIO_RXFE_NB_ICI_COEF8_NB4_ADDR A:0x1:0x6805c
y.create.l HWIO_RXFE_NB_ICI_COEF9_NB4_ADDR A:0x1:0x68060
y.create.l HWIO_RXFE_NB_GDA_NB4_ADDR A:0x1:0x68068
y.create.l HWIO_RXFE_NB_NBDC_COMPVAL_I_NB4_ADDR A:0x1:0x6806c
y.create.l HWIO_RXFE_NB_NBDC_COMPVAL_Q_NB4_ADDR A:0x1:0x68070
y.create.l HWIO_RXFE_NB_NBPWR_CFG_NB4_ADDR A:0x1:0x68074
y.create.l HWIO_RXFE_NB_NBPWR_CMD_NB4_ADDR A:0x1:0x68078
y.create.l HWIO_RXFE_NB_NBPWR_START_ACTION_SAMPLE_NB4_ADDR A:0x1:0x6807c
y.create.l HWIO_RXFE_NB_NBPWR_START_MASK_NB4_ADDR A:0x1:0x68080
y.create.l HWIO_RXFE_NB_NBPWR_STOP_ACTION_SAMPLE_NB4_ADDR A:0x1:0x68084
y.create.l HWIO_RXFE_NB_NBPWR_FINAL_ACC_NB4_ADDR A:0x1:0x68088
y.create.l HWIO_RXFE_NB_NBPWR_CURR_ACC_NB4_ADDR A:0x1:0x6808c
y.create.l HWIO_RXFE_NB_NBPWR_MAX_ACC_NB4_ADDR A:0x1:0x68090
y.create.l HWIO_RXFE_NB_DVGA_CFG_NB4_ADDR A:0x1:0x68094
y.create.l HWIO_RXFE_NB_DVGA_RXFE_GAIN_NB4_ADDR A:0x1:0x68098
y.create.l HWIO_RXFE_NB_DVGA_OVERRIDE_DVGA_GAIN_NB4_ADDR A:0x1:0x6809c
y.create.l HWIO_RXFE_NB_DVGA_CMD_NB4_ADDR A:0x1:0x680a0
y.create.l HWIO_RXFE_NB_DVGA_UPDT_ACTION_SAMPLE_NB4_ADDR A:0x1:0x680a4
y.create.l HWIO_RXFE_NB_DVGA_UPDT_MASK_NB4_ADDR A:0x1:0x680a8
y.create.l HWIO_RXFE_NB_FINAL_BITWIDTHS_CFG_NB4_ADDR A:0x1:0x680ac
y.create.l HWIO_RXFE_NB_WTR_CFG_NB4_ADDR A:0x1:0x680b0
y.create.l HWIO_RXFE_NB_WTR_FUNC_CFG_NB4_ADDR A:0x1:0x680b4
y.create.l HWIO_RXFE_NB_WTR_DBG_CFG0_NB4_ADDR A:0x1:0x680b8
y.create.l HWIO_RXFE_NB_WTR_DBG_CFG1_NB4_ADDR A:0x1:0x680bc
y.create.l HWIO_RXFE_NB_WTR_CMD_NB4_ADDR A:0x1:0x680c0
y.create.l HWIO_RXFE_NB_WTR_START_ACTION_SAMPLE_NB4_ADDR A:0x1:0x680c4
y.create.l HWIO_RXFE_NB_WTR_STOP_ACTION_SAMPLE_NB4_ADDR A:0x1:0x680c8
y.create.l HWIO_RXFE_NB_WTR_STATUS_NB4_ADDR A:0x1:0x680d0
y.create.l HWIO_RXFE_NB_WTR_ADDR_SNAPSHOT_NB4_ADDR A:0x1:0x680d4
y.create.l HWIO_RXFE_NB_SPARE_REG_NB4_ADDR A:0x1:0x680d8
y.create.l HWIO_RXFE_NB_TOP_CTL_NB5_ADDR A:0x1:0x70000
y.create.l HWIO_RXFE_NB_GATE_CMD_NB5_ADDR A:0x1:0x70004
y.create.l HWIO_RXFE_NB_GATE_STATUS_NB5_ADDR A:0x1:0x70008
y.create.l HWIO_RXFE_NB_GATE_ACTION_SAMPLE_NB5_ADDR A:0x1:0x7000c
y.create.l HWIO_RXFE_NB_TIMINGCTL_STATUS_NB5_ADDR A:0x1:0x70010
y.create.l HWIO_RXFE_NB_CSR_CFG_NB5_ADDR A:0x1:0x70014
y.create.l HWIO_RXFE_NB_CSR_CMD_NB5_ADDR A:0x1:0x70018
y.create.l HWIO_RXFE_NB_CSR_PHASEUPDT_ACTION_SAMPLE_NB5_ADDR A:0x1:0x7001c
y.create.l HWIO_RXFE_NB_CSR_FREQUPDT_ACTION_SAMPLE_NB5_ADDR A:0x1:0x70020
y.create.l HWIO_RXFE_NB_CSR_PHASE_OFFSET_NB5_ADDR A:0x1:0x70024
y.create.l HWIO_RXFE_NB_CSR_FREQ_OFFSET_NB5_ADDR A:0x1:0x70028
y.create.l HWIO_RXFE_NB_CSR_CURR_PHASE_OFFSET_NB5_ADDR A:0x1:0x7002c
y.create.l HWIO_RXFE_NB_CSR_CURR_FREQ_OFFSET_NB5_ADDR A:0x1:0x70030
y.create.l HWIO_RXFE_NB_FILTERS_CFG_NB5_ADDR A:0x1:0x70034
y.create.l HWIO_RXFE_NB_ICI_COEF0_NB5_ADDR A:0x1:0x7003c
y.create.l HWIO_RXFE_NB_ICI_COEF1_NB5_ADDR A:0x1:0x70040
y.create.l HWIO_RXFE_NB_ICI_COEF2_NB5_ADDR A:0x1:0x70044
y.create.l HWIO_RXFE_NB_ICI_COEF3_NB5_ADDR A:0x1:0x70048
y.create.l HWIO_RXFE_NB_ICI_COEF4_NB5_ADDR A:0x1:0x7004c
y.create.l HWIO_RXFE_NB_ICI_COEF5_NB5_ADDR A:0x1:0x70050
y.create.l HWIO_RXFE_NB_ICI_COEF6_NB5_ADDR A:0x1:0x70054
y.create.l HWIO_RXFE_NB_ICI_COEF7_NB5_ADDR A:0x1:0x70058
y.create.l HWIO_RXFE_NB_ICI_COEF8_NB5_ADDR A:0x1:0x7005c
y.create.l HWIO_RXFE_NB_ICI_COEF9_NB5_ADDR A:0x1:0x70060
y.create.l HWIO_RXFE_NB_GDA_NB5_ADDR A:0x1:0x70068
y.create.l HWIO_RXFE_NB_NBDC_COMPVAL_I_NB5_ADDR A:0x1:0x7006c
y.create.l HWIO_RXFE_NB_NBDC_COMPVAL_Q_NB5_ADDR A:0x1:0x70070
y.create.l HWIO_RXFE_NB_NBPWR_CFG_NB5_ADDR A:0x1:0x70074
y.create.l HWIO_RXFE_NB_NBPWR_CMD_NB5_ADDR A:0x1:0x70078
y.create.l HWIO_RXFE_NB_NBPWR_START_ACTION_SAMPLE_NB5_ADDR A:0x1:0x7007c
y.create.l HWIO_RXFE_NB_NBPWR_START_MASK_NB5_ADDR A:0x1:0x70080
y.create.l HWIO_RXFE_NB_NBPWR_STOP_ACTION_SAMPLE_NB5_ADDR A:0x1:0x70084
y.create.l HWIO_RXFE_NB_NBPWR_FINAL_ACC_NB5_ADDR A:0x1:0x70088
y.create.l HWIO_RXFE_NB_NBPWR_CURR_ACC_NB5_ADDR A:0x1:0x7008c
y.create.l HWIO_RXFE_NB_NBPWR_MAX_ACC_NB5_ADDR A:0x1:0x70090
y.create.l HWIO_RXFE_NB_DVGA_CFG_NB5_ADDR A:0x1:0x70094
y.create.l HWIO_RXFE_NB_DVGA_RXFE_GAIN_NB5_ADDR A:0x1:0x70098
y.create.l HWIO_RXFE_NB_DVGA_OVERRIDE_DVGA_GAIN_NB5_ADDR A:0x1:0x7009c
y.create.l HWIO_RXFE_NB_DVGA_CMD_NB5_ADDR A:0x1:0x700a0
y.create.l HWIO_RXFE_NB_DVGA_UPDT_ACTION_SAMPLE_NB5_ADDR A:0x1:0x700a4
y.create.l HWIO_RXFE_NB_DVGA_UPDT_MASK_NB5_ADDR A:0x1:0x700a8
y.create.l HWIO_RXFE_NB_FINAL_BITWIDTHS_CFG_NB5_ADDR A:0x1:0x700ac
y.create.l HWIO_RXFE_NB_WTR_CFG_NB5_ADDR A:0x1:0x700b0
y.create.l HWIO_RXFE_NB_WTR_FUNC_CFG_NB5_ADDR A:0x1:0x700b4
y.create.l HWIO_RXFE_NB_WTR_DBG_CFG0_NB5_ADDR A:0x1:0x700b8
y.create.l HWIO_RXFE_NB_WTR_DBG_CFG1_NB5_ADDR A:0x1:0x700bc
y.create.l HWIO_RXFE_NB_WTR_CMD_NB5_ADDR A:0x1:0x700c0
y.create.l HWIO_RXFE_NB_WTR_START_ACTION_SAMPLE_NB5_ADDR A:0x1:0x700c4
y.create.l HWIO_RXFE_NB_WTR_STOP_ACTION_SAMPLE_NB5_ADDR A:0x1:0x700c8
y.create.l HWIO_RXFE_NB_WTR_STATUS_NB5_ADDR A:0x1:0x700d0
y.create.l HWIO_RXFE_NB_WTR_ADDR_SNAPSHOT_NB5_ADDR A:0x1:0x700d4
y.create.l HWIO_RXFE_NB_SPARE_REG_NB5_ADDR A:0x1:0x700d8
y.create.l HWIO_RXFE_NB_TOP_CTL_NB6_ADDR A:0x1:0x78000
y.create.l HWIO_RXFE_NB_GATE_CMD_NB6_ADDR A:0x1:0x78004
y.create.l HWIO_RXFE_NB_GATE_STATUS_NB6_ADDR A:0x1:0x78008
y.create.l HWIO_RXFE_NB_GATE_ACTION_SAMPLE_NB6_ADDR A:0x1:0x7800c
y.create.l HWIO_RXFE_NB_TIMINGCTL_STATUS_NB6_ADDR A:0x1:0x78010
y.create.l HWIO_RXFE_NB_CSR_CFG_NB6_ADDR A:0x1:0x78014
y.create.l HWIO_RXFE_NB_CSR_CMD_NB6_ADDR A:0x1:0x78018
y.create.l HWIO_RXFE_NB_CSR_PHASEUPDT_ACTION_SAMPLE_NB6_ADDR A:0x1:0x7801c
y.create.l HWIO_RXFE_NB_CSR_FREQUPDT_ACTION_SAMPLE_NB6_ADDR A:0x1:0x78020
y.create.l HWIO_RXFE_NB_CSR_PHASE_OFFSET_NB6_ADDR A:0x1:0x78024
y.create.l HWIO_RXFE_NB_CSR_FREQ_OFFSET_NB6_ADDR A:0x1:0x78028
y.create.l HWIO_RXFE_NB_CSR_CURR_PHASE_OFFSET_NB6_ADDR A:0x1:0x7802c
y.create.l HWIO_RXFE_NB_CSR_CURR_FREQ_OFFSET_NB6_ADDR A:0x1:0x78030
y.create.l HWIO_RXFE_NB_FILTERS_CFG_NB6_ADDR A:0x1:0x78034
y.create.l HWIO_RXFE_NB_ICI_COEF0_NB6_ADDR A:0x1:0x7803c
y.create.l HWIO_RXFE_NB_ICI_COEF1_NB6_ADDR A:0x1:0x78040
y.create.l HWIO_RXFE_NB_ICI_COEF2_NB6_ADDR A:0x1:0x78044
y.create.l HWIO_RXFE_NB_ICI_COEF3_NB6_ADDR A:0x1:0x78048
y.create.l HWIO_RXFE_NB_ICI_COEF4_NB6_ADDR A:0x1:0x7804c
y.create.l HWIO_RXFE_NB_ICI_COEF5_NB6_ADDR A:0x1:0x78050
y.create.l HWIO_RXFE_NB_ICI_COEF6_NB6_ADDR A:0x1:0x78054
y.create.l HWIO_RXFE_NB_ICI_COEF7_NB6_ADDR A:0x1:0x78058
y.create.l HWIO_RXFE_NB_ICI_COEF8_NB6_ADDR A:0x1:0x7805c
y.create.l HWIO_RXFE_NB_ICI_COEF9_NB6_ADDR A:0x1:0x78060
y.create.l HWIO_RXFE_NB_GDA_NB6_ADDR A:0x1:0x78068
y.create.l HWIO_RXFE_NB_NBDC_COMPVAL_I_NB6_ADDR A:0x1:0x7806c
y.create.l HWIO_RXFE_NB_NBDC_COMPVAL_Q_NB6_ADDR A:0x1:0x78070
y.create.l HWIO_RXFE_NB_NBPWR_CFG_NB6_ADDR A:0x1:0x78074
y.create.l HWIO_RXFE_NB_NBPWR_CMD_NB6_ADDR A:0x1:0x78078
y.create.l HWIO_RXFE_NB_NBPWR_START_ACTION_SAMPLE_NB6_ADDR A:0x1:0x7807c
y.create.l HWIO_RXFE_NB_NBPWR_START_MASK_NB6_ADDR A:0x1:0x78080
y.create.l HWIO_RXFE_NB_NBPWR_STOP_ACTION_SAMPLE_NB6_ADDR A:0x1:0x78084
y.create.l HWIO_RXFE_NB_NBPWR_FINAL_ACC_NB6_ADDR A:0x1:0x78088
y.create.l HWIO_RXFE_NB_NBPWR_CURR_ACC_NB6_ADDR A:0x1:0x7808c
y.create.l HWIO_RXFE_NB_NBPWR_MAX_ACC_NB6_ADDR A:0x1:0x78090
y.create.l HWIO_RXFE_NB_DVGA_CFG_NB6_ADDR A:0x1:0x78094
y.create.l HWIO_RXFE_NB_DVGA_RXFE_GAIN_NB6_ADDR A:0x1:0x78098
y.create.l HWIO_RXFE_NB_DVGA_OVERRIDE_DVGA_GAIN_NB6_ADDR A:0x1:0x7809c
y.create.l HWIO_RXFE_NB_DVGA_CMD_NB6_ADDR A:0x1:0x780a0
y.create.l HWIO_RXFE_NB_DVGA_UPDT_ACTION_SAMPLE_NB6_ADDR A:0x1:0x780a4
y.create.l HWIO_RXFE_NB_DVGA_UPDT_MASK_NB6_ADDR A:0x1:0x780a8
y.create.l HWIO_RXFE_NB_FINAL_BITWIDTHS_CFG_NB6_ADDR A:0x1:0x780ac
y.create.l HWIO_RXFE_NB_WTR_CFG_NB6_ADDR A:0x1:0x780b0
y.create.l HWIO_RXFE_NB_WTR_FUNC_CFG_NB6_ADDR A:0x1:0x780b4
y.create.l HWIO_RXFE_NB_WTR_DBG_CFG0_NB6_ADDR A:0x1:0x780b8
y.create.l HWIO_RXFE_NB_WTR_DBG_CFG1_NB6_ADDR A:0x1:0x780bc
y.create.l HWIO_RXFE_NB_WTR_CMD_NB6_ADDR A:0x1:0x780c0
y.create.l HWIO_RXFE_NB_WTR_START_ACTION_SAMPLE_NB6_ADDR A:0x1:0x780c4
y.create.l HWIO_RXFE_NB_WTR_STOP_ACTION_SAMPLE_NB6_ADDR A:0x1:0x780c8
y.create.l HWIO_RXFE_NB_WTR_STATUS_NB6_ADDR A:0x1:0x780d0
y.create.l HWIO_RXFE_NB_WTR_ADDR_SNAPSHOT_NB6_ADDR A:0x1:0x780d4
y.create.l HWIO_RXFE_NB_SPARE_REG_NB6_ADDR A:0x1:0x780d8
y.create.l HWIO_RXFE_NB_TOP_CTL_NB7_ADDR A:0x1:0x80000
y.create.l HWIO_RXFE_NB_GATE_CMD_NB7_ADDR A:0x1:0x80004
y.create.l HWIO_RXFE_NB_GATE_STATUS_NB7_ADDR A:0x1:0x80008
y.create.l HWIO_RXFE_NB_GATE_ACTION_SAMPLE_NB7_ADDR A:0x1:0x8000c
y.create.l HWIO_RXFE_NB_TIMINGCTL_STATUS_NB7_ADDR A:0x1:0x80010
y.create.l HWIO_RXFE_NB_CSR_CFG_NB7_ADDR A:0x1:0x80014
y.create.l HWIO_RXFE_NB_CSR_CMD_NB7_ADDR A:0x1:0x80018
y.create.l HWIO_RXFE_NB_CSR_PHASEUPDT_ACTION_SAMPLE_NB7_ADDR A:0x1:0x8001c
y.create.l HWIO_RXFE_NB_CSR_FREQUPDT_ACTION_SAMPLE_NB7_ADDR A:0x1:0x80020
y.create.l HWIO_RXFE_NB_CSR_PHASE_OFFSET_NB7_ADDR A:0x1:0x80024
y.create.l HWIO_RXFE_NB_CSR_FREQ_OFFSET_NB7_ADDR A:0x1:0x80028
y.create.l HWIO_RXFE_NB_CSR_CURR_PHASE_OFFSET_NB7_ADDR A:0x1:0x8002c
y.create.l HWIO_RXFE_NB_CSR_CURR_FREQ_OFFSET_NB7_ADDR A:0x1:0x80030
y.create.l HWIO_RXFE_NB_FILTERS_CFG_NB7_ADDR A:0x1:0x80034
y.create.l HWIO_RXFE_NB_ICI_COEF0_NB7_ADDR A:0x1:0x8003c
y.create.l HWIO_RXFE_NB_ICI_COEF1_NB7_ADDR A:0x1:0x80040
y.create.l HWIO_RXFE_NB_ICI_COEF2_NB7_ADDR A:0x1:0x80044
y.create.l HWIO_RXFE_NB_ICI_COEF3_NB7_ADDR A:0x1:0x80048
y.create.l HWIO_RXFE_NB_ICI_COEF4_NB7_ADDR A:0x1:0x8004c
y.create.l HWIO_RXFE_NB_ICI_COEF5_NB7_ADDR A:0x1:0x80050
y.create.l HWIO_RXFE_NB_ICI_COEF6_NB7_ADDR A:0x1:0x80054
y.create.l HWIO_RXFE_NB_ICI_COEF7_NB7_ADDR A:0x1:0x80058
y.create.l HWIO_RXFE_NB_ICI_COEF8_NB7_ADDR A:0x1:0x8005c
y.create.l HWIO_RXFE_NB_ICI_COEF9_NB7_ADDR A:0x1:0x80060
y.create.l HWIO_RXFE_NB_GDA_NB7_ADDR A:0x1:0x80068
y.create.l HWIO_RXFE_NB_NBDC_COMPVAL_I_NB7_ADDR A:0x1:0x8006c
y.create.l HWIO_RXFE_NB_NBDC_COMPVAL_Q_NB7_ADDR A:0x1:0x80070
y.create.l HWIO_RXFE_NB_NBPWR_CFG_NB7_ADDR A:0x1:0x80074
y.create.l HWIO_RXFE_NB_NBPWR_CMD_NB7_ADDR A:0x1:0x80078
y.create.l HWIO_RXFE_NB_NBPWR_START_ACTION_SAMPLE_NB7_ADDR A:0x1:0x8007c
y.create.l HWIO_RXFE_NB_NBPWR_START_MASK_NB7_ADDR A:0x1:0x80080
y.create.l HWIO_RXFE_NB_NBPWR_STOP_ACTION_SAMPLE_NB7_ADDR A:0x1:0x80084
y.create.l HWIO_RXFE_NB_NBPWR_FINAL_ACC_NB7_ADDR A:0x1:0x80088
y.create.l HWIO_RXFE_NB_NBPWR_CURR_ACC_NB7_ADDR A:0x1:0x8008c
y.create.l HWIO_RXFE_NB_NBPWR_MAX_ACC_NB7_ADDR A:0x1:0x80090
y.create.l HWIO_RXFE_NB_DVGA_CFG_NB7_ADDR A:0x1:0x80094
y.create.l HWIO_RXFE_NB_DVGA_RXFE_GAIN_NB7_ADDR A:0x1:0x80098
y.create.l HWIO_RXFE_NB_DVGA_OVERRIDE_DVGA_GAIN_NB7_ADDR A:0x1:0x8009c
y.create.l HWIO_RXFE_NB_DVGA_CMD_NB7_ADDR A:0x1:0x800a0
y.create.l HWIO_RXFE_NB_DVGA_UPDT_ACTION_SAMPLE_NB7_ADDR A:0x1:0x800a4
y.create.l HWIO_RXFE_NB_DVGA_UPDT_MASK_NB7_ADDR A:0x1:0x800a8
y.create.l HWIO_RXFE_NB_FINAL_BITWIDTHS_CFG_NB7_ADDR A:0x1:0x800ac
y.create.l HWIO_RXFE_NB_WTR_CFG_NB7_ADDR A:0x1:0x800b0
y.create.l HWIO_RXFE_NB_WTR_FUNC_CFG_NB7_ADDR A:0x1:0x800b4
y.create.l HWIO_RXFE_NB_WTR_DBG_CFG0_NB7_ADDR A:0x1:0x800b8
y.create.l HWIO_RXFE_NB_WTR_DBG_CFG1_NB7_ADDR A:0x1:0x800bc
y.create.l HWIO_RXFE_NB_WTR_CMD_NB7_ADDR A:0x1:0x800c0
y.create.l HWIO_RXFE_NB_WTR_START_ACTION_SAMPLE_NB7_ADDR A:0x1:0x800c4
y.create.l HWIO_RXFE_NB_WTR_STOP_ACTION_SAMPLE_NB7_ADDR A:0x1:0x800c8
y.create.l HWIO_RXFE_NB_WTR_STATUS_NB7_ADDR A:0x1:0x800d0
y.create.l HWIO_RXFE_NB_WTR_ADDR_SNAPSHOT_NB7_ADDR A:0x1:0x800d4
y.create.l HWIO_RXFE_NB_SPARE_REG_NB7_ADDR A:0x1:0x800d8
y.create.l HWIO_RXFE_NB_TOP_CTL_NB8_ADDR A:0x1:0x88000
y.create.l HWIO_RXFE_NB_GATE_CMD_NB8_ADDR A:0x1:0x88004
y.create.l HWIO_RXFE_NB_GATE_STATUS_NB8_ADDR A:0x1:0x88008
y.create.l HWIO_RXFE_NB_GATE_ACTION_SAMPLE_NB8_ADDR A:0x1:0x8800c
y.create.l HWIO_RXFE_NB_TIMINGCTL_STATUS_NB8_ADDR A:0x1:0x88010
y.create.l HWIO_RXFE_NB_CSR_CFG_NB8_ADDR A:0x1:0x88014
y.create.l HWIO_RXFE_NB_CSR_CMD_NB8_ADDR A:0x1:0x88018
y.create.l HWIO_RXFE_NB_CSR_PHASEUPDT_ACTION_SAMPLE_NB8_ADDR A:0x1:0x8801c
y.create.l HWIO_RXFE_NB_CSR_FREQUPDT_ACTION_SAMPLE_NB8_ADDR A:0x1:0x88020
y.create.l HWIO_RXFE_NB_CSR_PHASE_OFFSET_NB8_ADDR A:0x1:0x88024
y.create.l HWIO_RXFE_NB_CSR_FREQ_OFFSET_NB8_ADDR A:0x1:0x88028
y.create.l HWIO_RXFE_NB_CSR_CURR_PHASE_OFFSET_NB8_ADDR A:0x1:0x8802c
y.create.l HWIO_RXFE_NB_CSR_CURR_FREQ_OFFSET_NB8_ADDR A:0x1:0x88030
y.create.l HWIO_RXFE_NB_FILTERS_CFG_NB8_ADDR A:0x1:0x88034
y.create.l HWIO_RXFE_NB_ICI_COEF0_NB8_ADDR A:0x1:0x8803c
y.create.l HWIO_RXFE_NB_ICI_COEF1_NB8_ADDR A:0x1:0x88040
y.create.l HWIO_RXFE_NB_ICI_COEF2_NB8_ADDR A:0x1:0x88044
y.create.l HWIO_RXFE_NB_ICI_COEF3_NB8_ADDR A:0x1:0x88048
y.create.l HWIO_RXFE_NB_ICI_COEF4_NB8_ADDR A:0x1:0x8804c
y.create.l HWIO_RXFE_NB_ICI_COEF5_NB8_ADDR A:0x1:0x88050
y.create.l HWIO_RXFE_NB_ICI_COEF6_NB8_ADDR A:0x1:0x88054
y.create.l HWIO_RXFE_NB_ICI_COEF7_NB8_ADDR A:0x1:0x88058
y.create.l HWIO_RXFE_NB_ICI_COEF8_NB8_ADDR A:0x1:0x8805c
y.create.l HWIO_RXFE_NB_ICI_COEF9_NB8_ADDR A:0x1:0x88060
y.create.l HWIO_RXFE_NB_GDA_NB8_ADDR A:0x1:0x88068
y.create.l HWIO_RXFE_NB_NBDC_COMPVAL_I_NB8_ADDR A:0x1:0x8806c
y.create.l HWIO_RXFE_NB_NBDC_COMPVAL_Q_NB8_ADDR A:0x1:0x88070
y.create.l HWIO_RXFE_NB_NBPWR_CFG_NB8_ADDR A:0x1:0x88074
y.create.l HWIO_RXFE_NB_NBPWR_CMD_NB8_ADDR A:0x1:0x88078
y.create.l HWIO_RXFE_NB_NBPWR_START_ACTION_SAMPLE_NB8_ADDR A:0x1:0x8807c
y.create.l HWIO_RXFE_NB_NBPWR_START_MASK_NB8_ADDR A:0x1:0x88080
y.create.l HWIO_RXFE_NB_NBPWR_STOP_ACTION_SAMPLE_NB8_ADDR A:0x1:0x88084
y.create.l HWIO_RXFE_NB_NBPWR_FINAL_ACC_NB8_ADDR A:0x1:0x88088
y.create.l HWIO_RXFE_NB_NBPWR_CURR_ACC_NB8_ADDR A:0x1:0x8808c
y.create.l HWIO_RXFE_NB_NBPWR_MAX_ACC_NB8_ADDR A:0x1:0x88090
y.create.l HWIO_RXFE_NB_DVGA_CFG_NB8_ADDR A:0x1:0x88094
y.create.l HWIO_RXFE_NB_DVGA_RXFE_GAIN_NB8_ADDR A:0x1:0x88098
y.create.l HWIO_RXFE_NB_DVGA_OVERRIDE_DVGA_GAIN_NB8_ADDR A:0x1:0x8809c
y.create.l HWIO_RXFE_NB_DVGA_CMD_NB8_ADDR A:0x1:0x880a0
y.create.l HWIO_RXFE_NB_DVGA_UPDT_ACTION_SAMPLE_NB8_ADDR A:0x1:0x880a4
y.create.l HWIO_RXFE_NB_DVGA_UPDT_MASK_NB8_ADDR A:0x1:0x880a8
y.create.l HWIO_RXFE_NB_FINAL_BITWIDTHS_CFG_NB8_ADDR A:0x1:0x880ac
y.create.l HWIO_RXFE_NB_WTR_CFG_NB8_ADDR A:0x1:0x880b0
y.create.l HWIO_RXFE_NB_WTR_FUNC_CFG_NB8_ADDR A:0x1:0x880b4
y.create.l HWIO_RXFE_NB_WTR_DBG_CFG0_NB8_ADDR A:0x1:0x880b8
y.create.l HWIO_RXFE_NB_WTR_DBG_CFG1_NB8_ADDR A:0x1:0x880bc
y.create.l HWIO_RXFE_NB_WTR_CMD_NB8_ADDR A:0x1:0x880c0
y.create.l HWIO_RXFE_NB_WTR_START_ACTION_SAMPLE_NB8_ADDR A:0x1:0x880c4
y.create.l HWIO_RXFE_NB_WTR_STOP_ACTION_SAMPLE_NB8_ADDR A:0x1:0x880c8
y.create.l HWIO_RXFE_NB_WTR_STATUS_NB8_ADDR A:0x1:0x880d0
y.create.l HWIO_RXFE_NB_WTR_ADDR_SNAPSHOT_NB8_ADDR A:0x1:0x880d4
y.create.l HWIO_RXFE_NB_SPARE_REG_NB8_ADDR A:0x1:0x880d8
y.create.l HWIO_DTR_TXFE0_START_ADDR A:0x1:0xa0000
y.create.l HWIO_DTR_TXFE0_START_DAC_CLK_OFFSET_ADDR A:0x1:0xa0004
y.create.l HWIO_DTR_TXFE0_STOP_ADDR A:0x1:0xa0008
y.create.l HWIO_DTR_DAC0_IREF_UPDATE_START_ADDR A:0x1:0xa0024
y.create.l HWIO_DTR_DAC0_IREF_UPDATE_STOP_ADDR A:0x1:0xa0028
y.create.l HWIO_DTR_TXFE0_IMMEDIATE_UPDATE_EN_ADDR A:0x1:0xa002c
y.create.l HWIO_DTR_TXFE0_CURRENT_SAMPLE_COUNT_ADDR A:0x1:0xa0030
y.create.l HWIO_DTR_TXFE0_CALIBRATION_MODE_ADDR A:0x1:0xa003c
y.create.l HWIO_DTR_TXFE1_START_ADDR A:0x1:0xa0040
y.create.l HWIO_DTR_TXFE1_START_DAC_CLK_OFFSET_ADDR A:0x1:0xa0044
y.create.l HWIO_DTR_TXFE1_STOP_ADDR A:0x1:0xa0048
y.create.l HWIO_DTR_DAC1_IREF_UPDATE_START_ADDR A:0x1:0xa0064
y.create.l HWIO_DTR_DAC1_IREF_UPDATE_STOP_ADDR A:0x1:0xa0068
y.create.l HWIO_DTR_TXFE1_IMMEDIATE_UPDATE_EN_ADDR A:0x1:0xa006c
y.create.l HWIO_DTR_TXFE1_CURRENT_SAMPLE_COUNT_ADDR A:0x1:0xa0078
y.create.l HWIO_DTR_TXFE1_CALIBRATION_MODE_ADDR A:0x1:0xa007c
y.create.l HWIO_DTR_RXFE_XO_TRIGGER_RXCH0_ADDR A:0x1:0xa0080
y.create.l HWIO_DTR_RXFE_XO_TRIGGER_RXCH1_ADDR A:0x1:0xa0084
y.create.l HWIO_DTR_RXFE_XO_TRIGGER_RXCH2_ADDR A:0x1:0xa0088
y.create.l HWIO_DTR_RXFE_XO_TRIGGER_RXCH3_ADDR A:0x1:0xa008c
y.create.l HWIO_DTR_RXFE_XO_TRIGGER_RXCH4_ADDR A:0x1:0xa0090
y.create.l HWIO_DTR_CLK_DIV_CFG_ADDR A:0x1:0xa0094
y.create.l HWIO_DTR_TXFE0_EN_ADDR A:0x1:0xa0098
y.create.l HWIO_DTR_TXFE1_EN_ADDR A:0x1:0xa009c
y.create.l HWIO_DTR_RXFE_EN_ADDR A:0x1:0xa00a0
y.create.l HWIO_DTR_DAC0_EN_ADDR A:0x1:0xa00a4
y.create.l HWIO_DTR_DAC1_EN_ADDR A:0x1:0xa00a8
y.create.l HWIO_DTR_CARR_AGGREGATION_MODE_ADDR A:0x1:0xa00ac
y.create.l HWIO_DTR_TXFE0_STATE_RESET_ADDR A:0x1:0xa00b0
y.create.l HWIO_DTR_TXFE1_STATE_RESET_ADDR A:0x1:0xa00b4
y.create.l HWIO_DTR_TXFE0_BYPASS_ADDR A:0x1:0xa00b8
y.create.l HWIO_DTR_TXFE1_BYPASS_ADDR A:0x1:0xa00bc
y.create.l HWIO_DTR_TXFE0_STMR_SYNC_TRIG_ADDR A:0x1:0xa00c0
y.create.l HWIO_DTR_TXFE1_STMR_SYNC_TRIG_ADDR A:0x1:0xa00c4
y.create.l HWIO_DTR_TXFE0_SAMPLE_COUNT_LOAD_NSAMPLE_ADDR A:0x1:0xa000c
y.create.l HWIO_DTR_TXFE0_SAMPLE_COUNT_LOAD_UPDATE_INDEX_ADDR A:0x1:0xa0010
y.create.l HWIO_DTR_TXFE0_SAMPLE_COUNT_LOAD_LOG_START_ADDR A:0x1:0xa0014
y.create.l HWIO_DTR_TXFE0_SAMPLE_COUNT_LOAD_LOG_STOP_ADDR A:0x1:0xa0018
y.create.l HWIO_DTR_TXFE0_SAMPLE_COUNT_LOAD_UPDATE_ENABLE_ADDR A:0x1:0xa001c
y.create.l HWIO_DTR_TXFE0_SAMPLE_COUNT_LOAD_SAMPLE_COUNT_UPDATE_STATUS_ADDR A:0x1:0xa0020
y.create.l HWIO_DTR_TXFE0_DONE_COUNT_RDB_DONE_SAMPLE_COUNT_ADDR A:0x1:0xa0034
y.create.l HWIO_DTR_TXFE0_DONE_COUNT_RDB_DONE_STMR_COUNT_ADDR A:0x1:0xa0038
y.create.l HWIO_DTR_TXFE1_SAMPLE_COUNT_LOAD_NSAMPLE_ADDR A:0x1:0xa004c
y.create.l HWIO_DTR_TXFE1_SAMPLE_COUNT_LOAD_UPDATE_INDEX_ADDR A:0x1:0xa0050
y.create.l HWIO_DTR_TXFE1_SAMPLE_COUNT_LOAD_LOG_START_ADDR A:0x1:0xa0054
y.create.l HWIO_DTR_TXFE1_SAMPLE_COUNT_LOAD_LOG_STOP_ADDR A:0x1:0xa0058
y.create.l HWIO_DTR_TXFE1_SAMPLE_COUNT_LOAD_UPDATE_ENABLE_ADDR A:0x1:0xa005c
y.create.l HWIO_DTR_TXFE1_SAMPLE_COUNT_LOAD_SAMPLE_COUNT_UPDATE_STATUS_ADDR A:0x1:0xa0060
y.create.l HWIO_DTR_TXFE1_DONE_COUNT_RDB_DONE_SAMPLE_COUNT_ADDR A:0x1:0xa0070
y.create.l HWIO_DTR_TXFE1_DONE_COUNT_RDB_DONE_STMR_COUNT_ADDR A:0x1:0xa0074
y.create.l HWIO_DTR_TXFE_SP_CFG_CHAIN0_ADDR A:0x1:0xb8000
y.create.l HWIO_DTR_TXFE_SP_REFLOG_CHAIN0_ADDR A:0x1:0xb8004
y.create.l HWIO_DTR_TXFE_SP_PPDSM_CFG_CHAIN0_ADDR A:0x1:0xb8008
y.create.l HWIO_DTR_TXFE_SP_FMTC_CHAIN0_ADDR A:0x1:0xb800c
y.create.l HWIO_DTR_TXET_SP_FMTC_CHAIN0_ADDR A:0x1:0xb8010
y.create.l HWIO_DTR_TXFE_SP_QPT_CFG_CHAIN0_ADDR A:0x1:0xb8014
y.create.l HWIO_DTR_TXFE_SP_DM2_FINE_TAU_CHAIN0_ADDR A:0x1:0xb8018
y.create.l HWIO_DTR_TXFE_SP_DM3_FRAC_TAU_CHAIN0_ADDR A:0x1:0xb801c
y.create.l HWIO_DTR_TXFE_SP_UDM1_CFG_CHAIN0_ADDR A:0x1:0xb8020
y.create.l HWIO_DTR_TXFE_SP_QPTSP_DM4_CFG_CHAIN0_ADDR A:0x1:0xb8024
y.create.l HWIO_DTR_TXFE_SP_LUTS_RDBADDR_CHAIN0_ADDR A:0x1:0xb8028
y.create.l HWIO_DTR_TXFE_SP_LUTS_RDBDATA_CHAIN0_ADDR A:0x1:0xb802c
y.create.l HWIO_DTR_TXFE_DPRDB_ENVRAMP_RAMP_ARM_CHAIN0_ADDR A:0x1:0xb8030
y.create.l HWIO_DTR_TXFE_DPRDB_ENVRAMP_RAMP_SLOT_A_CFG_CHAIN0_ADDR A:0x1:0xb8034
y.create.l HWIO_DTR_TXFE_DPRDB_ENVRAMP_RAMP_SLOT_B_CFG_CHAIN0_ADDR A:0x1:0xb8038
y.create.l HWIO_DTR_TXFE_DPRDB_ENVRAMP_RAMP_GAP_CHAIN0_ADDR A:0x1:0xb803c
y.create.l HWIO_DTR_TXFE_DPRDB_ENV_RAMP_SCALE_VAL_CHAIN0_ADDR A:0x1:0xb8040
y.create.l HWIO_DTR_TXFE_DPRDB_PPDS_GAIN_CHAIN0_ADDR A:0x1:0xb8044
y.create.l HWIO_DTR_TXFE_DPRDB_GSM_RAMP_LUT_CFG_CHAIN0_ADDR A:0x1:0xb8048
y.create.l HWIO_DTR_TXFE_DPRDB_PHASE_OVR_VAL_CHAIN0_ADDR A:0x1:0xb804c
y.create.l HWIO_DTR_TXFE_DPRDB_DPRDB_ENV_OVR_VAL_CHAIN0_ADDR A:0x1:0xb8050
y.create.l HWIO_DTR_TXFE_DPRDB_ET_ENV_OVR_VAL_CHAIN0_ADDR A:0x1:0xb8054
y.create.l HWIO_DTR_TXFE_DPRDB_ROTATOR_CFG_CHAIN0_ADDR A:0x1:0xb8058
y.create.l HWIO_DTR_TXFE_DPRDB_ROTATOR_PHASE_INC_CHAIN0_ADDR A:0x1:0xb805c
y.create.l HWIO_DTR_TXFE_DPRDB_ROTATOR_PHASE_INIT_CHAIN0_ADDR A:0x1:0xb8060
y.create.l HWIO_DTR_TXFE_DPRDB_ROTATOR_PHASE_SHIFT_CHAIN0_ADDR A:0x1:0xb8064
y.create.l HWIO_DTR_TXFE_DPRDB_CARAGG_CFG_CHAIN0_ADDR A:0x1:0xb8068
y.create.l HWIO_DTR_TXFE_DPRDB_DPRDBSEL_CFG0_CHAIN0_ADDR A:0x1:0xb806c
y.create.l HWIO_DTR_TXFE_DPRDB_DPRDBSEL_CFG1_CHAIN0_ADDR A:0x1:0xb8070
y.create.l HWIO_DTR_TXFE_DPRDB_EPT_AMAM_LUT_CFG_CHAIN0_ADDR A:0x1:0xb8074
y.create.l HWIO_DTR_TXFE_DPRDB_EPT_AMPM_LUT_CFG_CHAIN0_ADDR A:0x1:0xb8078
y.create.l HWIO_DTR_TXFE_DPRDB_ET_AMAM_LUT_CFG_CHAIN0_ADDR A:0x1:0xb807c
y.create.l HWIO_DTR_TXFE_DPRDB_ET_AMPM_LUT_CFG_CHAIN0_ADDR A:0x1:0xb8080
y.create.l HWIO_DTR_TXFE_DPRDB_ETDT_LUT_CFG_CHAIN0_ADDR A:0x1:0xb8084
y.create.l HWIO_DTR_TXFE_DPRDB_SPINV_CHAIN0_ADDR A:0x1:0xb8088
y.create.l HWIO_DTR_TXFE_DPRDB_UDM1_CFG_CHAIN0_ADDR A:0x1:0xb808c
y.create.l HWIO_DTR_TXFE_DPRDB_QPT_CFG_CHAIN0_ADDR A:0x1:0xb8090
y.create.l HWIO_DTR_TXFE_DPRDB_QPT_AMAM_LUT_CFG_CHAIN0_ADDR A:0x1:0xb8094
y.create.l HWIO_DTR_TXFE_DPRDB_QPT_AMPM_0_LUT_CFG_CHAIN0_ADDR A:0x1:0xb8098
y.create.l HWIO_DTR_TXFE_DPRDB_QPT_PREDICT_CHAIN0_ADDR A:0x1:0xb809c
y.create.l HWIO_DTR_TXFE_DPRDB_QPT_PREDICT_RLC_METRIC_CHAIN0_ADDR A:0x1:0xb80a0
y.create.l HWIO_DTR_TXFE_DPRDB_QPT_PREDICT_UPPER_LIMIT_CHAIN0_ADDR A:0x1:0xb80a4
y.create.l HWIO_DTR_TXFE_DPRDB_QPT_PREDICT_AMPM_VESTIMATE_CHAIN0_ADDR A:0x1:0xb80a8
y.create.l HWIO_DTR_TXFE_DPRDB_QPT_BLUT_LUT_CFG_CHAIN0_ADDR A:0x1:0xb80ac
y.create.l HWIO_DTR_TXFE_DPRDB_QPT_AMAM_PRELUT_LUT_CFG_CHAIN0_ADDR A:0x1:0xb80b0
y.create.l HWIO_DTR_TXFE_DPRDB_QPT_AMAM_POSTLUT_LUT_CFG_CHAIN0_ADDR A:0x1:0xb80b4
y.create.l HWIO_DTR_TXFE_DPRDB_QPT_AMPM_1_LUT_CFG_CHAIN0_ADDR A:0x1:0xb80b8
y.create.l HWIO_DTR_TXFE_DPRDB_QPT_AMPM_2_LUT_CFG_CHAIN0_ADDR A:0x1:0xb80bc
y.create.l HWIO_DTR_TXFE_DPRDB_QPT_AMPM_3_LUT_CFG_CHAIN0_ADDR A:0x1:0xb80c0
y.create.l HWIO_DTR_TXFE_DPRDB_GH_LUT_CFG_CHAIN0_ADDR A:0x1:0xb80c4
y.create.l HWIO_DTR_TXFE_DPRDB_QPT_OVERRIDE_CHAIN0_ADDR A:0x1:0xb80c8
y.create.l HWIO_DTR_TXFE_DPRDB_IREF_UPDT_CFG_CHAIN0_ADDR A:0x1:0xb80cc
y.create.l HWIO_DTR_TXRFI_DPRDB_CFG_CHAIN0_ADDR A:0x1:0xb80d0
y.create.l HWIO_DTR_TXRFI_DPRDB_GAIN_CHAIN0_ADDR A:0x1:0xb80d4
y.create.l HWIO_DTR_TXRFI_DPRDB_GAIN2_CHAIN0_ADDR A:0x1:0xb80d8
y.create.l HWIO_DTR_TXRFI_DPRDB_IQMC_CHAIN0_ADDR A:0x1:0xb80dc
y.create.l HWIO_DTR_TXRFI_DPRDB_PEQ1_CHAIN0_ADDR A:0x1:0xb80e0
y.create.l HWIO_DTR_TXRFI_DPRDB_PEQ1_SORU_CHAIN0_ADDR A:0x1:0xb80e4
y.create.l HWIO_DTR_TXRFI_DPRDB_PEQ2_CHAIN0_ADDR A:0x1:0xb80e8
y.create.l HWIO_DTR_TXRFI_DPRDB_DCOC_CHAIN0_ADDR A:0x1:0xb80ec
y.create.l HWIO_DTR_TXRFI_DPRDB_SAWEQ_COEFF0_CHAIN0_ADDR A:0x1:0xb80f0
y.create.l HWIO_DTR_TXRFI_DPRDB_SAWEQ_COEFF1_CHAIN0_ADDR A:0x1:0xb80f4
y.create.l HWIO_DTR_TXRFI_DPRDB_SAWEQ_COEFF2_CHAIN0_ADDR A:0x1:0xb80f8
y.create.l HWIO_DTR_TXRFI_DPRDB_SAWEQ_COEFF3_CHAIN0_ADDR A:0x1:0xb80fc
y.create.l HWIO_DTR_TXRFI_DPRDB_SAWEQ_COEFF4_CHAIN0_ADDR A:0x1:0xb8100
y.create.l HWIO_DTR_TXRFI_DPRDB_SAWEQ_COEFF5_CHAIN0_ADDR A:0x1:0xb8104
y.create.l HWIO_DTR_TXRFI_DPRDB_SAWEQ_COEFF6_CHAIN0_ADDR A:0x1:0xb8108
y.create.l HWIO_DTR_TXRFI_DPRDB_SAWEQ_COEFF7_CHAIN0_ADDR A:0x1:0xb810c
y.create.l HWIO_DTR_TXET_DPRDB_CFG_CHAIN0_ADDR A:0x1:0xb8110
y.create.l HWIO_DTR_TXET_DPRDB_GAIN_CHAIN0_ADDR A:0x1:0xb8114
y.create.l HWIO_DTR_TXET_DPRDB_PEQ1_CHAIN0_ADDR A:0x1:0xb8118
y.create.l HWIO_DTR_TXET_DPRDB_PEQ1_SORU_CHAIN0_ADDR A:0x1:0xb811c
y.create.l HWIO_DTR_TXET_DPRDB_PEQ2_CHAIN0_ADDR A:0x1:0xb8120
y.create.l HWIO_DTR_TXET_DPRDB_DCOC_CHAIN0_ADDR A:0x1:0xb8124
y.create.l HWIO_DTR_TXET_DPRDB_DM2_FINE_TAU_CHAIN0_ADDR A:0x1:0xb8128
y.create.l HWIO_DTR_TXET_DPRDB_DM3_FRAC_TAU_CHAIN0_ADDR A:0x1:0xb812c
y.create.l HWIO_DTR_TXFE_SP_CFG_CHAIN1_ADDR A:0x1:0xc0000
y.create.l HWIO_DTR_TXFE_SP_REFLOG_CHAIN1_ADDR A:0x1:0xc0004
y.create.l HWIO_DTR_TXFE_SP_PPDSM_CFG_CHAIN1_ADDR A:0x1:0xc0008
y.create.l HWIO_DTR_TXFE_SP_FMTC_CHAIN1_ADDR A:0x1:0xc000c
y.create.l HWIO_DTR_TXET_SP_FMTC_CHAIN1_ADDR A:0x1:0xc0010
y.create.l HWIO_DTR_TXFE_SP_QPT_CFG_CHAIN1_ADDR A:0x1:0xc0014
y.create.l HWIO_DTR_TXFE_SP_DM2_FINE_TAU_CHAIN1_ADDR A:0x1:0xc0018
y.create.l HWIO_DTR_TXFE_SP_DM3_FRAC_TAU_CHAIN1_ADDR A:0x1:0xc001c
y.create.l HWIO_DTR_TXFE_SP_UDM1_CFG_CHAIN1_ADDR A:0x1:0xc0020
y.create.l HWIO_DTR_TXFE_SP_QPTSP_DM4_CFG_CHAIN1_ADDR A:0x1:0xc0024
y.create.l HWIO_DTR_TXFE_SP_LUTS_RDBADDR_CHAIN1_ADDR A:0x1:0xc0028
y.create.l HWIO_DTR_TXFE_SP_LUTS_RDBDATA_CHAIN1_ADDR A:0x1:0xc002c
y.create.l HWIO_DTR_TXFE_DPRDB_ENVRAMP_RAMP_ARM_CHAIN1_ADDR A:0x1:0xc0030
y.create.l HWIO_DTR_TXFE_DPRDB_ENVRAMP_RAMP_SLOT_A_CFG_CHAIN1_ADDR A:0x1:0xc0034
y.create.l HWIO_DTR_TXFE_DPRDB_ENVRAMP_RAMP_SLOT_B_CFG_CHAIN1_ADDR A:0x1:0xc0038
y.create.l HWIO_DTR_TXFE_DPRDB_ENVRAMP_RAMP_GAP_CHAIN1_ADDR A:0x1:0xc003c
y.create.l HWIO_DTR_TXFE_DPRDB_ENV_RAMP_SCALE_VAL_CHAIN1_ADDR A:0x1:0xc0040
y.create.l HWIO_DTR_TXFE_DPRDB_PPDS_GAIN_CHAIN1_ADDR A:0x1:0xc0044
y.create.l HWIO_DTR_TXFE_DPRDB_GSM_RAMP_LUT_CFG_CHAIN1_ADDR A:0x1:0xc0048
y.create.l HWIO_DTR_TXFE_DPRDB_PHASE_OVR_VAL_CHAIN1_ADDR A:0x1:0xc004c
y.create.l HWIO_DTR_TXFE_DPRDB_DPRDB_ENV_OVR_VAL_CHAIN1_ADDR A:0x1:0xc0050
y.create.l HWIO_DTR_TXFE_DPRDB_ET_ENV_OVR_VAL_CHAIN1_ADDR A:0x1:0xc0054
y.create.l HWIO_DTR_TXFE_DPRDB_ROTATOR_CFG_CHAIN1_ADDR A:0x1:0xc0058
y.create.l HWIO_DTR_TXFE_DPRDB_ROTATOR_PHASE_INC_CHAIN1_ADDR A:0x1:0xc005c
y.create.l HWIO_DTR_TXFE_DPRDB_ROTATOR_PHASE_INIT_CHAIN1_ADDR A:0x1:0xc0060
y.create.l HWIO_DTR_TXFE_DPRDB_ROTATOR_PHASE_SHIFT_CHAIN1_ADDR A:0x1:0xc0064
y.create.l HWIO_DTR_TXFE_DPRDB_CARAGG_CFG_CHAIN1_ADDR A:0x1:0xc0068
y.create.l HWIO_DTR_TXFE_DPRDB_DPRDBSEL_CFG0_CHAIN1_ADDR A:0x1:0xc006c
y.create.l HWIO_DTR_TXFE_DPRDB_DPRDBSEL_CFG1_CHAIN1_ADDR A:0x1:0xc0070
y.create.l HWIO_DTR_TXFE_DPRDB_EPT_AMAM_LUT_CFG_CHAIN1_ADDR A:0x1:0xc0074
y.create.l HWIO_DTR_TXFE_DPRDB_EPT_AMPM_LUT_CFG_CHAIN1_ADDR A:0x1:0xc0078
y.create.l HWIO_DTR_TXFE_DPRDB_ET_AMAM_LUT_CFG_CHAIN1_ADDR A:0x1:0xc007c
y.create.l HWIO_DTR_TXFE_DPRDB_ET_AMPM_LUT_CFG_CHAIN1_ADDR A:0x1:0xc0080
y.create.l HWIO_DTR_TXFE_DPRDB_ETDT_LUT_CFG_CHAIN1_ADDR A:0x1:0xc0084
y.create.l HWIO_DTR_TXFE_DPRDB_SPINV_CHAIN1_ADDR A:0x1:0xc0088
y.create.l HWIO_DTR_TXFE_DPRDB_UDM1_CFG_CHAIN1_ADDR A:0x1:0xc008c
y.create.l HWIO_DTR_TXFE_DPRDB_QPT_CFG_CHAIN1_ADDR A:0x1:0xc0090
y.create.l HWIO_DTR_TXFE_DPRDB_QPT_AMAM_LUT_CFG_CHAIN1_ADDR A:0x1:0xc0094
y.create.l HWIO_DTR_TXFE_DPRDB_QPT_AMPM_0_LUT_CFG_CHAIN1_ADDR A:0x1:0xc0098
y.create.l HWIO_DTR_TXFE_DPRDB_QPT_PREDICT_CHAIN1_ADDR A:0x1:0xc009c
y.create.l HWIO_DTR_TXFE_DPRDB_QPT_PREDICT_RLC_METRIC_CHAIN1_ADDR A:0x1:0xc00a0
y.create.l HWIO_DTR_TXFE_DPRDB_QPT_PREDICT_UPPER_LIMIT_CHAIN1_ADDR A:0x1:0xc00a4
y.create.l HWIO_DTR_TXFE_DPRDB_QPT_PREDICT_AMPM_VESTIMATE_CHAIN1_ADDR A:0x1:0xc00a8
y.create.l HWIO_DTR_TXFE_DPRDB_QPT_BLUT_LUT_CFG_CHAIN1_ADDR A:0x1:0xc00ac
y.create.l HWIO_DTR_TXFE_DPRDB_QPT_AMAM_PRELUT_LUT_CFG_CHAIN1_ADDR A:0x1:0xc00b0
y.create.l HWIO_DTR_TXFE_DPRDB_QPT_AMAM_POSTLUT_LUT_CFG_CHAIN1_ADDR A:0x1:0xc00b4
y.create.l HWIO_DTR_TXFE_DPRDB_QPT_AMPM_1_LUT_CFG_CHAIN1_ADDR A:0x1:0xc00b8
y.create.l HWIO_DTR_TXFE_DPRDB_QPT_AMPM_2_LUT_CFG_CHAIN1_ADDR A:0x1:0xc00bc
y.create.l HWIO_DTR_TXFE_DPRDB_QPT_AMPM_3_LUT_CFG_CHAIN1_ADDR A:0x1:0xc00c0
y.create.l HWIO_DTR_TXFE_DPRDB_GH_LUT_CFG_CHAIN1_ADDR A:0x1:0xc00c4
y.create.l HWIO_DTR_TXFE_DPRDB_QPT_OVERRIDE_CHAIN1_ADDR A:0x1:0xc00c8
y.create.l HWIO_DTR_TXFE_DPRDB_IREF_UPDT_CFG_CHAIN1_ADDR A:0x1:0xc00cc
y.create.l HWIO_DTR_TXRFI_DPRDB_CFG_CHAIN1_ADDR A:0x1:0xc00d0
y.create.l HWIO_DTR_TXRFI_DPRDB_GAIN_CHAIN1_ADDR A:0x1:0xc00d4
y.create.l HWIO_DTR_TXRFI_DPRDB_GAIN2_CHAIN1_ADDR A:0x1:0xc00d8
y.create.l HWIO_DTR_TXRFI_DPRDB_IQMC_CHAIN1_ADDR A:0x1:0xc00dc
y.create.l HWIO_DTR_TXRFI_DPRDB_PEQ1_CHAIN1_ADDR A:0x1:0xc00e0
y.create.l HWIO_DTR_TXRFI_DPRDB_PEQ1_SORU_CHAIN1_ADDR A:0x1:0xc00e4
y.create.l HWIO_DTR_TXRFI_DPRDB_PEQ2_CHAIN1_ADDR A:0x1:0xc00e8
y.create.l HWIO_DTR_TXRFI_DPRDB_DCOC_CHAIN1_ADDR A:0x1:0xc00ec
y.create.l HWIO_DTR_TXRFI_DPRDB_SAWEQ_COEFF0_CHAIN1_ADDR A:0x1:0xc00f0
y.create.l HWIO_DTR_TXRFI_DPRDB_SAWEQ_COEFF1_CHAIN1_ADDR A:0x1:0xc00f4
y.create.l HWIO_DTR_TXRFI_DPRDB_SAWEQ_COEFF2_CHAIN1_ADDR A:0x1:0xc00f8
y.create.l HWIO_DTR_TXRFI_DPRDB_SAWEQ_COEFF3_CHAIN1_ADDR A:0x1:0xc00fc
y.create.l HWIO_DTR_TXRFI_DPRDB_SAWEQ_COEFF4_CHAIN1_ADDR A:0x1:0xc0100
y.create.l HWIO_DTR_TXRFI_DPRDB_SAWEQ_COEFF5_CHAIN1_ADDR A:0x1:0xc0104
y.create.l HWIO_DTR_TXRFI_DPRDB_SAWEQ_COEFF6_CHAIN1_ADDR A:0x1:0xc0108
y.create.l HWIO_DTR_TXRFI_DPRDB_SAWEQ_COEFF7_CHAIN1_ADDR A:0x1:0xc010c
y.create.l HWIO_DTR_TXET_DPRDB_CFG_CHAIN1_ADDR A:0x1:0xc0110
y.create.l HWIO_DTR_TXET_DPRDB_GAIN_CHAIN1_ADDR A:0x1:0xc0114
y.create.l HWIO_DTR_TXET_DPRDB_PEQ1_CHAIN1_ADDR A:0x1:0xc0118
y.create.l HWIO_DTR_TXET_DPRDB_PEQ1_SORU_CHAIN1_ADDR A:0x1:0xc011c
y.create.l HWIO_DTR_TXET_DPRDB_PEQ2_CHAIN1_ADDR A:0x1:0xc0120
y.create.l HWIO_DTR_TXET_DPRDB_DCOC_CHAIN1_ADDR A:0x1:0xc0124
y.create.l HWIO_DTR_TXET_DPRDB_DM2_FINE_TAU_CHAIN1_ADDR A:0x1:0xc0128
y.create.l HWIO_DTR_TXET_DPRDB_DM3_FRAC_TAU_CHAIN1_ADDR A:0x1:0xc012c
y.create.l HWIO_DTR_BRDG_RXFE_WRTR0_CFG0_ADDR A:0x1:0xd0000
y.create.l HWIO_DTR_BRDG_RXFE_WRTR1_CFG0_ADDR A:0x1:0xd0008
y.create.l HWIO_DTR_BRDG_RXFE_WRTR2_CFG0_ADDR A:0x1:0xd0010
y.create.l HWIO_DTR_BRDG_RXFE_WRTR3_CFG0_ADDR A:0x1:0xd0018
y.create.l HWIO_DTR_BRDG_RXFE_WRTR4_CFG0_ADDR A:0x1:0xd0020
y.create.l HWIO_DTR_BRDG_RXFE_WRTR5_CFG0_ADDR A:0x1:0xd0028
y.create.l HWIO_DTR_BRDG_RXFE_WRTR6_CFG0_ADDR A:0x1:0xd0030
y.create.l HWIO_DTR_BRDG_RXFE_WRTR7_CFG0_ADDR A:0x1:0xd0038
y.create.l HWIO_DTR_BRDG_RXFE_WRTR0_CFG1_ADDR A:0x1:0xd0004
y.create.l HWIO_DTR_BRDG_RXFE_WRTR1_CFG1_ADDR A:0x1:0xd000c
y.create.l HWIO_DTR_BRDG_RXFE_WRTR2_CFG1_ADDR A:0x1:0xd0014
y.create.l HWIO_DTR_BRDG_RXFE_WRTR3_CFG1_ADDR A:0x1:0xd001c
y.create.l HWIO_DTR_BRDG_RXFE_WRTR4_CFG1_ADDR A:0x1:0xd0024
y.create.l HWIO_DTR_BRDG_RXFE_WRTR5_CFG1_ADDR A:0x1:0xd002c
y.create.l HWIO_DTR_BRDG_RXFE_WRTR6_CFG1_ADDR A:0x1:0xd0034
y.create.l HWIO_DTR_BRDG_RXFE_WRTR7_CFG1_ADDR A:0x1:0xd003c
y.create.l HWIO_DTR_BRDG_RXFE_WRTR_XFER_CTL_ADDR A:0x1:0xd0040
y.create.l HWIO_DTR_BRDG_RXFE_WRTR_CTL_ADDR A:0x1:0xd0044
y.create.l HWIO_DTR_BRDG_RXFE_WRTR_STATUS_ADDR A:0x1:0xd0048
y.create.l HWIO_DTR_BRDG_RXFE_WRTR_CLEAR_ADDR A:0x1:0xd004c
y.create.l HWIO_DTR_BRDG_FBRX_WRTR_CFG0_ADDR A:0x1:0xd0100
y.create.l HWIO_DTR_BRDG_FBRX_WRTR_CFG1_ADDR A:0x1:0xd0104
y.create.l HWIO_DTR_BRDG_FBRX_WRTR_XFER_CTL_ADDR A:0x1:0xd0108
y.create.l HWIO_DTR_BRDG_FBRX_WRTR_CTL_ADDR A:0x1:0xd010c
y.create.l HWIO_DTR_BRDG_FBRX_WRTR_STATUS_ADDR A:0x1:0xd0110
y.create.l HWIO_DTR_BRDG_FBRX_WRTR_CLEAR_ADDR A:0x1:0xd0114
y.create.l HWIO_DTR_BRDG_TXFE_RDR0_CFG0_ADDR A:0x1:0xd0200
y.create.l HWIO_DTR_BRDG_TXFE_RDR1_CFG0_ADDR A:0x1:0xd0210
y.create.l HWIO_DTR_BRDG_TXFE_RDR0_CFG1_ADDR A:0x1:0xd0204
y.create.l HWIO_DTR_BRDG_TXFE_RDR1_CFG1_ADDR A:0x1:0xd0214
y.create.l HWIO_DTR_BRDG_TXFE_RDR0_XFER_LEN_ADDR A:0x1:0xd0208
y.create.l HWIO_DTR_BRDG_TXFE_RDR1_XFER_LEN_ADDR A:0x1:0xd0218
y.create.l HWIO_DTR_BRDG_TXFE_RDR0_VADDR_ADDR A:0x1:0xd020c
y.create.l HWIO_DTR_BRDG_TXFE_RDR1_VADDR_ADDR A:0x1:0xd021c
y.create.l HWIO_DTR_BRDG_TXFE_RDR_XFER_CTL_ADDR A:0x1:0xd0220
y.create.l HWIO_DTR_BRDG_TXFE_RDR_CTL_ADDR A:0x1:0xd0224
y.create.l HWIO_DTR_BRDG_TXFE_RDR_STATUS_ADDR A:0x1:0xd0228
y.create.l HWIO_DTR_BRDG_TXFE_RDR_CLEAR_ADDR A:0x1:0xd022c
y.create.l HWIO_DTR_BRDG_REFLOG_WRTR_CFG0_ADDR A:0x1:0xd0300
y.create.l HWIO_DTR_BRDG_REFLOG_WRTR_CFG1_ADDR A:0x1:0xd0304
y.create.l HWIO_DTR_BRDG_REFLOG_WRTR_XFER_LEN_ADDR A:0x1:0xd0308
y.create.l HWIO_DTR_BRDG_REFLOG_WRTR_VADDR_ADDR A:0x1:0xd030c
y.create.l HWIO_DTR_BRDG_REFLOG_WRTR_XFER_CTL_ADDR A:0x1:0xd0310
y.create.l HWIO_DTR_BRDG_REFLOG_WRTR_CTL_ADDR A:0x1:0xd0314
y.create.l HWIO_DTR_BRDG_REFLOG_WRTR_STATUS_ADDR A:0x1:0xd0318
y.create.l HWIO_DTR_BRDG_REFLOG_WRTR_CLEAR_ADDR A:0x1:0xd031c
y.create.l HWIO_DTR_BRDG_TXCONFIG_CH0_CFG0_ADDR A:0x1:0xd0400
y.create.l HWIO_DTR_BRDG_TXCONFIG_CH1_CFG0_ADDR A:0x1:0xd0408
y.create.l HWIO_DTR_BRDG_TXCONFIG_CH2_CFG0_ADDR A:0x1:0xd0410
y.create.l HWIO_DTR_BRDG_TXCONFIG_CH3_CFG0_ADDR A:0x1:0xd0418
y.create.l HWIO_DTR_BRDG_TXCONFIG_CH4_CFG0_ADDR A:0x1:0xd0420
y.create.l HWIO_DTR_BRDG_TXCONFIG_CH5_CFG0_ADDR A:0x1:0xd0428
y.create.l HWIO_DTR_BRDG_TXCONFIG_CH6_CFG0_ADDR A:0x1:0xd0430
y.create.l HWIO_DTR_BRDG_TXCONFIG_CH7_CFG0_ADDR A:0x1:0xd0438
y.create.l HWIO_DTR_BRDG_TXCONFIG_CH0_CFG1_ADDR A:0x1:0xd0404
y.create.l HWIO_DTR_BRDG_TXCONFIG_CH1_CFG1_ADDR A:0x1:0xd040c
y.create.l HWIO_DTR_BRDG_TXCONFIG_CH2_CFG1_ADDR A:0x1:0xd0414
y.create.l HWIO_DTR_BRDG_TXCONFIG_CH3_CFG1_ADDR A:0x1:0xd041c
y.create.l HWIO_DTR_BRDG_TXCONFIG_CH4_CFG1_ADDR A:0x1:0xd0424
y.create.l HWIO_DTR_BRDG_TXCONFIG_CH5_CFG1_ADDR A:0x1:0xd042c
y.create.l HWIO_DTR_BRDG_TXCONFIG_CH6_CFG1_ADDR A:0x1:0xd0434
y.create.l HWIO_DTR_BRDG_TXCONFIG_CH7_CFG1_ADDR A:0x1:0xd043c
y.create.l HWIO_DTR_BRDG_TXCONFIG_VBUF0_CFG0_ADDR A:0x1:0xd0440
y.create.l HWIO_DTR_BRDG_TXCONFIG_VBUF1_CFG0_ADDR A:0x1:0xd0448
y.create.l HWIO_DTR_BRDG_TXCONFIG_VBUF2_CFG0_ADDR A:0x1:0xd0450
y.create.l HWIO_DTR_BRDG_TXCONFIG_VBUF3_CFG0_ADDR A:0x1:0xd0458
y.create.l HWIO_DTR_BRDG_TXCONFIG_VBUF4_CFG0_ADDR A:0x1:0xd0460
y.create.l HWIO_DTR_BRDG_TXCONFIG_VBUF5_CFG0_ADDR A:0x1:0xd0468
y.create.l HWIO_DTR_BRDG_TXCONFIG_VBUF6_CFG0_ADDR A:0x1:0xd0470
y.create.l HWIO_DTR_BRDG_TXCONFIG_VBUF7_CFG0_ADDR A:0x1:0xd0478
y.create.l HWIO_DTR_BRDG_TXCONFIG_VBUF0_CFG1_ADDR A:0x1:0xd0444
y.create.l HWIO_DTR_BRDG_TXCONFIG_VBUF1_CFG1_ADDR A:0x1:0xd044c
y.create.l HWIO_DTR_BRDG_TXCONFIG_VBUF2_CFG1_ADDR A:0x1:0xd0454
y.create.l HWIO_DTR_BRDG_TXCONFIG_VBUF3_CFG1_ADDR A:0x1:0xd045c
y.create.l HWIO_DTR_BRDG_TXCONFIG_VBUF4_CFG1_ADDR A:0x1:0xd0464
y.create.l HWIO_DTR_BRDG_TXCONFIG_VBUF5_CFG1_ADDR A:0x1:0xd046c
y.create.l HWIO_DTR_BRDG_TXCONFIG_VBUF6_CFG1_ADDR A:0x1:0xd0474
y.create.l HWIO_DTR_BRDG_TXCONFIG_VBUF7_CFG1_ADDR A:0x1:0xd047c
y.create.l HWIO_DTR_BRDG_TXCONFIG_CH_ENABLE_ADDR A:0x1:0xd0480
y.create.l HWIO_DTR_BRDG_TXCONFIG_CH_DISABLE_ADDR A:0x1:0xd0484
y.create.l HWIO_DTR_BRDG_TXCONFIG_CH_STATUS_ADDR A:0x1:0xd0488
y.create.l HWIO_DTR_BRDG_TXCONFIG_RDR_CLEAR_ADDR A:0x1:0xd048c
y.create.l HWIO_DAC_CALIB_CFG_0_ADDR A:0x1:0xd8000
y.create.l HWIO_DAC_IREF_UPDATE_0_ADDR A:0x1:0xd8008
y.create.l HWIO_DAC_RT_FUSE_CODE_0_ADDR A:0x1:0xd8010
y.create.l HWIO_TXDAC_CONFIG0_0_ADDR A:0x1:0xd8018
y.create.l HWIO_TXDAC_CONFIG1_0_ADDR A:0x1:0xd8020
y.create.l HWIO_TXDAC_CONFIG2_0_ADDR A:0x1:0xd8028
y.create.l HWIO_TXDAC_CONFIG3_0_ADDR A:0x1:0xd8030
y.create.l HWIO_ETDAC_CONFIG0_0_ADDR A:0x1:0xd8038
y.create.l HWIO_ETDAC_CONFIG1_0_ADDR A:0x1:0xd8040
y.create.l HWIO_ETDAC_CONFIG2_0_ADDR A:0x1:0xd8048
y.create.l HWIO_ETDAC_CONFIG3_0_ADDR A:0x1:0xd8050
y.create.l HWIO_DAC_CALIB_STATUS_0_ADDR A:0x1:0xd8060
y.create.l HWIO_DAC_ATEST_MUX_SEL_0_ADDR A:0x1:0xd8068
y.create.l HWIO_TXDAC_DEBUG_MODE_0_ADDR A:0x1:0xd8070
y.create.l HWIO_ETDAC_DEBUG_MODE_0_ADDR A:0x1:0xd8078
y.create.l HWIO_TXDAC_STATUS0_0_ADDR A:0x1:0xd8080
y.create.l HWIO_TXDAC_STATUS1_0_ADDR A:0x1:0xd8088
y.create.l HWIO_ETDAC_STATUS0_0_ADDR A:0x1:0xd8090
y.create.l HWIO_ETDAC_STATUS1_0_ADDR A:0x1:0xd8098
y.create.l HWIO_DAC_CALIB_CMDS_0_ADDR A:0x1:0xd80a0
y.create.l HWIO_DAC_MANUAL_MEM_DEBUG_0_ADDR A:0x1:0xd80a8
y.create.l HWIO_DAC_SIGGEN_CFG_0_ADDR A:0x1:0xd80b0
y.create.l HWIO_DAC_GPIO_CFG_0_ADDR A:0x1:0xd80b8
y.create.l HWIO_DAC_MANUAL_MEM_RD_0_ADDR A:0x1:0xd80c0
y.create.l HWIO_DAC_REGARRAY_START_0_ADDR A:0x1:0xd9000
y.create.l HWIO_DAC_REGARRAY_END_0_ADDR A:0x1:0xd9120
y.create.l HWIO_DAC_CALIB_CFG_1_ADDR A:0x1:0xda000
y.create.l HWIO_DAC_IREF_UPDATE_1_ADDR A:0x1:0xda008
y.create.l HWIO_DAC_RT_FUSE_CODE_1_ADDR A:0x1:0xda010
y.create.l HWIO_TXDAC_CONFIG0_1_ADDR A:0x1:0xda018
y.create.l HWIO_TXDAC_CONFIG1_1_ADDR A:0x1:0xda020
y.create.l HWIO_TXDAC_CONFIG2_1_ADDR A:0x1:0xda028
y.create.l HWIO_TXDAC_CONFIG3_1_ADDR A:0x1:0xda030
y.create.l HWIO_ETDAC_CONFIG0_1_ADDR A:0x1:0xda038
y.create.l HWIO_ETDAC_CONFIG1_1_ADDR A:0x1:0xda040
y.create.l HWIO_ETDAC_CONFIG2_1_ADDR A:0x1:0xda048
y.create.l HWIO_ETDAC_CONFIG3_1_ADDR A:0x1:0xda050
y.create.l HWIO_DAC_CALIB_STATUS_1_ADDR A:0x1:0xda060
y.create.l HWIO_DAC_ATEST_MUX_SEL_1_ADDR A:0x1:0xda068
y.create.l HWIO_TXDAC_DEBUG_MODE_1_ADDR A:0x1:0xda070
y.create.l HWIO_ETDAC_DEBUG_MODE_1_ADDR A:0x1:0xda078
y.create.l HWIO_TXDAC_STATUS0_1_ADDR A:0x1:0xda080
y.create.l HWIO_TXDAC_STATUS1_1_ADDR A:0x1:0xda088
y.create.l HWIO_ETDAC_STATUS0_1_ADDR A:0x1:0xda090
y.create.l HWIO_ETDAC_STATUS1_1_ADDR A:0x1:0xda098
y.create.l HWIO_DAC_CALIB_CMDS_1_ADDR A:0x1:0xda0a0
y.create.l HWIO_DAC_MANUAL_MEM_DEBUG_1_ADDR A:0x1:0xda0a8
y.create.l HWIO_DAC_SIGGEN_CFG_1_ADDR A:0x1:0xda0b0
y.create.l HWIO_DAC_GPIO_CFG_1_ADDR A:0x1:0xda0b8
y.create.l HWIO_DAC_MANUAL_MEM_RD_1_ADDR A:0x1:0xda0c0
y.create.l HWIO_DAC_REGARRAY_START_1_ADDR A:0x1:0xdb000
y.create.l HWIO_DAC_REGARRAY_END_1_ADDR A:0x1:0xdb120
y.create.l HWIO_VPE_ENABLE_0_ADDR A:0x1:0x100000
y.create.l HWIO_IU_CLK_CTL_0_ADDR A:0x1:0x100004
y.create.l HWIO_VU_CLK_EN_0_ADDR A:0x1:0x100008
y.create.l HWIO_VU_PWR_SEQ_EN_0_ADDR A:0x1:0x10000c
y.create.l HWIO_VPE_MODE_CTL_0_ADDR A:0x1:0x100010
y.create.l HWIO_VPE_SLP_CTL_0_ADDR A:0x1:0x100014
y.create.l HWIO_VPE_PWR_SEQ_THRES_0_ADDR A:0x1:0x100018
y.create.l HWIO_VPE_PWR_GATING_STATUS_0_ADDR A:0x1:0x10001c
y.create.l HWIO_IU_IRQ_PEND_LO_WDATA_0_ADDR A:0x1:0x100020
y.create.l HWIO_IU_IRQ_PEND_HI_WDATA_0_ADDR A:0x1:0x100024
y.create.l HWIO_IU_IRQ_PEND_LO_RDATA_0_ADDR A:0x1:0x100028
y.create.l HWIO_IU_IRQ_PEND_HI_RDATA_0_ADDR A:0x1:0x10002c
y.create.l HWIO_IU_MVP_SCHEDULE_0_ADDR A:0x1:0x100030
y.create.l HWIO_VPE_DBG_EN_0_ADDR A:0x1:0x100040
y.create.l HWIO_VPE_DBG_HWTRACE_CTL_0_ADDR A:0x1:0x100044
y.create.l HWIO_IU_DBG_PCTRACE_CTL_0_ADDR A:0x1:0x100048
y.create.l HWIO_IU_DBG_PCBUF_STAT_VP0_0_ADDR A:0x1:0x100050
y.create.l HWIO_IU_DBG_PCBUF_STAT_VP1_0_ADDR A:0x1:0x100054
y.create.l HWIO_IU_DBG_PCBUF_STAT_VP2_0_ADDR A:0x1:0x100058
y.create.l HWIO_IU_DBG_PCBUF_STAT_VP3_0_ADDR A:0x1:0x10005c
y.create.l HWIO_IU_DBG_PCBUF_DATA_VP0_0_ADDR A:0x1:0x100060
y.create.l HWIO_IU_DBG_PCBUF_DATA_VP1_0_ADDR A:0x1:0x100064
y.create.l HWIO_IU_DBG_PCBUF_DATA_VP2_0_ADDR A:0x1:0x100068
y.create.l HWIO_IU_DBG_PCBUF_DATA_VP3_0_ADDR A:0x1:0x10006c
y.create.l HWIO_IU_MPBR_START_CH0_0_ADDR A:0x1:0x100080
y.create.l HWIO_IU_MPBR_STATUS_CH0_0_ADDR A:0x1:0x100084
y.create.l HWIO_IU_MPBR_START_CH1_0_ADDR A:0x1:0x100088
y.create.l HWIO_IU_MPBR_STATUS_CH1_0_ADDR A:0x1:0x10008c
y.create.l HWIO_IU_MPBR_START_CH2_0_ADDR A:0x1:0x100090
y.create.l HWIO_IU_MPBR_STATUS_CH2_0_ADDR A:0x1:0x100094
y.create.l HWIO_IU_MPBR_START_CH3_0_ADDR A:0x1:0x100098
y.create.l HWIO_IU_MPBR_STATUS_CH3_0_ADDR A:0x1:0x10009c
y.create.l HWIO_VPE_PWRON_CTL_0_ADDR A:0x1:0x1000a0
y.create.l HWIO_VPE_PWRON_STATUS_0_ADDR A:0x1:0x1000a4
y.create.l HWIO_CLK_PROC_ODIV_0_ADDR A:0x1:0x1000b0
y.create.l HWIO_CLK_TDEC_ODIV_0_ADDR A:0x1:0x1000b4
y.create.l HWIO_VPE_MVC_ENABLE_0_ADDR A:0x1:0x1000c0
y.create.l HWIO_VPE_PWRMODE_CTL_0_ADDR A:0x1:0x1000c4
y.create.l HWIO_VPE_PWRMODE_STAT_0_ADDR A:0x1:0x1000c8
y.create.l HWIO_VPE_PWRMODE_PROC_CFG_0_ADDR A:0x1:0x1000d0
y.create.l HWIO_VPE_PWRMODE_TDEC_CFG_0_ADDR A:0x1:0x1000d4
y.create.l HWIO_VPE_DMEM_START_IU0_ADDR A:0x1:0x101000
y.create.l HWIO_VPE_DMEM_END_IU0_ADDR A:0x1:0x108ffc
y.create.l HWIO_VPE_PMEM_START_IU0_ADDR A:0x1:0x109000
y.create.l HWIO_VPE_PMEM_END_IU0_ADDR A:0x1:0x12cffc
y.create.l HWIO_MODEM_LMEM_ENABLE_ADDR A:0x1:0x180000
y.create.l HWIO_MODEM_LMEM_SLAVE_ERR_ADDR A:0x1:0x18007c
y.create.l HWIO_MODEM_LMEM_CLR_SLAVE_ERR_ADDR A:0x1:0x180080
y.create.l HWIO_MODEM_LMEM_SLT_0_ADDR A:0x1:0x180100
y.create.l HWIO_MODEM_LMEM_SLT_1_ADDR A:0x1:0x180104
y.create.l HWIO_MODEM_LMEM_SLT_2_ADDR A:0x1:0x180108
y.create.l HWIO_MODEM_LMEM_SLT_3_ADDR A:0x1:0x18010c
y.create.l HWIO_MODEM_LMEM_SLT_4_ADDR A:0x1:0x180110
y.create.l HWIO_MODEM_LMEM_SLT_5_ADDR A:0x1:0x180114
y.create.l HWIO_MODEM_LMEM_SLT_6_ADDR A:0x1:0x180118
y.create.l HWIO_MODEM_LMEM_SLT_7_ADDR A:0x1:0x18011c
y.create.l HWIO_MODEM_LMEM_SLT_8_ADDR A:0x1:0x180120
y.create.l HWIO_MODEM_LMEM_SLT_9_ADDR A:0x1:0x180124
y.create.l HWIO_MODEM_LMEM_TDM_UPDATE_ADDR A:0x1:0x180300
y.create.l HWIO_VPE1_VPE_ENABLE_ADDR A:0x1:0x200000
y.create.l HWIO_VPE1_VPE_CLK_CTL_ADDR A:0x1:0x200004
y.create.l HWIO_VPE1_VPE_VU_CLK_EN_ADDR A:0x1:0x200008
y.create.l HWIO_VPE1_VPE_PWR_SEQ_EN_ADDR A:0x1:0x20000c
y.create.l HWIO_VPE1_VPE_MODE_CTL_ADDR A:0x1:0x200010
y.create.l HWIO_VPE1_VPE_PWR_SEQ_THRES_ADDR A:0x1:0x200014
y.create.l HWIO_VPE1_VPE_PWR_GATING_STATUS_ADDR A:0x1:0x200018
y.create.l HWIO_VPE1_VPE_AHB_MPBR_CTL_ADDR A:0x1:0x20001c
y.create.l HWIO_VPE1_VPE_AHB_MPBR_WDATA_ADDR A:0x1:0x200020
y.create.l HWIO_VPE1_VPE_AHB_MPBR_RDATA_ADDR A:0x1:0x200024
y.create.l HWIO_VPE1_VPE_AHB_MPBR_CH_EN_ADDR A:0x1:0x200028
y.create.l HWIO_VPE1_VPE_IU_IRQ_PEND_WDATA_ADDR A:0x1:0x20002c
y.create.l HWIO_VPE1_VPE_IU_IRQ_PEND_RDATA_ADDR A:0x1:0x200030
y.create.l HWIO_VPE1_VPE_MVP_SCHEDULE_ADDR A:0x1:0x200034
y.create.l HWIO_VPE1_VPE_DBG_EN_ADDR A:0x1:0x200040
y.create.l HWIO_VPE1_VPE_DBG_HWTRACE_CTL_ADDR A:0x1:0x200044
y.create.l HWIO_VPE1_VPE_DBG_PCTRACE_CTL_ADDR A:0x1:0x200048
y.create.l HWIO_VPE1_VPE_DBG_PCBUF_STAT_VP0_ADDR A:0x1:0x20004c
y.create.l HWIO_VPE1_VPE_DBG_PCBUF_STAT_VP1_ADDR A:0x1:0x200050
y.create.l HWIO_VPE1_VPE_DBG_PCBUF_STAT_VP2_ADDR A:0x1:0x200054
y.create.l HWIO_VPE1_VPE_DBG_PCBUF_STAT_VP3_ADDR A:0x1:0x200058
y.create.l HWIO_VPE1_VPE_DBG_PCBUF_DATA_VP0_ADDR A:0x1:0x200060
y.create.l HWIO_VPE1_VPE_DBG_PCBUF_DATA_VP1_ADDR A:0x1:0x200064
y.create.l HWIO_VPE1_VPE_DBG_PCBUF_DATA_VP2_ADDR A:0x1:0x200068
y.create.l HWIO_VPE1_VPE_DBG_PCBUF_DATA_VP3_ADDR A:0x1:0x20006c
y.create.l HWIO_VPE1_VPE_DMEM_START_ADDR A:0x1:0x201000
y.create.l HWIO_VPE1_VPE_DMEM_END_ADDR A:0x1:0x208ffc
y.create.l HWIO_VPE1_VPE_PMEM_START_ADDR A:0x1:0x209000
y.create.l HWIO_VPE1_VPE_PMEM_END_ADDR A:0x1:0x22cffc
y.create.l HWIO_VPE2_VPE_ENABLE_ADDR A:0x1:0x300000
y.create.l HWIO_VPE2_VPE_CLK_CTL_ADDR A:0x1:0x300004
y.create.l HWIO_VPE2_VPE_VU_CLK_EN_ADDR A:0x1:0x300008
y.create.l HWIO_VPE2_VPE_PWR_SEQ_EN_ADDR A:0x1:0x30000c
y.create.l HWIO_VPE2_VPE_MODE_CTL_ADDR A:0x1:0x300010
y.create.l HWIO_VPE2_VPE_PWR_SEQ_THRES_ADDR A:0x1:0x300014
y.create.l HWIO_VPE2_VPE_PWR_GATING_STATUS_ADDR A:0x1:0x300018
y.create.l HWIO_VPE2_VPE_AHB_MPBR_CTL_ADDR A:0x1:0x30001c
y.create.l HWIO_VPE2_VPE_AHB_MPBR_WDATA_ADDR A:0x1:0x300020
y.create.l HWIO_VPE2_VPE_AHB_MPBR_RDATA_ADDR A:0x1:0x300024
y.create.l HWIO_VPE2_VPE_AHB_MPBR_CH_EN_ADDR A:0x1:0x300028
y.create.l HWIO_VPE2_VPE_IU_IRQ_PEND_WDATA_ADDR A:0x1:0x30002c
y.create.l HWIO_VPE2_VPE_IU_IRQ_PEND_RDATA_ADDR A:0x1:0x300030
y.create.l HWIO_VPE2_VPE_MVP_SCHEDULE_ADDR A:0x1:0x300034
y.create.l HWIO_VPE2_VPE_DBG_EN_ADDR A:0x1:0x300040
y.create.l HWIO_VPE2_VPE_DBG_HWTRACE_CTL_ADDR A:0x1:0x300044
y.create.l HWIO_VPE2_VPE_DBG_PCTRACE_CTL_ADDR A:0x1:0x300048
y.create.l HWIO_VPE2_VPE_DBG_PCBUF_STAT_VP0_ADDR A:0x1:0x30004c
y.create.l HWIO_VPE2_VPE_DBG_PCBUF_STAT_VP1_ADDR A:0x1:0x300050
y.create.l HWIO_VPE2_VPE_DBG_PCBUF_STAT_VP2_ADDR A:0x1:0x300054
y.create.l HWIO_VPE2_VPE_DBG_PCBUF_STAT_VP3_ADDR A:0x1:0x300058
y.create.l HWIO_VPE2_VPE_DBG_PCBUF_DATA_VP0_ADDR A:0x1:0x300060
y.create.l HWIO_VPE2_VPE_DBG_PCBUF_DATA_VP1_ADDR A:0x1:0x300064
y.create.l HWIO_VPE2_VPE_DBG_PCBUF_DATA_VP2_ADDR A:0x1:0x300068
y.create.l HWIO_VPE2_VPE_DBG_PCBUF_DATA_VP3_ADDR A:0x1:0x30006c
y.create.l HWIO_VPE2_VPE_DMEM_START_ADDR A:0x1:0x301000
y.create.l HWIO_VPE2_VPE_DMEM_END_ADDR A:0x1:0x308ffc
y.create.l HWIO_VPE2_VPE_PMEM_START_ADDR A:0x1:0x309000
y.create.l HWIO_VPE2_VPE_PMEM_END_ADDR A:0x1:0x32cffc
y.create.l HWIO_ENC_LMEM_PAGE0_START_ADDR A:0x1:0x540000
y.create.l HWIO_ENC_LMEM_PAGE0_END_ADDR A:0x1:0x548ffc
y.create.l HWIO_IU_CLK_CTL_ADDR A:0x1:0x510000
y.create.l HWIO_IU_PWR_GATING_STATUS_ADDR A:0x1:0x510004
y.create.l HWIO_IU_IRQ_PEND_WDATA_ADDR A:0x1:0x510008
y.create.l HWIO_IU_IRQ_PEND_RDATA_ADDR A:0x1:0x51000c
y.create.l HWIO_IU_DBG_EN_ADDR A:0x1:0x510010
y.create.l HWIO_IU_DBG_PCTRACE_CTL_ADDR A:0x1:0x510014
y.create.l HWIO_IU_DBG_PCBUF_STAT_ADDR A:0x1:0x510018
y.create.l HWIO_IU_DBG_PCBUF_DATA_ADDR A:0x1:0x51001c
y.create.l HWIO_ENC_SS_EN_ADDR A:0x1:0x510400
y.create.l HWIO_CIPHER_CK_WORD0_ADDR A:0x1:0x61fe00
y.create.l HWIO_CIPHER_CK_WORD1_ADDR A:0x1:0x61fe04
y.create.l HWIO_CIPHER_CK_WORD2_ADDR A:0x1:0x61fe08
y.create.l HWIO_CIPHER_CK_WORD3_ADDR A:0x1:0x61fe0c
y.create.l HWIO_CIPHER_INIT_WORD0_ADDR A:0x1:0x61fe10
y.create.l HWIO_CIPHER_INIT_WORD1_ADDR A:0x1:0x61fe14
y.create.l HWIO_CIPHER_SETUP_WORD0_ADDR A:0x1:0x61fe18
y.create.l HWIO_CIPHER_SETUP_WORD1_ADDR A:0x1:0x61fe1c
y.create.l HWIO_CIPHER_DMA_CFG0_ADDR A:0x1:0x61fe20
y.create.l HWIO_CIPHER_DMA_CFG1_ADDR A:0x1:0x61fe24
y.create.l HWIO_CIPHER_DMA_CFG2_ADDR A:0x1:0x61fe28
y.create.l HWIO_CIPHER_RMW_WORD_ADDR A:0x1:0x61fe2c
y.create.l HWIO_CIPHER_CMD_CTRL_ADDR A:0x1:0x61fe30
y.create.l HWIO_CIPHER_TRIGGER_ADDR A:0x1:0x61fe34
y.create.l HWIO_CIPHER_DEBUG_EN_ADDR A:0x1:0x61fe38
y.create.l HWIO_CIPHER_KS_VECTOR_WORD0_ADDR A:0x1:0x61fe3c
y.create.l HWIO_CIPHER_KS_VECTOR_WORD1_ADDR A:0x1:0x61fe40
y.create.l HWIO_CIPHER_KS_VECTOR_WORD2_ADDR A:0x1:0x61fe44
y.create.l HWIO_CIPHER_KS_VECTOR_WORD3_ADDR A:0x1:0x61fe48
y.create.l HWIO_ENCRYPT_ACC_RESET_ADDR A:0x1:0x61ff00
y.create.l HWIO_ENCRYPT_ACC_CGC_CTL_ADDR A:0x1:0x61ff04
y.create.l HWIO_ENCRYPT_ACC_CGC_STATUS_ADDR A:0x1:0x61ff08
y.create.l HWIO_GEA_CONFIG_0_ADDR A:0x1:0x61ff0c
y.create.l HWIO_GEA_INPUT_ADDR A:0x1:0x61ff10
y.create.l HWIO_GEA_KC_0_ADDR A:0x1:0x61ff14
y.create.l HWIO_GEA_KC_1_ADDR A:0x1:0x61ff18
y.create.l HWIO_AMBA_KEY_STRM_WORD0_RD_ADDR A:0x1:0x61ff1c
y.create.l HWIO_AMBA_KEY_STRM_WORD1_RD_ADDR A:0x1:0x61ff20
y.create.l HWIO_AMBA_KEY_STRM_WORD2_RD_ADDR A:0x1:0x61ff24
y.create.l HWIO_AMBA_KEY_STRM_WORD3_RD_ADDR A:0x1:0x61ff28
y.create.l HWIO_AMBA_KEY_STRM_WORD4_RD_ADDR A:0x1:0x61ff2c
y.create.l HWIO_AMBA_KEY_STRM_WORD5_RD_ADDR A:0x1:0x61ff30
y.create.l HWIO_AMBA_KEY_STRM_WORD6_RD_ADDR A:0x1:0x61ff34
y.create.l HWIO_AMBA_KEY_STRM_WORD7_RD_ADDR A:0x1:0x61ff38
y.create.l HWIO_AMBA_KEY_STRM_STATUS_ADDR A:0x1:0x61ff3c
y.create.l HWIO_AFIVE_CONFIG_0_ADDR A:0x1:0x61ff40
y.create.l HWIO_AFIVE_INPUT_ADDR A:0x1:0x61ff44
y.create.l HWIO_AFIVE_KC_0_ADDR A:0x1:0x61ff48
y.create.l HWIO_AFIVE_KC_1_ADDR A:0x1:0x61ff4c
y.create.l HWIO_AFIVE_KEY_STRM_WORD0_RD_ADDR A:0x1:0x61ff50
y.create.l HWIO_AFIVE_KEY_STRM_WORD1_RD_ADDR A:0x1:0x61ff54
y.create.l HWIO_AFIVE_KEY_STRM_WORD2_RD_ADDR A:0x1:0x61ff58
y.create.l HWIO_AFIVE_KEY_STRM_WORD3_RD_ADDR A:0x1:0x61ff5c
y.create.l HWIO_AFIVE_KEY_STRM_WORD4_RD_ADDR A:0x1:0x61ff60
y.create.l HWIO_AFIVE_KEY_STRM_WORD5_RD_ADDR A:0x1:0x61ff64
y.create.l HWIO_AFIVE_KEY_STRM_WORD6_RD_ADDR A:0x1:0x61ff68
y.create.l HWIO_AFIVE_KEY_STRM_WORD7_RD_ADDR A:0x1:0x61ff6c
y.create.l HWIO_AFIVE_KEY_STRM_WORD8_RD_ADDR A:0x1:0x61ff70
y.create.l HWIO_AFIVE_KEY_STRM_WORD9_RD_ADDR A:0x1:0x61ff74
y.create.l HWIO_CCS_MSTS_ADDR A:0x1:0x61fc00
y.create.l HWIO_CCS_MCTL_ADDR A:0x1:0x61fc04
y.create.l HWIO_CCS_IPC_ADDR A:0x1:0x61fc08
y.create.l HWIO_CCS_PIC0MSK_ADDR A:0x1:0x61fc0c
y.create.l HWIO_CCS_PIC0STS_ADDR A:0x1:0x61fc10
y.create.l HWIO_CCS_PIC1MSK_ADDR A:0x1:0x61fc14
y.create.l HWIO_CCS_PIC1STS_ADDR A:0x1:0x61fc18
y.create.l HWIO_CCS_PIC2MSK_ADDR A:0x1:0x61fc1c
y.create.l HWIO_CCS_PIC2STS_ADDR A:0x1:0x61fc20
y.create.l HWIO_CCS_PIC3MSK_ADDR A:0x1:0x61fc24
y.create.l HWIO_CCS_PIC3STS_ADDR A:0x1:0x61fc28
y.create.l HWIO_CCS_PIC4MSK_ADDR A:0x1:0x61fc2c
y.create.l HWIO_CCS_PIC4STS_ADDR A:0x1:0x61fc30
y.create.l HWIO_CCS_PIT_ADDR A:0x1:0x61fc34
y.create.l HWIO_CCS_UTIME_ADDR A:0x1:0x61fc38
y.create.l HWIO_CCS_MON0_ADDR A:0x1:0x61fc3c
y.create.l HWIO_CCS_MON1_ADDR A:0x1:0x61fc40
y.create.l HWIO_CCS_MON2_ADDR A:0x1:0x61fc44
y.create.l HWIO_CCS_MON3_ADDR A:0x1:0x61fc48
y.create.l HWIO_CCS_DMAC_ADDR A:0x1:0x61fc4c
y.create.l HWIO_CCS_DMAC0SRC_ADDR A:0x1:0x61fc50
y.create.l HWIO_CCS_DMAC1SRC_ADDR A:0x1:0x61fc60
y.create.l HWIO_CCS_DMAC2SRC_ADDR A:0x1:0x61fc70
y.create.l HWIO_CCS_DMAC3SRC_ADDR A:0x1:0x61fc80
y.create.l HWIO_CCS_DMAC0DST_ADDR A:0x1:0x61fc54
y.create.l HWIO_CCS_DMAC1DST_ADDR A:0x1:0x61fc64
y.create.l HWIO_CCS_DMAC2DST_ADDR A:0x1:0x61fc74
y.create.l HWIO_CCS_DMAC3DST_ADDR A:0x1:0x61fc84
y.create.l HWIO_CCS_DMAC0LNK_ADDR A:0x1:0x61fc58
y.create.l HWIO_CCS_DMAC1LNK_ADDR A:0x1:0x61fc68
y.create.l HWIO_CCS_DMAC2LNK_ADDR A:0x1:0x61fc78
y.create.l HWIO_CCS_DMAC3LNK_ADDR A:0x1:0x61fc88
y.create.l HWIO_CCS_DMAC0CTL_ADDR A:0x1:0x61fc5c
y.create.l HWIO_CCS_DMAC1CTL_ADDR A:0x1:0x61fc6c
y.create.l HWIO_CCS_DMAC2CTL_ADDR A:0x1:0x61fc7c
y.create.l HWIO_CCS_DMAC3CTL_ADDR A:0x1:0x61fc8c
y.create.l HWIO_CCS_DEMBACK_PWRUP_ADDR A:0x1:0x61fc90
y.create.l HWIO_CCS_DEMBACK_PWRON_ADDR A:0x1:0x61fc94
y.create.l HWIO_CCS_PIC0MRG_ADDR A:0x1:0x61fc98
y.create.l HWIO_CCS_PIC2MRG_ADDR A:0x1:0x61fc9c
y.create.l HWIO_CPMEM_MIN_ADDR A:0x1:0x61f800
y.create.l HWIO_CPMEM_MAX_ADDR A:0x1:0x61fbfc
y.create.l HWIO_PDMEM_MIN_ADDR A:0x1:0x600000
y.create.l HWIO_PDMEM_MAX_ADDR A:0x1:0x60fffc
y.create.l HWIO_MCDMA_RESET_ADDR A:0x1:0x620400
y.create.l HWIO_MCDMA_ENABLE_ADDR A:0x1:0x620404
y.create.l HWIO_MCDMA_LOG_CH_BUSY_ADDR A:0x1:0x620408
y.create.l HWIO_MCDMA_LOG_HW_CH0_SYNC_ADDR A:0x1:0x62040c
y.create.l HWIO_MCDMA_LOG_HW_CH1_SYNC_ADDR A:0x1:0x620410
y.create.l HWIO_MCDMA_LOG_HW_CH2_SYNC_ADDR A:0x1:0x620414
y.create.l HWIO_MCDMA_LOG_HW_CH3_SYNC_ADDR A:0x1:0x620418
y.create.l HWIO_MCDMA_LOG_HW_CH0_CTL_ADDR A:0x1:0x620424
y.create.l HWIO_MCDMA_LOG_HW_CH1_CTL_ADDR A:0x1:0x620428
y.create.l HWIO_MCDMA_LOG_HW_CH2_CTL_ADDR A:0x1:0x62042c
y.create.l HWIO_MCDMA_LOG_HW_CH3_CTL_ADDR A:0x1:0x620430
y.create.l HWIO_MCDMA_LOG_SW_CH0_RESET_ADDR A:0x1:0x620440
y.create.l HWIO_MCDMA_LOG_SW_CH1_RESET_ADDR A:0x1:0x620444
y.create.l HWIO_MCDMA_LOG_SW_CH2_RESET_ADDR A:0x1:0x620448
y.create.l HWIO_MCDMA_LOG_SW_CH3_RESET_ADDR A:0x1:0x62044c
y.create.l HWIO_MCDMA_LOG_SW_CH4_RESET_ADDR A:0x1:0x620450
y.create.l HWIO_MCDMA_LOG_SW_CH5_RESET_ADDR A:0x1:0x620454
y.create.l HWIO_MCDMA_LOG_SW_CH6_RESET_ADDR A:0x1:0x620458
y.create.l HWIO_MCDMA_LOG_SW_CH7_RESET_ADDR A:0x1:0x62045c
y.create.l HWIO_MCDMA_LOG_SW_CH8_RESET_ADDR A:0x1:0x620460
y.create.l HWIO_MCDMA_LOG_SW_CH9_RESET_ADDR A:0x1:0x620464
y.create.l HWIO_MCDMA_LOG_SW_CH0_CTL_ADDR A:0x1:0x620468
y.create.l HWIO_MCDMA_LOG_SW_CH1_CTL_ADDR A:0x1:0x62046c
y.create.l HWIO_MCDMA_LOG_SW_CH2_CTL_ADDR A:0x1:0x620470
y.create.l HWIO_MCDMA_LOG_SW_CH3_CTL_ADDR A:0x1:0x620474
y.create.l HWIO_MCDMA_LOG_SW_CH4_CTL_ADDR A:0x1:0x620478
y.create.l HWIO_MCDMA_LOG_SW_CH5_CTL_ADDR A:0x1:0x62047c
y.create.l HWIO_MCDMA_LOG_SW_CH6_CTL_ADDR A:0x1:0x620480
y.create.l HWIO_MCDMA_LOG_SW_CH7_CTL_ADDR A:0x1:0x620484
y.create.l HWIO_MCDMA_LOG_SW_CH8_CTL_ADDR A:0x1:0x620488
y.create.l HWIO_MCDMA_LOG_SW_CH9_CTL_ADDR A:0x1:0x62048c
y.create.l HWIO_MCDMA_PHY_CH_CTL_ADDR A:0x1:0x620494
y.create.l HWIO_MCDMA_LOG_HW_CH0_DBG_ADDR A:0x1:0x620498
y.create.l HWIO_MCDMA_LOG_HW_CH1_DBG_ADDR A:0x1:0x62049c
y.create.l HWIO_MCDMA_LOG_HW_CH2_DBG_ADDR A:0x1:0x6204a0
y.create.l HWIO_MCDMA_LOG_HW_CH3_DBG_ADDR A:0x1:0x6204a4
y.create.l HWIO_MCDMA_LOG_SW_CH0_DBG_ADDR A:0x1:0x6204b0
y.create.l HWIO_MCDMA_LOG_SW_CH1_DBG_ADDR A:0x1:0x6204b4
y.create.l HWIO_MCDMA_LOG_SW_CH2_DBG_ADDR A:0x1:0x6204b8
y.create.l HWIO_MCDMA_LOG_SW_CH3_DBG_ADDR A:0x1:0x6204bc
y.create.l HWIO_MCDMA_LOG_SW_CH4_DBG_ADDR A:0x1:0x6204c0
y.create.l HWIO_MCDMA_LOG_SW_CH5_DBG_ADDR A:0x1:0x6204c4
y.create.l HWIO_MCDMA_LOG_SW_CH6_DBG_ADDR A:0x1:0x6204c8
y.create.l HWIO_MCDMA_LOG_SW_CH7_DBG_ADDR A:0x1:0x6204cc
y.create.l HWIO_MCDMA_LOG_SW_CH8_DBG_ADDR A:0x1:0x6204d0
y.create.l HWIO_MCDMA_LOG_SW_CH9_DBG_ADDR A:0x1:0x6204d4
y.create.l HWIO_MCDMA_PHY_CH_DBG_ADDR A:0x1:0x6204dc
y.create.l HWIO_MCDMA_VBUF_CFG_DBG_ADDR A:0x1:0x6204e0
y.create.l HWIO_MCDMA_VBUF_CFG_SEL_ADDR A:0x1:0x6204e4
y.create.l HWIO_MCDMA_VBUF_CFG_RD0_ADDR A:0x1:0x6204e8
y.create.l HWIO_MCDMA_VBUF_CFG_RD1_ADDR A:0x1:0x6204ec
y.create.l HWIO_A2_SW_RESET_THRD_ADDR A:0x1:0x620800
y.create.l HWIO_A2_TASK0_EN_ADDR A:0x1:0x620808
y.create.l HWIO_A2_TASK1_EN_ADDR A:0x1:0x62080c
y.create.l HWIO_A2_TASK2_EN_ADDR A:0x1:0x620810
y.create.l HWIO_A2_TASK3_EN_ADDR A:0x1:0x620814
y.create.l HWIO_A2_TASK4_EN_ADDR A:0x1:0x620818
y.create.l HWIO_A2_TASK5_EN_ADDR A:0x1:0x62081c
y.create.l HWIO_A2_TASK0_WR_PTR_ADDR A:0x1:0x620820
y.create.l HWIO_A2_TASK1_WR_PTR_ADDR A:0x1:0x620824
y.create.l HWIO_A2_TASK2_WR_PTR_ADDR A:0x1:0x620828
y.create.l HWIO_A2_TASK3_WR_PTR_ADDR A:0x1:0x62082c
y.create.l HWIO_A2_TASK4_WR_PTR_ADDR A:0x1:0x620830
y.create.l HWIO_A2_TASK5_WR_PTR_ADDR A:0x1:0x620834
y.create.l HWIO_A2_TASK0_RD_PTR_ADDR A:0x1:0x620838
y.create.l HWIO_A2_TASK1_RD_PTR_ADDR A:0x1:0x62083c
y.create.l HWIO_A2_TASK2_RD_PTR_ADDR A:0x1:0x620840
y.create.l HWIO_A2_TASK3_RD_PTR_ADDR A:0x1:0x620844
y.create.l HWIO_A2_TASK4_RD_PTR_ADDR A:0x1:0x620848
y.create.l HWIO_A2_TASK5_RD_PTR_ADDR A:0x1:0x62084c
y.create.l HWIO_A2_TASK0_RD_PTR_INIT_ADDR A:0x1:0x620850
y.create.l HWIO_A2_TASK1_RD_PTR_INIT_ADDR A:0x1:0x620854
y.create.l HWIO_A2_TASK2_RD_PTR_INIT_ADDR A:0x1:0x620858
y.create.l HWIO_A2_TASK3_RD_PTR_INIT_ADDR A:0x1:0x62085c
y.create.l HWIO_A2_TASK4_RD_PTR_INIT_ADDR A:0x1:0x620860
y.create.l HWIO_A2_TASK5_RD_PTR_INIT_ADDR A:0x1:0x620864
y.create.l HWIO_A2_TASK0_RD_PTR_INIT_EN_ADDR A:0x1:0x620868
y.create.l HWIO_A2_TASK1_RD_PTR_INIT_EN_ADDR A:0x1:0x62086c
y.create.l HWIO_A2_TASK2_RD_PTR_INIT_EN_ADDR A:0x1:0x620870
y.create.l HWIO_A2_TASK3_RD_PTR_INIT_EN_ADDR A:0x1:0x620874
y.create.l HWIO_A2_TASK4_RD_PTR_INIT_EN_ADDR A:0x1:0x620878
y.create.l HWIO_A2_TASK5_RD_PTR_INIT_EN_ADDR A:0x1:0x62087c
y.create.l HWIO_A2_QUEUE_UPPER_ADDR_ADDR A:0x1:0x620880
y.create.l HWIO_A2_STATUS0_WR_EN_ADDR A:0x1:0x620884
y.create.l HWIO_A2_STATUS1_WR_EN_ADDR A:0x1:0x620888
y.create.l HWIO_A2_STATUS2_WR_EN_ADDR A:0x1:0x62088c
y.create.l HWIO_A2_STATUS3_WR_EN_ADDR A:0x1:0x620890
y.create.l HWIO_A2_STATUS4_WR_EN_ADDR A:0x1:0x620894
y.create.l HWIO_A2_STATUS5_WR_EN_ADDR A:0x1:0x620898
y.create.l HWIO_A2_STATUS0_WR_START_ADDR A:0x1:0x62089c
y.create.l HWIO_A2_STATUS1_WR_START_ADDR A:0x1:0x6208a0
y.create.l HWIO_A2_STATUS2_WR_START_ADDR A:0x1:0x6208a4
y.create.l HWIO_A2_STATUS3_WR_START_ADDR A:0x1:0x6208a8
y.create.l HWIO_A2_STATUS4_WR_START_ADDR A:0x1:0x6208ac
y.create.l HWIO_A2_STATUS5_WR_START_ADDR A:0x1:0x6208b0
y.create.l HWIO_A2_STATUS0_WR_END_ADDR A:0x1:0x6208b4
y.create.l HWIO_A2_STATUS1_WR_END_ADDR A:0x1:0x6208b8
y.create.l HWIO_A2_STATUS2_WR_END_ADDR A:0x1:0x6208bc
y.create.l HWIO_A2_STATUS3_WR_END_ADDR A:0x1:0x6208c0
y.create.l HWIO_A2_STATUS4_WR_END_ADDR A:0x1:0x6208c4
y.create.l HWIO_A2_STATUS5_WR_END_ADDR A:0x1:0x6208c8
y.create.l HWIO_A2_STATUS0_WR_PTR_INIT_ADDR A:0x1:0x6208cc
y.create.l HWIO_A2_STATUS1_WR_PTR_INIT_ADDR A:0x1:0x6208d0
y.create.l HWIO_A2_STATUS2_WR_PTR_INIT_ADDR A:0x1:0x6208d4
y.create.l HWIO_A2_STATUS3_WR_PTR_INIT_ADDR A:0x1:0x6208d8
y.create.l HWIO_A2_STATUS4_WR_PTR_INIT_ADDR A:0x1:0x6208dc
y.create.l HWIO_A2_STATUS5_WR_PTR_INIT_ADDR A:0x1:0x6208e0
y.create.l HWIO_A2_STATUS0_WR_PTR_INIT_EN_ADDR A:0x1:0x6208e4
y.create.l HWIO_A2_STATUS1_WR_PTR_INIT_EN_ADDR A:0x1:0x6208e8
y.create.l HWIO_A2_STATUS2_WR_PTR_INIT_EN_ADDR A:0x1:0x6208ec
y.create.l HWIO_A2_STATUS3_WR_PTR_INIT_EN_ADDR A:0x1:0x6208f0
y.create.l HWIO_A2_STATUS4_WR_PTR_INIT_EN_ADDR A:0x1:0x6208f4
y.create.l HWIO_A2_STATUS5_WR_PTR_INIT_EN_ADDR A:0x1:0x6208f8
y.create.l HWIO_A2_STATUS0_WR_PTR_CURRENT_ADDR A:0x1:0x6208fc
y.create.l HWIO_A2_STATUS1_WR_PTR_CURRENT_ADDR A:0x1:0x620900
y.create.l HWIO_A2_STATUS2_WR_PTR_CURRENT_ADDR A:0x1:0x620904
y.create.l HWIO_A2_STATUS3_WR_PTR_CURRENT_ADDR A:0x1:0x620908
y.create.l HWIO_A2_STATUS4_WR_PTR_CURRENT_ADDR A:0x1:0x62090c
y.create.l HWIO_A2_STATUS5_WR_PTR_CURRENT_ADDR A:0x1:0x620910
y.create.l HWIO_A2_STATUS0_WR_PTR_ADDR A:0x1:0x620914
y.create.l HWIO_A2_STATUS1_WR_PTR_ADDR A:0x1:0x620918
y.create.l HWIO_A2_STATUS2_WR_PTR_ADDR A:0x1:0x62091c
y.create.l HWIO_A2_STATUS3_WR_PTR_ADDR A:0x1:0x620920
y.create.l HWIO_A2_STATUS4_WR_PTR_ADDR A:0x1:0x620924
y.create.l HWIO_A2_STATUS5_WR_PTR_ADDR A:0x1:0x620928
y.create.l HWIO_A2_STATUS0_RD_PTR_ADDR A:0x1:0x620b04
y.create.l HWIO_A2_STATUS1_RD_PTR_ADDR A:0x1:0x620b08
y.create.l HWIO_A2_STATUS2_RD_PTR_ADDR A:0x1:0x620b0c
y.create.l HWIO_A2_STATUS3_RD_PTR_ADDR A:0x1:0x620b10
y.create.l HWIO_A2_STATUS4_RD_PTR_ADDR A:0x1:0x620b14
y.create.l HWIO_A2_STATUS5_RD_PTR_ADDR A:0x1:0x620b18
y.create.l HWIO_A2_FRAG0_THRESHOLD_ADDR A:0x1:0x62092c
y.create.l HWIO_A2_FRAG1_THRESHOLD_ADDR A:0x1:0x620930
y.create.l HWIO_A2_FRAG0_REFILL_EN_ADDR A:0x1:0x620934
y.create.l HWIO_A2_FRAG1_REFILL_EN_ADDR A:0x1:0x620938
y.create.l HWIO_A2_FRAG0_LEN_ADDR A:0x1:0x62093c
y.create.l HWIO_A2_FRAG1_LEN_ADDR A:0x1:0x620940
y.create.l HWIO_A2_FRAG0_QUEUE_END_ADDR_ADDR A:0x1:0x620944
y.create.l HWIO_A2_FRAG1_QUEUE_END_ADDR_ADDR A:0x1:0x620948
y.create.l HWIO_A2_FRAG0_PTR_ADDR A:0x1:0x62094c
y.create.l HWIO_A2_FRAG1_PTR_ADDR A:0x1:0x620950
y.create.l HWIO_A2_FRAG_CACHE_LINE_ADDR A:0x1:0x620954
y.create.l HWIO_A2_FRAG_CACHE_LINE_MASK_ADDR A:0x1:0x620958
y.create.l HWIO_A2_FRAG0_TRANSFER_LEN_ADDR A:0x1:0x62095c
y.create.l HWIO_A2_FRAG1_TRANSFER_LEN_ADDR A:0x1:0x620960
y.create.l HWIO_A2_FRAG0_HDR_LEN_ADDR A:0x1:0x620964
y.create.l HWIO_A2_FRAG1_HDR_LEN_ADDR A:0x1:0x620968
y.create.l HWIO_A2_FRAG0_QUEUE_START_ADDR_ADDR A:0x1:0x62096c
y.create.l HWIO_A2_FRAG1_QUEUE_START_ADDR_ADDR A:0x1:0x620970
y.create.l HWIO_A2_FRAG0_QUEUE_WR_PTR_ADDR A:0x1:0x620974
y.create.l HWIO_A2_FRAG1_QUEUE_WR_PTR_ADDR A:0x1:0x620978
y.create.l HWIO_A2_FRAG0_QUEUE_RD_PTR_ADDR A:0x1:0x62097c
y.create.l HWIO_A2_FRAG1_QUEUE_RD_PTR_ADDR A:0x1:0x620980
y.create.l HWIO_A2_FRAG0_RD_PTR_INIT_EN_ADDR A:0x1:0x620984
y.create.l HWIO_A2_FRAG1_RD_PTR_INIT_EN_ADDR A:0x1:0x620988
y.create.l HWIO_A2_TIMER0_CFG_ADDR A:0x1:0x62098c
y.create.l HWIO_A2_TIMER1_CFG_ADDR A:0x1:0x620990
y.create.l HWIO_A2_TIMER2_CFG_ADDR A:0x1:0x620994
y.create.l HWIO_A2_TIMER3_CFG_ADDR A:0x1:0x620998
y.create.l HWIO_A2_TIMER0_CMD_ADDR A:0x1:0x62099c
y.create.l HWIO_A2_TIMER1_CMD_ADDR A:0x1:0x6209a0
y.create.l HWIO_A2_TIMER2_CMD_ADDR A:0x1:0x6209a4
y.create.l HWIO_A2_TIMER3_CMD_ADDR A:0x1:0x6209a8
y.create.l HWIO_A2_TIMER0_PERIOD_ADDR A:0x1:0x6209ac
y.create.l HWIO_A2_TIMER1_PERIOD_ADDR A:0x1:0x6209b0
y.create.l HWIO_A2_TIMER2_PERIOD_ADDR A:0x1:0x6209b4
y.create.l HWIO_A2_TIMER3_PERIOD_ADDR A:0x1:0x6209b8
y.create.l HWIO_A2_TIMER0_STATUS_ADDR A:0x1:0x6209bc
y.create.l HWIO_A2_TIMER1_STATUS_ADDR A:0x1:0x6209c0
y.create.l HWIO_A2_TIMER2_STATUS_ADDR A:0x1:0x6209c4
y.create.l HWIO_A2_TIMER3_STATUS_ADDR A:0x1:0x6209c8
y.create.l HWIO_A2_DL_PHY_DEC_TRBLK_THRESHOLD_ADDR A:0x1:0x6209cc
y.create.l HWIO_A2_DL_PHY_CFG_ADDR A:0x1:0x6209d0
y.create.l HWIO_A2_DL_PHY_1_DEC_TRBLK_THRESHOLD_ADDR A:0x1:0x6209d4
y.create.l HWIO_A2_DL_PHY_1_CFG_ADDR A:0x1:0x6209d8
y.create.l HWIO_A2_HW_THRD_EN_ADDR A:0x1:0x6209dc
y.create.l HWIO_A2_UL_PHY_CFG_ADDR A:0x1:0x6209e0
y.create.l HWIO_A2_UL_PHY_1_CFG_ADDR A:0x1:0x6209e4
y.create.l HWIO_A2_LTE_DLPHY_CMD_ADDR_ADDR A:0x1:0x6209e8
y.create.l HWIO_A2_LTE_DLPHY_1_CMD_ADDR_ADDR A:0x1:0x6209ec
y.create.l HWIO_A2_MCDMA_DMA_IN_ADDR_ADDR A:0x1:0x6209f0
y.create.l HWIO_A2_MCDMA_DMA_OUT_ADDR_ADDR A:0x1:0x6209f4
y.create.l HWIO_A2_MCDMA_TASK_ADDR_ADDR A:0x1:0x6209f8
y.create.l HWIO_A2_MCDMA_OST_BRST_ADDR A:0x1:0x620a04
y.create.l HWIO_A2_MCDMA_MAX_BRST_SIZE_ADDR A:0x1:0x620a08
y.create.l HWIO_A2_HW_CLK_CTL_ADDR A:0x1:0x620a0c
y.create.l HWIO_A2_CLK_EN_CTL_ADDR A:0x1:0x620a10
y.create.l HWIO_A2_CLK_STATUS_ADDR A:0x1:0x620a14
y.create.l HWIO_A2_DBG_LINK_RD0_ADDR A:0x1:0x620a18
y.create.l HWIO_A2_DBG_LINK_RD1_ADDR A:0x1:0x620a1c
y.create.l HWIO_A2_DBG_LINK_RD2_ADDR A:0x1:0x620a20
y.create.l HWIO_A2_DBG_LINK_RD3_ADDR A:0x1:0x620a24
y.create.l HWIO_A2_DBG_LINK_RD4_ADDR A:0x1:0x620a28
y.create.l HWIO_A2_DBG_LINK_RD5_ADDR A:0x1:0x620a2c
y.create.l HWIO_A2_DBG_LINK_RD6_ADDR A:0x1:0x620a30
y.create.l HWIO_A2_DBG_LINK_RD7_ADDR A:0x1:0x620a34
y.create.l HWIO_A2_DBG_LINK_RD8_ADDR A:0x1:0x620a38
y.create.l HWIO_A2_DBG_LINK_RD9_ADDR A:0x1:0x620a3c
y.create.l HWIO_A2_DBG_FRAG0_LEN_ADDR A:0x1:0x620a48
y.create.l HWIO_A2_DBG_FRAG1_LEN_ADDR A:0x1:0x620a4c
y.create.l HWIO_A2_DBG_FRAG2_LEN_ADDR A:0x1:0x620a50
y.create.l HWIO_A2_DBG_FRAG3_LEN_ADDR A:0x1:0x620a54
y.create.l HWIO_A2_DBG_FRAG4_LEN_ADDR A:0x1:0x620a58
y.create.l HWIO_A2_DBG_FRAG5_LEN_ADDR A:0x1:0x620a5c
y.create.l HWIO_A2_DBG_FRAG0_ADDR_CUR_ADDR A:0x1:0x620a60
y.create.l HWIO_A2_DBG_FRAG1_ADDR_CUR_ADDR A:0x1:0x620a64
y.create.l HWIO_A2_DBG_FRAG2_ADDR_CUR_ADDR A:0x1:0x620a68
y.create.l HWIO_A2_DBG_FRAG3_ADDR_CUR_ADDR A:0x1:0x620a6c
y.create.l HWIO_A2_DBG_FRAG4_ADDR_CUR_ADDR A:0x1:0x620a70
y.create.l HWIO_A2_DBG_FRAG5_ADDR_CUR_ADDR A:0x1:0x620a74
y.create.l HWIO_A2_DBG_FRAG0_ADDR_NXT_ADDR A:0x1:0x620a78
y.create.l HWIO_A2_DBG_FRAG1_ADDR_NXT_ADDR A:0x1:0x620a7c
y.create.l HWIO_A2_DBG_FRAG2_ADDR_NXT_ADDR A:0x1:0x620a80
y.create.l HWIO_A2_DBG_FRAG3_ADDR_NXT_ADDR A:0x1:0x620a84
y.create.l HWIO_A2_DBG_FRAG4_ADDR_NXT_ADDR A:0x1:0x620a88
y.create.l HWIO_A2_DBG_FRAG5_ADDR_NXT_ADDR A:0x1:0x620a8c
y.create.l HWIO_A2_DBG_FRAG0_PTR_ADDR A:0x1:0x620a90
y.create.l HWIO_A2_DBG_FRAG1_PTR_ADDR A:0x1:0x620a94
y.create.l HWIO_A2_DBG_FRAG2_PTR_ADDR A:0x1:0x620a98
y.create.l HWIO_A2_DBG_FRAG3_PTR_ADDR A:0x1:0x620a9c
y.create.l HWIO_A2_DBG_FRAG4_PTR_ADDR A:0x1:0x620aa0
y.create.l HWIO_A2_DBG_FRAG5_PTR_ADDR A:0x1:0x620aa4
y.create.l HWIO_A2_DBG_TRBLK_LENGTH_ADDR A:0x1:0x620aa8
y.create.l HWIO_A2_DBG_TRBLK_START_ADDR_ADDR A:0x1:0x620aac
y.create.l HWIO_A2_DBG_TRBLK_SW_INFO0_ADDR A:0x1:0x620ab0
y.create.l HWIO_A2_DBG_TRBLK_SW_INFO1_ADDR A:0x1:0x620ab4
y.create.l HWIO_A2_DBG_TRBLK_TRIGGER_ADDR A:0x1:0x620ab8
y.create.l HWIO_A2_DBG_TRBLK_STATUS_ADDR A:0x1:0x620abc
y.create.l HWIO_A2_DBG_TRBLK_1_LENGTH_ADDR A:0x1:0x620ac0
y.create.l HWIO_A2_DBG_TRBLK_1_START_ADDR_ADDR A:0x1:0x620ac4
y.create.l HWIO_A2_DBG_TRBLK_1_SW_INFO0_ADDR A:0x1:0x620ac8
y.create.l HWIO_A2_DBG_TRBLK_1_SW_INFO1_ADDR A:0x1:0x620acc
y.create.l HWIO_A2_DBG_TRBLK_1_STATUS_ADDR A:0x1:0x620ad4
y.create.l HWIO_A2_DBG_STRM_ID_ADDR A:0x1:0x620ad8
y.create.l HWIO_A2_DBG_DMA_SRC_ADDR A:0x1:0x620adc
y.create.l HWIO_A2_DBG_DMA_DST_ADDR A:0x1:0x620ae0
y.create.l HWIO_A2_DBG_DMA_CTL_ADDR A:0x1:0x620ae4
y.create.l HWIO_A2_DBG_TASK_FETCHER_ADDR A:0x1:0x620ae8
y.create.l HWIO_A2_DBG_CIPH_ADDR A:0x1:0x620aec
y.create.l HWIO_A2_DBG_MIU0_ADDR A:0x1:0x620af0
y.create.l HWIO_A2_DBG_MIU1_ADDR A:0x1:0x620af4
y.create.l HWIO_A2_DBG_MIU2_ADDR A:0x1:0x620af8
y.create.l HWIO_A2_DBG_TASK_WORD_ADDR A:0x1:0x620afc
y.create.l HWIO_A2_DBG_TASK_INFO_ADDR A:0x1:0x620b00
y.create.l HWIO_A2_DBG_MISC_EN_ADDR A:0x1:0x620b1c
y.create.l HWIO_DBG_RESET_ADDR A:0x1:0x620c00
y.create.l HWIO_DBG_ENABLE_ADDR A:0x1:0x620c04
y.create.l HWIO_DBG_LOG_STATUS_ADDR A:0x1:0x620c08
y.create.l HWIO_DBG_MUX_MASK_0_ADDR A:0x1:0x620c0c
y.create.l HWIO_DBG_MUX_MASK_1_ADDR A:0x1:0x620c10
y.create.l HWIO_DBG_MUX_MASK_2_ADDR A:0x1:0x620c14
y.create.l HWIO_DBG_MUX_MASK_3_ADDR A:0x1:0x620c18
y.create.l HWIO_DBG_MUX_MASK_4_ADDR A:0x1:0x620c1c
y.create.l HWIO_DBG_MUX_MASK_5_ADDR A:0x1:0x620c20
y.create.l HWIO_DBG_MUX_MASK_6_ADDR A:0x1:0x620c24
y.create.l HWIO_DBG_MUX_MASK_7_ADDR A:0x1:0x620c28
y.create.l HWIO_DBG_MUX_MASK_8_ADDR A:0x1:0x620c2c
y.create.l HWIO_DBG_MUX_MASK_9_ADDR A:0x1:0x620c30
y.create.l HWIO_DBG_SW_LOG_STATUS_ADDR A:0x1:0x620c4c
y.create.l HWIO_DBG_ERR_IRQ_MASK0_ADDR A:0x1:0x620c50
y.create.l HWIO_DBG_SW_LOG_ADDR A:0x1:0x620c58
y.create.l HWIO_DBG_DATA_DST_ADDR A:0x1:0x620c5c
y.create.l HWIO_DBG_START_ADDR_ADDR A:0x1:0x620c60
y.create.l HWIO_DBG_EXT_MEM_CNT_VAL_ADDR A:0x1:0x620c64
y.create.l HWIO_DBG_SHRD_START_ADDR_ADDR A:0x1:0x620c68
y.create.l HWIO_DBG_SHRD_END_ADDR_ADDR A:0x1:0x620c6c
y.create.l HWIO_DBG_MAX_OST_BURSTS_ADDR A:0x1:0x620c70
y.create.l HWIO_DBG_ERR_IRQ_EN0_ADDR A:0x1:0x620c74
y.create.l HWIO_DBG_ERR_IRQ_CLR0_ADDR A:0x1:0x620c7c
y.create.l HWIO_DBG_ERR_IRQ_STATUS0_ADDR A:0x1:0x620c84
y.create.l HWIO_MTC_BRDG_MCDMA_RD_ENABLE_ADDR A:0x1:0x62100c
y.create.l HWIO_MTC_BRDG_MCDMA_WR_ENABLE_ADDR A:0x1:0x621010
y.create.l HWIO_MTC_BRDG_A2_RD_ENABLE_ADDR A:0x1:0x621014
y.create.l HWIO_MTC_BRDG_CTL_ADDR A:0x1:0x621000
y.create.l HWIO_MTC_BRDG_STATUS_ADDR A:0x1:0x621004
y.create.l HWIO_MTC_BRDG_CLEAR_ADDR A:0x1:0x621008
y.create.l HWIO_A2_SHRD_MEM_BASE_MIN_ADDR A:0x1:0x622000
y.create.l HWIO_A2_SHRD_MEM_BASE_MAX_ADDR A:0x1:0x62367c
y.create.l HWIO_MCDMA_TS_STATUS_WORD0_ADDR A:0x1:0x624000
y.create.l HWIO_MCDMA_TS_VBUF_CFG_WORD0_ADDR A:0x1:0x624100
y.create.l HWIO_MCDMA_TS_VBUF_CFG_WORD1_ADDR A:0x1:0x624104
y.create.l HWIO_MCDMA_TS_DMA_CH0_WORD0_ADDR A:0x1:0x624200
y.create.l HWIO_MCDMA_TS_DMA_CH0_WORD1_ADDR A:0x1:0x624204
y.create.l HWIO_MCDMA_TS_DMA_CH0_WORD2_ADDR A:0x1:0x624208
y.create.l HWIO_MCDMA_TS_DMA_CH1_WORD0_ADDR A:0x1:0x624300
y.create.l HWIO_MCDMA_TS_DMA_CH1_WORD1_ADDR A:0x1:0x624304
y.create.l HWIO_MCDMA_TS_DMA_CH1_WORD2_ADDR A:0x1:0x624308
y.create.l HWIO_MCDMA_TS_DMA_CH2_WORD0_ADDR A:0x1:0x624400
y.create.l HWIO_MCDMA_TS_DMA_CH2_WORD1_ADDR A:0x1:0x624404
y.create.l HWIO_MCDMA_TS_DMA_CH2_WORD2_ADDR A:0x1:0x624408
y.create.l HWIO_MCDMA_TS_DMA_CH3_WORD0_ADDR A:0x1:0x624500
y.create.l HWIO_MCDMA_TS_DMA_CH3_WORD1_ADDR A:0x1:0x624504
y.create.l HWIO_MCDMA_TS_DMA_CH3_WORD2_ADDR A:0x1:0x624508
y.create.l HWIO_MCDMA_TS_DMA_CH4_WORD0_ADDR A:0x1:0x624600
y.create.l HWIO_MCDMA_TS_DMA_CH4_WORD1_ADDR A:0x1:0x624604
y.create.l HWIO_MCDMA_TS_DMA_CH5_WORD0_ADDR A:0x1:0x624700
y.create.l HWIO_MCDMA_TS_DMA_CH5_WORD1_ADDR A:0x1:0x624704
y.create.l HWIO_MCDMA_TS_DMA_CH6_WORD0_ADDR A:0x1:0x624800
y.create.l HWIO_MCDMA_TS_DMA_CH6_WORD1_ADDR A:0x1:0x624804
y.create.l HWIO_MCDMA_TS_DMA_CH6_WORD2_ADDR A:0x1:0x624808
y.create.l HWIO_MCDMA_TS_DMA_CH7_WORD0_ADDR A:0x1:0x624900
y.create.l HWIO_MCDMA_TS_DMA_CH7_WORD1_ADDR A:0x1:0x624904
y.create.l HWIO_MCDMA_TS_DMA_CH7_WORD2_ADDR A:0x1:0x624908
y.create.l HWIO_MCDMA_TS_DMA_CH8_WORD0_ADDR A:0x1:0x624a00
y.create.l HWIO_MCDMA_TS_DMA_CH8_WORD1_ADDR A:0x1:0x624a04
y.create.l HWIO_MCDMA_TS_DMA_CH8_WORD2_ADDR A:0x1:0x624a08
y.create.l HWIO_MCDMA_TS_DMA_CH9_WORD0_ADDR A:0x1:0x624b00
y.create.l HWIO_MCDMA_TS_DMA_CH9_WORD1_ADDR A:0x1:0x624b04
y.create.l HWIO_MCDMA_TS_DMA_CH9_WORD2_ADDR A:0x1:0x624b08
y.create.l HWIO_TDEC_CLK_CTL_ADDR A:0x1:0x640000
y.create.l HWIO_TDEC_SW_CLK_EN_ADDR A:0x1:0x640004
y.create.l HWIO_TDEC_CLK_STATUS_REG_ADDR A:0x1:0x640008
y.create.l HWIO_TDEC_MODE_CTL_ADDR A:0x1:0x64000c
y.create.l HWIO_TDECIB_CLK_CTL_ADDR A:0x1:0x640010
y.create.l HWIO_TDECIB_SW_CLK_EN_ADDR A:0x1:0x640014
y.create.l HWIO_TDECIB_CLK_STATUS_ADDR A:0x1:0x640018
y.create.l HWIO_TD_COMMON_CFG0_ADDR A:0x1:0x640020
y.create.l HWIO_TD_COMMON_CFG1_ADDR A:0x1:0x640024
y.create.l HWIO_TD_COMMON_CFG2_ADDR A:0x1:0x640028
y.create.l HWIO_TD_COMMON_CFG3_ADDR A:0x1:0x64002c
y.create.l HWIO_TD_COMMON_CFG4_ADDR A:0x1:0x640030
y.create.l HWIO_TD_COMMON_CFG5_ADDR A:0x1:0x640034
y.create.l HWIO_TD_COMMON_START_ADDR A:0x1:0x640038
y.create.l HWIO_TD_1X_CFG_ADDR A:0x1:0x64003c
y.create.l HWIO_TD_1X_DECOB_WRITE_PTR_ADDR A:0x1:0x640040
y.create.l HWIO_TDEC_HW_IDLE_ADDR A:0x1:0x640044
y.create.l HWIO_TDEC_PING_STATUS_0_ADDR A:0x1:0x640048
y.create.l HWIO_TDEC_PING_STATUS_1_ADDR A:0x1:0x64004c
y.create.l HWIO_TDEC_PONG_STATUS_0_ADDR A:0x1:0x640050
y.create.l HWIO_TDEC_PONG_STATUS_1_ADDR A:0x1:0x640054
y.create.l HWIO_TDEC_GERAN_STATUS_0_ADDR A:0x1:0x640058
y.create.l HWIO_TDEC_GERAN_STATUS_1_ADDR A:0x1:0x64005c
y.create.l HWIO_TDEC_TESTBUS_ENABLE_ADDR A:0x1:0x640060
y.create.l HWIO_TDEC_TESTBUS_STATUS_ADDR A:0x1:0x640064
y.create.l HWIO_DECIB_PAGE_ID_ADDR A:0x1:0x640068
y.create.l HWIO_TDEC_AHB_ERROR_ADDR_RD_ADDR A:0x1:0x640070
y.create.l HWIO_TEST_CRC_000_RD_ADDR A:0x1:0x640074
y.create.l HWIO_TEST_CRC_001_RD_ADDR A:0x1:0x640078
y.create.l HWIO_TEST_CRC_010_RD_ADDR A:0x1:0x64007c
y.create.l HWIO_TEST_CRC_011_RD_ADDR A:0x1:0x640080
y.create.l HWIO_TEST_CRC_100_RD_ADDR A:0x1:0x640084
y.create.l HWIO_TEST_CRC_101_RD_ADDR A:0x1:0x640088
y.create.l HWIO_TEST_CRC_110_RD_ADDR A:0x1:0x64008c
y.create.l HWIO_TEST_CRC_111_RD_ADDR A:0x1:0x640090
y.create.l HWIO_A2_TEST_SW_CFG_DATA0_ADDR A:0x1:0x640094
y.create.l HWIO_A2_TEST_SW_CFG_DATA1_ADDR A:0x1:0x640098
y.create.l HWIO_A2_TEST_SW_CFG_DATA2_ADDR A:0x1:0x64009c
y.create.l HWIO_A2_TEST_SW_CFG_DATA3_ADDR A:0x1:0x6400a0
y.create.l HWIO_A2_TEST_SW_CFG_DATA4_ADDR A:0x1:0x6400a4
y.create.l HWIO_TD_CFG_STATUS_WORD0_ADDR A:0x1:0x641000
y.create.l HWIO_LTE_CFG_WORD0_ADDR A:0x1:0x641100
y.create.l HWIO_LTE_CFG_WORD1_ADDR A:0x1:0x641104
y.create.l HWIO_LTE_CFG_WORD2_ADDR A:0x1:0x641108
y.create.l HWIO_W_TD_CFG_WORD0_0_ADDR A:0x1:0x641200
y.create.l HWIO_W_TD_CFG_WORD1_0_ADDR A:0x1:0x641204
y.create.l HWIO_W_TD_CFG_WORD2_0_ADDR A:0x1:0x641208
y.create.l HWIO_W_TD_CFG_WORD3_0_ADDR A:0x1:0x64120c
y.create.l HWIO_W_TD_CFG_WORD4_0_ADDR A:0x1:0x641210
y.create.l HWIO_W_TD_CFG_WORD5_0_ADDR A:0x1:0x641214
y.create.l HWIO_W_TD_CFG_WORD6_0_ADDR A:0x1:0x641218
y.create.l HWIO_W_TD_CFG_WORD7_0_ADDR A:0x1:0x64121c
y.create.l HWIO_W_TD_CFG_WORD8_0_ADDR A:0x1:0x641220
y.create.l HWIO_W_TD_CFG_WORD9_0_ADDR A:0x1:0x641224
y.create.l HWIO_W_TD_CFG_WORD0_1_ADDR A:0x1:0x641300
y.create.l HWIO_W_TD_CFG_WORD1_1_ADDR A:0x1:0x641304
y.create.l HWIO_W_TD_CFG_WORD2_1_ADDR A:0x1:0x641308
y.create.l HWIO_W_TD_CFG_WORD3_1_ADDR A:0x1:0x64130c
y.create.l HWIO_W_TD_CFG_WORD4_1_ADDR A:0x1:0x641310
y.create.l HWIO_W_TD_CFG_WORD5_1_ADDR A:0x1:0x641314
y.create.l HWIO_W_TD_CFG_WORD6_1_ADDR A:0x1:0x641318
y.create.l HWIO_W_TD_CFG_WORD7_1_ADDR A:0x1:0x64131c
y.create.l HWIO_W_TD_CFG_WORD8_1_ADDR A:0x1:0x641320
y.create.l HWIO_W_TD_CFG_WORD9_1_ADDR A:0x1:0x641324
y.create.l HWIO_LTE_TRBLK_CFG_WORD0_0_ADDR A:0x1:0x641400
y.create.l HWIO_LTE_TRBLK_CFG_WORD1_0_ADDR A:0x1:0x641404
y.create.l HWIO_LTE_TRBLK_CFG_WORD2_0_ADDR A:0x1:0x641408
y.create.l HWIO_LTE_TRBLK_CFG_WORD3_0_ADDR A:0x1:0x64140c
y.create.l HWIO_LTE_TRBLK_CFG_WORD4_0_ADDR A:0x1:0x641410
y.create.l HWIO_LTE_TRBLK_CFG_WORD5_0_ADDR A:0x1:0x641414
y.create.l HWIO_LTE_TRBLK_CFG_WORD0_1_ADDR A:0x1:0x641500
y.create.l HWIO_LTE_TRBLK_CFG_WORD1_1_ADDR A:0x1:0x641504
y.create.l HWIO_LTE_TRBLK_CFG_WORD2_1_ADDR A:0x1:0x641508
y.create.l HWIO_LTE_TRBLK_CFG_WORD3_1_ADDR A:0x1:0x64150c
y.create.l HWIO_LTE_TRBLK_CFG_WORD4_1_ADDR A:0x1:0x641510
y.create.l HWIO_LTE_TRBLK_CFG_WORD5_1_ADDR A:0x1:0x641514
y.create.l HWIO_GERAN_TD_CFG_WORD0_0_ADDR A:0x1:0x641600
y.create.l HWIO_GERAN_TD_CFG_WORD1_0_ADDR A:0x1:0x641604
y.create.l HWIO_GERAN_TD_CFG_WORD2_0_ADDR A:0x1:0x641608
y.create.l HWIO_GERAN_TD_CFG_WORD3_0_ADDR A:0x1:0x64160c
y.create.l HWIO_GERAN_TD_CFG_WORD0_1_ADDR A:0x1:0x641700
y.create.l HWIO_GERAN_TD_CFG_WORD1_1_ADDR A:0x1:0x641704
y.create.l HWIO_GERAN_TD_CFG_WORD2_1_ADDR A:0x1:0x641708
y.create.l HWIO_GERAN_TD_CFG_WORD3_1_ADDR A:0x1:0x64170c
y.create.l HWIO_HDR_TD_CFG_WORD0_0_ADDR A:0x1:0x641800
y.create.l HWIO_HDR_TD_CFG_WORD1_0_ADDR A:0x1:0x641804
y.create.l HWIO_HDR_TD_CFG_WORD2_0_ADDR A:0x1:0x641808
y.create.l HWIO_HDR_TD_CFG_WORD0_1_ADDR A:0x1:0x641900
y.create.l HWIO_HDR_TD_CFG_WORD1_1_ADDR A:0x1:0x641904
y.create.l HWIO_HDR_TD_CFG_WORD2_1_ADDR A:0x1:0x641908
y.create.l HWIO_TD_STATUS_WORD0_ADDR A:0x1:0x642000
y.create.l HWIO_W_TD_WORD0_0_ADDR A:0x1:0x642100
y.create.l HWIO_W_TD_WORD0_1_ADDR A:0x1:0x642200
y.create.l HWIO_LTE_PDSCH_WORD0_0_ADDR A:0x1:0x642300
y.create.l HWIO_LTE_PDSCH_WORD1_0_ADDR A:0x1:0x642304
y.create.l HWIO_LTE_PDSCH_WORD2_0_ADDR A:0x1:0x642308
y.create.l HWIO_LTE_PDSCH_WORD0_1_ADDR A:0x1:0x642400
y.create.l HWIO_LTE_PDSCH_WORD1_1_ADDR A:0x1:0x642404
y.create.l HWIO_LTE_PDSCH_WORD2_1_ADDR A:0x1:0x642408
y.create.l HWIO_GERAN_TD_WORD0_0_ADDR A:0x1:0x642500
y.create.l HWIO_GERAN_TD_WORD1_0_ADDR A:0x1:0x642504
y.create.l HWIO_GERAN_TD_WORD2_0_ADDR A:0x1:0x642508
y.create.l HWIO_GERAN_TD_WORD3_0_ADDR A:0x1:0x64250c
y.create.l HWIO_GERAN_TD_WORD4_0_ADDR A:0x1:0x642510
y.create.l HWIO_GERAN_TD_WORD5_0_ADDR A:0x1:0x642514
y.create.l HWIO_GERAN_TD_WORD6_0_ADDR A:0x1:0x642518
y.create.l HWIO_GERAN_TD_WORD0_1_ADDR A:0x1:0x642600
y.create.l HWIO_GERAN_TD_WORD1_1_ADDR A:0x1:0x642604
y.create.l HWIO_GERAN_TD_WORD2_1_ADDR A:0x1:0x642608
y.create.l HWIO_GERAN_TD_WORD3_1_ADDR A:0x1:0x64260c
y.create.l HWIO_GERAN_TD_WORD4_1_ADDR A:0x1:0x642610
y.create.l HWIO_GERAN_TD_WORD5_1_ADDR A:0x1:0x642614
y.create.l HWIO_GERAN_TD_WORD6_1_ADDR A:0x1:0x642618
y.create.l HWIO_HDR_TD_WORD0_0_ADDR A:0x1:0x642700
y.create.l HWIO_HDR_TD_WORD1_0_ADDR A:0x1:0x642704
y.create.l HWIO_HDR_TD_WORD2_0_ADDR A:0x1:0x642708
y.create.l HWIO_HDR_TD_WORD3_0_ADDR A:0x1:0x64270c
y.create.l HWIO_HDR_TD_WORD4_0_ADDR A:0x1:0x642710
y.create.l HWIO_HDR_TD_WORD5_0_ADDR A:0x1:0x642714
y.create.l HWIO_HDR_TD_WORD0_1_ADDR A:0x1:0x642800
y.create.l HWIO_HDR_TD_WORD1_1_ADDR A:0x1:0x642804
y.create.l HWIO_HDR_TD_WORD2_1_ADDR A:0x1:0x642808
y.create.l HWIO_HDR_TD_WORD3_1_ADDR A:0x1:0x64280c
y.create.l HWIO_HDR_TD_WORD4_1_ADDR A:0x1:0x642810
y.create.l HWIO_HDR_TD_WORD5_1_ADDR A:0x1:0x642814
y.create.l HWIO_TDECIB_MEM_START_ADDR A:0x1:0x643000
y.create.l HWIO_TDECIB_MEM_END_ADDR A:0x1:0x643ffc
y.create.l HWIO_DEMBACK_EN_ADDR A:0x1:0x660000
y.create.l HWIO_DEMBACK_MODE_SEL_ADDR A:0x1:0x660004
y.create.l HWIO_DEMBACK_AHB_ERR_ADDR A:0x1:0x660008
y.create.l HWIO_DEMBACK_MM_RDR0_CFG0_ADDR A:0x1:0x661000
y.create.l HWIO_DEMBACK_MM_RDR1_CFG0_ADDR A:0x1:0x66100c
y.create.l HWIO_DEMBACK_MM_RDR2_CFG0_ADDR A:0x1:0x661018
y.create.l HWIO_DEMBACK_MM_RDR0_CFG1_ADDR A:0x1:0x661004
y.create.l HWIO_DEMBACK_MM_RDR1_CFG1_ADDR A:0x1:0x661010
y.create.l HWIO_DEMBACK_MM_RDR2_CFG1_ADDR A:0x1:0x66101c
y.create.l HWIO_DEMBACK_MM_RDR0_XFER_CTL_ADDR A:0x1:0x661008
y.create.l HWIO_DEMBACK_MM_RDR1_XFER_CTL_ADDR A:0x1:0x661014
y.create.l HWIO_DEMBACK_MM_RDR2_XFER_CTL_ADDR A:0x1:0x661020
y.create.l HWIO_DEMBACK_RDR3_CFG0_ADDR A:0x1:0x661024
y.create.l HWIO_DEMBACK_RDR3_CFG1_ADDR A:0x1:0x661028
y.create.l HWIO_DEMBACK_RDR3_XFER_CTL_ADDR A:0x1:0x66102c
y.create.l HWIO_DEMBACK_NN_RDR0_CFG0_ADDR A:0x1:0x661030
y.create.l HWIO_DEMBACK_NN_RDR1_CFG0_ADDR A:0x1:0x66103c
y.create.l HWIO_DEMBACK_NN_RDR0_CFG1_ADDR A:0x1:0x661034
y.create.l HWIO_DEMBACK_NN_RDR1_CFG1_ADDR A:0x1:0x661040
y.create.l HWIO_DEMBACK_NN_RDR0_XFER_CTL_ADDR A:0x1:0x661038
y.create.l HWIO_DEMBACK_NN_RDR1_XFER_CTL_ADDR A:0x1:0x661044
y.create.l HWIO_DEMBACK_NN_RDR2_CFG0_ADDR A:0x1:0x661048
y.create.l HWIO_DEMBACK_NN_RDR2_CFG1_ADDR A:0x1:0x66104c
y.create.l HWIO_DEMBACK_NN_RDR2_XFER_CTL_ADDR A:0x1:0x661050
y.create.l HWIO_DEMBACK_NN_RDR3_CFG0_ADDR A:0x1:0x661054
y.create.l HWIO_DEMBACK_NN_RDR3_CFG1_ADDR A:0x1:0x661058
y.create.l HWIO_DEMBACK_NN_RDR3_XFER_CTL_ADDR A:0x1:0x66105c
y.create.l HWIO_DEMBACK_WRTR0_CFG0_ADDR A:0x1:0x661060
y.create.l HWIO_DEMBACK_WRTR1_CFG0_ADDR A:0x1:0x66106c
y.create.l HWIO_DEMBACK_WRTR0_CFG1_ADDR A:0x1:0x661064
y.create.l HWIO_DEMBACK_WRTR1_CFG1_ADDR A:0x1:0x661070
y.create.l HWIO_DEMBACK_WRTR0_XFER_CTL_ADDR A:0x1:0x661068
y.create.l HWIO_DEMBACK_WRTR1_XFER_CTL_ADDR A:0x1:0x661074
y.create.l HWIO_DEMBACK_WRTR2_CFG0_ADDR A:0x1:0x661078
y.create.l HWIO_DEMBACK_WRTR2_CFG1_ADDR A:0x1:0x66107c
y.create.l HWIO_DEMBACK_WRTR2_XFER_CTL_ADDR A:0x1:0x661080
y.create.l HWIO_DEMBACK_WRTR3_CFG0_ADDR A:0x1:0x661084
y.create.l HWIO_DEMBACK_WRTR3_CFG1_ADDR A:0x1:0x661088
y.create.l HWIO_DEMBACK_WRTR3_XFER_CTL_ADDR A:0x1:0x66108c
y.create.l HWIO_DEMBACK_BRDG_CTL_ADDR A:0x1:0x661090
y.create.l HWIO_DEMBACK_BRDG_STATUS_ADDR A:0x1:0x661094
y.create.l HWIO_DEMBACK_BRDG_CLEAR_ADDR A:0x1:0x661098
y.create.l HWIO_DEMBACK_DBG_CFG0_ADDR A:0x1:0x66109c
y.create.l HWIO_DEMBACK_DBG_CFG1_ADDR A:0x1:0x6610a0
y.create.l HWIO_DEMBACK_DBG_CTL_ADDR A:0x1:0x6610a4
y.create.l HWIO_DEMBACK_DBG_MATCH_MASK0_ADDR A:0x1:0x6610a8
y.create.l HWIO_DEMBACK_DBG_MATCH_MASK1_ADDR A:0x1:0x6610ac
y.create.l HWIO_DEMBACK_DBG_MATCH_PATTERN0_ADDR A:0x1:0x6610b0
y.create.l HWIO_DEMBACK_DBG_MATCH_PATTERN1_ADDR A:0x1:0x6610b4
y.create.l HWIO_DEMBACK_DBG_TRACE_LEN_ADDR A:0x1:0x6610b8
y.create.l HWIO_DEMBACK_DBG_WINDOW_LEN_ADDR A:0x1:0x6610bc
y.create.l HWIO_DEMBACK_DBG_TRIGGER_LEN_ADDR A:0x1:0x6610c0
y.create.l HWIO_LTE_DBE_PHICH_STATUS_ADDR A:0x1:0x662000
y.create.l HWIO_LTE_DBE_PCFICH_STATUS_ADDR A:0x1:0x662004
y.create.l HWIO_LTE_DBE_SCRAMBLE_SEED_FF_X1_SEED_ADDR A:0x1:0x662008
y.create.l HWIO_LTE_DBE_TESTBUS_ENABLE_ADDR A:0x1:0x66200c
y.create.l HWIO_LTE_DBE_TESTBUS_STATUS_ADDR A:0x1:0x662010
y.create.l HWIO_LTE_DBE_PBCH_CMD_COUNT_ADDR A:0x1:0x662014
y.create.l HWIO_LTE_DBE_PDCCH_CMD_COUNT_ADDR A:0x1:0x662018
y.create.l HWIO_LTE_DBE_PDSCH_CMD_COUNT_ADDR A:0x1:0x66201c
y.create.l HWIO_LTE_DBE_PBCH_DONE_COUNT_ADDR A:0x1:0x662020
y.create.l HWIO_LTE_DBE_PDCCH_DONE_COUNT_ADDR A:0x1:0x662024
y.create.l HWIO_LTE_DBE_PDSCH_DONE_COUNT_ADDR A:0x1:0x662028
y.create.l HWIO_TESTBUS_ENABLE_ADDR A:0x1:0x663000
y.create.l HWIO_TESTBUS_STATUS_ADDR A:0x1:0x663004
y.create.l HWIO_DBACK_AMP_EST0_0_ADDR A:0x1:0x664000
y.create.l HWIO_DBACK_AMP_EST0_1_ADDR A:0x1:0x664008
y.create.l HWIO_DBACK_AMP_EST0_2_ADDR A:0x1:0x664010
y.create.l HWIO_DBACK_AMP_EST0_3_ADDR A:0x1:0x664018
y.create.l HWIO_DBACK_AMP_EST0_4_ADDR A:0x1:0x664020
y.create.l HWIO_DBACK_AMP_EST0_5_ADDR A:0x1:0x664028
y.create.l HWIO_DBACK_ENG_EST0_0_ADDR A:0x1:0x664004
y.create.l HWIO_DBACK_ENG_EST0_1_ADDR A:0x1:0x66400c
y.create.l HWIO_DBACK_ENG_EST0_2_ADDR A:0x1:0x664014
y.create.l HWIO_DBACK_ENG_EST0_3_ADDR A:0x1:0x66401c
y.create.l HWIO_DBACK_ENG_EST0_4_ADDR A:0x1:0x664024
y.create.l HWIO_DBACK_ENG_EST0_5_ADDR A:0x1:0x66402c
y.create.l HWIO_DBACK_AMP_EST1_0_ADDR A:0x1:0x664030
y.create.l HWIO_DBACK_AMP_EST1_1_ADDR A:0x1:0x664038
y.create.l HWIO_DBACK_AMP_EST1_2_ADDR A:0x1:0x664040
y.create.l HWIO_DBACK_AMP_EST1_3_ADDR A:0x1:0x664048
y.create.l HWIO_DBACK_AMP_EST1_4_ADDR A:0x1:0x664050
y.create.l HWIO_DBACK_AMP_EST1_5_ADDR A:0x1:0x664058
y.create.l HWIO_DBACK_ENG_EST1_0_ADDR A:0x1:0x664034
y.create.l HWIO_DBACK_ENG_EST1_1_ADDR A:0x1:0x66403c
y.create.l HWIO_DBACK_ENG_EST1_2_ADDR A:0x1:0x664044
y.create.l HWIO_DBACK_ENG_EST1_3_ADDR A:0x1:0x66404c
y.create.l HWIO_DBACK_ENG_EST1_4_ADDR A:0x1:0x664054
y.create.l HWIO_DBACK_ENG_EST1_5_ADDR A:0x1:0x66405c
y.create.l HWIO_DBACK_HS_CH0_PART1_DEC_DATA0_ADDR A:0x1:0x664060
y.create.l HWIO_DBACK_HS_CH1_PART1_DEC_DATA0_ADDR A:0x1:0x66406c
y.create.l HWIO_DBACK_HS_CH2_PART1_DEC_DATA0_ADDR A:0x1:0x664078
y.create.l HWIO_DBACK_HS_CH3_PART1_DEC_DATA0_ADDR A:0x1:0x664084
y.create.l HWIO_DBACK_HS_CH4_PART1_DEC_DATA0_ADDR A:0x1:0x664090
y.create.l HWIO_DBACK_HS_CH5_PART1_DEC_DATA0_ADDR A:0x1:0x66409c
y.create.l HWIO_DBACK_HS_CH6_PART1_DEC_DATA0_ADDR A:0x1:0x6640a8
y.create.l HWIO_DBACK_HS_CH7_PART1_DEC_DATA0_ADDR A:0x1:0x6640b4
y.create.l HWIO_DBACK_HS_CH8_PART1_DEC_DATA0_ADDR A:0x1:0x6640c0
y.create.l HWIO_DBACK_HS_CH9_PART1_DEC_DATA0_ADDR A:0x1:0x6640cc
y.create.l HWIO_DBACK_HS_CH0_PART1_DEC_STAT_ADDR A:0x1:0x664064
y.create.l HWIO_DBACK_HS_CH1_PART1_DEC_STAT_ADDR A:0x1:0x664070
y.create.l HWIO_DBACK_HS_CH2_PART1_DEC_STAT_ADDR A:0x1:0x66407c
y.create.l HWIO_DBACK_HS_CH3_PART1_DEC_STAT_ADDR A:0x1:0x664088
y.create.l HWIO_DBACK_HS_CH4_PART1_DEC_STAT_ADDR A:0x1:0x664094
y.create.l HWIO_DBACK_HS_CH5_PART1_DEC_STAT_ADDR A:0x1:0x6640a0
y.create.l HWIO_DBACK_HS_CH6_PART1_DEC_STAT_ADDR A:0x1:0x6640ac
y.create.l HWIO_DBACK_HS_CH7_PART1_DEC_STAT_ADDR A:0x1:0x6640b8
y.create.l HWIO_DBACK_HS_CH8_PART1_DEC_STAT_ADDR A:0x1:0x6640c4
y.create.l HWIO_DBACK_HS_CH9_PART1_DEC_STAT_ADDR A:0x1:0x6640d0
y.create.l HWIO_DBACK_HS_CH0_SLOT1_AE_EST_ADDR A:0x1:0x664068
y.create.l HWIO_DBACK_HS_CH1_SLOT1_AE_EST_ADDR A:0x1:0x664074
y.create.l HWIO_DBACK_HS_CH2_SLOT1_AE_EST_ADDR A:0x1:0x664080
y.create.l HWIO_DBACK_HS_CH3_SLOT1_AE_EST_ADDR A:0x1:0x66408c
y.create.l HWIO_DBACK_HS_CH4_SLOT1_AE_EST_ADDR A:0x1:0x664098
y.create.l HWIO_DBACK_HS_CH5_SLOT1_AE_EST_ADDR A:0x1:0x6640a4
y.create.l HWIO_DBACK_HS_CH6_SLOT1_AE_EST_ADDR A:0x1:0x6640b0
y.create.l HWIO_DBACK_HS_CH7_SLOT1_AE_EST_ADDR A:0x1:0x6640bc
y.create.l HWIO_DBACK_HS_CH8_SLOT1_AE_EST_ADDR A:0x1:0x6640c8
y.create.l HWIO_DBACK_HS_CH9_SLOT1_AE_EST_ADDR A:0x1:0x6640d4
y.create.l HWIO_DBACK_HS_CH0_PART2_DEC_DATA1_ADDR A:0x1:0x6640d8
y.create.l HWIO_DBACK_HS_CH1_PART2_DEC_DATA1_ADDR A:0x1:0x6640e8
y.create.l HWIO_DBACK_HS_CH2_PART2_DEC_DATA1_ADDR A:0x1:0x6640f8
y.create.l HWIO_DBACK_HS_CH3_PART2_DEC_DATA1_ADDR A:0x1:0x664108
y.create.l HWIO_DBACK_HS_CH4_PART2_DEC_DATA1_ADDR A:0x1:0x664118
y.create.l HWIO_DBACK_HS_CH5_PART2_DEC_DATA1_ADDR A:0x1:0x664128
y.create.l HWIO_DBACK_HS_CH6_PART2_DEC_DATA1_ADDR A:0x1:0x664138
y.create.l HWIO_DBACK_HS_CH7_PART2_DEC_DATA1_ADDR A:0x1:0x664148
y.create.l HWIO_DBACK_HS_CH8_PART2_DEC_DATA1_ADDR A:0x1:0x664158
y.create.l HWIO_DBACK_HS_CH9_PART2_DEC_DATA1_ADDR A:0x1:0x664168
y.create.l HWIO_DBACK_HS_CH0_PART2_DEC_STAT_ADDR A:0x1:0x6640dc
y.create.l HWIO_DBACK_HS_CH1_PART2_DEC_STAT_ADDR A:0x1:0x6640ec
y.create.l HWIO_DBACK_HS_CH2_PART2_DEC_STAT_ADDR A:0x1:0x6640fc
y.create.l HWIO_DBACK_HS_CH3_PART2_DEC_STAT_ADDR A:0x1:0x66410c
y.create.l HWIO_DBACK_HS_CH4_PART2_DEC_STAT_ADDR A:0x1:0x66411c
y.create.l HWIO_DBACK_HS_CH5_PART2_DEC_STAT_ADDR A:0x1:0x66412c
y.create.l HWIO_DBACK_HS_CH6_PART2_DEC_STAT_ADDR A:0x1:0x66413c
y.create.l HWIO_DBACK_HS_CH7_PART2_DEC_STAT_ADDR A:0x1:0x66414c
y.create.l HWIO_DBACK_HS_CH8_PART2_DEC_STAT_ADDR A:0x1:0x66415c
y.create.l HWIO_DBACK_HS_CH9_PART2_DEC_STAT_ADDR A:0x1:0x66416c
y.create.l HWIO_DBACK_HS_CH0_SLOT2_AE_EST_ADDR A:0x1:0x6640e0
y.create.l HWIO_DBACK_HS_CH1_SLOT2_AE_EST_ADDR A:0x1:0x6640f0
y.create.l HWIO_DBACK_HS_CH2_SLOT2_AE_EST_ADDR A:0x1:0x664100
y.create.l HWIO_DBACK_HS_CH3_SLOT2_AE_EST_ADDR A:0x1:0x664110
y.create.l HWIO_DBACK_HS_CH4_SLOT2_AE_EST_ADDR A:0x1:0x664120
y.create.l HWIO_DBACK_HS_CH5_SLOT2_AE_EST_ADDR A:0x1:0x664130
y.create.l HWIO_DBACK_HS_CH6_SLOT2_AE_EST_ADDR A:0x1:0x664140
y.create.l HWIO_DBACK_HS_CH7_SLOT2_AE_EST_ADDR A:0x1:0x664150
y.create.l HWIO_DBACK_HS_CH8_SLOT2_AE_EST_ADDR A:0x1:0x664160
y.create.l HWIO_DBACK_HS_CH9_SLOT2_AE_EST_ADDR A:0x1:0x664170
y.create.l HWIO_DBACK_HS_CH0_SLOT3_AE_EST_ADDR A:0x1:0x6640e4
y.create.l HWIO_DBACK_HS_CH1_SLOT3_AE_EST_ADDR A:0x1:0x6640f4
y.create.l HWIO_DBACK_HS_CH2_SLOT3_AE_EST_ADDR A:0x1:0x664104
y.create.l HWIO_DBACK_HS_CH3_SLOT3_AE_EST_ADDR A:0x1:0x664114
y.create.l HWIO_DBACK_HS_CH4_SLOT3_AE_EST_ADDR A:0x1:0x664124
y.create.l HWIO_DBACK_HS_CH5_SLOT3_AE_EST_ADDR A:0x1:0x664134
y.create.l HWIO_DBACK_HS_CH6_SLOT3_AE_EST_ADDR A:0x1:0x664144
y.create.l HWIO_DBACK_HS_CH7_SLOT3_AE_EST_ADDR A:0x1:0x664154
y.create.l HWIO_DBACK_HS_CH8_SLOT3_AE_EST_ADDR A:0x1:0x664164
y.create.l HWIO_DBACK_HS_CH9_SLOT3_AE_EST_ADDR A:0x1:0x664174
y.create.l HWIO_DBACK_EAGCH_DEC_DATA_ADDR A:0x1:0x664178
y.create.l HWIO_DBACK_EAGCH_DEC_STAT_ADDR A:0x1:0x66417c
y.create.l HWIO_DBACK_EAGCH_METRIC_ADDR A:0x1:0x664180
y.create.l HWIO_DBACK_HSSCCH_CTL1_ADDR A:0x1:0x664184
y.create.l HWIO_DBACK_HSSCCH_CTL2_ADDR A:0x1:0x664188
y.create.l HWIO_HS_SCCH_PART2_DECODE_MAP_ADDR A:0x1:0x66418c
y.create.l HWIO_DBACK_CH0_UEID_MASK_0_ADDR A:0x1:0x664190
y.create.l HWIO_DBACK_CH1_UEID_MASK_0_ADDR A:0x1:0x664194
y.create.l HWIO_DBACK_CH2_UEID_MASK_0_ADDR A:0x1:0x664198
y.create.l HWIO_DBACK_CH3_UEID_MASK_0_ADDR A:0x1:0x66419c
y.create.l HWIO_DBACK_CH4_UEID_MASK_0_ADDR A:0x1:0x6641a0
y.create.l HWIO_DBACK_CH5_UEID_MASK_0_ADDR A:0x1:0x6641a4
y.create.l HWIO_DBACK_CH6_UEID_MASK_0_ADDR A:0x1:0x6641a8
y.create.l HWIO_DBACK_CH7_UEID_MASK_0_ADDR A:0x1:0x6641ac
y.create.l HWIO_DBACK_CH8_UEID_MASK_0_ADDR A:0x1:0x6641b0
y.create.l HWIO_DBACK_CH9_UEID_MASK_0_ADDR A:0x1:0x6641b4
y.create.l HWIO_DBACK_CH0_UEID_MASK_1_ADDR A:0x1:0x6641b8
y.create.l HWIO_DBACK_CH1_UEID_MASK_1_ADDR A:0x1:0x6641bc
y.create.l HWIO_DBACK_CH2_UEID_MASK_1_ADDR A:0x1:0x6641c0
y.create.l HWIO_DBACK_CH3_UEID_MASK_1_ADDR A:0x1:0x6641c4
y.create.l HWIO_DBACK_CH4_UEID_MASK_1_ADDR A:0x1:0x6641c8
y.create.l HWIO_DBACK_CH5_UEID_MASK_1_ADDR A:0x1:0x6641cc
y.create.l HWIO_DBACK_CH6_UEID_MASK_1_ADDR A:0x1:0x6641d0
y.create.l HWIO_DBACK_CH7_UEID_MASK_1_ADDR A:0x1:0x6641d4
y.create.l HWIO_DBACK_CH8_UEID_MASK_1_ADDR A:0x1:0x6641d8
y.create.l HWIO_DBACK_CH9_UEID_MASK_1_ADDR A:0x1:0x6641dc
y.create.l HWIO_DBACK_HSSCCH_PART1_TRIGGER_ADDR A:0x1:0x6641e0
y.create.l HWIO_DBACK_HSSCCH_YAM_THRES_ADDR A:0x1:0x6641e4
y.create.l HWIO_DBACK_HSSCCH_PART2_TRIGGER_ADDR A:0x1:0x6641e8
y.create.l HWIO_DBACK_HSSCCH_STATUS_ADDR A:0x1:0x6641ec
y.create.l HWIO_DBACK_EAGCH_CONFIG_ADDR A:0x1:0x6641f0
y.create.l HWIO_DBACK_EAGCH_CTL_ADDR A:0x1:0x6641f4
y.create.l HWIO_DBACK_EAGCH_TRIGGER_ADDR A:0x1:0x6641f8
y.create.l HWIO_DBACK_EAGCH_RM_PATTERN_0_ADDR A:0x1:0x6641fc
y.create.l HWIO_DBACK_EAGCH_RM_PATTERN_1_ADDR A:0x1:0x664200
y.create.l HWIO_DBACK_EAGCH_RM_PATTERN_2_ADDR A:0x1:0x664204
y.create.l HWIO_DBACK_HS_EUL_CTL_CH_RST_ADDR A:0x1:0x664208
y.create.l HWIO_DBACK_NONHS_WCB_SIZE_ADDR A:0x1:0x66420c
y.create.l HWIO_DBACK_HS_WCB_SIZE_ADDR A:0x1:0x664210
y.create.l HWIO_DBACK_PART1_INT_STATUS_ADDR A:0x1:0x664214
y.create.l HWIO_DBACK_PART1_INT_CLR_ADDR A:0x1:0x664218
y.create.l HWIO_DBACK_PART1_INT_EN_ADDR A:0x1:0x66421c
y.create.l HWIO_DBACK_PART2_INT_STATUS_ADDR A:0x1:0x664220
y.create.l HWIO_DBACK_PART2_INT_CLR_ADDR A:0x1:0x664224
y.create.l HWIO_DBACK_PART2_INT_EN_ADDR A:0x1:0x664228
y.create.l HWIO_DBACK_EAGCH_INT_EN_ADDR A:0x1:0x66422c
y.create.l HWIO_DBACK_TEST_MEM_SEL_ADDR A:0x1:0x664230
y.create.l HWIO_DBACK_TEST_BUS_SEL_ADDR A:0x1:0x664234
y.create.l HWIO_DBACK_MEM_ADDR_ADDR A:0x1:0x664238
y.create.l HWIO_DBACK_MEM_DATA0_ADDR A:0x1:0x66423c
y.create.l HWIO_DBACK_MEM_DATA1_ADDR A:0x1:0x664240
y.create.l HWIO_DBACK_MEM_DATA2_ADDR A:0x1:0x664244
y.create.l HWIO_DBACK_MEM_DATA3_ADDR A:0x1:0x664248
y.create.l HWIO_DBACK_MEM_DATA4_ADDR A:0x1:0x66424c
y.create.l HWIO_T_DBACK_HS_CH0_DEC_DATA0_ADDR A:0x1:0x665000
y.create.l HWIO_T_DBACK_HS_CH1_DEC_DATA0_ADDR A:0x1:0x66500c
y.create.l HWIO_T_DBACK_HS_CH2_DEC_DATA0_ADDR A:0x1:0x665018
y.create.l HWIO_T_DBACK_HS_CH3_DEC_DATA0_ADDR A:0x1:0x665024
y.create.l HWIO_T_DBACK_HS_CH0_DEC_DATA1_ADDR A:0x1:0x665004
y.create.l HWIO_T_DBACK_HS_CH1_DEC_DATA1_ADDR A:0x1:0x665010
y.create.l HWIO_T_DBACK_HS_CH2_DEC_DATA1_ADDR A:0x1:0x66501c
y.create.l HWIO_T_DBACK_HS_CH3_DEC_DATA1_ADDR A:0x1:0x665028
y.create.l HWIO_T_DBACK_HS_CH0_DEC_STAT_ADDR A:0x1:0x665008
y.create.l HWIO_T_DBACK_HS_CH1_DEC_STAT_ADDR A:0x1:0x665014
y.create.l HWIO_T_DBACK_HS_CH2_DEC_STAT_ADDR A:0x1:0x665020
y.create.l HWIO_T_DBACK_HS_CH3_DEC_STAT_ADDR A:0x1:0x66502c
y.create.l HWIO_T_DBACK_EAGCH0_DEC_DATA0_ADDR A:0x1:0x665030
y.create.l HWIO_T_DBACK_EAGCH1_DEC_DATA0_ADDR A:0x1:0x665040
y.create.l HWIO_T_DBACK_EAGCH2_DEC_DATA0_ADDR A:0x1:0x665050
y.create.l HWIO_T_DBACK_EAGCH3_DEC_DATA0_ADDR A:0x1:0x665060
y.create.l HWIO_T_DBACK_EAGCH0_DEC_DATA1_ADDR A:0x1:0x665034
y.create.l HWIO_T_DBACK_EAGCH1_DEC_DATA1_ADDR A:0x1:0x665044
y.create.l HWIO_T_DBACK_EAGCH2_DEC_DATA1_ADDR A:0x1:0x665054
y.create.l HWIO_T_DBACK_EAGCH3_DEC_DATA1_ADDR A:0x1:0x665064
y.create.l HWIO_T_DBACK_EAGCH0_DEC_STAT_ADDR A:0x1:0x665038
y.create.l HWIO_T_DBACK_EAGCH1_DEC_STAT_ADDR A:0x1:0x665048
y.create.l HWIO_T_DBACK_EAGCH2_DEC_STAT_ADDR A:0x1:0x665058
y.create.l HWIO_T_DBACK_EAGCH3_DEC_STAT_ADDR A:0x1:0x665068
y.create.l HWIO_T_DBACK_EAGCH0_METRIC_ADDR A:0x1:0x66503c
y.create.l HWIO_T_DBACK_EAGCH1_METRIC_ADDR A:0x1:0x66504c
y.create.l HWIO_T_DBACK_EAGCH2_METRIC_ADDR A:0x1:0x66505c
y.create.l HWIO_T_DBACK_EAGCH3_METRIC_ADDR A:0x1:0x66506c
y.create.l HWIO_T_DBACK_FPACH_DEC_DATA0_ADDR A:0x1:0x665070
y.create.l HWIO_T_DBACK_FPACH_DEC_DATA1_ADDR A:0x1:0x665074
y.create.l HWIO_T_DBACK_FPACH_DEC_STAT_ADDR A:0x1:0x665078
y.create.l HWIO_T_DBACK_TEST_MEM_SEL_ADDR A:0x1:0x66507c
y.create.l HWIO_T_DBACK_TEST_BUS_SEL_ADDR A:0x1:0x665080
y.create.l HWIO_T_DBACK_MEM_ADDR_ADDR A:0x1:0x665084
y.create.l HWIO_T_DBACK_MEM_DATA0_ADDR A:0x1:0x665088
y.create.l HWIO_T_DBACK_MEM_DATA1_ADDR A:0x1:0x66508c
y.create.l HWIO_T_DBACK_MEM_DATA2_ADDR A:0x1:0x665090
y.create.l HWIO_T_DBACK_MEM_DATA3_ADDR A:0x1:0x665094
y.create.l HWIO_T_DBACK_MEM_DATA4_ADDR A:0x1:0x665098
y.create.l HWIO_T_DBACK_HS_CH0_DC_DEC_DATA0_ADDR A:0x1:0x66509c
y.create.l HWIO_T_DBACK_HS_CH1_DC_DEC_DATA0_ADDR A:0x1:0x6650a8
y.create.l HWIO_T_DBACK_HS_CH2_DC_DEC_DATA0_ADDR A:0x1:0x6650b4
y.create.l HWIO_T_DBACK_HS_CH3_DC_DEC_DATA0_ADDR A:0x1:0x6650c0
y.create.l HWIO_T_DBACK_HS_CH0_DC_DEC_DATA1_ADDR A:0x1:0x6650a0
y.create.l HWIO_T_DBACK_HS_CH1_DC_DEC_DATA1_ADDR A:0x1:0x6650ac
y.create.l HWIO_T_DBACK_HS_CH2_DC_DEC_DATA1_ADDR A:0x1:0x6650b8
y.create.l HWIO_T_DBACK_HS_CH3_DC_DEC_DATA1_ADDR A:0x1:0x6650c4
y.create.l HWIO_T_DBACK_HS_CH0_DC_DEC_STAT_ADDR A:0x1:0x6650a4
y.create.l HWIO_T_DBACK_HS_CH1_DC_DEC_STAT_ADDR A:0x1:0x6650b0
y.create.l HWIO_T_DBACK_HS_CH2_DC_DEC_STAT_ADDR A:0x1:0x6650bc
y.create.l HWIO_T_DBACK_HS_CH3_DC_DEC_STAT_ADDR A:0x1:0x6650c8
y.create.l HWIO_DINT_CFG_ADDR A:0x1:0x666000
y.create.l HWIO_DINT_CH0_CFG_ADDR A:0x1:0x666004
y.create.l HWIO_DINT_CH1_CFG_ADDR A:0x1:0x666008
y.create.l HWIO_DINT_CH2_CFG_ADDR A:0x1:0x66600c
y.create.l HWIO_TD_BLOCK_SIZE_ADDR A:0x1:0x666014
y.create.l HWIO_TD_INTLV_CFG_LO_ADDR A:0x1:0x666018
y.create.l HWIO_TD_INTLV_CFG_HI_ADDR A:0x1:0x66601c
y.create.l HWIO_TD_INTLV_SIZE_LO_ADDR A:0x1:0x666020
y.create.l HWIO_TD_PUNCT_LO_ADDR A:0x1:0x666024
y.create.l HWIO_TD_PUNCT_HI_ADDR A:0x1:0x666028
y.create.l HWIO_DINT_PKT_OFFSET_ADDR A:0x1:0x666030
y.create.l HWIO_DINT_PKT_CFG_ADDR A:0x1:0x666034
y.create.l HWIO_DINT_TASK_OFFSET_ADDR A:0x1:0x666038
y.create.l HWIO_DINT_TASK_LIST_ADDR A:0x1:0x66603c
y.create.l HWIO_TST_SYNC_DINT_ADDR A:0x1:0x666040
y.create.l HWIO_TST_CH0_SYMS_ADDR A:0x1:0x666044
y.create.l HWIO_TST_CH1_SYMS_ADDR A:0x1:0x666048
y.create.l HWIO_TST_CH2_SYMS_ADDR A:0x1:0x66604c
y.create.l HWIO_TST_SEL_DINT_ADDR A:0x1:0x666054
y.create.l HWIO_DINT_OTD_CFG_ADDR A:0x1:0x666058
y.create.l HWIO_TST_SYS_TIME_ADDR A:0x1:0x666070
y.create.l HWIO_DEINT_DBG_BUS_CTL_ADDR A:0x1:0x666074
y.create.l HWIO_DEC_CLR_INT_STATUS_ADDR A:0x1:0x666084
y.create.l HWIO_DEINT_CLK_STATUS_ADDR A:0x1:0x666088
y.create.l HWIO_DEC_DONE_INT_STATUS_ADDR A:0x1:0x66608c
y.create.l HWIO_DEINT_TASK_STATUS_ADDR A:0x1:0x666090
y.create.l HWIO_DEINT_FRMHYP_STATUS_ADDR A:0x1:0x666094
y.create.l HWIO_DINT_VD_RD_ADDR_ADDR A:0x1:0x666098
y.create.l HWIO_DINT_FCH_CFG0_ADDR A:0x1:0x66609c
y.create.l HWIO_DINT_FCH_CFG1_ADDR A:0x1:0x6660a0
y.create.l HWIO_DINT_FCH_TRIGGER_ADDR A:0x1:0x6660a4
y.create.l HWIO_DINT_FCH_WR_BANK_ADDR A:0x1:0x6660a8
y.create.l HWIO_DINT_FCH_EGTH_HYP_CFG0_ADDR A:0x1:0x6660ac
y.create.l HWIO_DINT_FCH_EGTH_HYP_CFG1_ADDR A:0x1:0x6660b0
y.create.l HWIO_DINT_FCH_EGTH_HYP_CFG2_ADDR A:0x1:0x6660b4
y.create.l HWIO_DINT_FCH_EGTH_HYP_CFG3_ADDR A:0x1:0x6660b8
y.create.l HWIO_DINT_FCH_QRTR_HYP_CFG0_ADDR A:0x1:0x6660bc
y.create.l HWIO_DINT_FCH_QRTR_HYP_CFG1_ADDR A:0x1:0x6660c0
y.create.l HWIO_DINT_FCH_QRTR_HYP_CFG2_ADDR A:0x1:0x6660c4
y.create.l HWIO_DINT_FCH_QRTR_HYP_CFG3_ADDR A:0x1:0x6660c8
y.create.l HWIO_DINT_FCH_HALF_HYP_CFG0_ADDR A:0x1:0x6660cc
y.create.l HWIO_DINT_FCH_HALF_HYP_CFG1_ADDR A:0x1:0x6660d0
y.create.l HWIO_DINT_FCH_HALF_HYP_CFG2_ADDR A:0x1:0x6660d4
y.create.l HWIO_DINT_FCH_HALF_HYP_CFG3_ADDR A:0x1:0x6660d8
y.create.l HWIO_DINT_FCH_FULL_HYP_CFG0_ADDR A:0x1:0x6660dc
y.create.l HWIO_DINT_FCH_FULL_HYP_CFG1_ADDR A:0x1:0x6660e0
y.create.l HWIO_DINT_FCH_FULL_HYP_CFG2_ADDR A:0x1:0x6660e4
y.create.l HWIO_DINT_FCH_FULL_HYP_CFG3_ADDR A:0x1:0x6660e8
y.create.l HWIO_COMB_FUND_SOFT_DEC_IQ_WR_ADDR A:0x1:0x666100
y.create.l HWIO_C_SYNC_TRIG_REG_ADDR A:0x1:0x666104
y.create.l HWIO_CH0_Q_SOFTDEC_ENABLE_ADDR A:0x1:0x666108
y.create.l HWIO_CH1_CONTROL_ADDR A:0x1:0x66610c
y.create.l HWIO_CH2_CONTROL_ADDR A:0x1:0x666110
y.create.l HWIO_CDMA_WIDGET_STATUS0_ADDR A:0x1:0x666114
y.create.l HWIO_RESET_STATUS0_ADDR A:0x1:0x666118
y.create.l HWIO_CDMA_WIDGET_STATUS1_ADDR A:0x1:0x66611c
y.create.l HWIO_RESET_STATUS1_ADDR A:0x1:0x666120
y.create.l HWIO_CDMA_WIDGET_TEST_CTL_ADDR A:0x1:0x666124
y.create.l HWIO_HDR_DINT_STATUS_ADDR A:0x1:0x667024
y.create.l HWIO_HDR_DINT_DGB_BUS_ADDR A:0x1:0x667080
y.create.l HWIO_HDR_DINT_CLK_STATUS_ADDR A:0x1:0x667084
y.create.l HWIO_SVD_TBVD_CLK_STATUS_REG_ADDR A:0x1:0x668000
y.create.l HWIO_SVD_TBVD_HW_IDLE_ADDR A:0x1:0x668004
y.create.l HWIO_SVD_TBVD_TESTBUS_ENABLE_ADDR A:0x1:0x668008
y.create.l HWIO_SVD_MODE_ADDR A:0x1:0x66800c
y.create.l HWIO_SVD_POLY2IJ_ADDR A:0x1:0x668010
y.create.l HWIO_SVD_POLY3IJ_ADDR A:0x1:0x668014
y.create.l HWIO_SVD_POLY3K_ADDR A:0x1:0x668018
y.create.l HWIO_SVD_POLY4IJ_ADDR A:0x1:0x66801c
y.create.l HWIO_SVD_POLY4KL_ADDR A:0x1:0x668020
y.create.l HWIO_SVD_TESTCON_ADDR A:0x1:0x668024
y.create.l HWIO_SVD_TESTOUT_ADDR A:0x1:0x668028
y.create.l HWIO_SVD_TEST_MEM_SEL_ADDR A:0x1:0x66802c
y.create.l HWIO_SVD_TEST_MEM_ADDR_ADDR A:0x1:0x668030
y.create.l HWIO_SVD_TEST_MEM_WRITE_ADDR A:0x1:0x668034
y.create.l HWIO_SVD_TEST_MEM_READ0_ADDR A:0x1:0x668038
y.create.l HWIO_SVD_TEST_MEM_READ1_ADDR A:0x1:0x66803c
y.create.l HWIO_SVD_TEST_MEM_DIN_ADDR A:0x1:0x668040
y.create.l HWIO_TBVD_DEBUG_MEM_CMD_ADDR A:0x1:0x668044
y.create.l HWIO_TBVD_DEBUG_MEM_WR_ADDR A:0x1:0x668048
y.create.l HWIO_TBVD_DEBUG_MEM_RD_ADDR A:0x1:0x66804c
y.create.l HWIO_LTE_DEMBACK_SCH_STATUS_WORD0_ADDR A:0x1:0x669000
y.create.l HWIO_LTE_DEMBACK_SCH_SHARED_WORD0_ADDR A:0x1:0x669100
y.create.l HWIO_LTE_DEMBACK_SCH_SHARED_WORD1_ADDR A:0x1:0x669104
y.create.l HWIO_LTE_DEMBACK_SCH_SHARED_WORD2_ADDR A:0x1:0x669108
y.create.l HWIO_LTE_DEMBACK_SCH_SHARED_WORD3_ADDR A:0x1:0x66910c
y.create.l HWIO_LTE_DEMBACK_SCH_SHARED_WORD4_ADDR A:0x1:0x669110
y.create.l HWIO_LTE_DEMBACK_SCH_SHARED_WORD5_ADDR A:0x1:0x669114
y.create.l HWIO_PDSCH_HARQ_CFG_WORD0_ADDR A:0x1:0x669200
y.create.l HWIO_PDSCH_HARQ_CFG_WORD1_ADDR A:0x1:0x669204
y.create.l HWIO_PDSCH_HARQ_CFG_WORD2_ADDR A:0x1:0x669208
y.create.l HWIO_PDSCH_HARQ_CFG_WORD3_ADDR A:0x1:0x66920c
y.create.l HWIO_PDSCH_HARQ_CFG_WORD4_ADDR A:0x1:0x669210
y.create.l HWIO_PDSCH_HARQ_CFG_WORD5_ADDR A:0x1:0x669214
y.create.l HWIO_PDSCH_HARQ_CFG_WORD6_ADDR A:0x1:0x669218
y.create.l HWIO_PDSCH_HARQ_CFG_WORD7_ADDR A:0x1:0x66921c
y.create.l HWIO_PDSCH_HARQ_CFG_WORD8_ADDR A:0x1:0x669220
y.create.l HWIO_LTE_DEMBACK_CCH_STATUS_WORD0_ADDR A:0x1:0x66a000
y.create.l HWIO_LTE_DEMBACK_CCH_SHARED_WORD0_ADDR A:0x1:0x66a100
y.create.l HWIO_LTE_DEMBACK_CCH_SHARED_WORD1_ADDR A:0x1:0x66a104
y.create.l HWIO_LTE_DEMBACK_CCH_SHARED_WORD2_ADDR A:0x1:0x66a108
y.create.l HWIO_LTE_DEMBACK_CCH_SHARED_WORD3_ADDR A:0x1:0x66a10c
y.create.l HWIO_LTE_DEMBACK_CCH_SHARED_WORD4_ADDR A:0x1:0x66a110
y.create.l HWIO_LTE_DEMBACK_CCH_SHARED_WORD5_ADDR A:0x1:0x66a114
y.create.l HWIO_LTE_DEMBACK_CCH_SHARED_WORD6_ADDR A:0x1:0x66a118
y.create.l HWIO_LTE_DEMBACK_CCH_SHARED_WORD7_ADDR A:0x1:0x66a11c
y.create.l HWIO_PDCCH_DEINT_CFG_WORD0_ADDR A:0x1:0x66a200
y.create.l HWIO_PDCCH_DEINT_CFG_WORD1_ADDR A:0x1:0x66a204
y.create.l HWIO_PDCCH_DEINT_CFG_WORD2_ADDR A:0x1:0x66a208
y.create.l HWIO_SYMBOL0_REG_MAP_0_WORD0_ADDR A:0x1:0x66a300
y.create.l HWIO_SYMBOL0_REG_MAP_0_WORD1_ADDR A:0x1:0x66a304
y.create.l HWIO_SYMBOL0_REG_MAP_0_WORD2_ADDR A:0x1:0x66a308
y.create.l HWIO_SYMBOL0_REG_MAP_0_WORD3_ADDR A:0x1:0x66a30c
y.create.l HWIO_SYMBOL0_REG_MAP_0_WORD4_ADDR A:0x1:0x66a310
y.create.l HWIO_SYMBOL0_REG_MAP_0_WORD5_ADDR A:0x1:0x66a314
y.create.l HWIO_SYMBOL0_REG_MAP_0_WORD6_ADDR A:0x1:0x66a318
y.create.l HWIO_SYMBOL0_REG_MAP_0_WORD7_ADDR A:0x1:0x66a31c
y.create.l HWIO_SYMBOL0_REG_MAP_1_WORD0_ADDR A:0x1:0x66a400
y.create.l HWIO_SYMBOL0_REG_MAP_1_WORD1_ADDR A:0x1:0x66a404
y.create.l HWIO_SYMBOL0_REG_MAP_1_WORD2_ADDR A:0x1:0x66a408
y.create.l HWIO_SYMBOL0_REG_MAP_1_WORD3_ADDR A:0x1:0x66a40c
y.create.l HWIO_SYMBOL0_REG_MAP_1_WORD4_ADDR A:0x1:0x66a410
y.create.l HWIO_SYMBOL0_REG_MAP_1_WORD5_ADDR A:0x1:0x66a414
y.create.l HWIO_SYMBOL0_REG_MAP_1_WORD6_ADDR A:0x1:0x66a418
y.create.l HWIO_SYMBOL0_REG_MAP_1_WORD7_ADDR A:0x1:0x66a41c
y.create.l HWIO_SYMBOL0_REG_MAP_2_WORD0_ADDR A:0x1:0x66a500
y.create.l HWIO_SYMBOL0_REG_MAP_2_WORD1_ADDR A:0x1:0x66a504
y.create.l HWIO_SYMBOL0_REG_MAP_2_WORD2_ADDR A:0x1:0x66a508
y.create.l HWIO_SYMBOL0_REG_MAP_2_WORD3_ADDR A:0x1:0x66a50c
y.create.l HWIO_SYMBOL0_REG_MAP_2_WORD4_ADDR A:0x1:0x66a510
y.create.l HWIO_SYMBOL0_REG_MAP_2_WORD5_ADDR A:0x1:0x66a514
y.create.l HWIO_SYMBOL0_REG_MAP_2_WORD6_ADDR A:0x1:0x66a518
y.create.l HWIO_SYMBOL0_REG_MAP_2_WORD7_ADDR A:0x1:0x66a51c
y.create.l HWIO_SYMBOL1_REG_MAP_0_WORD0_ADDR A:0x1:0x66a600
y.create.l HWIO_SYMBOL1_REG_MAP_0_WORD1_ADDR A:0x1:0x66a604
y.create.l HWIO_SYMBOL1_REG_MAP_0_WORD2_ADDR A:0x1:0x66a608
y.create.l HWIO_SYMBOL1_REG_MAP_0_WORD3_ADDR A:0x1:0x66a60c
y.create.l HWIO_SYMBOL1_REG_MAP_0_WORD4_ADDR A:0x1:0x66a610
y.create.l HWIO_SYMBOL1_REG_MAP_0_WORD5_ADDR A:0x1:0x66a614
y.create.l HWIO_SYMBOL1_REG_MAP_0_WORD6_ADDR A:0x1:0x66a618
y.create.l HWIO_SYMBOL1_REG_MAP_0_WORD7_ADDR A:0x1:0x66a61c
y.create.l HWIO_SYMBOL1_REG_MAP_0_WORD8_ADDR A:0x1:0x66a620
y.create.l HWIO_SYMBOL1_REG_MAP_0_WORD9_ADDR A:0x1:0x66a624
y.create.l HWIO_SYMBOL1_REG_MAP_0_WORD10_ADDR A:0x1:0x66a628
y.create.l HWIO_SYMBOL1_REG_MAP_1_WORD0_ADDR A:0x1:0x66a700
y.create.l HWIO_SYMBOL1_REG_MAP_1_WORD1_ADDR A:0x1:0x66a704
y.create.l HWIO_SYMBOL1_REG_MAP_1_WORD2_ADDR A:0x1:0x66a708
y.create.l HWIO_SYMBOL1_REG_MAP_1_WORD3_ADDR A:0x1:0x66a70c
y.create.l HWIO_SYMBOL1_REG_MAP_1_WORD4_ADDR A:0x1:0x66a710
y.create.l HWIO_SYMBOL1_REG_MAP_1_WORD5_ADDR A:0x1:0x66a714
y.create.l HWIO_SYMBOL1_REG_MAP_1_WORD6_ADDR A:0x1:0x66a718
y.create.l HWIO_SYMBOL1_REG_MAP_1_WORD7_ADDR A:0x1:0x66a71c
y.create.l HWIO_SYMBOL1_REG_MAP_1_WORD8_ADDR A:0x1:0x66a720
y.create.l HWIO_SYMBOL1_REG_MAP_1_WORD9_ADDR A:0x1:0x66a724
y.create.l HWIO_SYMBOL1_REG_MAP_1_WORD10_ADDR A:0x1:0x66a728
y.create.l HWIO_SYMBOL2_REG_MAP_WORD0_ADDR A:0x1:0x66a800
y.create.l HWIO_SYMBOL2_REG_MAP_WORD1_ADDR A:0x1:0x66a804
y.create.l HWIO_SYMBOL2_REG_MAP_WORD2_ADDR A:0x1:0x66a808
y.create.l HWIO_SYMBOL2_REG_MAP_WORD3_ADDR A:0x1:0x66a80c
y.create.l HWIO_SYMBOL2_REG_MAP_WORD4_ADDR A:0x1:0x66a810
y.create.l HWIO_SYMBOL2_REG_MAP_WORD5_ADDR A:0x1:0x66a814
y.create.l HWIO_SYMBOL2_REG_MAP_WORD6_ADDR A:0x1:0x66a818
y.create.l HWIO_SYMBOL2_REG_MAP_WORD7_ADDR A:0x1:0x66a81c
y.create.l HWIO_SYMBOL2_REG_MAP_WORD8_ADDR A:0x1:0x66a820
y.create.l HWIO_SYMBOL2_REG_MAP_WORD9_ADDR A:0x1:0x66a824
y.create.l HWIO_SYMBOL2_REG_MAP_WORD10_ADDR A:0x1:0x66a828
y.create.l HWIO_PBCH_DEINT_CFG_WORD0_ADDR A:0x1:0x66a900
y.create.l HWIO_PBCH_DEINT_CFG_WORD1_ADDR A:0x1:0x66a904
y.create.l HWIO_PBCH_DEINT_CFG_WORD2_ADDR A:0x1:0x66a908
y.create.l HWIO_PBCH_DEINT_CFG_WORD3_ADDR A:0x1:0x66a90c
y.create.l HWIO_PBCH_DEINT_CFG_WORD4_ADDR A:0x1:0x66a910
y.create.l HWIO_PBCH_DEINT_CFG_WORD5_ADDR A:0x1:0x66a914
y.create.l HWIO_PBCH_DEINT_CFG_WORD6_ADDR A:0x1:0x66a918
y.create.l HWIO_PBCH_DEINT_CFG_WORD7_ADDR A:0x1:0x66a91c
y.create.l HWIO_PBCH_DEINT_CFG_WORD8_ADDR A:0x1:0x66a920
y.create.l HWIO_PBCH_DEINT_CFG_WORD9_ADDR A:0x1:0x66a924
y.create.l HWIO_PBCH_DEINT_CFG_WORD10_ADDR A:0x1:0x66a928
y.create.l HWIO_PDCCH_REG_REORDER_WORD0_ADDR A:0x1:0x66aa00
y.create.l HWIO_PDCCH_REG_REORDER_WORD1_ADDR A:0x1:0x66aa04
y.create.l HWIO_PDCCH_REG_REORDER_WORD2_ADDR A:0x1:0x66aa08
y.create.l HWIO_PDCCH_REG_REORDER_WORD3_ADDR A:0x1:0x66aa0c
y.create.l HWIO_PDCCH_REG_REORDER_WORD4_ADDR A:0x1:0x66aa10
y.create.l HWIO_PBCH_FOH_WORD0_ADDR A:0x1:0x66ab00
y.create.l HWIO_PBCH_FOH_WORD1_ADDR A:0x1:0x66ab04
y.create.l HWIO_PBCH_FOH_WORD2_ADDR A:0x1:0x66ab08
y.create.l HWIO_PDSCH_REENC_TB_CFG_WORD0_ADDR A:0x1:0x66b100
y.create.l HWIO_PDSCH_REENC_TB_CFG_WORD1_ADDR A:0x1:0x66b104
y.create.l HWIO_PDSCH_REENC_TB_CFG_WORD2_ADDR A:0x1:0x66b108
y.create.l HWIO_PDSCH_REENC_CB_WORD0_ADDR A:0x1:0x66b200
y.create.l HWIO_PDSCH_REENC_CB_WORD1_ADDR A:0x1:0x66b204
y.create.l HWIO_PDSCH_REENC_CB_WORD2_ADDR A:0x1:0x66b208
y.create.l HWIO_PBCH_REENC_WORD0_ADDR A:0x1:0x66b300
y.create.l HWIO_PBCH_REENC_WORD1_ADDR A:0x1:0x66b304
y.create.l HWIO_PBCH_REENC_WORD2_ADDR A:0x1:0x66b308
y.create.l HWIO_W_DBACK_HS_SHARED_WORD0_ADDR A:0x1:0x66c100
y.create.l HWIO_W_DBACK_HS_SHARED_WORD1_ADDR A:0x1:0x66c104
y.create.l HWIO_W_DBACK_HS_SHARED_WORD2_ADDR A:0x1:0x66c108
y.create.l HWIO_W_DBACK_HS_SHARED_WORD3_ADDR A:0x1:0x66c10c
y.create.l HWIO_W_DBACK_HS_SHARED_WORD4_ADDR A:0x1:0x66c110
y.create.l HWIO_W_DBACK_HS_SHARED_WORD5_ADDR A:0x1:0x66c114
y.create.l HWIO_W_DBACK_HS_SHARED_WORD6_ADDR A:0x1:0x66c118
y.create.l HWIO_W_DBACK_HS_SHARED_WORD7_ADDR A:0x1:0x66c11c
y.create.l HWIO_W_DBACK_HS_SHARED_WORD8_ADDR A:0x1:0x66c120
y.create.l HWIO_W_DBACK_HS_SHARED_WORD9_ADDR A:0x1:0x66c124
y.create.l HWIO_W_DBACK_HS_SHARED_WORD10_ADDR A:0x1:0x66c128
y.create.l HWIO_W_DBACK_HS_SHARED_WORD11_ADDR A:0x1:0x66c12c
y.create.l HWIO_W_DBACK_HS_SHARED_WORD12_ADDR A:0x1:0x66c130
y.create.l HWIO_W_DBACK_HS_SHARED_WORD13_ADDR A:0x1:0x66c134
y.create.l HWIO_W_DBACK_HS_SHARED_WORD14_ADDR A:0x1:0x66c138
y.create.l HWIO_W_DBACK_HS_SHARED_WORD15_ADDR A:0x1:0x66c13c
y.create.l HWIO_W_DBACK_HS_SHARED_WORD16_ADDR A:0x1:0x66c140
y.create.l HWIO_W_DBACK_HS_SHARED_WORD17_ADDR A:0x1:0x66c144
y.create.l HWIO_W_DBACK_HS_SHARED_WORD18_ADDR A:0x1:0x66c148
y.create.l HWIO_W_DBACK_HS_SHARED_WORD19_ADDR A:0x1:0x66c14c
y.create.l HWIO_W_DBACK_HS_SHARED_WORD20_ADDR A:0x1:0x66c150
y.create.l HWIO_W_DBACK_HS_SHARED_WORD21_ADDR A:0x1:0x66c154
y.create.l HWIO_W_DBACK_HS_SHARED_WORD22_ADDR A:0x1:0x66c158
y.create.l HWIO_W_DBACK_HS_SHARED_WORD23_ADDR A:0x1:0x66c15c
y.create.l HWIO_W_DBACK_HS_SHARED_WORD24_ADDR A:0x1:0x66c160
y.create.l HWIO_W_DBACK_HS_SHARED_WORD25_ADDR A:0x1:0x66c164
y.create.l HWIO_W_DBACK_HS_SHARED_WORD26_ADDR A:0x1:0x66c168
y.create.l HWIO_W_DBACK_HS_SHARED_WORD27_ADDR A:0x1:0x66c16c
y.create.l HWIO_W_DBACK_HS_SHARED_WORD28_ADDR A:0x1:0x66c170
y.create.l HWIO_W_DBACK_HS_SHARED_WORD29_ADDR A:0x1:0x66c174
y.create.l HWIO_W_DBACK_HS_SHARED_WORD30_ADDR A:0x1:0x66c178
y.create.l HWIO_W_DBACK_HS_SHARED_WORD31_ADDR A:0x1:0x66c17c
y.create.l HWIO_W_DBACK_HS_SHARED_WORD32_ADDR A:0x1:0x66c180
y.create.l HWIO_W_DBACK_HS_SHARED_WORD33_ADDR A:0x1:0x66c184
y.create.l HWIO_W_DBACK_HS_SHARED_WORD34_ADDR A:0x1:0x66c188
y.create.l HWIO_W_DBACK_HS_SHARED_WORD35_ADDR A:0x1:0x66c18c
y.create.l HWIO_W_DBACK_HS_SHARED_WORD36_ADDR A:0x1:0x66c190
y.create.l HWIO_W_DBACK_HS_SHARED_WORD37_ADDR A:0x1:0x66c194
y.create.l HWIO_W_DBACK_HS_SHARED_WORD38_ADDR A:0x1:0x66c198
y.create.l HWIO_W_DBACK_HS_SHARED_WORD39_ADDR A:0x1:0x66c19c
y.create.l HWIO_W_DBACK_HS_SHARED_WORD40_ADDR A:0x1:0x66c1a0
y.create.l HWIO_W_DBACK_HS_SHARED_WORD41_ADDR A:0x1:0x66c1a4
y.create.l HWIO_W_DBACK_HS_SHARED_WORD42_ADDR A:0x1:0x66c1a8
y.create.l HWIO_W_DBACK_HS_SHARED_WORD43_ADDR A:0x1:0x66c1ac
y.create.l HWIO_W_DBACK_HS_SHARED_WORD44_ADDR A:0x1:0x66c1b0
y.create.l HWIO_W_DBACK_HS_SHARED_WORD45_ADDR A:0x1:0x66c1b4
y.create.l HWIO_W_DBACK_HS_SHARED_WORD46_ADDR A:0x1:0x66c1b8
y.create.l HWIO_W_DBACK_HS_SHARED_WORD47_ADDR A:0x1:0x66c1bc
y.create.l HWIO_W_DBACK_HS_SHARED_WORD48_ADDR A:0x1:0x66c1c0
y.create.l HWIO_W_DBACK_HS_SHARED_WORD49_ADDR A:0x1:0x66c1c4
y.create.l HWIO_W_DBACK_HS_SHARED_WORD50_ADDR A:0x1:0x66c1c8
y.create.l HWIO_W_DBACK_HS_SHARED_WORD51_ADDR A:0x1:0x66c1cc
y.create.l HWIO_W_DBACK_HS_SHARED_WORD52_ADDR A:0x1:0x66c1d0
y.create.l HWIO_W_DBACK_HS_SHARED_WORD53_ADDR A:0x1:0x66c1d4
y.create.l HWIO_W_DBACK_HS_SHARED_WORD54_ADDR A:0x1:0x66c1d8
y.create.l HWIO_W_DBACK_HS_SHARED_WORD55_ADDR A:0x1:0x66c1dc
y.create.l HWIO_W_DBACK_HS_SHARED_WORD56_ADDR A:0x1:0x66c1e0
y.create.l HWIO_W_DBACK_HS_SHARED_WORD57_ADDR A:0x1:0x66c1e4
y.create.l HWIO_W_DBACK_HS_TD_DECIB_WRITER_WORD0_ADDR A:0x1:0x66c200
y.create.l HWIO_W_DBACK_HS_TD_DECIB_WRITER_CFG_WORD0_ADDR A:0x1:0x66c300
y.create.l HWIO_W_DBACK_HS_TD_DECIB_WRITER_CFG_WORD1_ADDR A:0x1:0x66c304
y.create.l HWIO_W_DBACK_HS_TD_DECIB_WRITER_CFG_WORD2_ADDR A:0x1:0x66c308
y.create.l HWIO_W_DBACK_HS_TD_DECIB_WRITER_CFG_WORD3_ADDR A:0x1:0x66c30c
y.create.l HWIO_W_DBACK_HS_TD_DECIB_WRITER_CFG_WORD4_ADDR A:0x1:0x66c310
y.create.l HWIO_W_DBACK_HS_TD_DECIB_WRITER_CFG_WORD5_ADDR A:0x1:0x66c314
y.create.l HWIO_W_DBACK_HS_TD_DECIB_WRITER_CFG_WORD6_ADDR A:0x1:0x66c318
y.create.l HWIO_W_DBACK_HS_TD_DECIB_WRITER_CFG_WORD7_ADDR A:0x1:0x66c31c
y.create.l HWIO_W_DBACK_NONHS_SHARED_WORD0_ADDR A:0x1:0x66d100
y.create.l HWIO_W_DBACK_NONHS_SHARED_WORD1_ADDR A:0x1:0x66d104
y.create.l HWIO_W_DBACK_NONHS_SHARED_WORD2_ADDR A:0x1:0x66d108
y.create.l HWIO_W_DBACK_NONHS_SHARED_WORD3_ADDR A:0x1:0x66d10c
y.create.l HWIO_W_DBACK_NONHS_SHARED_WORD4_ADDR A:0x1:0x66d110
y.create.l HWIO_W_DBACK_NONHS_SHARED_WORD5_ADDR A:0x1:0x66d114
y.create.l HWIO_W_DBACK_NONHS_SHARED_WORD6_ADDR A:0x1:0x66d118
y.create.l HWIO_W_DBACK_NONHS_SHARED_WORD7_ADDR A:0x1:0x66d11c
y.create.l HWIO_W_DBACK_NONHS_DRM_CFG_WORD0_ADDR A:0x1:0x66d200
y.create.l HWIO_W_DBACK_NONHS_DRM_CFG_WORD1_ADDR A:0x1:0x66d204
y.create.l HWIO_W_DBACK_NONHS_DRM_CFG_WORD2_ADDR A:0x1:0x66d208
y.create.l HWIO_W_DBACK_NONHS_DRM_CFG_WORD3_ADDR A:0x1:0x66d20c
y.create.l HWIO_W_DBACK_NONHS_DRM_CFG_WORD4_ADDR A:0x1:0x66d210
y.create.l HWIO_W_DBACK_NONHS_DRM_CFG_WORD5_ADDR A:0x1:0x66d214
y.create.l HWIO_W_DBACK_NONHS_DRM_CFG_WORD6_ADDR A:0x1:0x66d218
y.create.l HWIO_W_DBACK_NONHS_DRM_CFG_WORD7_ADDR A:0x1:0x66d21c
y.create.l HWIO_W_DBACK_NONHS_DRM_CFG_WORD8_ADDR A:0x1:0x66d220
y.create.l HWIO_W_DBACK_NONHS_DRM_CFG_WORD9_ADDR A:0x1:0x66d224
y.create.l HWIO_W_DBACK_NONHS_DRM_CFG_WORD10_ADDR A:0x1:0x66d228
y.create.l HWIO_W_DBACK_NONHS_DRM_CFG_WORD11_ADDR A:0x1:0x66d22c
y.create.l HWIO_W_DBACK_NONHS_DRM_CFG_WORD12_ADDR A:0x1:0x66d230
y.create.l HWIO_W_DBACK_NONHS_DRM_CFG_WORD13_ADDR A:0x1:0x66d234
y.create.l HWIO_W_DBACK_NONHS_DRM_CFG_WORD14_ADDR A:0x1:0x66d238
y.create.l HWIO_W_DBACK_NONHS_DRM_CFG_WORD15_ADDR A:0x1:0x66d23c
y.create.l HWIO_W_DBACK_NONHS_TD_DECIB_WRITER_CFG_WORD0_ADDR A:0x1:0x66d300
y.create.l HWIO_W_DBACK_NONHS_TD_DECIB_WRITER_CFG_WORD1_ADDR A:0x1:0x66d304
y.create.l HWIO_T_DBACK_SHARED_WORD0_ADDR A:0x1:0x66e100
y.create.l HWIO_T_DBACK_SHARED_WORD1_ADDR A:0x1:0x66e104
y.create.l HWIO_T_DBACK_SHARED_WORD2_ADDR A:0x1:0x66e108
y.create.l HWIO_T_DBACK_SHARED_WORD3_ADDR A:0x1:0x66e10c
y.create.l HWIO_T_DBACK_SHARED_WORD4_ADDR A:0x1:0x66e110
y.create.l HWIO_T_DBACK_SHARED_WORD5_ADDR A:0x1:0x66e114
y.create.l HWIO_T_DBACK_SHARED_WORD6_ADDR A:0x1:0x66e118
y.create.l HWIO_T_DBACK_SHARED_WORD7_ADDR A:0x1:0x66e11c
y.create.l HWIO_T_DBACK_SHARED_WORD8_ADDR A:0x1:0x66e120
y.create.l HWIO_T_DBACK_SHARED_WORD9_ADDR A:0x1:0x66e124
y.create.l HWIO_T_DBACK_SHARED_WORD10_ADDR A:0x1:0x66e128
y.create.l HWIO_T_DBACK_SHARED_WORD11_ADDR A:0x1:0x66e12c
y.create.l HWIO_T_DBACK_SHARED_WORD12_ADDR A:0x1:0x66e130
y.create.l HWIO_T_DBACK_SHARED_WORD13_ADDR A:0x1:0x66e134
y.create.l HWIO_T_DBACK_SHARED_WORD14_ADDR A:0x1:0x66e138
y.create.l HWIO_T_DBACK_SHARED_WORD15_ADDR A:0x1:0x66e13c
y.create.l HWIO_T_DBACK_SHARED_WORD16_ADDR A:0x1:0x66e140
y.create.l HWIO_T_DBACK_SHARED_WORD17_ADDR A:0x1:0x66e144
y.create.l HWIO_T_DBACK_SHARED_WORD18_ADDR A:0x1:0x66e148
y.create.l HWIO_T_DBACK_SHARED_WORD19_ADDR A:0x1:0x66e14c
y.create.l HWIO_T_DBACK_SHARED_WORD20_ADDR A:0x1:0x66e150
y.create.l HWIO_T_DBACK_SHARED_WORD21_ADDR A:0x1:0x66e154
y.create.l HWIO_T_DBACK_SHARED_WORD22_ADDR A:0x1:0x66e158
y.create.l HWIO_T_DBACK_SHARED_WORD23_ADDR A:0x1:0x66e15c
y.create.l HWIO_T_DBACK_SHARED_WORD24_ADDR A:0x1:0x66e160
y.create.l HWIO_T_DBACK_SHARED_WORD25_ADDR A:0x1:0x66e164
y.create.l HWIO_T_DBACK_SHARED_WORD26_ADDR A:0x1:0x66e168
y.create.l HWIO_T_DBACK_SHARED_WORD27_ADDR A:0x1:0x66e16c
y.create.l HWIO_T_DBACK_SHARED_WORD28_ADDR A:0x1:0x66e170
y.create.l HWIO_T_DBACK_SHARED_WORD29_ADDR A:0x1:0x66e174
y.create.l HWIO_T_DBACK_SHARED_WORD30_ADDR A:0x1:0x66e178
y.create.l HWIO_T_DBACK_SHARED_WORD31_ADDR A:0x1:0x66e17c
y.create.l HWIO_T_DBACK_SHARED_WORD32_ADDR A:0x1:0x66e180
y.create.l HWIO_T_DBACK_SHARED_WORD33_ADDR A:0x1:0x66e184
y.create.l HWIO_T_DBACK_SHARED_WORD34_ADDR A:0x1:0x66e188
y.create.l HWIO_T_DBACK_SHARED_WORD35_ADDR A:0x1:0x66e18c
y.create.l HWIO_T_DBACK_SHARED_WORD36_ADDR A:0x1:0x66e190
y.create.l HWIO_T_DBACK_SHARED_WORD37_ADDR A:0x1:0x66e194
y.create.l HWIO_T_DBACK_SHARED_WORD38_ADDR A:0x1:0x66e198
y.create.l HWIO_T_DBACK_NONHS_DRM_CFG_WORD0_ADDR A:0x1:0x66e200
y.create.l HWIO_T_DBACK_NONHS_DRM_CFG_WORD1_ADDR A:0x1:0x66e204
y.create.l HWIO_T_DBACK_NONHS_DRM_CFG_WORD2_ADDR A:0x1:0x66e208
y.create.l HWIO_T_DBACK_NONHS_DRM_CFG_WORD3_ADDR A:0x1:0x66e20c
y.create.l HWIO_T_DBACK_NONHS_DRM_CFG_WORD4_ADDR A:0x1:0x66e210
y.create.l HWIO_T_DBACK_NONHS_DRM_CFG_WORD5_ADDR A:0x1:0x66e214
y.create.l HWIO_T_DBACK_NONHS_DRM_CFG_WORD6_ADDR A:0x1:0x66e218
y.create.l HWIO_T_DBACK_NONHS_DRM_CFG_WORD7_ADDR A:0x1:0x66e21c
y.create.l HWIO_T_DBACK_NONHS_DRM_CFG_WORD8_ADDR A:0x1:0x66e220
y.create.l HWIO_T_DBACK_NONHS_DRM_CFG_WORD9_ADDR A:0x1:0x66e224
y.create.l HWIO_T_DBACK_NONHS_DRM_CFG_WORD10_ADDR A:0x1:0x66e228
y.create.l HWIO_T_DBACK_NONHS_DRM_CFG_WORD11_ADDR A:0x1:0x66e22c
y.create.l HWIO_T_DBACK_NONHS_DRM_CFG_WORD12_ADDR A:0x1:0x66e230
y.create.l HWIO_T_DBACK_NONHS_DRM_CFG_WORD13_ADDR A:0x1:0x66e234
y.create.l HWIO_T_DBACK_NONHS_DRM_CFG_WORD14_ADDR A:0x1:0x66e238
y.create.l HWIO_T_DBACK_NONHS_DRM_CFG_WORD15_ADDR A:0x1:0x66e23c
y.create.l HWIO_T_DBACK_NONHS_DRM_CFG_WORD16_ADDR A:0x1:0x66e240
y.create.l HWIO_T_DBACK_NONHS_DRM_CFG_WORD17_ADDR A:0x1:0x66e244
y.create.l HWIO_T_DBACK_NONHS_DRM_CFG_WORD18_ADDR A:0x1:0x66e248
y.create.l HWIO_T_DBACK_NONHS_DRM_CFG_WORD19_ADDR A:0x1:0x66e24c
y.create.l HWIO_T_DBACK_NONHS_DRM_CFG_WORD20_ADDR A:0x1:0x66e250
y.create.l HWIO_T_DBACK_NONHS_DRM_CFG_WORD21_ADDR A:0x1:0x66e254
y.create.l HWIO_T_DBACK_NONHS_DRM_CFG_WORD22_ADDR A:0x1:0x66e258
y.create.l HWIO_T_DBACK_NONHS_DRM_CFG_WORD23_ADDR A:0x1:0x66e25c
y.create.l HWIO_T_DBACK_NONHS_DRM_CFG_WORD24_ADDR A:0x1:0x66e260
y.create.l HWIO_T_DBACK_NONHS_DRM_CFG_WORD25_ADDR A:0x1:0x66e264
y.create.l HWIO_T_DBACK_NONHS_TD_DECIB_WRITER_CFG_WORD0_ADDR A:0x1:0x66e300
y.create.l HWIO_T_DBACK_NONHS_TD_DECIB_WRITER_CFG_WORD1_ADDR A:0x1:0x66e304
y.create.l HWIO_T_DBACK_HS_TD_DECIB_WRITER_CFG_WORD0_ADDR A:0x1:0x66e400
y.create.l HWIO_T_DBACK_HS_TD_DECIB_WRITER_CFG_WORD1_ADDR A:0x1:0x66e404
y.create.l HWIO_T_DBACK_HS_TD_DECIB_WRITER_CFG_WORD2_ADDR A:0x1:0x66e408
y.create.l HWIO_T_DBACK_HS_TD_DECIB_WRITER_CFG_WORD3_ADDR A:0x1:0x66e40c
y.create.l HWIO_T_DBACK_HS_TD_DECIB_WRITER_CFG_WORD4_ADDR A:0x1:0x66e410
y.create.l HWIO_T_DBACK_HS_TD_DECIB_WRITER_CFG_WORD5_ADDR A:0x1:0x66e414
y.create.l HWIO_T_DBACK_HS_TD_DECIB_WRITER_CFG_WORD6_ADDR A:0x1:0x66e418
y.create.l HWIO_T_DBACK_HS_TD_DECIB_WRITER_CFG_WORD7_ADDR A:0x1:0x66e41c
y.create.l HWIO_HDR_DEINT_CFG_WORD0_ADDR A:0x1:0x66f100
y.create.l HWIO_HDR_DEINT_CFG_WORD1_ADDR A:0x1:0x66f104
y.create.l HWIO_HDR_DEINT_CFG_WORD2_ADDR A:0x1:0x66f108
y.create.l HWIO_HDR_DEINT_CFG_WORD3_ADDR A:0x1:0x66f10c
y.create.l HWIO_HDR_DEINT_CFG_WORD4_ADDR A:0x1:0x66f110
y.create.l HWIO_HDR_DEINT_CFG_WORD5_ADDR A:0x1:0x66f114
y.create.l HWIO_HDR_DEINT_CFG_WORD6_ADDR A:0x1:0x66f118
y.create.l HWIO_HDR_DEINT_CFG_WORD7_ADDR A:0x1:0x66f11c
y.create.l HWIO_HDR_DEINT_CFG_WORD8_ADDR A:0x1:0x66f120
y.create.l HWIO_HDR_DEINT_CFG_WORD9_ADDR A:0x1:0x66f124
y.create.l HWIO_HDR_DEINT_CFG_WORD10_ADDR A:0x1:0x66f128
y.create.l HWIO_HDR_DEINT_CFG_WORD11_ADDR A:0x1:0x66f12c
y.create.l HWIO_HDR_DEINT_CFG_WORD12_ADDR A:0x1:0x66f130
y.create.l HWIO_HDR_DEINT_CFG_WORD13_ADDR A:0x1:0x66f134
y.create.l HWIO_HDR_DEINT_CFG_WORD14_ADDR A:0x1:0x66f138
y.create.l HWIO_HDR_DEINT_CFG_WORD15_ADDR A:0x1:0x66f13c
y.create.l HWIO_HDR_DEINT_CFG_WORD16_ADDR A:0x1:0x66f140
y.create.l HWIO_HDR_DEINT_WORD0_ADDR A:0x1:0x66f200
y.create.l HWIO_HDR_DEINT_WORD1_ADDR A:0x1:0x66f204
y.create.l HWIO_HDR_DEINT_WORD2_ADDR A:0x1:0x66f208
y.create.l HWIO_HDR_DEINT_WORD3_ADDR A:0x1:0x66f20c
y.create.l HWIO_HDR_DEINT_WORD4_ADDR A:0x1:0x66f210
y.create.l HWIO_HDR_DEINT_WORD5_ADDR A:0x1:0x66f214
y.create.l HWIO_HDR_DEINT_WORD6_ADDR A:0x1:0x66f218
y.create.l HWIO_HDR_DEINT_WORD7_ADDR A:0x1:0x66f21c
y.create.l HWIO_HDR_DEINT_WORD8_ADDR A:0x1:0x66f220
y.create.l HWIO_HDR_DEINT_WORD9_ADDR A:0x1:0x66f224
y.create.l HWIO_HDR_DEINT_WORD10_ADDR A:0x1:0x66f228
y.create.l HWIO_HDR_DEINT_WORD11_ADDR A:0x1:0x66f22c
y.create.l HWIO_HDR_DEINT_WORD12_ADDR A:0x1:0x66f230
y.create.l HWIO_HDR_DEINT_WORD13_ADDR A:0x1:0x66f234
y.create.l HWIO_TBVD_CCH_STATUS_WORD0_ADDR A:0x1:0x670000
y.create.l HWIO_TBVD_CCH_LTE_CFG_WORD0_ADDR A:0x1:0x670100
y.create.l HWIO_TBVD_CCH_LTE_CFG_WORD1_ADDR A:0x1:0x670104
y.create.l HWIO_TBVD_CCH_LTE_CFG_WORD2_ADDR A:0x1:0x670108
y.create.l HWIO_TBVD_CCH_LTE_CFG_WORD3_ADDR A:0x1:0x67010c
y.create.l HWIO_TBVD_CCH_LTE_CFG_WORD4_ADDR A:0x1:0x670110
y.create.l HWIO_TBVD_CCH_LTE_CFG_WORD5_ADDR A:0x1:0x670114
y.create.l HWIO_TBVD_CCH_LTE_CFG_WORD6_ADDR A:0x1:0x670118
y.create.l HWIO_TBVD_CCH_LTE_CFG_WORD7_ADDR A:0x1:0x67011c
y.create.l HWIO_TBVD_CCH_LTE_CFG_WORD8_ADDR A:0x1:0x670120
y.create.l HWIO_TBVD_CCH_LTE_CFG_WORD9_ADDR A:0x1:0x670124
y.create.l HWIO_TBVD_CCH_LTE_CFG_WORD10_ADDR A:0x1:0x670128
y.create.l HWIO_TBVD_CCH_LTE_CFG_WORD11_ADDR A:0x1:0x67012c
y.create.l HWIO_TBVD_CCH_LTE_CFG_WORD12_ADDR A:0x1:0x670130
y.create.l HWIO_TBVD_CCH_LTE_CFG_WORD13_ADDR A:0x1:0x670134
y.create.l HWIO_TBVD_CCH_LTE_CFG_WORD14_ADDR A:0x1:0x670138
y.create.l HWIO_TBVD_CCH_LTE_CFG_WORD15_ADDR A:0x1:0x67013c
y.create.l HWIO_TBVD_CCH_LTE_CFG_WORD16_ADDR A:0x1:0x670140
y.create.l HWIO_TBVD_CCH_LTE_CFG_WORD17_ADDR A:0x1:0x670144
y.create.l HWIO_TBVD_CCH_LTE_CFG_WORD18_ADDR A:0x1:0x670148
y.create.l HWIO_TBVD_CCH_LTE_CFG_WORD19_ADDR A:0x1:0x67014c
y.create.l HWIO_TBVD_CCH_LTE_PDCCH_WORD0_ADDR A:0x1:0x670200
y.create.l HWIO_TBVD_CCH_LTE_PDCCH_WORD1_ADDR A:0x1:0x670204
y.create.l HWIO_TBVD_CCH_LTE_PDCCH_WORD2_ADDR A:0x1:0x670208
y.create.l HWIO_TBVD_CCH_LTE_PDCCH_WORD3_ADDR A:0x1:0x67020c
y.create.l HWIO_TBVD_CCH_LTE_PDCCH_WORD4_ADDR A:0x1:0x670210
y.create.l HWIO_TBVD_CCH_LTE_PDCCH_WORD5_ADDR A:0x1:0x670214
y.create.l HWIO_TBVD_CCH_LTE_PDCCH_WORD6_ADDR A:0x1:0x670218
y.create.l HWIO_DEC_O_CCH_W_NONHS_LTE_PBCH_WORD0_ADDR A:0x1:0x670300
y.create.l HWIO_DEC_O_CCH_W_NONHS_LTE_PBCH_WORD1_ADDR A:0x1:0x670304
y.create.l HWIO_DEC_O_CCH_W_NONHS_LTE_PBCH_WORD2_ADDR A:0x1:0x670308
y.create.l HWIO_DEMBACK_ENABLE_ADDR A:0x1:0x674000
y.create.l HWIO_DEMBACK_BUFF_MODE_ADDR A:0x1:0x674004
y.create.l HWIO_DEMBACK_BUFF_MEM_CMD_ADDR A:0x1:0x674010
y.create.l HWIO_DEMBACK_BUFF_MEM_WR_ADDR A:0x1:0x674014
y.create.l HWIO_DEMBACK_BUFF_MEM_RD_ADDR A:0x1:0x674018
y.create.l HWIO_DEMBACK_BUFF_TBVD_DECOB_RD_MIN_ADDR A:0x1:0x675000
y.create.l HWIO_DEMBACK_BUFF_TBVD_DECOB_RD_MAX_ADDR A:0x1:0x67577c
y.create.l HWIO_DEMBACK_BUFF_SVD_DECOB_RD_MIN_ADDR A:0x1:0x676000
y.create.l HWIO_DEMBACK_BUFF_SVD_DECOB_RD_MAX_ADDR A:0x1:0x676d7c
y.create.l HWIO_TDEC_CLK_CTL_DB1_ADDR A:0x1:0x680000
y.create.l HWIO_TDEC_SW_CLK_EN_DB1_ADDR A:0x1:0x680004
y.create.l HWIO_TDEC_CLK_STATUS_REG_DB1_ADDR A:0x1:0x680008
y.create.l HWIO_TDEC_MODE_CTL_DB1_ADDR A:0x1:0x68000c
y.create.l HWIO_TDECIB_CLK_CTL_DB1_ADDR A:0x1:0x680010
y.create.l HWIO_TDECIB_SW_CLK_EN_DB1_ADDR A:0x1:0x680014
y.create.l HWIO_TDECIB_CLK_STATUS_DB1_ADDR A:0x1:0x680018
y.create.l HWIO_TD_COMMON_CFG0_DB1_ADDR A:0x1:0x680020
y.create.l HWIO_TD_COMMON_CFG1_DB1_ADDR A:0x1:0x680024
y.create.l HWIO_TD_COMMON_CFG2_DB1_ADDR A:0x1:0x680028
y.create.l HWIO_TD_COMMON_CFG3_DB1_ADDR A:0x1:0x68002c
y.create.l HWIO_TD_COMMON_CFG4_DB1_ADDR A:0x1:0x680030
y.create.l HWIO_TD_COMMON_CFG5_DB1_ADDR A:0x1:0x680034
y.create.l HWIO_TD_COMMON_START_DB1_ADDR A:0x1:0x680038
y.create.l HWIO_TD_1X_CFG_DB1_ADDR A:0x1:0x68003c
y.create.l HWIO_TD_1X_DECOB_WRITE_PTR_DB1_ADDR A:0x1:0x680040
y.create.l HWIO_TDEC_HW_IDLE_DB1_ADDR A:0x1:0x680044
y.create.l HWIO_TDEC_PING_STATUS_0_DB1_ADDR A:0x1:0x680048
y.create.l HWIO_TDEC_PING_STATUS_1_DB1_ADDR A:0x1:0x68004c
y.create.l HWIO_TDEC_PONG_STATUS_0_DB1_ADDR A:0x1:0x680050
y.create.l HWIO_TDEC_PONG_STATUS_1_DB1_ADDR A:0x1:0x680054
y.create.l HWIO_TDEC_GERAN_STATUS_0_DB1_ADDR A:0x1:0x680058
y.create.l HWIO_TDEC_GERAN_STATUS_1_DB1_ADDR A:0x1:0x68005c
y.create.l HWIO_TDEC_TESTBUS_ENABLE_DB1_ADDR A:0x1:0x680060
y.create.l HWIO_TDEC_TESTBUS_STATUS_DB1_ADDR A:0x1:0x680064
y.create.l HWIO_DECIB_PAGE_ID_DB1_ADDR A:0x1:0x680068
y.create.l HWIO_TDEC_AHB_ERROR_ADDR_RD_DB1_ADDR A:0x1:0x680070
y.create.l HWIO_TEST_CRC_000_RD_DB1_ADDR A:0x1:0x680074
y.create.l HWIO_TEST_CRC_001_RD_DB1_ADDR A:0x1:0x680078
y.create.l HWIO_TEST_CRC_010_RD_DB1_ADDR A:0x1:0x68007c
y.create.l HWIO_TEST_CRC_011_RD_DB1_ADDR A:0x1:0x680080
y.create.l HWIO_TEST_CRC_100_RD_DB1_ADDR A:0x1:0x680084
y.create.l HWIO_TEST_CRC_101_RD_DB1_ADDR A:0x1:0x680088
y.create.l HWIO_TEST_CRC_110_RD_DB1_ADDR A:0x1:0x68008c
y.create.l HWIO_TEST_CRC_111_RD_DB1_ADDR A:0x1:0x680090
y.create.l HWIO_A2_TEST_SW_CFG_DATA0_DB1_ADDR A:0x1:0x680094
y.create.l HWIO_A2_TEST_SW_CFG_DATA1_DB1_ADDR A:0x1:0x680098
y.create.l HWIO_A2_TEST_SW_CFG_DATA2_DB1_ADDR A:0x1:0x68009c
y.create.l HWIO_A2_TEST_SW_CFG_DATA3_DB1_ADDR A:0x1:0x6800a0
y.create.l HWIO_A2_TEST_SW_CFG_DATA4_DB1_ADDR A:0x1:0x6800a4
y.create.l HWIO_TD_CFG_STATUS_WORD0_DB1_ADDR A:0x1:0x681000
y.create.l HWIO_LTE_CFG_WORD0_DB1_ADDR A:0x1:0x681100
y.create.l HWIO_LTE_CFG_WORD1_DB1_ADDR A:0x1:0x681104
y.create.l HWIO_LTE_CFG_WORD2_DB1_ADDR A:0x1:0x681108
y.create.l HWIO_W_TD_CFG_WORD0_0_DB1_ADDR A:0x1:0x681200
y.create.l HWIO_W_TD_CFG_WORD1_0_DB1_ADDR A:0x1:0x681204
y.create.l HWIO_W_TD_CFG_WORD2_0_DB1_ADDR A:0x1:0x681208
y.create.l HWIO_W_TD_CFG_WORD3_0_DB1_ADDR A:0x1:0x68120c
y.create.l HWIO_W_TD_CFG_WORD4_0_DB1_ADDR A:0x1:0x681210
y.create.l HWIO_W_TD_CFG_WORD5_0_DB1_ADDR A:0x1:0x681214
y.create.l HWIO_W_TD_CFG_WORD6_0_DB1_ADDR A:0x1:0x681218
y.create.l HWIO_W_TD_CFG_WORD7_0_DB1_ADDR A:0x1:0x68121c
y.create.l HWIO_W_TD_CFG_WORD8_0_DB1_ADDR A:0x1:0x681220
y.create.l HWIO_W_TD_CFG_WORD9_0_DB1_ADDR A:0x1:0x681224
y.create.l HWIO_W_TD_CFG_WORD0_1_DB1_ADDR A:0x1:0x681300
y.create.l HWIO_W_TD_CFG_WORD1_1_DB1_ADDR A:0x1:0x681304
y.create.l HWIO_W_TD_CFG_WORD2_1_DB1_ADDR A:0x1:0x681308
y.create.l HWIO_W_TD_CFG_WORD3_1_DB1_ADDR A:0x1:0x68130c
y.create.l HWIO_W_TD_CFG_WORD4_1_DB1_ADDR A:0x1:0x681310
y.create.l HWIO_W_TD_CFG_WORD5_1_DB1_ADDR A:0x1:0x681314
y.create.l HWIO_W_TD_CFG_WORD6_1_DB1_ADDR A:0x1:0x681318
y.create.l HWIO_W_TD_CFG_WORD7_1_DB1_ADDR A:0x1:0x68131c
y.create.l HWIO_W_TD_CFG_WORD8_1_DB1_ADDR A:0x1:0x681320
y.create.l HWIO_W_TD_CFG_WORD9_1_DB1_ADDR A:0x1:0x681324
y.create.l HWIO_LTE_TRBLK_CFG_WORD0_0_DB1_ADDR A:0x1:0x681400
y.create.l HWIO_LTE_TRBLK_CFG_WORD1_0_DB1_ADDR A:0x1:0x681404
y.create.l HWIO_LTE_TRBLK_CFG_WORD2_0_DB1_ADDR A:0x1:0x681408
y.create.l HWIO_LTE_TRBLK_CFG_WORD3_0_DB1_ADDR A:0x1:0x68140c
y.create.l HWIO_LTE_TRBLK_CFG_WORD4_0_DB1_ADDR A:0x1:0x681410
y.create.l HWIO_LTE_TRBLK_CFG_WORD5_0_DB1_ADDR A:0x1:0x681414
y.create.l HWIO_LTE_TRBLK_CFG_WORD0_1_DB1_ADDR A:0x1:0x681500
y.create.l HWIO_LTE_TRBLK_CFG_WORD1_1_DB1_ADDR A:0x1:0x681504
y.create.l HWIO_LTE_TRBLK_CFG_WORD2_1_DB1_ADDR A:0x1:0x681508
y.create.l HWIO_LTE_TRBLK_CFG_WORD3_1_DB1_ADDR A:0x1:0x68150c
y.create.l HWIO_LTE_TRBLK_CFG_WORD4_1_DB1_ADDR A:0x1:0x681510
y.create.l HWIO_LTE_TRBLK_CFG_WORD5_1_DB1_ADDR A:0x1:0x681514
y.create.l HWIO_GERAN_TD_CFG_WORD0_0_DB1_ADDR A:0x1:0x681600
y.create.l HWIO_GERAN_TD_CFG_WORD1_0_DB1_ADDR A:0x1:0x681604
y.create.l HWIO_GERAN_TD_CFG_WORD2_0_DB1_ADDR A:0x1:0x681608
y.create.l HWIO_GERAN_TD_CFG_WORD3_0_DB1_ADDR A:0x1:0x68160c
y.create.l HWIO_GERAN_TD_CFG_WORD0_1_DB1_ADDR A:0x1:0x681700
y.create.l HWIO_GERAN_TD_CFG_WORD1_1_DB1_ADDR A:0x1:0x681704
y.create.l HWIO_GERAN_TD_CFG_WORD2_1_DB1_ADDR A:0x1:0x681708
y.create.l HWIO_GERAN_TD_CFG_WORD3_1_DB1_ADDR A:0x1:0x68170c
y.create.l HWIO_HDR_TD_CFG_WORD0_0_DB1_ADDR A:0x1:0x681800
y.create.l HWIO_HDR_TD_CFG_WORD1_0_DB1_ADDR A:0x1:0x681804
y.create.l HWIO_HDR_TD_CFG_WORD2_0_DB1_ADDR A:0x1:0x681808
y.create.l HWIO_HDR_TD_CFG_WORD0_1_DB1_ADDR A:0x1:0x681900
y.create.l HWIO_HDR_TD_CFG_WORD1_1_DB1_ADDR A:0x1:0x681904
y.create.l HWIO_HDR_TD_CFG_WORD2_1_DB1_ADDR A:0x1:0x681908
y.create.l HWIO_TD_STATUS_WORD0_DB1_ADDR A:0x1:0x682000
y.create.l HWIO_W_TD_WORD0_0_DB1_ADDR A:0x1:0x682100
y.create.l HWIO_W_TD_WORD0_1_DB1_ADDR A:0x1:0x682200
y.create.l HWIO_LTE_PDSCH_WORD0_0_DB1_ADDR A:0x1:0x682300
y.create.l HWIO_LTE_PDSCH_WORD1_0_DB1_ADDR A:0x1:0x682304
y.create.l HWIO_LTE_PDSCH_WORD2_0_DB1_ADDR A:0x1:0x682308
y.create.l HWIO_LTE_PDSCH_WORD0_1_DB1_ADDR A:0x1:0x682400
y.create.l HWIO_LTE_PDSCH_WORD1_1_DB1_ADDR A:0x1:0x682404
y.create.l HWIO_LTE_PDSCH_WORD2_1_DB1_ADDR A:0x1:0x682408
y.create.l HWIO_GERAN_TD_WORD0_0_DB1_ADDR A:0x1:0x682500
y.create.l HWIO_GERAN_TD_WORD1_0_DB1_ADDR A:0x1:0x682504
y.create.l HWIO_GERAN_TD_WORD2_0_DB1_ADDR A:0x1:0x682508
y.create.l HWIO_GERAN_TD_WORD3_0_DB1_ADDR A:0x1:0x68250c
y.create.l HWIO_GERAN_TD_WORD4_0_DB1_ADDR A:0x1:0x682510
y.create.l HWIO_GERAN_TD_WORD5_0_DB1_ADDR A:0x1:0x682514
y.create.l HWIO_GERAN_TD_WORD6_0_DB1_ADDR A:0x1:0x682518
y.create.l HWIO_GERAN_TD_WORD0_1_DB1_ADDR A:0x1:0x682600
y.create.l HWIO_GERAN_TD_WORD1_1_DB1_ADDR A:0x1:0x682604
y.create.l HWIO_GERAN_TD_WORD2_1_DB1_ADDR A:0x1:0x682608
y.create.l HWIO_GERAN_TD_WORD3_1_DB1_ADDR A:0x1:0x68260c
y.create.l HWIO_GERAN_TD_WORD4_1_DB1_ADDR A:0x1:0x682610
y.create.l HWIO_GERAN_TD_WORD5_1_DB1_ADDR A:0x1:0x682614
y.create.l HWIO_GERAN_TD_WORD6_1_DB1_ADDR A:0x1:0x682618
y.create.l HWIO_HDR_TD_WORD0_0_DB1_ADDR A:0x1:0x682700
y.create.l HWIO_HDR_TD_WORD1_0_DB1_ADDR A:0x1:0x682704
y.create.l HWIO_HDR_TD_WORD2_0_DB1_ADDR A:0x1:0x682708
y.create.l HWIO_HDR_TD_WORD3_0_DB1_ADDR A:0x1:0x68270c
y.create.l HWIO_HDR_TD_WORD4_0_DB1_ADDR A:0x1:0x682710
y.create.l HWIO_HDR_TD_WORD5_0_DB1_ADDR A:0x1:0x682714
y.create.l HWIO_HDR_TD_WORD0_1_DB1_ADDR A:0x1:0x682800
y.create.l HWIO_HDR_TD_WORD1_1_DB1_ADDR A:0x1:0x682804
y.create.l HWIO_HDR_TD_WORD2_1_DB1_ADDR A:0x1:0x682808
y.create.l HWIO_HDR_TD_WORD3_1_DB1_ADDR A:0x1:0x68280c
y.create.l HWIO_HDR_TD_WORD4_1_DB1_ADDR A:0x1:0x682810
y.create.l HWIO_HDR_TD_WORD5_1_DB1_ADDR A:0x1:0x682814
y.create.l HWIO_TDECIB_MEM_START_DB1_ADDR A:0x1:0x683000
y.create.l HWIO_TDECIB_MEM_END_DB1_ADDR A:0x1:0x683ffc
y.create.l HWIO_DEMBACK_EN_DB1_ADDR A:0x1:0x6a0000
y.create.l HWIO_DEMBACK_MODE_SEL_DB1_ADDR A:0x1:0x6a0004
y.create.l HWIO_DEMBACK_AHB_ERR_DB1_ADDR A:0x1:0x6a0008
y.create.l HWIO_DEMBACK_MM_RDR0_CFG0_DB1_ADDR A:0x1:0x6a1000
y.create.l HWIO_DEMBACK_MM_RDR1_CFG0_DB1_ADDR A:0x1:0x6a100c
y.create.l HWIO_DEMBACK_MM_RDR2_CFG0_DB1_ADDR A:0x1:0x6a1018
y.create.l HWIO_DEMBACK_MM_RDR0_CFG1_DB1_ADDR A:0x1:0x6a1004
y.create.l HWIO_DEMBACK_MM_RDR1_CFG1_DB1_ADDR A:0x1:0x6a1010
y.create.l HWIO_DEMBACK_MM_RDR2_CFG1_DB1_ADDR A:0x1:0x6a101c
y.create.l HWIO_DEMBACK_MM_RDR0_XFER_CTL_DB1_ADDR A:0x1:0x6a1008
y.create.l HWIO_DEMBACK_MM_RDR1_XFER_CTL_DB1_ADDR A:0x1:0x6a1014
y.create.l HWIO_DEMBACK_MM_RDR2_XFER_CTL_DB1_ADDR A:0x1:0x6a1020
y.create.l HWIO_DEMBACK_RDR3_CFG0_DB1_ADDR A:0x1:0x6a1024
y.create.l HWIO_DEMBACK_RDR3_CFG1_DB1_ADDR A:0x1:0x6a1028
y.create.l HWIO_DEMBACK_RDR3_XFER_CTL_DB1_ADDR A:0x1:0x6a102c
y.create.l HWIO_DEMBACK_NN_RDR0_CFG0_DB1_ADDR A:0x1:0x6a1030
y.create.l HWIO_DEMBACK_NN_RDR1_CFG0_DB1_ADDR A:0x1:0x6a103c
y.create.l HWIO_DEMBACK_NN_RDR0_CFG1_DB1_ADDR A:0x1:0x6a1034
y.create.l HWIO_DEMBACK_NN_RDR1_CFG1_DB1_ADDR A:0x1:0x6a1040
y.create.l HWIO_DEMBACK_NN_RDR0_XFER_CTL_DB1_ADDR A:0x1:0x6a1038
y.create.l HWIO_DEMBACK_NN_RDR1_XFER_CTL_DB1_ADDR A:0x1:0x6a1044
y.create.l HWIO_DEMBACK_NN_RDR2_CFG0_DB1_ADDR A:0x1:0x6a1048
y.create.l HWIO_DEMBACK_NN_RDR2_CFG1_DB1_ADDR A:0x1:0x6a104c
y.create.l HWIO_DEMBACK_NN_RDR2_XFER_CTL_DB1_ADDR A:0x1:0x6a1050
y.create.l HWIO_DEMBACK_NN_RDR3_CFG0_DB1_ADDR A:0x1:0x6a1054
y.create.l HWIO_DEMBACK_NN_RDR3_CFG1_DB1_ADDR A:0x1:0x6a1058
y.create.l HWIO_DEMBACK_NN_RDR3_XFER_CTL_DB1_ADDR A:0x1:0x6a105c
y.create.l HWIO_DEMBACK_WRTR0_CFG0_DB1_ADDR A:0x1:0x6a1060
y.create.l HWIO_DEMBACK_WRTR1_CFG0_DB1_ADDR A:0x1:0x6a106c
y.create.l HWIO_DEMBACK_WRTR0_CFG1_DB1_ADDR A:0x1:0x6a1064
y.create.l HWIO_DEMBACK_WRTR1_CFG1_DB1_ADDR A:0x1:0x6a1070
y.create.l HWIO_DEMBACK_WRTR0_XFER_CTL_DB1_ADDR A:0x1:0x6a1068
y.create.l HWIO_DEMBACK_WRTR1_XFER_CTL_DB1_ADDR A:0x1:0x6a1074
y.create.l HWIO_DEMBACK_WRTR2_CFG0_DB1_ADDR A:0x1:0x6a1078
y.create.l HWIO_DEMBACK_WRTR2_CFG1_DB1_ADDR A:0x1:0x6a107c
y.create.l HWIO_DEMBACK_WRTR2_XFER_CTL_DB1_ADDR A:0x1:0x6a1080
y.create.l HWIO_DEMBACK_WRTR3_CFG0_DB1_ADDR A:0x1:0x6a1084
y.create.l HWIO_DEMBACK_WRTR3_CFG1_DB1_ADDR A:0x1:0x6a1088
y.create.l HWIO_DEMBACK_WRTR3_XFER_CTL_DB1_ADDR A:0x1:0x6a108c
y.create.l HWIO_DEMBACK_BRDG_CTL_DB1_ADDR A:0x1:0x6a1090
y.create.l HWIO_DEMBACK_BRDG_STATUS_DB1_ADDR A:0x1:0x6a1094
y.create.l HWIO_DEMBACK_BRDG_CLEAR_DB1_ADDR A:0x1:0x6a1098
y.create.l HWIO_DEMBACK_DBG_CFG0_DB1_ADDR A:0x1:0x6a109c
y.create.l HWIO_DEMBACK_DBG_CFG1_DB1_ADDR A:0x1:0x6a10a0
y.create.l HWIO_DEMBACK_DBG_CTL_DB1_ADDR A:0x1:0x6a10a4
y.create.l HWIO_DEMBACK_DBG_MATCH_MASK0_DB1_ADDR A:0x1:0x6a10a8
y.create.l HWIO_DEMBACK_DBG_MATCH_MASK1_DB1_ADDR A:0x1:0x6a10ac
y.create.l HWIO_DEMBACK_DBG_MATCH_PATTERN0_DB1_ADDR A:0x1:0x6a10b0
y.create.l HWIO_DEMBACK_DBG_MATCH_PATTERN1_DB1_ADDR A:0x1:0x6a10b4
y.create.l HWIO_DEMBACK_DBG_TRACE_LEN_DB1_ADDR A:0x1:0x6a10b8
y.create.l HWIO_DEMBACK_DBG_WINDOW_LEN_DB1_ADDR A:0x1:0x6a10bc
y.create.l HWIO_DEMBACK_DBG_TRIGGER_LEN_DB1_ADDR A:0x1:0x6a10c0
y.create.l HWIO_LTE_DBE_PHICH_STATUS_DB1_ADDR A:0x1:0x6a2000
y.create.l HWIO_LTE_DBE_PCFICH_STATUS_DB1_ADDR A:0x1:0x6a2004
y.create.l HWIO_LTE_DBE_SCRAMBLE_SEED_FF_X1_SEED_DB1_ADDR A:0x1:0x6a2008
y.create.l HWIO_LTE_DBE_TESTBUS_ENABLE_DB1_ADDR A:0x1:0x6a200c
y.create.l HWIO_LTE_DBE_TESTBUS_STATUS_DB1_ADDR A:0x1:0x6a2010
y.create.l HWIO_LTE_DBE_PBCH_CMD_COUNT_DB1_ADDR A:0x1:0x6a2014
y.create.l HWIO_LTE_DBE_PDCCH_CMD_COUNT_DB1_ADDR A:0x1:0x6a2018
y.create.l HWIO_LTE_DBE_PDSCH_CMD_COUNT_DB1_ADDR A:0x1:0x6a201c
y.create.l HWIO_LTE_DBE_PBCH_DONE_COUNT_DB1_ADDR A:0x1:0x6a2020
y.create.l HWIO_LTE_DBE_PDCCH_DONE_COUNT_DB1_ADDR A:0x1:0x6a2024
y.create.l HWIO_LTE_DBE_PDSCH_DONE_COUNT_DB1_ADDR A:0x1:0x6a2028
y.create.l HWIO_TESTBUS_ENABLE_DB1_ADDR A:0x1:0x6a3000
y.create.l HWIO_TESTBUS_STATUS_DB1_ADDR A:0x1:0x6a3004
y.create.l HWIO_DBACK_AMP_EST0_0_DB1_ADDR A:0x1:0x6a4000
y.create.l HWIO_DBACK_AMP_EST0_1_DB1_ADDR A:0x1:0x6a4008
y.create.l HWIO_DBACK_AMP_EST0_2_DB1_ADDR A:0x1:0x6a4010
y.create.l HWIO_DBACK_AMP_EST0_3_DB1_ADDR A:0x1:0x6a4018
y.create.l HWIO_DBACK_AMP_EST0_4_DB1_ADDR A:0x1:0x6a4020
y.create.l HWIO_DBACK_AMP_EST0_5_DB1_ADDR A:0x1:0x6a4028
y.create.l HWIO_DBACK_ENG_EST0_0_DB1_ADDR A:0x1:0x6a4004
y.create.l HWIO_DBACK_ENG_EST0_1_DB1_ADDR A:0x1:0x6a400c
y.create.l HWIO_DBACK_ENG_EST0_2_DB1_ADDR A:0x1:0x6a4014
y.create.l HWIO_DBACK_ENG_EST0_3_DB1_ADDR A:0x1:0x6a401c
y.create.l HWIO_DBACK_ENG_EST0_4_DB1_ADDR A:0x1:0x6a4024
y.create.l HWIO_DBACK_ENG_EST0_5_DB1_ADDR A:0x1:0x6a402c
y.create.l HWIO_DBACK_AMP_EST1_0_DB1_ADDR A:0x1:0x6a4030
y.create.l HWIO_DBACK_AMP_EST1_1_DB1_ADDR A:0x1:0x6a4038
y.create.l HWIO_DBACK_AMP_EST1_2_DB1_ADDR A:0x1:0x6a4040
y.create.l HWIO_DBACK_AMP_EST1_3_DB1_ADDR A:0x1:0x6a4048
y.create.l HWIO_DBACK_AMP_EST1_4_DB1_ADDR A:0x1:0x6a4050
y.create.l HWIO_DBACK_AMP_EST1_5_DB1_ADDR A:0x1:0x6a4058
y.create.l HWIO_DBACK_ENG_EST1_0_DB1_ADDR A:0x1:0x6a4034
y.create.l HWIO_DBACK_ENG_EST1_1_DB1_ADDR A:0x1:0x6a403c
y.create.l HWIO_DBACK_ENG_EST1_2_DB1_ADDR A:0x1:0x6a4044
y.create.l HWIO_DBACK_ENG_EST1_3_DB1_ADDR A:0x1:0x6a404c
y.create.l HWIO_DBACK_ENG_EST1_4_DB1_ADDR A:0x1:0x6a4054
y.create.l HWIO_DBACK_ENG_EST1_5_DB1_ADDR A:0x1:0x6a405c
y.create.l HWIO_DBACK_HS_CH0_PART1_DEC_DATA0_DB1_ADDR A:0x1:0x6a4060
y.create.l HWIO_DBACK_HS_CH1_PART1_DEC_DATA0_DB1_ADDR A:0x1:0x6a406c
y.create.l HWIO_DBACK_HS_CH2_PART1_DEC_DATA0_DB1_ADDR A:0x1:0x6a4078
y.create.l HWIO_DBACK_HS_CH3_PART1_DEC_DATA0_DB1_ADDR A:0x1:0x6a4084
y.create.l HWIO_DBACK_HS_CH4_PART1_DEC_DATA0_DB1_ADDR A:0x1:0x6a4090
y.create.l HWIO_DBACK_HS_CH5_PART1_DEC_DATA0_DB1_ADDR A:0x1:0x6a409c
y.create.l HWIO_DBACK_HS_CH6_PART1_DEC_DATA0_DB1_ADDR A:0x1:0x6a40a8
y.create.l HWIO_DBACK_HS_CH7_PART1_DEC_DATA0_DB1_ADDR A:0x1:0x6a40b4
y.create.l HWIO_DBACK_HS_CH8_PART1_DEC_DATA0_DB1_ADDR A:0x1:0x6a40c0
y.create.l HWIO_DBACK_HS_CH9_PART1_DEC_DATA0_DB1_ADDR A:0x1:0x6a40cc
y.create.l HWIO_DBACK_HS_CH0_PART1_DEC_STAT_DB1_ADDR A:0x1:0x6a4064
y.create.l HWIO_DBACK_HS_CH1_PART1_DEC_STAT_DB1_ADDR A:0x1:0x6a4070
y.create.l HWIO_DBACK_HS_CH2_PART1_DEC_STAT_DB1_ADDR A:0x1:0x6a407c
y.create.l HWIO_DBACK_HS_CH3_PART1_DEC_STAT_DB1_ADDR A:0x1:0x6a4088
y.create.l HWIO_DBACK_HS_CH4_PART1_DEC_STAT_DB1_ADDR A:0x1:0x6a4094
y.create.l HWIO_DBACK_HS_CH5_PART1_DEC_STAT_DB1_ADDR A:0x1:0x6a40a0
y.create.l HWIO_DBACK_HS_CH6_PART1_DEC_STAT_DB1_ADDR A:0x1:0x6a40ac
y.create.l HWIO_DBACK_HS_CH7_PART1_DEC_STAT_DB1_ADDR A:0x1:0x6a40b8
y.create.l HWIO_DBACK_HS_CH8_PART1_DEC_STAT_DB1_ADDR A:0x1:0x6a40c4
y.create.l HWIO_DBACK_HS_CH9_PART1_DEC_STAT_DB1_ADDR A:0x1:0x6a40d0
y.create.l HWIO_DBACK_HS_CH0_SLOT1_AE_EST_DB1_ADDR A:0x1:0x6a4068
y.create.l HWIO_DBACK_HS_CH1_SLOT1_AE_EST_DB1_ADDR A:0x1:0x6a4074
y.create.l HWIO_DBACK_HS_CH2_SLOT1_AE_EST_DB1_ADDR A:0x1:0x6a4080
y.create.l HWIO_DBACK_HS_CH3_SLOT1_AE_EST_DB1_ADDR A:0x1:0x6a408c
y.create.l HWIO_DBACK_HS_CH4_SLOT1_AE_EST_DB1_ADDR A:0x1:0x6a4098
y.create.l HWIO_DBACK_HS_CH5_SLOT1_AE_EST_DB1_ADDR A:0x1:0x6a40a4
y.create.l HWIO_DBACK_HS_CH6_SLOT1_AE_EST_DB1_ADDR A:0x1:0x6a40b0
y.create.l HWIO_DBACK_HS_CH7_SLOT1_AE_EST_DB1_ADDR A:0x1:0x6a40bc
y.create.l HWIO_DBACK_HS_CH8_SLOT1_AE_EST_DB1_ADDR A:0x1:0x6a40c8
y.create.l HWIO_DBACK_HS_CH9_SLOT1_AE_EST_DB1_ADDR A:0x1:0x6a40d4
y.create.l HWIO_DBACK_HS_CH0_PART2_DEC_DATA1_DB1_ADDR A:0x1:0x6a40d8
y.create.l HWIO_DBACK_HS_CH1_PART2_DEC_DATA1_DB1_ADDR A:0x1:0x6a40e8
y.create.l HWIO_DBACK_HS_CH2_PART2_DEC_DATA1_DB1_ADDR A:0x1:0x6a40f8
y.create.l HWIO_DBACK_HS_CH3_PART2_DEC_DATA1_DB1_ADDR A:0x1:0x6a4108
y.create.l HWIO_DBACK_HS_CH4_PART2_DEC_DATA1_DB1_ADDR A:0x1:0x6a4118
y.create.l HWIO_DBACK_HS_CH5_PART2_DEC_DATA1_DB1_ADDR A:0x1:0x6a4128
y.create.l HWIO_DBACK_HS_CH6_PART2_DEC_DATA1_DB1_ADDR A:0x1:0x6a4138
y.create.l HWIO_DBACK_HS_CH7_PART2_DEC_DATA1_DB1_ADDR A:0x1:0x6a4148
y.create.l HWIO_DBACK_HS_CH8_PART2_DEC_DATA1_DB1_ADDR A:0x1:0x6a4158
y.create.l HWIO_DBACK_HS_CH9_PART2_DEC_DATA1_DB1_ADDR A:0x1:0x6a4168
y.create.l HWIO_DBACK_HS_CH0_PART2_DEC_STAT_DB1_ADDR A:0x1:0x6a40dc
y.create.l HWIO_DBACK_HS_CH1_PART2_DEC_STAT_DB1_ADDR A:0x1:0x6a40ec
y.create.l HWIO_DBACK_HS_CH2_PART2_DEC_STAT_DB1_ADDR A:0x1:0x6a40fc
y.create.l HWIO_DBACK_HS_CH3_PART2_DEC_STAT_DB1_ADDR A:0x1:0x6a410c
y.create.l HWIO_DBACK_HS_CH4_PART2_DEC_STAT_DB1_ADDR A:0x1:0x6a411c
y.create.l HWIO_DBACK_HS_CH5_PART2_DEC_STAT_DB1_ADDR A:0x1:0x6a412c
y.create.l HWIO_DBACK_HS_CH6_PART2_DEC_STAT_DB1_ADDR A:0x1:0x6a413c
y.create.l HWIO_DBACK_HS_CH7_PART2_DEC_STAT_DB1_ADDR A:0x1:0x6a414c
y.create.l HWIO_DBACK_HS_CH8_PART2_DEC_STAT_DB1_ADDR A:0x1:0x6a415c
y.create.l HWIO_DBACK_HS_CH9_PART2_DEC_STAT_DB1_ADDR A:0x1:0x6a416c
y.create.l HWIO_DBACK_HS_CH0_SLOT2_AE_EST_DB1_ADDR A:0x1:0x6a40e0
y.create.l HWIO_DBACK_HS_CH1_SLOT2_AE_EST_DB1_ADDR A:0x1:0x6a40f0
y.create.l HWIO_DBACK_HS_CH2_SLOT2_AE_EST_DB1_ADDR A:0x1:0x6a4100
y.create.l HWIO_DBACK_HS_CH3_SLOT2_AE_EST_DB1_ADDR A:0x1:0x6a4110
y.create.l HWIO_DBACK_HS_CH4_SLOT2_AE_EST_DB1_ADDR A:0x1:0x6a4120
y.create.l HWIO_DBACK_HS_CH5_SLOT2_AE_EST_DB1_ADDR A:0x1:0x6a4130
y.create.l HWIO_DBACK_HS_CH6_SLOT2_AE_EST_DB1_ADDR A:0x1:0x6a4140
y.create.l HWIO_DBACK_HS_CH7_SLOT2_AE_EST_DB1_ADDR A:0x1:0x6a4150
y.create.l HWIO_DBACK_HS_CH8_SLOT2_AE_EST_DB1_ADDR A:0x1:0x6a4160
y.create.l HWIO_DBACK_HS_CH9_SLOT2_AE_EST_DB1_ADDR A:0x1:0x6a4170
y.create.l HWIO_DBACK_HS_CH0_SLOT3_AE_EST_DB1_ADDR A:0x1:0x6a40e4
y.create.l HWIO_DBACK_HS_CH1_SLOT3_AE_EST_DB1_ADDR A:0x1:0x6a40f4
y.create.l HWIO_DBACK_HS_CH2_SLOT3_AE_EST_DB1_ADDR A:0x1:0x6a4104
y.create.l HWIO_DBACK_HS_CH3_SLOT3_AE_EST_DB1_ADDR A:0x1:0x6a4114
y.create.l HWIO_DBACK_HS_CH4_SLOT3_AE_EST_DB1_ADDR A:0x1:0x6a4124
y.create.l HWIO_DBACK_HS_CH5_SLOT3_AE_EST_DB1_ADDR A:0x1:0x6a4134
y.create.l HWIO_DBACK_HS_CH6_SLOT3_AE_EST_DB1_ADDR A:0x1:0x6a4144
y.create.l HWIO_DBACK_HS_CH7_SLOT3_AE_EST_DB1_ADDR A:0x1:0x6a4154
y.create.l HWIO_DBACK_HS_CH8_SLOT3_AE_EST_DB1_ADDR A:0x1:0x6a4164
y.create.l HWIO_DBACK_HS_CH9_SLOT3_AE_EST_DB1_ADDR A:0x1:0x6a4174
y.create.l HWIO_DBACK_EAGCH_DEC_DATA_DB1_ADDR A:0x1:0x6a4178
y.create.l HWIO_DBACK_EAGCH_DEC_STAT_DB1_ADDR A:0x1:0x6a417c
y.create.l HWIO_DBACK_EAGCH_METRIC_DB1_ADDR A:0x1:0x6a4180
y.create.l HWIO_DBACK_HSSCCH_CTL1_DB1_ADDR A:0x1:0x6a4184
y.create.l HWIO_DBACK_HSSCCH_CTL2_DB1_ADDR A:0x1:0x6a4188
y.create.l HWIO_HS_SCCH_PART2_DECODE_MAP_DB1_ADDR A:0x1:0x6a418c
y.create.l HWIO_DBACK_CH0_UEID_MASK_0_DB1_ADDR A:0x1:0x6a4190
y.create.l HWIO_DBACK_CH1_UEID_MASK_0_DB1_ADDR A:0x1:0x6a4194
y.create.l HWIO_DBACK_CH2_UEID_MASK_0_DB1_ADDR A:0x1:0x6a4198
y.create.l HWIO_DBACK_CH3_UEID_MASK_0_DB1_ADDR A:0x1:0x6a419c
y.create.l HWIO_DBACK_CH4_UEID_MASK_0_DB1_ADDR A:0x1:0x6a41a0
y.create.l HWIO_DBACK_CH5_UEID_MASK_0_DB1_ADDR A:0x1:0x6a41a4
y.create.l HWIO_DBACK_CH6_UEID_MASK_0_DB1_ADDR A:0x1:0x6a41a8
y.create.l HWIO_DBACK_CH7_UEID_MASK_0_DB1_ADDR A:0x1:0x6a41ac
y.create.l HWIO_DBACK_CH8_UEID_MASK_0_DB1_ADDR A:0x1:0x6a41b0
y.create.l HWIO_DBACK_CH9_UEID_MASK_0_DB1_ADDR A:0x1:0x6a41b4
y.create.l HWIO_DBACK_CH0_UEID_MASK_1_DB1_ADDR A:0x1:0x6a41b8
y.create.l HWIO_DBACK_CH1_UEID_MASK_1_DB1_ADDR A:0x1:0x6a41bc
y.create.l HWIO_DBACK_CH2_UEID_MASK_1_DB1_ADDR A:0x1:0x6a41c0
y.create.l HWIO_DBACK_CH3_UEID_MASK_1_DB1_ADDR A:0x1:0x6a41c4
y.create.l HWIO_DBACK_CH4_UEID_MASK_1_DB1_ADDR A:0x1:0x6a41c8
y.create.l HWIO_DBACK_CH5_UEID_MASK_1_DB1_ADDR A:0x1:0x6a41cc
y.create.l HWIO_DBACK_CH6_UEID_MASK_1_DB1_ADDR A:0x1:0x6a41d0
y.create.l HWIO_DBACK_CH7_UEID_MASK_1_DB1_ADDR A:0x1:0x6a41d4
y.create.l HWIO_DBACK_CH8_UEID_MASK_1_DB1_ADDR A:0x1:0x6a41d8
y.create.l HWIO_DBACK_CH9_UEID_MASK_1_DB1_ADDR A:0x1:0x6a41dc
y.create.l HWIO_DBACK_HSSCCH_PART1_TRIGGER_DB1_ADDR A:0x1:0x6a41e0
y.create.l HWIO_DBACK_HSSCCH_YAM_THRES_DB1_ADDR A:0x1:0x6a41e4
y.create.l HWIO_DBACK_HSSCCH_PART2_TRIGGER_DB1_ADDR A:0x1:0x6a41e8
y.create.l HWIO_DBACK_HSSCCH_STATUS_DB1_ADDR A:0x1:0x6a41ec
y.create.l HWIO_DBACK_EAGCH_CONFIG_DB1_ADDR A:0x1:0x6a41f0
y.create.l HWIO_DBACK_EAGCH_CTL_DB1_ADDR A:0x1:0x6a41f4
y.create.l HWIO_DBACK_EAGCH_TRIGGER_DB1_ADDR A:0x1:0x6a41f8
y.create.l HWIO_DBACK_EAGCH_RM_PATTERN_0_DB1_ADDR A:0x1:0x6a41fc
y.create.l HWIO_DBACK_EAGCH_RM_PATTERN_1_DB1_ADDR A:0x1:0x6a4200
y.create.l HWIO_DBACK_EAGCH_RM_PATTERN_2_DB1_ADDR A:0x1:0x6a4204
y.create.l HWIO_DBACK_HS_EUL_CTL_CH_RST_DB1_ADDR A:0x1:0x6a4208
y.create.l HWIO_DBACK_NONHS_WCB_SIZE_DB1_ADDR A:0x1:0x6a420c
y.create.l HWIO_DBACK_HS_WCB_SIZE_DB1_ADDR A:0x1:0x6a4210
y.create.l HWIO_DBACK_PART1_INT_STATUS_DB1_ADDR A:0x1:0x6a4214
y.create.l HWIO_DBACK_PART1_INT_CLR_DB1_ADDR A:0x1:0x6a4218
y.create.l HWIO_DBACK_PART1_INT_EN_DB1_ADDR A:0x1:0x6a421c
y.create.l HWIO_DBACK_PART2_INT_STATUS_DB1_ADDR A:0x1:0x6a4220
y.create.l HWIO_DBACK_PART2_INT_CLR_DB1_ADDR A:0x1:0x6a4224
y.create.l HWIO_DBACK_PART2_INT_EN_DB1_ADDR A:0x1:0x6a4228
y.create.l HWIO_DBACK_EAGCH_INT_EN_DB1_ADDR A:0x1:0x6a422c
y.create.l HWIO_DBACK_TEST_MEM_SEL_DB1_ADDR A:0x1:0x6a4230
y.create.l HWIO_DBACK_TEST_BUS_SEL_DB1_ADDR A:0x1:0x6a4234
y.create.l HWIO_DBACK_MEM_ADDR_DB1_ADDR A:0x1:0x6a4238
y.create.l HWIO_DBACK_MEM_DATA0_DB1_ADDR A:0x1:0x6a423c
y.create.l HWIO_DBACK_MEM_DATA1_DB1_ADDR A:0x1:0x6a4240
y.create.l HWIO_DBACK_MEM_DATA2_DB1_ADDR A:0x1:0x6a4244
y.create.l HWIO_DBACK_MEM_DATA3_DB1_ADDR A:0x1:0x6a4248
y.create.l HWIO_DBACK_MEM_DATA4_DB1_ADDR A:0x1:0x6a424c
y.create.l HWIO_T_DBACK_HS_CH0_DEC_DATA0_DB1_ADDR A:0x1:0x6a5000
y.create.l HWIO_T_DBACK_HS_CH1_DEC_DATA0_DB1_ADDR A:0x1:0x6a500c
y.create.l HWIO_T_DBACK_HS_CH2_DEC_DATA0_DB1_ADDR A:0x1:0x6a5018
y.create.l HWIO_T_DBACK_HS_CH3_DEC_DATA0_DB1_ADDR A:0x1:0x6a5024
y.create.l HWIO_T_DBACK_HS_CH0_DEC_DATA1_DB1_ADDR A:0x1:0x6a5004
y.create.l HWIO_T_DBACK_HS_CH1_DEC_DATA1_DB1_ADDR A:0x1:0x6a5010
y.create.l HWIO_T_DBACK_HS_CH2_DEC_DATA1_DB1_ADDR A:0x1:0x6a501c
y.create.l HWIO_T_DBACK_HS_CH3_DEC_DATA1_DB1_ADDR A:0x1:0x6a5028
y.create.l HWIO_T_DBACK_HS_CH0_DEC_STAT_DB1_ADDR A:0x1:0x6a5008
y.create.l HWIO_T_DBACK_HS_CH1_DEC_STAT_DB1_ADDR A:0x1:0x6a5014
y.create.l HWIO_T_DBACK_HS_CH2_DEC_STAT_DB1_ADDR A:0x1:0x6a5020
y.create.l HWIO_T_DBACK_HS_CH3_DEC_STAT_DB1_ADDR A:0x1:0x6a502c
y.create.l HWIO_T_DBACK_EAGCH0_DEC_DATA0_DB1_ADDR A:0x1:0x6a5030
y.create.l HWIO_T_DBACK_EAGCH1_DEC_DATA0_DB1_ADDR A:0x1:0x6a5040
y.create.l HWIO_T_DBACK_EAGCH2_DEC_DATA0_DB1_ADDR A:0x1:0x6a5050
y.create.l HWIO_T_DBACK_EAGCH3_DEC_DATA0_DB1_ADDR A:0x1:0x6a5060
y.create.l HWIO_T_DBACK_EAGCH0_DEC_DATA1_DB1_ADDR A:0x1:0x6a5034
y.create.l HWIO_T_DBACK_EAGCH1_DEC_DATA1_DB1_ADDR A:0x1:0x6a5044
y.create.l HWIO_T_DBACK_EAGCH2_DEC_DATA1_DB1_ADDR A:0x1:0x6a5054
y.create.l HWIO_T_DBACK_EAGCH3_DEC_DATA1_DB1_ADDR A:0x1:0x6a5064
y.create.l HWIO_T_DBACK_EAGCH0_DEC_STAT_DB1_ADDR A:0x1:0x6a5038
y.create.l HWIO_T_DBACK_EAGCH1_DEC_STAT_DB1_ADDR A:0x1:0x6a5048
y.create.l HWIO_T_DBACK_EAGCH2_DEC_STAT_DB1_ADDR A:0x1:0x6a5058
y.create.l HWIO_T_DBACK_EAGCH3_DEC_STAT_DB1_ADDR A:0x1:0x6a5068
y.create.l HWIO_T_DBACK_EAGCH0_METRIC_DB1_ADDR A:0x1:0x6a503c
y.create.l HWIO_T_DBACK_EAGCH1_METRIC_DB1_ADDR A:0x1:0x6a504c
y.create.l HWIO_T_DBACK_EAGCH2_METRIC_DB1_ADDR A:0x1:0x6a505c
y.create.l HWIO_T_DBACK_EAGCH3_METRIC_DB1_ADDR A:0x1:0x6a506c
y.create.l HWIO_T_DBACK_FPACH_DEC_DATA0_DB1_ADDR A:0x1:0x6a5070
y.create.l HWIO_T_DBACK_FPACH_DEC_DATA1_DB1_ADDR A:0x1:0x6a5074
y.create.l HWIO_T_DBACK_FPACH_DEC_STAT_DB1_ADDR A:0x1:0x6a5078
y.create.l HWIO_T_DBACK_TEST_MEM_SEL_DB1_ADDR A:0x1:0x6a507c
y.create.l HWIO_T_DBACK_TEST_BUS_SEL_DB1_ADDR A:0x1:0x6a5080
y.create.l HWIO_T_DBACK_MEM_ADDR_DB1_ADDR A:0x1:0x6a5084
y.create.l HWIO_T_DBACK_MEM_DATA0_DB1_ADDR A:0x1:0x6a5088
y.create.l HWIO_T_DBACK_MEM_DATA1_DB1_ADDR A:0x1:0x6a508c
y.create.l HWIO_T_DBACK_MEM_DATA2_DB1_ADDR A:0x1:0x6a5090
y.create.l HWIO_T_DBACK_MEM_DATA3_DB1_ADDR A:0x1:0x6a5094
y.create.l HWIO_T_DBACK_MEM_DATA4_DB1_ADDR A:0x1:0x6a5098
y.create.l HWIO_T_DBACK_HS_CH0_DC_DEC_DATA0_DB1_ADDR A:0x1:0x6a509c
y.create.l HWIO_T_DBACK_HS_CH1_DC_DEC_DATA0_DB1_ADDR A:0x1:0x6a50a8
y.create.l HWIO_T_DBACK_HS_CH2_DC_DEC_DATA0_DB1_ADDR A:0x1:0x6a50b4
y.create.l HWIO_T_DBACK_HS_CH3_DC_DEC_DATA0_DB1_ADDR A:0x1:0x6a50c0
y.create.l HWIO_T_DBACK_HS_CH0_DC_DEC_DATA1_DB1_ADDR A:0x1:0x6a50a0
y.create.l HWIO_T_DBACK_HS_CH1_DC_DEC_DATA1_DB1_ADDR A:0x1:0x6a50ac
y.create.l HWIO_T_DBACK_HS_CH2_DC_DEC_DATA1_DB1_ADDR A:0x1:0x6a50b8
y.create.l HWIO_T_DBACK_HS_CH3_DC_DEC_DATA1_DB1_ADDR A:0x1:0x6a50c4
y.create.l HWIO_T_DBACK_HS_CH0_DC_DEC_STAT_DB1_ADDR A:0x1:0x6a50a4
y.create.l HWIO_T_DBACK_HS_CH1_DC_DEC_STAT_DB1_ADDR A:0x1:0x6a50b0
y.create.l HWIO_T_DBACK_HS_CH2_DC_DEC_STAT_DB1_ADDR A:0x1:0x6a50bc
y.create.l HWIO_T_DBACK_HS_CH3_DC_DEC_STAT_DB1_ADDR A:0x1:0x6a50c8
y.create.l HWIO_DINT_CFG_DB1_ADDR A:0x1:0x6a6000
y.create.l HWIO_DINT_CH0_CFG_DB1_ADDR A:0x1:0x6a6004
y.create.l HWIO_DINT_CH1_CFG_DB1_ADDR A:0x1:0x6a6008
y.create.l HWIO_DINT_CH2_CFG_DB1_ADDR A:0x1:0x6a600c
y.create.l HWIO_TD_BLOCK_SIZE_DB1_ADDR A:0x1:0x6a6014
y.create.l HWIO_TD_INTLV_CFG_LO_DB1_ADDR A:0x1:0x6a6018
y.create.l HWIO_TD_INTLV_CFG_HI_DB1_ADDR A:0x1:0x6a601c
y.create.l HWIO_TD_INTLV_SIZE_LO_DB1_ADDR A:0x1:0x6a6020
y.create.l HWIO_TD_PUNCT_LO_DB1_ADDR A:0x1:0x6a6024
y.create.l HWIO_TD_PUNCT_HI_DB1_ADDR A:0x1:0x6a6028
y.create.l HWIO_DINT_PKT_OFFSET_DB1_ADDR A:0x1:0x6a6030
y.create.l HWIO_DINT_PKT_CFG_DB1_ADDR A:0x1:0x6a6034
y.create.l HWIO_DINT_TASK_OFFSET_DB1_ADDR A:0x1:0x6a6038
y.create.l HWIO_DINT_TASK_LIST_DB1_ADDR A:0x1:0x6a603c
y.create.l HWIO_TST_SYNC_DINT_DB1_ADDR A:0x1:0x6a6040
y.create.l HWIO_TST_CH0_SYMS_DB1_ADDR A:0x1:0x6a6044
y.create.l HWIO_TST_CH1_SYMS_DB1_ADDR A:0x1:0x6a6048
y.create.l HWIO_TST_CH2_SYMS_DB1_ADDR A:0x1:0x6a604c
y.create.l HWIO_TST_SEL_DINT_DB1_ADDR A:0x1:0x6a6054
y.create.l HWIO_DINT_OTD_CFG_DB1_ADDR A:0x1:0x6a6058
y.create.l HWIO_TST_SYS_TIME_DB1_ADDR A:0x1:0x6a6070
y.create.l HWIO_DEINT_DBG_BUS_CTL_DB1_ADDR A:0x1:0x6a6074
y.create.l HWIO_DEC_CLR_INT_STATUS_DB1_ADDR A:0x1:0x6a6084
y.create.l HWIO_DEINT_CLK_STATUS_DB1_ADDR A:0x1:0x6a6088
y.create.l HWIO_DEC_DONE_INT_STATUS_DB1_ADDR A:0x1:0x6a608c
y.create.l HWIO_DEINT_TASK_STATUS_DB1_ADDR A:0x1:0x6a6090
y.create.l HWIO_DEINT_FRMHYP_STATUS_DB1_ADDR A:0x1:0x6a6094
y.create.l HWIO_DINT_VD_RD_ADDR_DB1_ADDR A:0x1:0x6a6098
y.create.l HWIO_DINT_FCH_CFG0_DB1_ADDR A:0x1:0x6a609c
y.create.l HWIO_DINT_FCH_CFG1_DB1_ADDR A:0x1:0x6a60a0
y.create.l HWIO_DINT_FCH_TRIGGER_DB1_ADDR A:0x1:0x6a60a4
y.create.l HWIO_DINT_FCH_WR_BANK_DB1_ADDR A:0x1:0x6a60a8
y.create.l HWIO_DINT_FCH_EGTH_HYP_CFG0_DB1_ADDR A:0x1:0x6a60ac
y.create.l HWIO_DINT_FCH_EGTH_HYP_CFG1_DB1_ADDR A:0x1:0x6a60b0
y.create.l HWIO_DINT_FCH_EGTH_HYP_CFG2_DB1_ADDR A:0x1:0x6a60b4
y.create.l HWIO_DINT_FCH_EGTH_HYP_CFG3_DB1_ADDR A:0x1:0x6a60b8
y.create.l HWIO_DINT_FCH_QRTR_HYP_CFG0_DB1_ADDR A:0x1:0x6a60bc
y.create.l HWIO_DINT_FCH_QRTR_HYP_CFG1_DB1_ADDR A:0x1:0x6a60c0
y.create.l HWIO_DINT_FCH_QRTR_HYP_CFG2_DB1_ADDR A:0x1:0x6a60c4
y.create.l HWIO_DINT_FCH_QRTR_HYP_CFG3_DB1_ADDR A:0x1:0x6a60c8
y.create.l HWIO_DINT_FCH_HALF_HYP_CFG0_DB1_ADDR A:0x1:0x6a60cc
y.create.l HWIO_DINT_FCH_HALF_HYP_CFG1_DB1_ADDR A:0x1:0x6a60d0
y.create.l HWIO_DINT_FCH_HALF_HYP_CFG2_DB1_ADDR A:0x1:0x6a60d4
y.create.l HWIO_DINT_FCH_HALF_HYP_CFG3_DB1_ADDR A:0x1:0x6a60d8
y.create.l HWIO_DINT_FCH_FULL_HYP_CFG0_DB1_ADDR A:0x1:0x6a60dc
y.create.l HWIO_DINT_FCH_FULL_HYP_CFG1_DB1_ADDR A:0x1:0x6a60e0
y.create.l HWIO_DINT_FCH_FULL_HYP_CFG2_DB1_ADDR A:0x1:0x6a60e4
y.create.l HWIO_DINT_FCH_FULL_HYP_CFG3_DB1_ADDR A:0x1:0x6a60e8
y.create.l HWIO_COMB_FUND_SOFT_DEC_IQ_WR_DB1_ADDR A:0x1:0x6a6100
y.create.l HWIO_C_SYNC_TRIG_REG_DB1_ADDR A:0x1:0x6a6104
y.create.l HWIO_CH0_Q_SOFTDEC_ENABLE_DB1_ADDR A:0x1:0x6a6108
y.create.l HWIO_CH1_CONTROL_DB1_ADDR A:0x1:0x6a610c
y.create.l HWIO_CH2_CONTROL_DB1_ADDR A:0x1:0x6a6110
y.create.l HWIO_CDMA_WIDGET_STATUS0_DB1_ADDR A:0x1:0x6a6114
y.create.l HWIO_RESET_STATUS0_DB1_ADDR A:0x1:0x6a6118
y.create.l HWIO_CDMA_WIDGET_STATUS1_DB1_ADDR A:0x1:0x6a611c
y.create.l HWIO_RESET_STATUS1_DB1_ADDR A:0x1:0x6a6120
y.create.l HWIO_CDMA_WIDGET_TEST_CTL_DB1_ADDR A:0x1:0x6a6124
y.create.l HWIO_HDR_DINT_STATUS_DB1_ADDR A:0x1:0x6a7024
y.create.l HWIO_HDR_DINT_DGB_BUS_DB1_ADDR A:0x1:0x6a7080
y.create.l HWIO_HDR_DINT_CLK_STATUS_DB1_ADDR A:0x1:0x6a7084
y.create.l HWIO_SVD_TBVD_CLK_STATUS_REG_DB1_ADDR A:0x1:0x6a8000
y.create.l HWIO_SVD_TBVD_HW_IDLE_DB1_ADDR A:0x1:0x6a8004
y.create.l HWIO_SVD_TBVD_TESTBUS_ENABLE_DB1_ADDR A:0x1:0x6a8008
y.create.l HWIO_SVD_MODE_DB1_ADDR A:0x1:0x6a800c
y.create.l HWIO_SVD_POLY2IJ_DB1_ADDR A:0x1:0x6a8010
y.create.l HWIO_SVD_POLY3IJ_DB1_ADDR A:0x1:0x6a8014
y.create.l HWIO_SVD_POLY3K_DB1_ADDR A:0x1:0x6a8018
y.create.l HWIO_SVD_POLY4IJ_DB1_ADDR A:0x1:0x6a801c
y.create.l HWIO_SVD_POLY4KL_DB1_ADDR A:0x1:0x6a8020
y.create.l HWIO_SVD_TESTCON_DB1_ADDR A:0x1:0x6a8024
y.create.l HWIO_SVD_TESTOUT_DB1_ADDR A:0x1:0x6a8028
y.create.l HWIO_SVD_TEST_MEM_SEL_DB1_ADDR A:0x1:0x6a802c
y.create.l HWIO_SVD_TEST_MEM_ADDR_DB1_ADDR A:0x1:0x6a8030
y.create.l HWIO_SVD_TEST_MEM_WRITE_DB1_ADDR A:0x1:0x6a8034
y.create.l HWIO_SVD_TEST_MEM_READ0_DB1_ADDR A:0x1:0x6a8038
y.create.l HWIO_SVD_TEST_MEM_READ1_DB1_ADDR A:0x1:0x6a803c
y.create.l HWIO_SVD_TEST_MEM_DIN_DB1_ADDR A:0x1:0x6a8040
y.create.l HWIO_TBVD_DEBUG_MEM_CMD_DB1_ADDR A:0x1:0x6a8044
y.create.l HWIO_TBVD_DEBUG_MEM_WR_DB1_ADDR A:0x1:0x6a8048
y.create.l HWIO_TBVD_DEBUG_MEM_RD_DB1_ADDR A:0x1:0x6a804c
y.create.l HWIO_LTE_DEMBACK_SCH_STATUS_WORD0_DB1_ADDR A:0x1:0x6a9000
y.create.l HWIO_LTE_DEMBACK_SCH_SHARED_WORD0_DB1_ADDR A:0x1:0x6a9100
y.create.l HWIO_LTE_DEMBACK_SCH_SHARED_WORD1_DB1_ADDR A:0x1:0x6a9104
y.create.l HWIO_LTE_DEMBACK_SCH_SHARED_WORD2_DB1_ADDR A:0x1:0x6a9108
y.create.l HWIO_LTE_DEMBACK_SCH_SHARED_WORD3_DB1_ADDR A:0x1:0x6a910c
y.create.l HWIO_LTE_DEMBACK_SCH_SHARED_WORD4_DB1_ADDR A:0x1:0x6a9110
y.create.l HWIO_LTE_DEMBACK_SCH_SHARED_WORD5_DB1_ADDR A:0x1:0x6a9114
y.create.l HWIO_PDSCH_HARQ_CFG_WORD0_DB1_ADDR A:0x1:0x6a9200
y.create.l HWIO_PDSCH_HARQ_CFG_WORD1_DB1_ADDR A:0x1:0x6a9204
y.create.l HWIO_PDSCH_HARQ_CFG_WORD2_DB1_ADDR A:0x1:0x6a9208
y.create.l HWIO_PDSCH_HARQ_CFG_WORD3_DB1_ADDR A:0x1:0x6a920c
y.create.l HWIO_PDSCH_HARQ_CFG_WORD4_DB1_ADDR A:0x1:0x6a9210
y.create.l HWIO_PDSCH_HARQ_CFG_WORD5_DB1_ADDR A:0x1:0x6a9214
y.create.l HWIO_PDSCH_HARQ_CFG_WORD6_DB1_ADDR A:0x1:0x6a9218
y.create.l HWIO_PDSCH_HARQ_CFG_WORD7_DB1_ADDR A:0x1:0x6a921c
y.create.l HWIO_PDSCH_HARQ_CFG_WORD8_DB1_ADDR A:0x1:0x6a9220
y.create.l HWIO_LTE_DEMBACK_CCH_STATUS_WORD0_DB1_ADDR A:0x1:0x6aa000
y.create.l HWIO_LTE_DEMBACK_CCH_SHARED_WORD0_DB1_ADDR A:0x1:0x6aa100
y.create.l HWIO_LTE_DEMBACK_CCH_SHARED_WORD1_DB1_ADDR A:0x1:0x6aa104
y.create.l HWIO_LTE_DEMBACK_CCH_SHARED_WORD2_DB1_ADDR A:0x1:0x6aa108
y.create.l HWIO_LTE_DEMBACK_CCH_SHARED_WORD3_DB1_ADDR A:0x1:0x6aa10c
y.create.l HWIO_LTE_DEMBACK_CCH_SHARED_WORD4_DB1_ADDR A:0x1:0x6aa110
y.create.l HWIO_LTE_DEMBACK_CCH_SHARED_WORD5_DB1_ADDR A:0x1:0x6aa114
y.create.l HWIO_LTE_DEMBACK_CCH_SHARED_WORD6_DB1_ADDR A:0x1:0x6aa118
y.create.l HWIO_LTE_DEMBACK_CCH_SHARED_WORD7_DB1_ADDR A:0x1:0x6aa11c
y.create.l HWIO_PDCCH_DEINT_CFG_WORD0_DB1_ADDR A:0x1:0x6aa200
y.create.l HWIO_PDCCH_DEINT_CFG_WORD1_DB1_ADDR A:0x1:0x6aa204
y.create.l HWIO_PDCCH_DEINT_CFG_WORD2_DB1_ADDR A:0x1:0x6aa208
y.create.l HWIO_SYMBOL0_REG_MAP_0_WORD0_DB1_ADDR A:0x1:0x6aa300
y.create.l HWIO_SYMBOL0_REG_MAP_0_WORD1_DB1_ADDR A:0x1:0x6aa304
y.create.l HWIO_SYMBOL0_REG_MAP_0_WORD2_DB1_ADDR A:0x1:0x6aa308
y.create.l HWIO_SYMBOL0_REG_MAP_0_WORD3_DB1_ADDR A:0x1:0x6aa30c
y.create.l HWIO_SYMBOL0_REG_MAP_0_WORD4_DB1_ADDR A:0x1:0x6aa310
y.create.l HWIO_SYMBOL0_REG_MAP_0_WORD5_DB1_ADDR A:0x1:0x6aa314
y.create.l HWIO_SYMBOL0_REG_MAP_0_WORD6_DB1_ADDR A:0x1:0x6aa318
y.create.l HWIO_SYMBOL0_REG_MAP_0_WORD7_DB1_ADDR A:0x1:0x6aa31c
y.create.l HWIO_SYMBOL0_REG_MAP_1_WORD0_DB1_ADDR A:0x1:0x6aa400
y.create.l HWIO_SYMBOL0_REG_MAP_1_WORD1_DB1_ADDR A:0x1:0x6aa404
y.create.l HWIO_SYMBOL0_REG_MAP_1_WORD2_DB1_ADDR A:0x1:0x6aa408
y.create.l HWIO_SYMBOL0_REG_MAP_1_WORD3_DB1_ADDR A:0x1:0x6aa40c
y.create.l HWIO_SYMBOL0_REG_MAP_1_WORD4_DB1_ADDR A:0x1:0x6aa410
y.create.l HWIO_SYMBOL0_REG_MAP_1_WORD5_DB1_ADDR A:0x1:0x6aa414
y.create.l HWIO_SYMBOL0_REG_MAP_1_WORD6_DB1_ADDR A:0x1:0x6aa418
y.create.l HWIO_SYMBOL0_REG_MAP_1_WORD7_DB1_ADDR A:0x1:0x6aa41c
y.create.l HWIO_SYMBOL0_REG_MAP_2_WORD0_DB1_ADDR A:0x1:0x6aa500
y.create.l HWIO_SYMBOL0_REG_MAP_2_WORD1_DB1_ADDR A:0x1:0x6aa504
y.create.l HWIO_SYMBOL0_REG_MAP_2_WORD2_DB1_ADDR A:0x1:0x6aa508
y.create.l HWIO_SYMBOL0_REG_MAP_2_WORD3_DB1_ADDR A:0x1:0x6aa50c
y.create.l HWIO_SYMBOL0_REG_MAP_2_WORD4_DB1_ADDR A:0x1:0x6aa510
y.create.l HWIO_SYMBOL0_REG_MAP_2_WORD5_DB1_ADDR A:0x1:0x6aa514
y.create.l HWIO_SYMBOL0_REG_MAP_2_WORD6_DB1_ADDR A:0x1:0x6aa518
y.create.l HWIO_SYMBOL0_REG_MAP_2_WORD7_DB1_ADDR A:0x1:0x6aa51c
y.create.l HWIO_SYMBOL1_REG_MAP_0_WORD0_DB1_ADDR A:0x1:0x6aa600
y.create.l HWIO_SYMBOL1_REG_MAP_0_WORD1_DB1_ADDR A:0x1:0x6aa604
y.create.l HWIO_SYMBOL1_REG_MAP_0_WORD2_DB1_ADDR A:0x1:0x6aa608
y.create.l HWIO_SYMBOL1_REG_MAP_0_WORD3_DB1_ADDR A:0x1:0x6aa60c
y.create.l HWIO_SYMBOL1_REG_MAP_0_WORD4_DB1_ADDR A:0x1:0x6aa610
y.create.l HWIO_SYMBOL1_REG_MAP_0_WORD5_DB1_ADDR A:0x1:0x6aa614
y.create.l HWIO_SYMBOL1_REG_MAP_0_WORD6_DB1_ADDR A:0x1:0x6aa618
y.create.l HWIO_SYMBOL1_REG_MAP_0_WORD7_DB1_ADDR A:0x1:0x6aa61c
y.create.l HWIO_SYMBOL1_REG_MAP_0_WORD8_DB1_ADDR A:0x1:0x6aa620
y.create.l HWIO_SYMBOL1_REG_MAP_0_WORD9_DB1_ADDR A:0x1:0x6aa624
y.create.l HWIO_SYMBOL1_REG_MAP_0_WORD10_DB1_ADDR A:0x1:0x6aa628
y.create.l HWIO_SYMBOL1_REG_MAP_1_WORD0_DB1_ADDR A:0x1:0x6aa700
y.create.l HWIO_SYMBOL1_REG_MAP_1_WORD1_DB1_ADDR A:0x1:0x6aa704
y.create.l HWIO_SYMBOL1_REG_MAP_1_WORD2_DB1_ADDR A:0x1:0x6aa708
y.create.l HWIO_SYMBOL1_REG_MAP_1_WORD3_DB1_ADDR A:0x1:0x6aa70c
y.create.l HWIO_SYMBOL1_REG_MAP_1_WORD4_DB1_ADDR A:0x1:0x6aa710
y.create.l HWIO_SYMBOL1_REG_MAP_1_WORD5_DB1_ADDR A:0x1:0x6aa714
y.create.l HWIO_SYMBOL1_REG_MAP_1_WORD6_DB1_ADDR A:0x1:0x6aa718
y.create.l HWIO_SYMBOL1_REG_MAP_1_WORD7_DB1_ADDR A:0x1:0x6aa71c
y.create.l HWIO_SYMBOL1_REG_MAP_1_WORD8_DB1_ADDR A:0x1:0x6aa720
y.create.l HWIO_SYMBOL1_REG_MAP_1_WORD9_DB1_ADDR A:0x1:0x6aa724
y.create.l HWIO_SYMBOL1_REG_MAP_1_WORD10_DB1_ADDR A:0x1:0x6aa728
y.create.l HWIO_SYMBOL2_REG_MAP_WORD0_DB1_ADDR A:0x1:0x6aa800
y.create.l HWIO_SYMBOL2_REG_MAP_WORD1_DB1_ADDR A:0x1:0x6aa804
y.create.l HWIO_SYMBOL2_REG_MAP_WORD2_DB1_ADDR A:0x1:0x6aa808
y.create.l HWIO_SYMBOL2_REG_MAP_WORD3_DB1_ADDR A:0x1:0x6aa80c
y.create.l HWIO_SYMBOL2_REG_MAP_WORD4_DB1_ADDR A:0x1:0x6aa810
y.create.l HWIO_SYMBOL2_REG_MAP_WORD5_DB1_ADDR A:0x1:0x6aa814
y.create.l HWIO_SYMBOL2_REG_MAP_WORD6_DB1_ADDR A:0x1:0x6aa818
y.create.l HWIO_SYMBOL2_REG_MAP_WORD7_DB1_ADDR A:0x1:0x6aa81c
y.create.l HWIO_SYMBOL2_REG_MAP_WORD8_DB1_ADDR A:0x1:0x6aa820
y.create.l HWIO_SYMBOL2_REG_MAP_WORD9_DB1_ADDR A:0x1:0x6aa824
y.create.l HWIO_SYMBOL2_REG_MAP_WORD10_DB1_ADDR A:0x1:0x6aa828
y.create.l HWIO_PBCH_DEINT_CFG_WORD0_DB1_ADDR A:0x1:0x6aa900
y.create.l HWIO_PBCH_DEINT_CFG_WORD1_DB1_ADDR A:0x1:0x6aa904
y.create.l HWIO_PBCH_DEINT_CFG_WORD2_DB1_ADDR A:0x1:0x6aa908
y.create.l HWIO_PBCH_DEINT_CFG_WORD3_DB1_ADDR A:0x1:0x6aa90c
y.create.l HWIO_PBCH_DEINT_CFG_WORD4_DB1_ADDR A:0x1:0x6aa910
y.create.l HWIO_PBCH_DEINT_CFG_WORD5_DB1_ADDR A:0x1:0x6aa914
y.create.l HWIO_PBCH_DEINT_CFG_WORD6_DB1_ADDR A:0x1:0x6aa918
y.create.l HWIO_PBCH_DEINT_CFG_WORD7_DB1_ADDR A:0x1:0x6aa91c
y.create.l HWIO_PBCH_DEINT_CFG_WORD8_DB1_ADDR A:0x1:0x6aa920
y.create.l HWIO_PBCH_DEINT_CFG_WORD9_DB1_ADDR A:0x1:0x6aa924
y.create.l HWIO_PBCH_DEINT_CFG_WORD10_DB1_ADDR A:0x1:0x6aa928
y.create.l HWIO_PDCCH_REG_REORDER_WORD0_DB1_ADDR A:0x1:0x6aaa00
y.create.l HWIO_PDCCH_REG_REORDER_WORD1_DB1_ADDR A:0x1:0x6aaa04
y.create.l HWIO_PDCCH_REG_REORDER_WORD2_DB1_ADDR A:0x1:0x6aaa08
y.create.l HWIO_PDCCH_REG_REORDER_WORD3_DB1_ADDR A:0x1:0x6aaa0c
y.create.l HWIO_PDCCH_REG_REORDER_WORD4_DB1_ADDR A:0x1:0x6aaa10
y.create.l HWIO_PBCH_FOH_WORD0_DB1_ADDR A:0x1:0x6aab00
y.create.l HWIO_PBCH_FOH_WORD1_DB1_ADDR A:0x1:0x6aab04
y.create.l HWIO_PBCH_FOH_WORD2_DB1_ADDR A:0x1:0x6aab08
y.create.l HWIO_PDSCH_REENC_TB_CFG_WORD0_DB1_ADDR A:0x1:0x6ab100
y.create.l HWIO_PDSCH_REENC_TB_CFG_WORD1_DB1_ADDR A:0x1:0x6ab104
y.create.l HWIO_PDSCH_REENC_TB_CFG_WORD2_DB1_ADDR A:0x1:0x6ab108
y.create.l HWIO_PDSCH_REENC_CB_WORD0_DB1_ADDR A:0x1:0x6ab200
y.create.l HWIO_PDSCH_REENC_CB_WORD1_DB1_ADDR A:0x1:0x6ab204
y.create.l HWIO_PDSCH_REENC_CB_WORD2_DB1_ADDR A:0x1:0x6ab208
y.create.l HWIO_PBCH_REENC_WORD0_DB1_ADDR A:0x1:0x6ab300
y.create.l HWIO_PBCH_REENC_WORD1_DB1_ADDR A:0x1:0x6ab304
y.create.l HWIO_PBCH_REENC_WORD2_DB1_ADDR A:0x1:0x6ab308
y.create.l HWIO_W_DBACK_HS_SHARED_WORD0_DB1_ADDR A:0x1:0x6ac100
y.create.l HWIO_W_DBACK_HS_SHARED_WORD1_DB1_ADDR A:0x1:0x6ac104
y.create.l HWIO_W_DBACK_HS_SHARED_WORD2_DB1_ADDR A:0x1:0x6ac108
y.create.l HWIO_W_DBACK_HS_SHARED_WORD3_DB1_ADDR A:0x1:0x6ac10c
y.create.l HWIO_W_DBACK_HS_SHARED_WORD4_DB1_ADDR A:0x1:0x6ac110
y.create.l HWIO_W_DBACK_HS_SHARED_WORD5_DB1_ADDR A:0x1:0x6ac114
y.create.l HWIO_W_DBACK_HS_SHARED_WORD6_DB1_ADDR A:0x1:0x6ac118
y.create.l HWIO_W_DBACK_HS_SHARED_WORD7_DB1_ADDR A:0x1:0x6ac11c
y.create.l HWIO_W_DBACK_HS_SHARED_WORD8_DB1_ADDR A:0x1:0x6ac120
y.create.l HWIO_W_DBACK_HS_SHARED_WORD9_DB1_ADDR A:0x1:0x6ac124
y.create.l HWIO_W_DBACK_HS_SHARED_WORD10_DB1_ADDR A:0x1:0x6ac128
y.create.l HWIO_W_DBACK_HS_SHARED_WORD11_DB1_ADDR A:0x1:0x6ac12c
y.create.l HWIO_W_DBACK_HS_SHARED_WORD12_DB1_ADDR A:0x1:0x6ac130
y.create.l HWIO_W_DBACK_HS_SHARED_WORD13_DB1_ADDR A:0x1:0x6ac134
y.create.l HWIO_W_DBACK_HS_SHARED_WORD14_DB1_ADDR A:0x1:0x6ac138
y.create.l HWIO_W_DBACK_HS_SHARED_WORD15_DB1_ADDR A:0x1:0x6ac13c
y.create.l HWIO_W_DBACK_HS_SHARED_WORD16_DB1_ADDR A:0x1:0x6ac140
y.create.l HWIO_W_DBACK_HS_SHARED_WORD17_DB1_ADDR A:0x1:0x6ac144
y.create.l HWIO_W_DBACK_HS_SHARED_WORD18_DB1_ADDR A:0x1:0x6ac148
y.create.l HWIO_W_DBACK_HS_SHARED_WORD19_DB1_ADDR A:0x1:0x6ac14c
y.create.l HWIO_W_DBACK_HS_SHARED_WORD20_DB1_ADDR A:0x1:0x6ac150
y.create.l HWIO_W_DBACK_HS_SHARED_WORD21_DB1_ADDR A:0x1:0x6ac154
y.create.l HWIO_W_DBACK_HS_SHARED_WORD22_DB1_ADDR A:0x1:0x6ac158
y.create.l HWIO_W_DBACK_HS_SHARED_WORD23_DB1_ADDR A:0x1:0x6ac15c
y.create.l HWIO_W_DBACK_HS_SHARED_WORD24_DB1_ADDR A:0x1:0x6ac160
y.create.l HWIO_W_DBACK_HS_SHARED_WORD25_DB1_ADDR A:0x1:0x6ac164
y.create.l HWIO_W_DBACK_HS_SHARED_WORD26_DB1_ADDR A:0x1:0x6ac168
y.create.l HWIO_W_DBACK_HS_SHARED_WORD27_DB1_ADDR A:0x1:0x6ac16c
y.create.l HWIO_W_DBACK_HS_SHARED_WORD28_DB1_ADDR A:0x1:0x6ac170
y.create.l HWIO_W_DBACK_HS_SHARED_WORD29_DB1_ADDR A:0x1:0x6ac174
y.create.l HWIO_W_DBACK_HS_SHARED_WORD30_DB1_ADDR A:0x1:0x6ac178
y.create.l HWIO_W_DBACK_HS_SHARED_WORD31_DB1_ADDR A:0x1:0x6ac17c
y.create.l HWIO_W_DBACK_HS_SHARED_WORD32_DB1_ADDR A:0x1:0x6ac180
y.create.l HWIO_W_DBACK_HS_SHARED_WORD33_DB1_ADDR A:0x1:0x6ac184
y.create.l HWIO_W_DBACK_HS_SHARED_WORD34_DB1_ADDR A:0x1:0x6ac188
y.create.l HWIO_W_DBACK_HS_SHARED_WORD35_DB1_ADDR A:0x1:0x6ac18c
y.create.l HWIO_W_DBACK_HS_SHARED_WORD36_DB1_ADDR A:0x1:0x6ac190
y.create.l HWIO_W_DBACK_HS_SHARED_WORD37_DB1_ADDR A:0x1:0x6ac194
y.create.l HWIO_W_DBACK_HS_SHARED_WORD38_DB1_ADDR A:0x1:0x6ac198
y.create.l HWIO_W_DBACK_HS_SHARED_WORD39_DB1_ADDR A:0x1:0x6ac19c
y.create.l HWIO_W_DBACK_HS_SHARED_WORD40_DB1_ADDR A:0x1:0x6ac1a0
y.create.l HWIO_W_DBACK_HS_SHARED_WORD41_DB1_ADDR A:0x1:0x6ac1a4
y.create.l HWIO_W_DBACK_HS_SHARED_WORD42_DB1_ADDR A:0x1:0x6ac1a8
y.create.l HWIO_W_DBACK_HS_SHARED_WORD43_DB1_ADDR A:0x1:0x6ac1ac
y.create.l HWIO_W_DBACK_HS_SHARED_WORD44_DB1_ADDR A:0x1:0x6ac1b0
y.create.l HWIO_W_DBACK_HS_SHARED_WORD45_DB1_ADDR A:0x1:0x6ac1b4
y.create.l HWIO_W_DBACK_HS_SHARED_WORD46_DB1_ADDR A:0x1:0x6ac1b8
y.create.l HWIO_W_DBACK_HS_SHARED_WORD47_DB1_ADDR A:0x1:0x6ac1bc
y.create.l HWIO_W_DBACK_HS_SHARED_WORD48_DB1_ADDR A:0x1:0x6ac1c0
y.create.l HWIO_W_DBACK_HS_SHARED_WORD49_DB1_ADDR A:0x1:0x6ac1c4
y.create.l HWIO_W_DBACK_HS_SHARED_WORD50_DB1_ADDR A:0x1:0x6ac1c8
y.create.l HWIO_W_DBACK_HS_SHARED_WORD51_DB1_ADDR A:0x1:0x6ac1cc
y.create.l HWIO_W_DBACK_HS_SHARED_WORD52_DB1_ADDR A:0x1:0x6ac1d0
y.create.l HWIO_W_DBACK_HS_SHARED_WORD53_DB1_ADDR A:0x1:0x6ac1d4
y.create.l HWIO_W_DBACK_HS_SHARED_WORD54_DB1_ADDR A:0x1:0x6ac1d8
y.create.l HWIO_W_DBACK_HS_SHARED_WORD55_DB1_ADDR A:0x1:0x6ac1dc
y.create.l HWIO_W_DBACK_HS_SHARED_WORD56_DB1_ADDR A:0x1:0x6ac1e0
y.create.l HWIO_W_DBACK_HS_SHARED_WORD57_DB1_ADDR A:0x1:0x6ac1e4
y.create.l HWIO_W_DBACK_HS_TD_DECIB_WRITER_WORD0_DB1_ADDR A:0x1:0x6ac200
y.create.l HWIO_W_DBACK_HS_TD_DECIB_WRITER_CFG_WORD0_DB1_ADDR A:0x1:0x6ac300
y.create.l HWIO_W_DBACK_HS_TD_DECIB_WRITER_CFG_WORD1_DB1_ADDR A:0x1:0x6ac304
y.create.l HWIO_W_DBACK_HS_TD_DECIB_WRITER_CFG_WORD2_DB1_ADDR A:0x1:0x6ac308
y.create.l HWIO_W_DBACK_HS_TD_DECIB_WRITER_CFG_WORD3_DB1_ADDR A:0x1:0x6ac30c
y.create.l HWIO_W_DBACK_HS_TD_DECIB_WRITER_CFG_WORD4_DB1_ADDR A:0x1:0x6ac310
y.create.l HWIO_W_DBACK_HS_TD_DECIB_WRITER_CFG_WORD5_DB1_ADDR A:0x1:0x6ac314
y.create.l HWIO_W_DBACK_HS_TD_DECIB_WRITER_CFG_WORD6_DB1_ADDR A:0x1:0x6ac318
y.create.l HWIO_W_DBACK_HS_TD_DECIB_WRITER_CFG_WORD7_DB1_ADDR A:0x1:0x6ac31c
y.create.l HWIO_W_DBACK_NONHS_SHARED_WORD0_DB1_ADDR A:0x1:0x6ad100
y.create.l HWIO_W_DBACK_NONHS_SHARED_WORD1_DB1_ADDR A:0x1:0x6ad104
y.create.l HWIO_W_DBACK_NONHS_SHARED_WORD2_DB1_ADDR A:0x1:0x6ad108
y.create.l HWIO_W_DBACK_NONHS_SHARED_WORD3_DB1_ADDR A:0x1:0x6ad10c
y.create.l HWIO_W_DBACK_NONHS_SHARED_WORD4_DB1_ADDR A:0x1:0x6ad110
y.create.l HWIO_W_DBACK_NONHS_SHARED_WORD5_DB1_ADDR A:0x1:0x6ad114
y.create.l HWIO_W_DBACK_NONHS_SHARED_WORD6_DB1_ADDR A:0x1:0x6ad118
y.create.l HWIO_W_DBACK_NONHS_SHARED_WORD7_DB1_ADDR A:0x1:0x6ad11c
y.create.l HWIO_W_DBACK_NONHS_DRM_CFG_WORD0_DB1_ADDR A:0x1:0x6ad200
y.create.l HWIO_W_DBACK_NONHS_DRM_CFG_WORD1_DB1_ADDR A:0x1:0x6ad204
y.create.l HWIO_W_DBACK_NONHS_DRM_CFG_WORD2_DB1_ADDR A:0x1:0x6ad208
y.create.l HWIO_W_DBACK_NONHS_DRM_CFG_WORD3_DB1_ADDR A:0x1:0x6ad20c
y.create.l HWIO_W_DBACK_NONHS_DRM_CFG_WORD4_DB1_ADDR A:0x1:0x6ad210
y.create.l HWIO_W_DBACK_NONHS_DRM_CFG_WORD5_DB1_ADDR A:0x1:0x6ad214
y.create.l HWIO_W_DBACK_NONHS_DRM_CFG_WORD6_DB1_ADDR A:0x1:0x6ad218
y.create.l HWIO_W_DBACK_NONHS_DRM_CFG_WORD7_DB1_ADDR A:0x1:0x6ad21c
y.create.l HWIO_W_DBACK_NONHS_DRM_CFG_WORD8_DB1_ADDR A:0x1:0x6ad220
y.create.l HWIO_W_DBACK_NONHS_DRM_CFG_WORD9_DB1_ADDR A:0x1:0x6ad224
y.create.l HWIO_W_DBACK_NONHS_DRM_CFG_WORD10_DB1_ADDR A:0x1:0x6ad228
y.create.l HWIO_W_DBACK_NONHS_DRM_CFG_WORD11_DB1_ADDR A:0x1:0x6ad22c
y.create.l HWIO_W_DBACK_NONHS_DRM_CFG_WORD12_DB1_ADDR A:0x1:0x6ad230
y.create.l HWIO_W_DBACK_NONHS_DRM_CFG_WORD13_DB1_ADDR A:0x1:0x6ad234
y.create.l HWIO_W_DBACK_NONHS_DRM_CFG_WORD14_DB1_ADDR A:0x1:0x6ad238
y.create.l HWIO_W_DBACK_NONHS_DRM_CFG_WORD15_DB1_ADDR A:0x1:0x6ad23c
y.create.l HWIO_W_DBACK_NONHS_TD_DECIB_WRITER_CFG_WORD0_DB1_ADDR A:0x1:0x6ad300
y.create.l HWIO_W_DBACK_NONHS_TD_DECIB_WRITER_CFG_WORD1_DB1_ADDR A:0x1:0x6ad304
y.create.l HWIO_T_DBACK_SHARED_WORD0_DB1_ADDR A:0x1:0x6ae100
y.create.l HWIO_T_DBACK_SHARED_WORD1_DB1_ADDR A:0x1:0x6ae104
y.create.l HWIO_T_DBACK_SHARED_WORD2_DB1_ADDR A:0x1:0x6ae108
y.create.l HWIO_T_DBACK_SHARED_WORD3_DB1_ADDR A:0x1:0x6ae10c
y.create.l HWIO_T_DBACK_SHARED_WORD4_DB1_ADDR A:0x1:0x6ae110
y.create.l HWIO_T_DBACK_SHARED_WORD5_DB1_ADDR A:0x1:0x6ae114
y.create.l HWIO_T_DBACK_SHARED_WORD6_DB1_ADDR A:0x1:0x6ae118
y.create.l HWIO_T_DBACK_SHARED_WORD7_DB1_ADDR A:0x1:0x6ae11c
y.create.l HWIO_T_DBACK_SHARED_WORD8_DB1_ADDR A:0x1:0x6ae120
y.create.l HWIO_T_DBACK_SHARED_WORD9_DB1_ADDR A:0x1:0x6ae124
y.create.l HWIO_T_DBACK_SHARED_WORD10_DB1_ADDR A:0x1:0x6ae128
y.create.l HWIO_T_DBACK_SHARED_WORD11_DB1_ADDR A:0x1:0x6ae12c
y.create.l HWIO_T_DBACK_SHARED_WORD12_DB1_ADDR A:0x1:0x6ae130
y.create.l HWIO_T_DBACK_SHARED_WORD13_DB1_ADDR A:0x1:0x6ae134
y.create.l HWIO_T_DBACK_SHARED_WORD14_DB1_ADDR A:0x1:0x6ae138
y.create.l HWIO_T_DBACK_SHARED_WORD15_DB1_ADDR A:0x1:0x6ae13c
y.create.l HWIO_T_DBACK_SHARED_WORD16_DB1_ADDR A:0x1:0x6ae140
y.create.l HWIO_T_DBACK_SHARED_WORD17_DB1_ADDR A:0x1:0x6ae144
y.create.l HWIO_T_DBACK_SHARED_WORD18_DB1_ADDR A:0x1:0x6ae148
y.create.l HWIO_T_DBACK_SHARED_WORD19_DB1_ADDR A:0x1:0x6ae14c
y.create.l HWIO_T_DBACK_SHARED_WORD20_DB1_ADDR A:0x1:0x6ae150
y.create.l HWIO_T_DBACK_SHARED_WORD21_DB1_ADDR A:0x1:0x6ae154
y.create.l HWIO_T_DBACK_SHARED_WORD22_DB1_ADDR A:0x1:0x6ae158
y.create.l HWIO_T_DBACK_SHARED_WORD23_DB1_ADDR A:0x1:0x6ae15c
y.create.l HWIO_T_DBACK_SHARED_WORD24_DB1_ADDR A:0x1:0x6ae160
y.create.l HWIO_T_DBACK_SHARED_WORD25_DB1_ADDR A:0x1:0x6ae164
y.create.l HWIO_T_DBACK_SHARED_WORD26_DB1_ADDR A:0x1:0x6ae168
y.create.l HWIO_T_DBACK_SHARED_WORD27_DB1_ADDR A:0x1:0x6ae16c
y.create.l HWIO_T_DBACK_SHARED_WORD28_DB1_ADDR A:0x1:0x6ae170
y.create.l HWIO_T_DBACK_SHARED_WORD29_DB1_ADDR A:0x1:0x6ae174
y.create.l HWIO_T_DBACK_SHARED_WORD30_DB1_ADDR A:0x1:0x6ae178
y.create.l HWIO_T_DBACK_SHARED_WORD31_DB1_ADDR A:0x1:0x6ae17c
y.create.l HWIO_T_DBACK_SHARED_WORD32_DB1_ADDR A:0x1:0x6ae180
y.create.l HWIO_T_DBACK_SHARED_WORD33_DB1_ADDR A:0x1:0x6ae184
y.create.l HWIO_T_DBACK_SHARED_WORD34_DB1_ADDR A:0x1:0x6ae188
y.create.l HWIO_T_DBACK_SHARED_WORD35_DB1_ADDR A:0x1:0x6ae18c
y.create.l HWIO_T_DBACK_SHARED_WORD36_DB1_ADDR A:0x1:0x6ae190
y.create.l HWIO_T_DBACK_SHARED_WORD37_DB1_ADDR A:0x1:0x6ae194
y.create.l HWIO_T_DBACK_SHARED_WORD38_DB1_ADDR A:0x1:0x6ae198
y.create.l HWIO_T_DBACK_NONHS_DRM_CFG_WORD0_DB1_ADDR A:0x1:0x6ae200
y.create.l HWIO_T_DBACK_NONHS_DRM_CFG_WORD1_DB1_ADDR A:0x1:0x6ae204
y.create.l HWIO_T_DBACK_NONHS_DRM_CFG_WORD2_DB1_ADDR A:0x1:0x6ae208
y.create.l HWIO_T_DBACK_NONHS_DRM_CFG_WORD3_DB1_ADDR A:0x1:0x6ae20c
y.create.l HWIO_T_DBACK_NONHS_DRM_CFG_WORD4_DB1_ADDR A:0x1:0x6ae210
y.create.l HWIO_T_DBACK_NONHS_DRM_CFG_WORD5_DB1_ADDR A:0x1:0x6ae214
y.create.l HWIO_T_DBACK_NONHS_DRM_CFG_WORD6_DB1_ADDR A:0x1:0x6ae218
y.create.l HWIO_T_DBACK_NONHS_DRM_CFG_WORD7_DB1_ADDR A:0x1:0x6ae21c
y.create.l HWIO_T_DBACK_NONHS_DRM_CFG_WORD8_DB1_ADDR A:0x1:0x6ae220
y.create.l HWIO_T_DBACK_NONHS_DRM_CFG_WORD9_DB1_ADDR A:0x1:0x6ae224
y.create.l HWIO_T_DBACK_NONHS_DRM_CFG_WORD10_DB1_ADDR A:0x1:0x6ae228
y.create.l HWIO_T_DBACK_NONHS_DRM_CFG_WORD11_DB1_ADDR A:0x1:0x6ae22c
y.create.l HWIO_T_DBACK_NONHS_DRM_CFG_WORD12_DB1_ADDR A:0x1:0x6ae230
y.create.l HWIO_T_DBACK_NONHS_DRM_CFG_WORD13_DB1_ADDR A:0x1:0x6ae234
y.create.l HWIO_T_DBACK_NONHS_DRM_CFG_WORD14_DB1_ADDR A:0x1:0x6ae238
y.create.l HWIO_T_DBACK_NONHS_DRM_CFG_WORD15_DB1_ADDR A:0x1:0x6ae23c
y.create.l HWIO_T_DBACK_NONHS_DRM_CFG_WORD16_DB1_ADDR A:0x1:0x6ae240
y.create.l HWIO_T_DBACK_NONHS_DRM_CFG_WORD17_DB1_ADDR A:0x1:0x6ae244
y.create.l HWIO_T_DBACK_NONHS_DRM_CFG_WORD18_DB1_ADDR A:0x1:0x6ae248
y.create.l HWIO_T_DBACK_NONHS_DRM_CFG_WORD19_DB1_ADDR A:0x1:0x6ae24c
y.create.l HWIO_T_DBACK_NONHS_DRM_CFG_WORD20_DB1_ADDR A:0x1:0x6ae250
y.create.l HWIO_T_DBACK_NONHS_DRM_CFG_WORD21_DB1_ADDR A:0x1:0x6ae254
y.create.l HWIO_T_DBACK_NONHS_DRM_CFG_WORD22_DB1_ADDR A:0x1:0x6ae258
y.create.l HWIO_T_DBACK_NONHS_DRM_CFG_WORD23_DB1_ADDR A:0x1:0x6ae25c
y.create.l HWIO_T_DBACK_NONHS_DRM_CFG_WORD24_DB1_ADDR A:0x1:0x6ae260
y.create.l HWIO_T_DBACK_NONHS_DRM_CFG_WORD25_DB1_ADDR A:0x1:0x6ae264
y.create.l HWIO_T_DBACK_NONHS_TD_DECIB_WRITER_CFG_WORD0_DB1_ADDR A:0x1:0x6ae300
y.create.l HWIO_T_DBACK_NONHS_TD_DECIB_WRITER_CFG_WORD1_DB1_ADDR A:0x1:0x6ae304
y.create.l HWIO_T_DBACK_HS_TD_DECIB_WRITER_CFG_WORD0_DB1_ADDR A:0x1:0x6ae400
y.create.l HWIO_T_DBACK_HS_TD_DECIB_WRITER_CFG_WORD1_DB1_ADDR A:0x1:0x6ae404
y.create.l HWIO_T_DBACK_HS_TD_DECIB_WRITER_CFG_WORD2_DB1_ADDR A:0x1:0x6ae408
y.create.l HWIO_T_DBACK_HS_TD_DECIB_WRITER_CFG_WORD3_DB1_ADDR A:0x1:0x6ae40c
y.create.l HWIO_T_DBACK_HS_TD_DECIB_WRITER_CFG_WORD4_DB1_ADDR A:0x1:0x6ae410
y.create.l HWIO_T_DBACK_HS_TD_DECIB_WRITER_CFG_WORD5_DB1_ADDR A:0x1:0x6ae414
y.create.l HWIO_T_DBACK_HS_TD_DECIB_WRITER_CFG_WORD6_DB1_ADDR A:0x1:0x6ae418
y.create.l HWIO_T_DBACK_HS_TD_DECIB_WRITER_CFG_WORD7_DB1_ADDR A:0x1:0x6ae41c
y.create.l HWIO_HDR_DEINT_CFG_WORD0_DB1_ADDR A:0x1:0x6af100
y.create.l HWIO_HDR_DEINT_CFG_WORD1_DB1_ADDR A:0x1:0x6af104
y.create.l HWIO_HDR_DEINT_CFG_WORD2_DB1_ADDR A:0x1:0x6af108
y.create.l HWIO_HDR_DEINT_CFG_WORD3_DB1_ADDR A:0x1:0x6af10c
y.create.l HWIO_HDR_DEINT_CFG_WORD4_DB1_ADDR A:0x1:0x6af110
y.create.l HWIO_HDR_DEINT_CFG_WORD5_DB1_ADDR A:0x1:0x6af114
y.create.l HWIO_HDR_DEINT_CFG_WORD6_DB1_ADDR A:0x1:0x6af118
y.create.l HWIO_HDR_DEINT_CFG_WORD7_DB1_ADDR A:0x1:0x6af11c
y.create.l HWIO_HDR_DEINT_CFG_WORD8_DB1_ADDR A:0x1:0x6af120
y.create.l HWIO_HDR_DEINT_CFG_WORD9_DB1_ADDR A:0x1:0x6af124
y.create.l HWIO_HDR_DEINT_CFG_WORD10_DB1_ADDR A:0x1:0x6af128
y.create.l HWIO_HDR_DEINT_CFG_WORD11_DB1_ADDR A:0x1:0x6af12c
y.create.l HWIO_HDR_DEINT_CFG_WORD12_DB1_ADDR A:0x1:0x6af130
y.create.l HWIO_HDR_DEINT_CFG_WORD13_DB1_ADDR A:0x1:0x6af134
y.create.l HWIO_HDR_DEINT_CFG_WORD14_DB1_ADDR A:0x1:0x6af138
y.create.l HWIO_HDR_DEINT_CFG_WORD15_DB1_ADDR A:0x1:0x6af13c
y.create.l HWIO_HDR_DEINT_CFG_WORD16_DB1_ADDR A:0x1:0x6af140
y.create.l HWIO_HDR_DEINT_WORD0_DB1_ADDR A:0x1:0x6af200
y.create.l HWIO_HDR_DEINT_WORD1_DB1_ADDR A:0x1:0x6af204
y.create.l HWIO_HDR_DEINT_WORD2_DB1_ADDR A:0x1:0x6af208
y.create.l HWIO_HDR_DEINT_WORD3_DB1_ADDR A:0x1:0x6af20c
y.create.l HWIO_HDR_DEINT_WORD4_DB1_ADDR A:0x1:0x6af210
y.create.l HWIO_HDR_DEINT_WORD5_DB1_ADDR A:0x1:0x6af214
y.create.l HWIO_HDR_DEINT_WORD6_DB1_ADDR A:0x1:0x6af218
y.create.l HWIO_HDR_DEINT_WORD7_DB1_ADDR A:0x1:0x6af21c
y.create.l HWIO_HDR_DEINT_WORD8_DB1_ADDR A:0x1:0x6af220
y.create.l HWIO_HDR_DEINT_WORD9_DB1_ADDR A:0x1:0x6af224
y.create.l HWIO_HDR_DEINT_WORD10_DB1_ADDR A:0x1:0x6af228
y.create.l HWIO_HDR_DEINT_WORD11_DB1_ADDR A:0x1:0x6af22c
y.create.l HWIO_HDR_DEINT_WORD12_DB1_ADDR A:0x1:0x6af230
y.create.l HWIO_HDR_DEINT_WORD13_DB1_ADDR A:0x1:0x6af234
y.create.l HWIO_TBVD_CCH_STATUS_WORD0_DB1_ADDR A:0x1:0x6b0000
y.create.l HWIO_TBVD_CCH_LTE_CFG_WORD0_DB1_ADDR A:0x1:0x6b0100
y.create.l HWIO_TBVD_CCH_LTE_CFG_WORD1_DB1_ADDR A:0x1:0x6b0104
y.create.l HWIO_TBVD_CCH_LTE_CFG_WORD2_DB1_ADDR A:0x1:0x6b0108
y.create.l HWIO_TBVD_CCH_LTE_CFG_WORD3_DB1_ADDR A:0x1:0x6b010c
y.create.l HWIO_TBVD_CCH_LTE_CFG_WORD4_DB1_ADDR A:0x1:0x6b0110
y.create.l HWIO_TBVD_CCH_LTE_CFG_WORD5_DB1_ADDR A:0x1:0x6b0114
y.create.l HWIO_TBVD_CCH_LTE_CFG_WORD6_DB1_ADDR A:0x1:0x6b0118
y.create.l HWIO_TBVD_CCH_LTE_CFG_WORD7_DB1_ADDR A:0x1:0x6b011c
y.create.l HWIO_TBVD_CCH_LTE_CFG_WORD8_DB1_ADDR A:0x1:0x6b0120
y.create.l HWIO_TBVD_CCH_LTE_CFG_WORD9_DB1_ADDR A:0x1:0x6b0124
y.create.l HWIO_TBVD_CCH_LTE_CFG_WORD10_DB1_ADDR A:0x1:0x6b0128
y.create.l HWIO_TBVD_CCH_LTE_CFG_WORD11_DB1_ADDR A:0x1:0x6b012c
y.create.l HWIO_TBVD_CCH_LTE_CFG_WORD12_DB1_ADDR A:0x1:0x6b0130
y.create.l HWIO_TBVD_CCH_LTE_CFG_WORD13_DB1_ADDR A:0x1:0x6b0134
y.create.l HWIO_TBVD_CCH_LTE_CFG_WORD14_DB1_ADDR A:0x1:0x6b0138
y.create.l HWIO_TBVD_CCH_LTE_CFG_WORD15_DB1_ADDR A:0x1:0x6b013c
y.create.l HWIO_TBVD_CCH_LTE_CFG_WORD16_DB1_ADDR A:0x1:0x6b0140
y.create.l HWIO_TBVD_CCH_LTE_CFG_WORD17_DB1_ADDR A:0x1:0x6b0144
y.create.l HWIO_TBVD_CCH_LTE_CFG_WORD18_DB1_ADDR A:0x1:0x6b0148
y.create.l HWIO_TBVD_CCH_LTE_CFG_WORD19_DB1_ADDR A:0x1:0x6b014c
y.create.l HWIO_TBVD_CCH_LTE_PDCCH_WORD0_DB1_ADDR A:0x1:0x6b0200
y.create.l HWIO_TBVD_CCH_LTE_PDCCH_WORD1_DB1_ADDR A:0x1:0x6b0204
y.create.l HWIO_TBVD_CCH_LTE_PDCCH_WORD2_DB1_ADDR A:0x1:0x6b0208
y.create.l HWIO_TBVD_CCH_LTE_PDCCH_WORD3_DB1_ADDR A:0x1:0x6b020c
y.create.l HWIO_TBVD_CCH_LTE_PDCCH_WORD4_DB1_ADDR A:0x1:0x6b0210
y.create.l HWIO_TBVD_CCH_LTE_PDCCH_WORD5_DB1_ADDR A:0x1:0x6b0214
y.create.l HWIO_TBVD_CCH_LTE_PDCCH_WORD6_DB1_ADDR A:0x1:0x6b0218
y.create.l HWIO_DEC_O_CCH_W_NONHS_LTE_PBCH_WORD0_DB1_ADDR A:0x1:0x6b0300
y.create.l HWIO_DEC_O_CCH_W_NONHS_LTE_PBCH_WORD1_DB1_ADDR A:0x1:0x6b0304
y.create.l HWIO_DEC_O_CCH_W_NONHS_LTE_PBCH_WORD2_DB1_ADDR A:0x1:0x6b0308
y.create.l HWIO_DEMBACK_ENABLE_DB1_ADDR A:0x1:0x6b4000
y.create.l HWIO_DEMBACK_BUFF_MODE_DB1_ADDR A:0x1:0x6b4004
y.create.l HWIO_DEMBACK_BUFF_MEM_CMD_DB1_ADDR A:0x1:0x6b4010
y.create.l HWIO_DEMBACK_BUFF_MEM_WR_DB1_ADDR A:0x1:0x6b4014
y.create.l HWIO_DEMBACK_BUFF_MEM_RD_DB1_ADDR A:0x1:0x6b4018
y.create.l HWIO_DEMBACK_BUFF_TBVD_DECOB_RD_MIN_DB1_ADDR A:0x1:0x6b5000
y.create.l HWIO_DEMBACK_BUFF_TBVD_DECOB_RD_MAX_DB1_ADDR A:0x1:0x6b577c
y.create.l HWIO_DEMBACK_BUFF_SVD_DECOB_RD_MIN_DB1_ADDR A:0x1:0x6b6000
y.create.l HWIO_DEMBACK_BUFF_SVD_DECOB_RD_MAX_DB1_ADDR A:0x1:0x6b6d7c
y.create.l HWIO_MODEM_MEM_PL_ENABLE_ADDR A:0x1:0x800000
y.create.l HWIO_MEM_PL_BRDG_CH0_CFG0_ADDR A:0x1:0x800004
y.create.l HWIO_MEM_PL_BRDG_CH1_CFG0_ADDR A:0x1:0x800010
y.create.l HWIO_MEM_PL_BRDG_CH0_CFG1_ADDR A:0x1:0x800008
y.create.l HWIO_MEM_PL_BRDG_CH1_CFG1_ADDR A:0x1:0x800014
y.create.l HWIO_MEM_PL_SLAVE_ERR_ADDR A:0x1:0x80001c
y.create.l HWIO_MEM_PL_CLR_SLAVE_ERR_ADDR A:0x1:0x800020
y.create.l HWIO_MEM_PL_BNK_GRP0_SLT_0_ADDR A:0x1:0x800400
y.create.l HWIO_MEM_PL_BNK_GRP0_SLT_1_ADDR A:0x1:0x800404
y.create.l HWIO_MEM_PL_BNK_GRP0_SLT_2_ADDR A:0x1:0x800408
y.create.l HWIO_MEM_PL_BNK_GRP0_SLT_3_ADDR A:0x1:0x80040c
y.create.l HWIO_MEM_PL_BNK_GRP1_SLT_0_ADDR A:0x1:0x800480
y.create.l HWIO_MEM_PL_BNK_GRP1_SLT_1_ADDR A:0x1:0x800484
y.create.l HWIO_MEM_PL_BNK_GRP1_SLT_2_ADDR A:0x1:0x800488
y.create.l HWIO_MEM_PL_BNK_GRP1_SLT_3_ADDR A:0x1:0x80048c
y.create.l HWIO_MEM_PL_TDM_UPDATE_ADDR A:0x1:0x800500
y.create.l HWIO_MEM_POOL_TBRDG0_START_ADDR A:0x1:0x840000
y.create.l HWIO_MEM_POOL_TBRDG0_END_ADDR A:0x1:0x87fffc
y.create.l HWIO_MEM_POOL_TBRDG1_START_ADDR A:0x1:0x880000
y.create.l HWIO_MEM_POOL_TBRDG1_END_ADDR A:0x1:0x8bfffc
y.create.l HWIO_MEM_POOL_AXI_START_ADDR A:0x1:0x900000
y.create.l HWIO_MEM_POOL_AXI_END_ADDR A:0x1:0x9dfffc
y.create.l HWIO_MODEM_LMEM_RAM_START_ADDR A:0x1:0xc00000
y.create.l HWIO_MODEM_LMEM_RAM_END_ADDR A:0x1:0xcbfffc
y.create.l HWIO_MSS_XPU_SCR_ADDR A:0xfc800000
y.create.l HWIO_MSS_XPU_SWDR_ADDR A:0xfc800004
y.create.l HWIO_MSS_XPU_SEAR0_ADDR A:0xfc800040
y.create.l HWIO_MSS_XPU_SESR_ADDR A:0xfc800048
y.create.l HWIO_MSS_XPU_SESRRESTORE_ADDR A:0xfc80004c
y.create.l HWIO_MSS_XPU_SESYNR0_ADDR A:0xfc800050
y.create.l HWIO_MSS_XPU_SESYNR1_ADDR A:0xfc800054
y.create.l HWIO_MSS_XPU_SESYNR2_ADDR A:0xfc800058
y.create.l HWIO_MSS_XPU_MCR_ADDR A:0xfc800100
y.create.l HWIO_MSS_XPU_MEAR0_ADDR A:0xfc800140
y.create.l HWIO_MSS_XPU_MESR_ADDR A:0xfc800148
y.create.l HWIO_MSS_XPU_MESRRESTORE_ADDR A:0xfc80014c
y.create.l HWIO_MSS_XPU_MESYNR0_ADDR A:0xfc800150
y.create.l HWIO_MSS_XPU_MESYNR1_ADDR A:0xfc800154
y.create.l HWIO_MSS_XPU_MESYNR2_ADDR A:0xfc800158
y.create.l HWIO_MSS_XPU_CR_ADDR A:0xfc800080
y.create.l HWIO_MSS_XPU_RPU_ACR0_ADDR A:0xfc8000a0
y.create.l HWIO_MSS_XPU_EAR0_ADDR A:0xfc8000c0
y.create.l HWIO_MSS_XPU_ESR_ADDR A:0xfc8000c8
y.create.l HWIO_MSS_XPU_ESRRESTORE_ADDR A:0xfc8000cc
y.create.l HWIO_MSS_XPU_ESYNR0_ADDR A:0xfc8000d0
y.create.l HWIO_MSS_XPU_ESYNR1_ADDR A:0xfc8000d4
y.create.l HWIO_MSS_XPU_ESYNR2_ADDR A:0xfc8000d8
y.create.l HWIO_MSS_XPU_IDR0_ADDR A:0xfc800074
y.create.l HWIO_MSS_XPU_IDR1_ADDR A:0xfc800078
y.create.l HWIO_MSS_XPU_REV_ADDR A:0xfc80007c
y.create.l HWIO_MSS_XPU_RG0_RACR0_ADDR A:0xfc800200
y.create.l HWIO_MSS_XPU_RG1_RACR0_ADDR A:0xfc800280
y.create.l HWIO_MSS_XPU_RG2_RACR0_ADDR A:0xfc800300
y.create.l HWIO_MSS_XPU_RG0_SCR_ADDR A:0xfc800250
y.create.l HWIO_MSS_XPU_RG1_SCR_ADDR A:0xfc8002d0
y.create.l HWIO_MSS_XPU_RG2_SCR_ADDR A:0xfc800350
y.create.l HWIO_MSS_XPU_RG0_MCR_ADDR A:0xfc800254
y.create.l HWIO_MSS_XPU_RG1_MCR_ADDR A:0xfc8002d4
y.create.l HWIO_MSS_XPU_RG2_MCR_ADDR A:0xfc800354
y.create.l HWIO_MSS_MODEM_VMIDMT_SCR0_ADDR A:0xfc808000
y.create.l HWIO_MSS_MODEM_VMIDMT_SCR1_ADDR A:0xfc808004
y.create.l HWIO_MSS_MODEM_VMIDMT_SCR2_ADDR A:0xfc808008
y.create.l HWIO_MSS_MODEM_VMIDMT_SACR_ADDR A:0xfc808010
y.create.l HWIO_MSS_MODEM_VMIDMT_SIDR0_ADDR A:0xfc808020
y.create.l HWIO_MSS_MODEM_VMIDMT_SIDR1_ADDR A:0xfc808024
y.create.l HWIO_MSS_MODEM_VMIDMT_SIDR2_ADDR A:0xfc808028
y.create.l HWIO_MSS_MODEM_VMIDMT_SIDR4_ADDR A:0xfc808030
y.create.l HWIO_MSS_MODEM_VMIDMT_SIDR5_ADDR A:0xfc808034
y.create.l HWIO_MSS_MODEM_VMIDMT_SIDR7_ADDR A:0xfc80803c
y.create.l HWIO_MSS_MODEM_VMIDMT_SGFAR0_ADDR A:0xfc808040
y.create.l HWIO_MSS_MODEM_VMIDMT_SGFSR_ADDR A:0xfc808048
y.create.l HWIO_MSS_MODEM_VMIDMT_SGFSRRESTORE_ADDR A:0xfc80804c
y.create.l HWIO_MSS_MODEM_VMIDMT_SGFSYNDR0_ADDR A:0xfc808050
y.create.l HWIO_MSS_MODEM_VMIDMT_SGFSYNDR1_ADDR A:0xfc808054
y.create.l HWIO_MSS_MODEM_VMIDMT_SGFSYNDR2_ADDR A:0xfc808058
y.create.l HWIO_MSS_MODEM_VMIDMT_VMIDMTSCR0_ADDR A:0xfc808090
y.create.l HWIO_MSS_MODEM_VMIDMT_CR0_ADDR A:0xfc808000
y.create.l HWIO_MSS_MODEM_VMIDMT_CR2_ADDR A:0xfc808008
y.create.l HWIO_MSS_MODEM_VMIDMT_ACR_ADDR A:0xfc808010
y.create.l HWIO_MSS_MODEM_VMIDMT_IDR0_ADDR A:0xfc808020
y.create.l HWIO_MSS_MODEM_VMIDMT_IDR1_ADDR A:0xfc808024
y.create.l HWIO_MSS_MODEM_VMIDMT_IDR2_ADDR A:0xfc808028
y.create.l HWIO_MSS_MODEM_VMIDMT_IDR4_ADDR A:0xfc808030
y.create.l HWIO_MSS_MODEM_VMIDMT_IDR5_ADDR A:0xfc808034
y.create.l HWIO_MSS_MODEM_VMIDMT_IDR7_ADDR A:0xfc80803c
y.create.l HWIO_MSS_MODEM_VMIDMT_GFAR0_ADDR A:0xfc808040
y.create.l HWIO_MSS_MODEM_VMIDMT_GFSR_ADDR A:0xfc808048
y.create.l HWIO_MSS_MODEM_VMIDMT_GFSRRESTORE_ADDR A:0xfc80804c
y.create.l HWIO_MSS_MODEM_VMIDMT_GFSYNDR0_ADDR A:0xfc808050
y.create.l HWIO_MSS_MODEM_VMIDMT_GFSYNDR1_ADDR A:0xfc808054
y.create.l HWIO_MSS_MODEM_VMIDMT_GFSYNDR2_ADDR A:0xfc808058
y.create.l HWIO_MSS_MODEM_VMIDMT_VMIDMTCR0_ADDR A:0xfc808090
y.create.l HWIO_MSS_MODEM_VMIDMT_VMIDMTACR_ADDR A:0xfc80809c
y.create.l HWIO_MSS_MODEM_VMIDMT_NSCR0_ADDR A:0xfc808400
y.create.l HWIO_MSS_MODEM_VMIDMT_NSCR2_ADDR A:0xfc808408
y.create.l HWIO_MSS_MODEM_VMIDMT_NSACR_ADDR A:0xfc808410
y.create.l HWIO_MSS_MODEM_VMIDMT_NSGFAR0_ADDR A:0xfc808440
y.create.l HWIO_MSS_MODEM_VMIDMT_NSGFSR_ADDR A:0xfc808448
y.create.l HWIO_MSS_MODEM_VMIDMT_NSGFSRRESTORE_ADDR A:0xfc80844c
y.create.l HWIO_MSS_MODEM_VMIDMT_NSGFSYNDR0_ADDR A:0xfc808450
y.create.l HWIO_MSS_MODEM_VMIDMT_NSGFSYNDR1_ADDR A:0xfc808454
y.create.l HWIO_MSS_MODEM_VMIDMT_NSGFSYNDR2_ADDR A:0xfc808458
y.create.l HWIO_MSS_MODEM_VMIDMT_NSVMIDMTCR0_ADDR A:0xfc808490
y.create.l HWIO_MSS_MODEM_VMIDMT_SSDR0_ADDR A:0xfc808080
y.create.l HWIO_MSS_MODEM_VMIDMT_S2VR0_ADDR A:0xfc808c00
y.create.l HWIO_MSS_MODEM_VMIDMT_AS2VR0_ADDR A:0xfc808e00
y.create.l HWIO_MSS_NAV_CE_VMIDMT_SCR0_ADDR A:0xfc810000
y.create.l HWIO_MSS_NAV_CE_VMIDMT_SCR1_ADDR A:0xfc810004
y.create.l HWIO_MSS_NAV_CE_VMIDMT_SCR2_ADDR A:0xfc810008
y.create.l HWIO_MSS_NAV_CE_VMIDMT_SACR_ADDR A:0xfc810010
y.create.l HWIO_MSS_NAV_CE_VMIDMT_SIDR0_ADDR A:0xfc810020
y.create.l HWIO_MSS_NAV_CE_VMIDMT_SIDR1_ADDR A:0xfc810024
y.create.l HWIO_MSS_NAV_CE_VMIDMT_SIDR2_ADDR A:0xfc810028
y.create.l HWIO_MSS_NAV_CE_VMIDMT_SIDR4_ADDR A:0xfc810030
y.create.l HWIO_MSS_NAV_CE_VMIDMT_SIDR5_ADDR A:0xfc810034
y.create.l HWIO_MSS_NAV_CE_VMIDMT_SIDR7_ADDR A:0xfc81003c
y.create.l HWIO_MSS_NAV_CE_VMIDMT_SGFAR0_ADDR A:0xfc810040
y.create.l HWIO_MSS_NAV_CE_VMIDMT_SGFSR_ADDR A:0xfc810048
y.create.l HWIO_MSS_NAV_CE_VMIDMT_SGFSRRESTORE_ADDR A:0xfc81004c
y.create.l HWIO_MSS_NAV_CE_VMIDMT_SGFSYNDR0_ADDR A:0xfc810050
y.create.l HWIO_MSS_NAV_CE_VMIDMT_SGFSYNDR1_ADDR A:0xfc810054
y.create.l HWIO_MSS_NAV_CE_VMIDMT_SGFSYNDR2_ADDR A:0xfc810058
y.create.l HWIO_MSS_NAV_CE_VMIDMT_VMIDMTSCR0_ADDR A:0xfc810090
y.create.l HWIO_MSS_NAV_CE_VMIDMT_CR0_ADDR A:0xfc810000
y.create.l HWIO_MSS_NAV_CE_VMIDMT_CR2_ADDR A:0xfc810008
y.create.l HWIO_MSS_NAV_CE_VMIDMT_ACR_ADDR A:0xfc810010
y.create.l HWIO_MSS_NAV_CE_VMIDMT_IDR0_ADDR A:0xfc810020
y.create.l HWIO_MSS_NAV_CE_VMIDMT_IDR1_ADDR A:0xfc810024
y.create.l HWIO_MSS_NAV_CE_VMIDMT_IDR2_ADDR A:0xfc810028
y.create.l HWIO_MSS_NAV_CE_VMIDMT_IDR4_ADDR A:0xfc810030
y.create.l HWIO_MSS_NAV_CE_VMIDMT_IDR5_ADDR A:0xfc810034
y.create.l HWIO_MSS_NAV_CE_VMIDMT_IDR7_ADDR A:0xfc81003c
y.create.l HWIO_MSS_NAV_CE_VMIDMT_GFAR0_ADDR A:0xfc810040
y.create.l HWIO_MSS_NAV_CE_VMIDMT_GFSR_ADDR A:0xfc810048
y.create.l HWIO_MSS_NAV_CE_VMIDMT_GFSRRESTORE_ADDR A:0xfc81004c
y.create.l HWIO_MSS_NAV_CE_VMIDMT_GFSYNDR0_ADDR A:0xfc810050
y.create.l HWIO_MSS_NAV_CE_VMIDMT_GFSYNDR1_ADDR A:0xfc810054
y.create.l HWIO_MSS_NAV_CE_VMIDMT_GFSYNDR2_ADDR A:0xfc810058
y.create.l HWIO_MSS_NAV_CE_VMIDMT_VMIDMTCR0_ADDR A:0xfc810090
y.create.l HWIO_MSS_NAV_CE_VMIDMT_VMIDMTACR_ADDR A:0xfc81009c
y.create.l HWIO_MSS_NAV_CE_VMIDMT_NSCR0_ADDR A:0xfc810400
y.create.l HWIO_MSS_NAV_CE_VMIDMT_NSCR2_ADDR A:0xfc810408
y.create.l HWIO_MSS_NAV_CE_VMIDMT_NSACR_ADDR A:0xfc810410
y.create.l HWIO_MSS_NAV_CE_VMIDMT_NSGFAR0_ADDR A:0xfc810440
y.create.l HWIO_MSS_NAV_CE_VMIDMT_NSGFSR_ADDR A:0xfc810448
y.create.l HWIO_MSS_NAV_CE_VMIDMT_NSGFSRRESTORE_ADDR A:0xfc81044c
y.create.l HWIO_MSS_NAV_CE_VMIDMT_NSGFSYNDR0_ADDR A:0xfc810450
y.create.l HWIO_MSS_NAV_CE_VMIDMT_NSGFSYNDR1_ADDR A:0xfc810454
y.create.l HWIO_MSS_NAV_CE_VMIDMT_NSGFSYNDR2_ADDR A:0xfc810458
y.create.l HWIO_MSS_NAV_CE_VMIDMT_NSVMIDMTCR0_ADDR A:0xfc810490
y.create.l HWIO_MSS_NAV_CE_VMIDMT_SSDR0_ADDR A:0xfc810080
y.create.l HWIO_MSS_NAV_CE_VMIDMT_S2VR0_ADDR A:0xfc810c00
y.create.l HWIO_MSS_NAV_CE_VMIDMT_AS2VR0_ADDR A:0xfc810e00
y.create.l HWIO_MSS_Q6_VMIDMT_SCR0_ADDR A:0xfc818000
y.create.l HWIO_MSS_Q6_VMIDMT_SCR1_ADDR A:0xfc818004
y.create.l HWIO_MSS_Q6_VMIDMT_SCR2_ADDR A:0xfc818008
y.create.l HWIO_MSS_Q6_VMIDMT_SACR_ADDR A:0xfc818010
y.create.l HWIO_MSS_Q6_VMIDMT_SIDR0_ADDR A:0xfc818020
y.create.l HWIO_MSS_Q6_VMIDMT_SIDR1_ADDR A:0xfc818024
y.create.l HWIO_MSS_Q6_VMIDMT_SIDR2_ADDR A:0xfc818028
y.create.l HWIO_MSS_Q6_VMIDMT_SIDR4_ADDR A:0xfc818030
y.create.l HWIO_MSS_Q6_VMIDMT_SIDR5_ADDR A:0xfc818034
y.create.l HWIO_MSS_Q6_VMIDMT_SIDR7_ADDR A:0xfc81803c
y.create.l HWIO_MSS_Q6_VMIDMT_SGFAR0_ADDR A:0xfc818040
y.create.l HWIO_MSS_Q6_VMIDMT_SGFSR_ADDR A:0xfc818048
y.create.l HWIO_MSS_Q6_VMIDMT_SGFSRRESTORE_ADDR A:0xfc81804c
y.create.l HWIO_MSS_Q6_VMIDMT_SGFSYNDR0_ADDR A:0xfc818050
y.create.l HWIO_MSS_Q6_VMIDMT_SGFSYNDR1_ADDR A:0xfc818054
y.create.l HWIO_MSS_Q6_VMIDMT_SGFSYNDR2_ADDR A:0xfc818058
y.create.l HWIO_MSS_Q6_VMIDMT_VMIDMTSCR0_ADDR A:0xfc818090
y.create.l HWIO_MSS_Q6_VMIDMT_CR0_ADDR A:0xfc818000
y.create.l HWIO_MSS_Q6_VMIDMT_CR2_ADDR A:0xfc818008
y.create.l HWIO_MSS_Q6_VMIDMT_ACR_ADDR A:0xfc818010
y.create.l HWIO_MSS_Q6_VMIDMT_IDR0_ADDR A:0xfc818020
y.create.l HWIO_MSS_Q6_VMIDMT_IDR1_ADDR A:0xfc818024
y.create.l HWIO_MSS_Q6_VMIDMT_IDR2_ADDR A:0xfc818028
y.create.l HWIO_MSS_Q6_VMIDMT_IDR4_ADDR A:0xfc818030
y.create.l HWIO_MSS_Q6_VMIDMT_IDR5_ADDR A:0xfc818034
y.create.l HWIO_MSS_Q6_VMIDMT_IDR7_ADDR A:0xfc81803c
y.create.l HWIO_MSS_Q6_VMIDMT_GFAR0_ADDR A:0xfc818040
y.create.l HWIO_MSS_Q6_VMIDMT_GFSR_ADDR A:0xfc818048
y.create.l HWIO_MSS_Q6_VMIDMT_GFSRRESTORE_ADDR A:0xfc81804c
y.create.l HWIO_MSS_Q6_VMIDMT_GFSYNDR0_ADDR A:0xfc818050
y.create.l HWIO_MSS_Q6_VMIDMT_GFSYNDR1_ADDR A:0xfc818054
y.create.l HWIO_MSS_Q6_VMIDMT_GFSYNDR2_ADDR A:0xfc818058
y.create.l HWIO_MSS_Q6_VMIDMT_VMIDMTCR0_ADDR A:0xfc818090
y.create.l HWIO_MSS_Q6_VMIDMT_VMIDMTACR_ADDR A:0xfc81809c
y.create.l HWIO_MSS_Q6_VMIDMT_NSCR0_ADDR A:0xfc818400
y.create.l HWIO_MSS_Q6_VMIDMT_NSCR2_ADDR A:0xfc818408
y.create.l HWIO_MSS_Q6_VMIDMT_NSACR_ADDR A:0xfc818410
y.create.l HWIO_MSS_Q6_VMIDMT_NSGFAR0_ADDR A:0xfc818440
y.create.l HWIO_MSS_Q6_VMIDMT_NSGFSR_ADDR A:0xfc818448
y.create.l HWIO_MSS_Q6_VMIDMT_NSGFSRRESTORE_ADDR A:0xfc81844c
y.create.l HWIO_MSS_Q6_VMIDMT_NSGFSYNDR0_ADDR A:0xfc818450
y.create.l HWIO_MSS_Q6_VMIDMT_NSGFSYNDR1_ADDR A:0xfc818454
y.create.l HWIO_MSS_Q6_VMIDMT_NSGFSYNDR2_ADDR A:0xfc818458
y.create.l HWIO_MSS_Q6_VMIDMT_NSVMIDMTCR0_ADDR A:0xfc818490
y.create.l HWIO_MSS_Q6_VMIDMT_SSDR0_ADDR A:0xfc818080
y.create.l HWIO_MSS_Q6_VMIDMT_S2VR0_ADDR A:0xfc818c00
y.create.l HWIO_MSS_Q6_VMIDMT_AS2VR0_ADDR A:0xfc818e00
y.create.l HWIO_MSS_RELAY_MSG_BUFFER_00_ADDR A:0xfc820000
y.create.l HWIO_MSS_RELAY_MSG_BUFFER_01_ADDR A:0xfc820004
y.create.l HWIO_MSS_RELAY_MSG_BUFFER_02_ADDR A:0xfc820008
y.create.l HWIO_MSS_RELAY_MSG_BUFFER_03_ADDR A:0xfc82000c
y.create.l HWIO_MSS_RELAY_MSG_BUFFER_04_ADDR A:0xfc820010
y.create.l HWIO_MSS_RELAY_MSG_BUFFER_05_ADDR A:0xfc820014
y.create.l HWIO_MSS_RELAY_MSG_BUFFER_06_ADDR A:0xfc820018
y.create.l HWIO_MSS_RELAY_MSG_BUFFER_07_ADDR A:0xfc82001c
y.create.l HWIO_MSS_RELAY_MSG_BUFFER_08_ADDR A:0xfc820020
y.create.l HWIO_MSS_QDSP6SS_VERSION_ADDR A:0xfc880000
y.create.l HWIO_MSS_QDSP6SS_RST_EVB_ADDR A:0xfc880010
y.create.l HWIO_MSS_QDSP6SS_RESET_ADDR A:0xfc880014
y.create.l HWIO_MSS_QDSP6SS_DBG_CFG_ADDR A:0xfc880018
y.create.l HWIO_MSS_QDSP6SS_RET_CFG_ADDR A:0xfc88001c
y.create.l HWIO_MSS_QDSP6SS_GFMUX_CTL_ADDR A:0xfc880020
y.create.l HWIO_MSS_QDSP6SS_GFMUX_STATUS_ADDR A:0xfc880024
y.create.l HWIO_MSS_QDSP6SS_CORE_CMD_RCGR_ADDR A:0xfc880028
y.create.l HWIO_MSS_QDSP6SS_CORE_CFG_RCGR_ADDR A:0xfc88002c
y.create.l HWIO_MSS_QDSP6SS_PWR_CTL_ADDR A:0xfc880030
y.create.l HWIO_MSS_QDSP6SS_CGC_OVERRIDE_ADDR A:0xfc880034
y.create.l HWIO_MSS_QDSP6SS_XO_CBCR_ADDR A:0xfc880038
y.create.l HWIO_MSS_QDSP6SS_SLEEP_CBCR_ADDR A:0xfc88003c
y.create.l HWIO_MSS_QDSP6SS_NMI_ADDR A:0xfc880040
y.create.l HWIO_MSS_QDSP6SS_NMI_STATUS_ADDR A:0xfc880044
y.create.l HWIO_MSS_QDSP6SS_CLOCK_SPDM_MON_ADDR A:0xfc880048
y.create.l HWIO_MSS_QDSP6SS_LDO_CFG0_ADDR A:0xfc880050
y.create.l HWIO_MSS_QDSP6SS_LDO_CFG1_ADDR A:0xfc880054
y.create.l HWIO_MSS_QDSP6SS_LDO_CFG2_ADDR A:0xfc880058
y.create.l HWIO_MSS_QDSP6SS_LDO_VREF_SET_ADDR A:0xfc88005c
y.create.l HWIO_MSS_QDSP6SS_LDO_VREF_TEST_CFG_ADDR A:0xfc880060
y.create.l HWIO_MSS_QDSP6SS_LDO_VREF_CMD_ADDR A:0xfc880064
y.create.l HWIO_MSS_QDSP6SS_QMC_SVS_CTL_ADDR A:0xfc880068
y.create.l HWIO_MSS_QDSP6SS_BHS_STATUS_ADDR A:0xfc88006c
y.create.l HWIO_MSS_QDSP6SS_STRAP_TCM_ADDR A:0xfc880100
y.create.l HWIO_MSS_QDSP6SS_STRAP_AHBUPPER_ADDR A:0xfc880104
y.create.l HWIO_MSS_QDSP6SS_STRAP_AHBLOWER_ADDR A:0xfc880108
y.create.l HWIO_MSS_QDSP6SS_STRAP_ACC_ADDR A:0xfc880110
y.create.l HWIO_MSS_QDSP6SS_STRAP_QMC_ACC_ADDR A:0xfc880114
y.create.l HWIO_MSS_QDSP6SS_DCC_CTRL_ADDR A:0xfc880118
y.create.l HWIO_MSS_QDSP6SS_STRAP_AXIM2UPPER_ADDR A:0xfc88011c
y.create.l HWIO_MSS_QDSP6SS_STRAP_AXIM2LOWER_ADDR A:0xfc880120
y.create.l HWIO_MSS_QDSP6SS_PLL_MODE_ADDR A:0xfc880200
y.create.l HWIO_MSS_QDSP6SS_PLL_L_VAL_ADDR A:0xfc880204
y.create.l HWIO_MSS_QDSP6SS_PLL_ALPHA_VAL_ADDR A:0xfc880208
y.create.l HWIO_MSS_QDSP6SS_PLL_ALPHA_VAL_U_ADDR A:0xfc88020c
y.create.l HWIO_MSS_QDSP6SS_PLL_USER_CTL_ADDR A:0xfc880210
y.create.l HWIO_MSS_QDSP6SS_PLL_USER_CTL_U_ADDR A:0xfc880214
y.create.l HWIO_MSS_QDSP6SS_PLL_CONFIG_CTL_ADDR A:0xfc880218
y.create.l HWIO_MSS_QDSP6SS_PLL_TEST_CTL_ADDR A:0xfc88021c
y.create.l HWIO_MSS_QDSP6SS_PLL_TEST_CTL_U_ADDR A:0xfc880220
y.create.l HWIO_MSS_QDSP6SS_PLL_STATUS_ADDR A:0xfc880224
y.create.l HWIO_MSS_QDSP6SS_PLL_FREQ_CTL_ADDR A:0xfc880228
y.create.l HWIO_MSS_QDSP6SS_EXT_WAKEUP_ADDR A:0xfc881000
y.create.l HWIO_MSS_QDSP6SS_EXT_PD_ADDR A:0xfc881004
y.create.l HWIO_MSS_QDSP6SS_TEST_BUS_CTL_ADDR A:0xfc882000
y.create.l HWIO_MSS_QDSP6SS_TEST_BUS_VALUE_ADDR A:0xfc882004
y.create.l HWIO_MSS_QDSP6SS_TEST_BUS_WDATA_ADDR A:0xfc882008
y.create.l HWIO_MSS_QDSP6SS_PWRDBG_CTL_ADDR A:0xfc88200c
y.create.l HWIO_MSS_QDSP6SS_TEST_CLK_CTL_ADDR A:0xfc882010
y.create.l HWIO_MSS_QDSP6SS_PWRDBG_STATUS_ADDR A:0xfc882014
y.create.l HWIO_MSS_QDSP6SS_ZMEAS_CONFIG_ADDR A:0xfc882018
y.create.l HWIO_MSS_QDSP6SS_LDO_ATEST_ADDR A:0xfc88201c
y.create.l HWIO_MSS_QDSP6SS_LDO_DAC_STATUS_LOW_ADDR A:0xfc882020
y.create.l HWIO_MSS_QDSP6SS_LDO_DAC_STATUS_HIGH_ADDR A:0xfc882024
y.create.l HWIO_MSS_QDSP6SS_INSTANCE_ID_ADDR A:0xfc900000
y.create.l HWIO_MSS_QDSP6SS_IDLT_MATCH_VAL_ADDR A:0xfc901000
y.create.l HWIO_MSS_QDSP6SS_IDLT_COUNT_VAL_ADDR A:0xfc901004
y.create.l HWIO_MSS_QDSP6SS_IDLT_ENABLE_ADDR A:0xfc901008
y.create.l HWIO_MSS_QDSP6SS_IDLT_SYNC_STATUS_ADDR A:0xfc90100c
y.create.l HWIO_MSS_QDSP6SS_WDOG_RESET_ADDR A:0xfc902000
y.create.l HWIO_MSS_QDSP6SS_WDOG_CTL_ADDR A:0xfc902004
y.create.l HWIO_MSS_QDSP6SS_WDOG_STATUS_ADDR A:0xfc902008
y.create.l HWIO_MSS_QDSP6SS_WDOG_BARK_TIME_ADDR A:0xfc90200c
y.create.l HWIO_MSS_QDSP6SS_WDOG_BITE_TIME_ADDR A:0xfc902010
y.create.l HWIO_MSS_QDSP6SS_WDOG_NMI_TIME_ADDR A:0xfc902014
y.create.l HWIO_MSS_QDSP6SS_WDOG_TEST_LOAD_ADDR A:0xfc902018
y.create.l HWIO_MSS_QDSP6SS_WDOG_TEST_ADDR A:0xfc90201c
y.create.l HWIO_MSS_QDSP6SS_IPC_ADDR A:0xfc905000
y.create.l HWIO_MSS_QDSP6SS_L1_IRQ_BACKUP_EN_ADDR A:0xfc905010
y.create.l HWIO_MSS_QDSP6SS_PD_HS_START_ADDR A:0xfc90700c
y.create.l HWIO_MSS_QDSP6SS_PD_HS_DONE_ADDR A:0xfc907010
y.create.l HWIO_MSS_QDSP6SS_PU_HS_START_ADDR A:0xfc907014
y.create.l HWIO_MSS_QDSP6SS_SLPC_CFG_ADDR A:0xfc90701c
y.create.l HWIO_MSS_QDSP6SS_SLPC_STATUS_ADDR A:0xfc907020
y.create.l HWIO_MSS_QDSP6SS_SPMCTL_EN_ARES_ADDR A:0xfc907024
y.create.l HWIO_MSS_QDSP6SS_SPMCTL_EN_CLAMP_ADDR A:0xfc907028
y.create.l HWIO_MSS_QDSP6SS_SPMCTL_EN_CLK_ADDR A:0xfc90702c
y.create.l HWIO_MSS_QDSP6SS_SPMCTL_EN_MEM_ADDR A:0xfc907030
y.create.l HWIO_MSS_QDSP6SS_SPMCTL_EN_BHS_ADDR A:0xfc907034
y.create.l HWIO_MSS_QDSP6SS_SPMCTL_EN_LDO_ADDR A:0xfc907038
y.create.l HWIO_MSS_QDSP6SS_SPMCTL_EN_EXT_ADDR A:0xfc90703c
y.create.l HWIO_MSS_QDSP6SS_SPMCTL_EN_PLL_ADDR A:0xfc907040
y.create.l HWIO_MSS_QDSP6SS_SPM_EVENT_CTL_ADDR A:0xfc907050
y.create.l HWIO_MSS_QDSP6SS_MVC_PWR_REQ_ADDR A:0xfc907080
y.create.l HWIO_MSS_QDSP6SS_L2VIC_VID_ADDR A:0xfc910000
y.create.l HWIO_MSS_QDSP6SS_L2VIC_INT_ENABLE0_ADDR A:0xfc910100
y.create.l HWIO_MSS_QDSP6SS_L2VIC_INT_ENABLE1_ADDR A:0xfc910104
y.create.l HWIO_MSS_QDSP6SS_L2VIC_INT_ENABLE2_ADDR A:0xfc910108
y.create.l HWIO_MSS_QDSP6SS_L2VIC_INT_ENABLE3_ADDR A:0xfc91010c
y.create.l HWIO_MSS_QDSP6SS_L2VIC_INT_ENABLE4_ADDR A:0xfc910110
y.create.l HWIO_MSS_QDSP6SS_L2VIC_INT_ENABLE5_ADDR A:0xfc910114
y.create.l HWIO_MSS_QDSP6SS_L2VIC_INT_ENABLE6_ADDR A:0xfc910118
y.create.l HWIO_MSS_QDSP6SS_L2VIC_INT_ENABLE7_ADDR A:0xfc91011c
y.create.l HWIO_MSS_QDSP6SS_L2VIC_INT_ENABLE8_ADDR A:0xfc910120
y.create.l HWIO_MSS_QDSP6SS_L2VIC_INT_ENABLE9_ADDR A:0xfc910124
y.create.l HWIO_MSS_QDSP6SS_L2VIC_INT_ENABLE_CLEAR0_ADDR A:0xfc910180
y.create.l HWIO_MSS_QDSP6SS_L2VIC_INT_ENABLE_CLEAR1_ADDR A:0xfc910184
y.create.l HWIO_MSS_QDSP6SS_L2VIC_INT_ENABLE_CLEAR2_ADDR A:0xfc910188
y.create.l HWIO_MSS_QDSP6SS_L2VIC_INT_ENABLE_CLEAR3_ADDR A:0xfc91018c
y.create.l HWIO_MSS_QDSP6SS_L2VIC_INT_ENABLE_CLEAR4_ADDR A:0xfc910190
y.create.l HWIO_MSS_QDSP6SS_L2VIC_INT_ENABLE_CLEAR5_ADDR A:0xfc910194
y.create.l HWIO_MSS_QDSP6SS_L2VIC_INT_ENABLE_CLEAR6_ADDR A:0xfc910198
y.create.l HWIO_MSS_QDSP6SS_L2VIC_INT_ENABLE_CLEAR7_ADDR A:0xfc91019c
y.create.l HWIO_MSS_QDSP6SS_L2VIC_INT_ENABLE_CLEAR8_ADDR A:0xfc9101a0
y.create.l HWIO_MSS_QDSP6SS_L2VIC_INT_ENABLE_CLEAR9_ADDR A:0xfc9101a4
y.create.l HWIO_MSS_QDSP6SS_L2VIC_INT_ENABLE_SET0_ADDR A:0xfc910200
y.create.l HWIO_MSS_QDSP6SS_L2VIC_INT_ENABLE_SET1_ADDR A:0xfc910204
y.create.l HWIO_MSS_QDSP6SS_L2VIC_INT_ENABLE_SET2_ADDR A:0xfc910208
y.create.l HWIO_MSS_QDSP6SS_L2VIC_INT_ENABLE_SET3_ADDR A:0xfc91020c
y.create.l HWIO_MSS_QDSP6SS_L2VIC_INT_ENABLE_SET4_ADDR A:0xfc910210
y.create.l HWIO_MSS_QDSP6SS_L2VIC_INT_ENABLE_SET5_ADDR A:0xfc910214
y.create.l HWIO_MSS_QDSP6SS_L2VIC_INT_ENABLE_SET6_ADDR A:0xfc910218
y.create.l HWIO_MSS_QDSP6SS_L2VIC_INT_ENABLE_SET7_ADDR A:0xfc91021c
y.create.l HWIO_MSS_QDSP6SS_L2VIC_INT_ENABLE_SET8_ADDR A:0xfc910220
y.create.l HWIO_MSS_QDSP6SS_L2VIC_INT_ENABLE_SET9_ADDR A:0xfc910224
y.create.l HWIO_MSS_QDSP6SS_L2VIC_INT_TYPE0_ADDR A:0xfc910280
y.create.l HWIO_MSS_QDSP6SS_L2VIC_INT_TYPE1_ADDR A:0xfc910284
y.create.l HWIO_MSS_QDSP6SS_L2VIC_INT_TYPE2_ADDR A:0xfc910288
y.create.l HWIO_MSS_QDSP6SS_L2VIC_INT_TYPE3_ADDR A:0xfc91028c
y.create.l HWIO_MSS_QDSP6SS_L2VIC_INT_TYPE4_ADDR A:0xfc910290
y.create.l HWIO_MSS_QDSP6SS_L2VIC_INT_TYPE5_ADDR A:0xfc910294
y.create.l HWIO_MSS_QDSP6SS_L2VIC_INT_TYPE6_ADDR A:0xfc910298
y.create.l HWIO_MSS_QDSP6SS_L2VIC_INT_TYPE7_ADDR A:0xfc91029c
y.create.l HWIO_MSS_QDSP6SS_L2VIC_INT_TYPE8_ADDR A:0xfc9102a0
y.create.l HWIO_MSS_QDSP6SS_L2VIC_INT_TYPE9_ADDR A:0xfc9102a4
y.create.l HWIO_MSS_QDSP6SS_L2VIC_INT_STATUS0_ADDR A:0xfc910380
y.create.l HWIO_MSS_QDSP6SS_L2VIC_INT_STATUS1_ADDR A:0xfc910384
y.create.l HWIO_MSS_QDSP6SS_L2VIC_INT_STATUS2_ADDR A:0xfc910388
y.create.l HWIO_MSS_QDSP6SS_L2VIC_INT_STATUS3_ADDR A:0xfc91038c
y.create.l HWIO_MSS_QDSP6SS_L2VIC_INT_STATUS4_ADDR A:0xfc910390
y.create.l HWIO_MSS_QDSP6SS_L2VIC_INT_STATUS5_ADDR A:0xfc910394
y.create.l HWIO_MSS_QDSP6SS_L2VIC_INT_STATUS6_ADDR A:0xfc910398
y.create.l HWIO_MSS_QDSP6SS_L2VIC_INT_STATUS7_ADDR A:0xfc91039c
y.create.l HWIO_MSS_QDSP6SS_L2VIC_INT_STATUS8_ADDR A:0xfc9103a0
y.create.l HWIO_MSS_QDSP6SS_L2VIC_INT_STATUS9_ADDR A:0xfc9103a4
y.create.l HWIO_MSS_QDSP6SS_L2VIC_INT_CLEAR0_ADDR A:0xfc910400
y.create.l HWIO_MSS_QDSP6SS_L2VIC_INT_CLEAR1_ADDR A:0xfc910404
y.create.l HWIO_MSS_QDSP6SS_L2VIC_INT_CLEAR2_ADDR A:0xfc910408
y.create.l HWIO_MSS_QDSP6SS_L2VIC_INT_CLEAR3_ADDR A:0xfc91040c
y.create.l HWIO_MSS_QDSP6SS_L2VIC_INT_CLEAR4_ADDR A:0xfc910410
y.create.l HWIO_MSS_QDSP6SS_L2VIC_INT_CLEAR5_ADDR A:0xfc910414
y.create.l HWIO_MSS_QDSP6SS_L2VIC_INT_CLEAR6_ADDR A:0xfc910418
y.create.l HWIO_MSS_QDSP6SS_L2VIC_INT_CLEAR7_ADDR A:0xfc91041c
y.create.l HWIO_MSS_QDSP6SS_L2VIC_INT_CLEAR8_ADDR A:0xfc910420
y.create.l HWIO_MSS_QDSP6SS_L2VIC_INT_CLEAR9_ADDR A:0xfc910424
y.create.l HWIO_MSS_QDSP6SS_L2VIC_SOFT_INT0_ADDR A:0xfc910480
y.create.l HWIO_MSS_QDSP6SS_L2VIC_SOFT_INT1_ADDR A:0xfc910484
y.create.l HWIO_MSS_QDSP6SS_L2VIC_SOFT_INT2_ADDR A:0xfc910488
y.create.l HWIO_MSS_QDSP6SS_L2VIC_SOFT_INT3_ADDR A:0xfc91048c
y.create.l HWIO_MSS_QDSP6SS_L2VIC_SOFT_INT4_ADDR A:0xfc910490
y.create.l HWIO_MSS_QDSP6SS_L2VIC_SOFT_INT5_ADDR A:0xfc910494
y.create.l HWIO_MSS_QDSP6SS_L2VIC_SOFT_INT6_ADDR A:0xfc910498
y.create.l HWIO_MSS_QDSP6SS_L2VIC_SOFT_INT7_ADDR A:0xfc91049c
y.create.l HWIO_MSS_QDSP6SS_L2VIC_SOFT_INT8_ADDR A:0xfc9104a0
y.create.l HWIO_MSS_QDSP6SS_L2VIC_SOFT_INT9_ADDR A:0xfc9104a4
y.create.l HWIO_MSS_QDSP6SS_L2VIC_INT_PENDING0_ADDR A:0xfc910500
y.create.l HWIO_MSS_QDSP6SS_L2VIC_INT_PENDING1_ADDR A:0xfc910504
y.create.l HWIO_MSS_QDSP6SS_L2VIC_INT_PENDING2_ADDR A:0xfc910508
y.create.l HWIO_MSS_QDSP6SS_L2VIC_INT_PENDING3_ADDR A:0xfc91050c
y.create.l HWIO_MSS_QDSP6SS_L2VIC_INT_PENDING4_ADDR A:0xfc910510
y.create.l HWIO_MSS_QDSP6SS_L2VIC_INT_PENDING5_ADDR A:0xfc910514
y.create.l HWIO_MSS_QDSP6SS_L2VIC_INT_PENDING6_ADDR A:0xfc910518
y.create.l HWIO_MSS_QDSP6SS_L2VIC_INT_PENDING7_ADDR A:0xfc91051c
y.create.l HWIO_MSS_QDSP6SS_L2VIC_INT_PENDING8_ADDR A:0xfc910520
y.create.l HWIO_MSS_QDSP6SS_L2VIC_INT_PENDING9_ADDR A:0xfc910524
y.create.l HWIO_MSS_QDSP6SS_QTMR_AC_CNTFRQ_ADDR A:0xfc920000
y.create.l HWIO_MSS_QDSP6SS_QTMR_AC_CNTSR_ADDR A:0xfc920004
y.create.l HWIO_MSS_QDSP6SS_QTMR_AC_CNTTID_ADDR A:0xfc920008
y.create.l HWIO_MSS_QDSP6SS_QTMR_AC_CNTACR_0_ADDR A:0xfc920040
y.create.l HWIO_MSS_QDSP6SS_QTMR_AC_CNTACR_1_ADDR A:0xfc920044
y.create.l HWIO_MSS_QDSP6SS_QTMR_AC_CNTACR_2_ADDR A:0xfc920048
y.create.l HWIO_MSS_QDSP6SS_QTMR_AC_CNTVOFF_LO_0_ADDR A:0xfc920080
y.create.l HWIO_MSS_QDSP6SS_QTMR_AC_CNTVOFF_LO_1_ADDR A:0xfc920088
y.create.l HWIO_MSS_QDSP6SS_QTMR_AC_CNTVOFF_LO_2_ADDR A:0xfc920090
y.create.l HWIO_MSS_QDSP6SS_QTMR_AC_CNTVOFF_HI_0_ADDR A:0xfc920084
y.create.l HWIO_MSS_QDSP6SS_QTMR_AC_CNTVOFF_HI_1_ADDR A:0xfc92008c
y.create.l HWIO_MSS_QDSP6SS_QTMR_AC_CNTVOFF_HI_2_ADDR A:0xfc920094
y.create.l HWIO_MSS_QDSP6SS_QTMR_AC_CFG_ADDR A:0xfc920fc0
y.create.l HWIO_MSS_QDSP6SS_QTMR_AC_VERSION_ADDR A:0xfc920fd0
y.create.l HWIO_MSS_QDSP6SS_QTMR_V1_CNTPCT_LO_0_ADDR A:0xfc921000
y.create.l HWIO_MSS_QDSP6SS_QTMR_V1_CNTPCT_HI_0_ADDR A:0xfc921004
y.create.l HWIO_MSS_QDSP6SS_QTMR_V1_CNTVCT_LO_0_ADDR A:0xfc921008
y.create.l HWIO_MSS_QDSP6SS_QTMR_V1_CNTVCT_HI_0_ADDR A:0xfc92100c
y.create.l HWIO_MSS_QDSP6SS_QTMR_V1_CNTFRQ_0_ADDR A:0xfc921010
y.create.l HWIO_MSS_QDSP6SS_QTMR_V1_CNTPL0ACR_0_ADDR A:0xfc921014
y.create.l HWIO_MSS_QDSP6SS_QTMR_V1_CNTVOFF_LO_0_ADDR A:0xfc921018
y.create.l HWIO_MSS_QDSP6SS_QTMR_V1_CNTVOFF_HI_0_ADDR A:0xfc92101c
y.create.l HWIO_MSS_QDSP6SS_QTMR_V1_CNTP_CVAL_LO_0_ADDR A:0xfc921020
y.create.l HWIO_MSS_QDSP6SS_QTMR_V1_CNTP_CVAL_HI_0_ADDR A:0xfc921024
y.create.l HWIO_MSS_QDSP6SS_QTMR_V1_CNTP_TVAL_0_ADDR A:0xfc921028
y.create.l HWIO_MSS_QDSP6SS_QTMR_V1_CNTP_CTL_0_ADDR A:0xfc92102c
y.create.l HWIO_MSS_QDSP6SS_QTMR_V1_CNTV_CVAL_LO_0_ADDR A:0xfc921030
y.create.l HWIO_MSS_QDSP6SS_QTMR_V1_CNTV_CVAL_HI_0_ADDR A:0xfc921034
y.create.l HWIO_MSS_QDSP6SS_QTMR_V1_CNTV_TVAL_0_ADDR A:0xfc921038
y.create.l HWIO_MSS_QDSP6SS_QTMR_V1_CNTV_CTL_0_ADDR A:0xfc92103c
y.create.l HWIO_MSS_QDSP6SS_QTMR_V1_VERSION_0_ADDR A:0xfc921fd0
y.create.l HWIO_MSS_QDSP6SS_QTMR_V1_CNTPCT_LO_1_ADDR A:0xfc922000
y.create.l HWIO_MSS_QDSP6SS_QTMR_V1_CNTPCT_HI_1_ADDR A:0xfc922004
y.create.l HWIO_MSS_QDSP6SS_QTMR_V1_CNTVCT_LO_1_ADDR A:0xfc922008
y.create.l HWIO_MSS_QDSP6SS_QTMR_V1_CNTVCT_HI_1_ADDR A:0xfc92200c
y.create.l HWIO_MSS_QDSP6SS_QTMR_V1_CNTFRQ_1_ADDR A:0xfc922010
y.create.l HWIO_MSS_QDSP6SS_QTMR_V1_CNTPL0ACR_1_ADDR A:0xfc922014
y.create.l HWIO_MSS_QDSP6SS_QTMR_V1_CNTVOFF_LO_1_ADDR A:0xfc922018
y.create.l HWIO_MSS_QDSP6SS_QTMR_V1_CNTVOFF_HI_1_ADDR A:0xfc92201c
y.create.l HWIO_MSS_QDSP6SS_QTMR_V1_CNTP_CVAL_LO_1_ADDR A:0xfc922020
y.create.l HWIO_MSS_QDSP6SS_QTMR_V1_CNTP_CVAL_HI_1_ADDR A:0xfc922024
y.create.l HWIO_MSS_QDSP6SS_QTMR_V1_CNTP_TVAL_1_ADDR A:0xfc922028
y.create.l HWIO_MSS_QDSP6SS_QTMR_V1_CNTP_CTL_1_ADDR A:0xfc92202c
y.create.l HWIO_MSS_QDSP6SS_QTMR_V1_CNTV_CVAL_LO_1_ADDR A:0xfc922030
y.create.l HWIO_MSS_QDSP6SS_QTMR_V1_CNTV_CVAL_HI_1_ADDR A:0xfc922034
y.create.l HWIO_MSS_QDSP6SS_QTMR_V1_CNTV_TVAL_1_ADDR A:0xfc922038
y.create.l HWIO_MSS_QDSP6SS_QTMR_V1_CNTV_CTL_1_ADDR A:0xfc92203c
y.create.l HWIO_MSS_QDSP6SS_QTMR_V1_VERSION_1_ADDR A:0xfc922fd0
y.create.l HWIO_MSS_QDSP6SS_QTMR_V1_CNTPCT_LO_2_ADDR A:0xfc923000
y.create.l HWIO_MSS_QDSP6SS_QTMR_V1_CNTPCT_HI_2_ADDR A:0xfc923004
y.create.l HWIO_MSS_QDSP6SS_QTMR_V1_CNTVCT_LO_2_ADDR A:0xfc923008
y.create.l HWIO_MSS_QDSP6SS_QTMR_V1_CNTVCT_HI_2_ADDR A:0xfc92300c
y.create.l HWIO_MSS_QDSP6SS_QTMR_V1_CNTFRQ_2_ADDR A:0xfc923010
y.create.l HWIO_MSS_QDSP6SS_QTMR_V1_CNTPL0ACR_2_ADDR A:0xfc923014
y.create.l HWIO_MSS_QDSP6SS_QTMR_V1_CNTVOFF_LO_2_ADDR A:0xfc923018
y.create.l HWIO_MSS_QDSP6SS_QTMR_V1_CNTVOFF_HI_2_ADDR A:0xfc92301c
y.create.l HWIO_MSS_QDSP6SS_QTMR_V1_CNTP_CVAL_LO_2_ADDR A:0xfc923020
y.create.l HWIO_MSS_QDSP6SS_QTMR_V1_CNTP_CVAL_HI_2_ADDR A:0xfc923024
y.create.l HWIO_MSS_QDSP6SS_QTMR_V1_CNTP_TVAL_2_ADDR A:0xfc923028
y.create.l HWIO_MSS_QDSP6SS_QTMR_V1_CNTP_CTL_2_ADDR A:0xfc92302c
y.create.l HWIO_MSS_QDSP6SS_QTMR_V1_CNTV_CVAL_LO_2_ADDR A:0xfc923030
y.create.l HWIO_MSS_QDSP6SS_QTMR_V1_CNTV_CVAL_HI_2_ADDR A:0xfc923034
y.create.l HWIO_MSS_QDSP6SS_QTMR_V1_CNTV_TVAL_2_ADDR A:0xfc923038
y.create.l HWIO_MSS_QDSP6SS_QTMR_V1_CNTV_CTL_2_ADDR A:0xfc92303c
y.create.l HWIO_MSS_QDSP6SS_QTMR_V1_VERSION_2_ADDR A:0xfc923fd0
y.create.l HWIO_MSS_QDSP6SS_SAW2_SECURE_ADDR A:0xfc930000
y.create.l HWIO_MSS_QDSP6SS_SAW2_ID_ADDR A:0xfc930004
y.create.l HWIO_MSS_QDSP6SS_SAW2_CFG_ADDR A:0xfc930008
y.create.l HWIO_MSS_QDSP6SS_SAW2_SPM_STS_ADDR A:0xfc93000c
y.create.l HWIO_MSS_QDSP6SS_SAW2_AVS_STS_ADDR A:0xfc930010
y.create.l HWIO_MSS_QDSP6SS_SAW2_PMIC_STS_ADDR A:0xfc930014
y.create.l HWIO_MSS_QDSP6SS_SAW2_RST_ADDR A:0xfc930018
y.create.l HWIO_MSS_QDSP6SS_SAW2_VCTL_ADDR A:0xfc93001c
y.create.l HWIO_MSS_QDSP6SS_SAW2_AVS_CTL_ADDR A:0xfc930020
y.create.l HWIO_MSS_QDSP6SS_SAW2_AVS_LIMIT_ADDR A:0xfc930024
y.create.l HWIO_MSS_QDSP6SS_SAW2_AVS_DLY_ADDR A:0xfc930028
y.create.l HWIO_MSS_QDSP6SS_SAW2_AVS_HYSTERESIS_ADDR A:0xfc93002c
y.create.l HWIO_MSS_QDSP6SS_SAW2_SPM_CTL_ADDR A:0xfc930030
y.create.l HWIO_MSS_QDSP6SS_SAW2_SPM_DLY_ADDR A:0xfc930034
y.create.l HWIO_MSS_QDSP6SS_SAW2_SPM_STS2_ADDR A:0xfc930038
y.create.l HWIO_MSS_QDSP6SS_SAW2_SPM_SLP_SEQ_ENTRY_0_ADDR A:0xfc930400
y.create.l HWIO_MSS_QDSP6SS_SAW2_SPM_SLP_SEQ_ENTRY_1_ADDR A:0xfc930404
y.create.l HWIO_MSS_QDSP6SS_SAW2_SPM_SLP_SEQ_ENTRY_2_ADDR A:0xfc930408
y.create.l HWIO_MSS_QDSP6SS_SAW2_SPM_SLP_SEQ_ENTRY_3_ADDR A:0xfc93040c
y.create.l HWIO_MSS_QDSP6SS_SAW2_SPM_SLP_SEQ_ENTRY_4_ADDR A:0xfc930410
y.create.l HWIO_MSS_QDSP6SS_SAW2_SPM_SLP_SEQ_ENTRY_5_ADDR A:0xfc930414
y.create.l HWIO_MSS_QDSP6SS_SAW2_SPM_SLP_SEQ_ENTRY_6_ADDR A:0xfc930418
y.create.l HWIO_MSS_QDSP6SS_SAW2_SPM_SLP_SEQ_ENTRY_7_ADDR A:0xfc93041c
y.create.l HWIO_MSS_QDSP6SS_SAW2_SPM_SLP_SEQ_ENTRY_8_ADDR A:0xfc930420
y.create.l HWIO_MSS_QDSP6SS_SAW2_SPM_SLP_SEQ_ENTRY_9_ADDR A:0xfc930424
y.create.l HWIO_MSS_QDSP6SS_SAW2_SPM_PMIC_DATA_0_ADDR A:0xfc930040
y.create.l HWIO_MSS_QDSP6SS_SAW2_SPM_PMIC_DATA_1_ADDR A:0xfc930044
y.create.l HWIO_MSS_QDSP6SS_SAW2_SPM_PMIC_DATA_2_ADDR A:0xfc930048
y.create.l HWIO_MSS_QDSP6SS_SAW2_SPM_PMIC_DATA_3_ADDR A:0xfc93004c
y.create.l HWIO_MSS_QDSP6SS_SAW2_VERSION_ADDR A:0xfc930fd0
y.create.l HWIO_MSS_CLAMP_MEM_ADDR A:0xfc980000
y.create.l HWIO_MSS_CLAMP_IO_ADDR A:0xfc980004
y.create.l HWIO_MSS_BUS_MAXI2AXI_CFG_ADDR A:0xfc980008
y.create.l HWIO_MSS_ATB_ID_ADDR A:0xfc98000c
y.create.l HWIO_MSS_DBG_BUS_CTL_ADDR A:0xfc980010
y.create.l HWIO_MSS_AHB_ACCESS_ERR_IRQ_EN_ADDR A:0xfc980014
y.create.l HWIO_MSS_AHB_ACCESS_ERR_IRQ_STATUS_ADDR A:0xfc980018
y.create.l HWIO_MSS_AHB_ACCESS_ERR_IRQ_CLR_ADDR A:0xfc98001c
y.create.l HWIO_MSS_RELAY_MSG_SHADOW0_ADDR A:0xfc980020
y.create.l HWIO_MSS_RELAY_MSG_SHADOW1_ADDR A:0xfc980024
y.create.l HWIO_MSS_RELAY_MSG_SHADOW2_ADDR A:0xfc980028
y.create.l HWIO_MSS_RELAY_MSG_SHADOW3_ADDR A:0xfc98002c
y.create.l HWIO_MSS_MSA_ADDR A:0xfc980030
y.create.l HWIO_MSS_HW_VERSION_ADDR A:0xfc980034
y.create.l HWIO_MSS_OFFLINE_MEM_SLP_CNTL_ADDR A:0xfc980038
y.create.l HWIO_MSS_OFFLINE_MEM_SLP_CNTL2_ADDR A:0xfc98003c
y.create.l HWIO_MSS_CLOCK_SPDM_MON_ADDR A:0xfc980040
y.create.l HWIO_MSS_DEBUG_CLOCK_CTL_ADDR A:0xfc980044
y.create.l HWIO_MSS_DEBUG_CTL_ADDR A:0xfc980048
y.create.l HWIO_MSS_CUSTOM_MEM_ARRSTBYN_ADDR A:0xfc98004c
y.create.l HWIO_MSS_OFFLINE_PLL_MODE_ADDR A:0xfc981000
y.create.l HWIO_MSS_OFFLINE_PLL_L_VAL_ADDR A:0xfc981004
y.create.l HWIO_MSS_OFFLINE_PLL_ALPHA_VAL_ADDR A:0xfc981008
y.create.l HWIO_MSS_OFFLINE_PLL_ALPHA_VAL_U_ADDR A:0xfc98100c
y.create.l HWIO_MSS_OFFLINE_PLL_USER_CTL_ADDR A:0xfc981010
y.create.l HWIO_MSS_OFFLINE_PLL_USER_CTL_U_ADDR A:0xfc981014
y.create.l HWIO_MSS_OFFLINE_PLL_CONFIG_CTL_ADDR A:0xfc981018
y.create.l HWIO_MSS_OFFLINE_PLL_TEST_CTL_ADDR A:0xfc98101c
y.create.l HWIO_MSS_OFFLINE_PLL_TEST_CTL_U_ADDR A:0xfc981020
y.create.l HWIO_MSS_OFFLINE_PLL_STATUS_ADDR A:0xfc981024
y.create.l HWIO_MSS_OFFLINE_PLL_FREQ_CTL_ADDR A:0xfc981028
y.create.l HWIO_MSS_BUS_CMD_RCGR_ADDR A:0xfc98102c
y.create.l HWIO_MSS_BUS_CFG_RCGR_ADDR A:0xfc981030
y.create.l HWIO_MSS_UIM_CMD_RCGR_ADDR A:0xfc981034
y.create.l HWIO_MSS_UIM_CFG_RCGR_ADDR A:0xfc981038
y.create.l HWIO_MSS_UIM0_MND_CMD_RCGR_ADDR A:0xfc98103c
y.create.l HWIO_MSS_UIM0_MND_CFG_RCGR_ADDR A:0xfc981040
y.create.l HWIO_MSS_UIM0_MND_M_ADDR A:0xfc981044
y.create.l HWIO_MSS_UIM0_MND_N_ADDR A:0xfc981048
y.create.l HWIO_MSS_UIM0_MND_D_ADDR A:0xfc98104c
y.create.l HWIO_MSS_UIM0_BCR_ADDR A:0xfc981050
y.create.l HWIO_MSS_CARD_SRC_UIM0_CBCR_ADDR A:0xfc981054
y.create.l HWIO_MSS_UART_BIT_UIM0_CBCR_ADDR A:0xfc981058
y.create.l HWIO_MSS_BUS_UIM0_CBCR_ADDR A:0xfc98105c
y.create.l HWIO_MSS_UIM1_MND_CMD_RCGR_ADDR A:0xfc981060
y.create.l HWIO_MSS_UIM1_MND_CFG_RCGR_ADDR A:0xfc981064
y.create.l HWIO_MSS_UIM1_MND_M_ADDR A:0xfc981068
y.create.l HWIO_MSS_UIM1_MND_N_ADDR A:0xfc98106c
y.create.l HWIO_MSS_UIM1_MND_D_ADDR A:0xfc981070
y.create.l HWIO_MSS_UIM1_BCR_ADDR A:0xfc981074
y.create.l HWIO_MSS_CARD_SRC_UIM1_CBCR_ADDR A:0xfc981078
y.create.l HWIO_MSS_UART_BIT_UIM1_CBCR_ADDR A:0xfc98107c
y.create.l HWIO_MSS_BUS_UIM1_CBCR_ADDR A:0xfc981080
y.create.l HWIO_MSS_UIM2_MND_CMD_RCGR_ADDR A:0xfc981084
y.create.l HWIO_MSS_UIM2_MND_CFG_RCGR_ADDR A:0xfc981088
y.create.l HWIO_MSS_UIM2_MND_M_ADDR A:0xfc98108c
y.create.l HWIO_MSS_UIM2_MND_N_ADDR A:0xfc981090
y.create.l HWIO_MSS_UIM2_MND_D_ADDR A:0xfc981094
y.create.l HWIO_MSS_UIM2_BCR_ADDR A:0xfc981098
y.create.l HWIO_MSS_CARD_SRC_UIM2_CBCR_ADDR A:0xfc98109c
y.create.l HWIO_MSS_UART_BIT_UIM2_CBCR_ADDR A:0xfc9810a0
y.create.l HWIO_MSS_BUS_UIM2_CBCR_ADDR A:0xfc9810a4
y.create.l HWIO_MSS_UIM3_MND_CMD_RCGR_ADDR A:0xfc9810a8
y.create.l HWIO_MSS_UIM3_MND_CFG_RCGR_ADDR A:0xfc9810ac
y.create.l HWIO_MSS_UIM3_MND_M_ADDR A:0xfc9810b0
y.create.l HWIO_MSS_UIM3_MND_N_ADDR A:0xfc9810b4
y.create.l HWIO_MSS_UIM3_MND_D_ADDR A:0xfc9810b8
y.create.l HWIO_MSS_UIM3_BCR_ADDR A:0xfc9810bc
y.create.l HWIO_MSS_CARD_SRC_UIM3_CBCR_ADDR A:0xfc9810c0
y.create.l HWIO_MSS_UART_BIT_UIM3_CBCR_ADDR A:0xfc9810c4
y.create.l HWIO_MSS_BUS_UIM3_CBCR_ADDR A:0xfc9810c8
y.create.l HWIO_MSS_MODEM_BCR_ADDR A:0xfc9810cc
y.create.l HWIO_MSS_AXI_MODEM_CBCR_ADDR A:0xfc9810d0
y.create.l HWIO_MSS_XO_MODEM_OFFLINE_CBCR_ADDR A:0xfc9810d4
y.create.l HWIO_MSS_Q6SS_BCR_ADDR A:0xfc9810d8
y.create.l HWIO_MSS_BUS_Q6SS_CBCR_ADDR A:0xfc9810dc
y.create.l HWIO_MSS_NAV_BCR_ADDR A:0xfc9810e0
y.create.l HWIO_MSS_BUS_NAV_CBCR_ADDR A:0xfc9810e4
y.create.l HWIO_MSS_XO_NAV_CBCR_ADDR A:0xfc9810e8
y.create.l HWIO_MSS_CE_NAV_BRIDGE_BCR_ADDR A:0xfc9810ec
y.create.l HWIO_MSS_AXI_CE_NAV_CBCR_ADDR A:0xfc9810f0
y.create.l HWIO_MSS_BUS_CE_NAV_BRIDGE_CBCR_ADDR A:0xfc9810f4
y.create.l HWIO_MSS_AXI_VMIDMT_CBCR_ADDR A:0xfc9810f8
y.create.l HWIO_MSS_CRYPTO_BCR_ADDR A:0xfc9810fc
y.create.l HWIO_MSS_BUS_CRYPTO_CBCR_ADDR A:0xfc981100
y.create.l HWIO_MSS_BIT_COXM_MND_CMD_RCGR_ADDR A:0xfc981104
y.create.l HWIO_MSS_BIT_COXM_MND_CFG_RCGR_ADDR A:0xfc981108
y.create.l HWIO_MSS_BIT_COXM_MND_M_ADDR A:0xfc98110c
y.create.l HWIO_MSS_BIT_COXM_MND_N_ADDR A:0xfc981110
y.create.l HWIO_MSS_BIT_COXM_MND_D_ADDR A:0xfc981114
y.create.l HWIO_MSS_COXM_BCR_ADDR A:0xfc981118
y.create.l HWIO_MSS_BUS_COXM_CBCR_ADDR A:0xfc98111c
y.create.l HWIO_MSS_BIT_COXM_CBCR_ADDR A:0xfc981120
y.create.l HWIO_MSS_RBCPR_REF_CMD_RCGR_ADDR A:0xfc981124
y.create.l HWIO_MSS_RBCPR_REF_CFG_RCGR_ADDR A:0xfc981128
y.create.l HWIO_MSS_RBCPR_BCR_ADDR A:0xfc98112c
y.create.l HWIO_MSS_BUS_RBCPR_CBCR_ADDR A:0xfc981130
y.create.l HWIO_MSS_RBCPR_REF_CBCR_ADDR A:0xfc981134
y.create.l HWIO_MSS_MGPI_BCR_ADDR A:0xfc981138
y.create.l HWIO_MSS_BUS_MGPI_CBCR_ADDR A:0xfc98113c
y.create.l HWIO_MSS_BUS_ATB_CBCR_ADDR A:0xfc981140
y.create.l HWIO_MSS_BUS_SLAVE_TIMEOUT_CBCR_ADDR A:0xfc981144
y.create.l HWIO_MSS_MVC_BCR_ADDR A:0xfc981148
y.create.l HWIO_MSS_BUS_MVC_CBCR_ADDR A:0xfc98114c
y.create.l HWIO_MSS_STMR_BCR_ADDR A:0xfc981150
y.create.l HWIO_MSS_BUS_STMR_CBCR_ADDR A:0xfc981154
y.create.l HWIO_MSS_XO_STMR_CBCR_ADDR A:0xfc981158
y.create.l HWIO_MSS_XO_DTR_CBCR_ADDR A:0xfc98115c
y.create.l HWIO_MSS_SW_FEATURE_FUSES_ADDR A:0xfc981170
y.create.l HWIO_MSS_RESERVE_02_ADDR A:0xfc981174
y.create.l HWIO_MSS_UIM0_UART_DM_MR1_ADDR A:0xfc990000
y.create.l HWIO_MSS_UIM0_UART_DM_MR2_ADDR A:0xfc990004
y.create.l HWIO_MSS_UIM0_UART_DM_CSR_SR_DEPRECATED_ADDR A:0xfc990008
y.create.l HWIO_MSS_UIM0_UART_DM_CR_MISR_DEPRECATED_ADDR A:0xfc990010
y.create.l HWIO_MSS_UIM0_UART_DM_IMR_ISR_DEPRECATED_ADDR A:0xfc990014
y.create.l HWIO_MSS_UIM0_UART_DM_IPR_ADDR A:0xfc990018
y.create.l HWIO_MSS_UIM0_UART_DM_TFWR_ADDR A:0xfc99001c
y.create.l HWIO_MSS_UIM0_UART_DM_RFWR_ADDR A:0xfc990020
y.create.l HWIO_MSS_UIM0_UART_DM_HCR_ADDR A:0xfc990024
y.create.l HWIO_MSS_UIM0_UART_DM_DMRX_ADDR A:0xfc990034
y.create.l HWIO_MSS_UIM0_UART_DM_IRDA_RX_TOTAL_SNAP_DEPRECATED_ADDR A:0xfc990038
y.create.l HWIO_MSS_UIM0_UART_DM_DMEN_ADDR A:0xfc99003c
y.create.l HWIO_MSS_UIM0_UART_DM_NO_CHARS_FOR_TX_ADDR A:0xfc990040
y.create.l HWIO_MSS_UIM0_UART_DM_BADR_ADDR A:0xfc990044
y.create.l HWIO_MSS_UIM0_UART_DM_TESTSL_ADDR A:0xfc990048
y.create.l HWIO_MSS_UIM0_UART_DM_TXFS_ADDR A:0xfc99004c
y.create.l HWIO_MSS_UIM0_UART_DM_RXFS_ADDR A:0xfc990050
y.create.l HWIO_MSS_UIM0_UART_DM_MISR_MODE_ADDR A:0xfc990060
y.create.l HWIO_MSS_UIM0_UART_DM_MISR_RESET_ADDR A:0xfc990064
y.create.l HWIO_MSS_UIM0_UART_DM_MISR_EXPORT_ADDR A:0xfc990068
y.create.l HWIO_MSS_UIM0_UART_DM_MISR_VAL_ADDR A:0xfc99006c
y.create.l HWIO_MSS_UIM0_UART_DM_TF_RF_DEPRECATED_ADDR A:0xfc990070
y.create.l HWIO_MSS_UIM0_UART_DM_TF_RF_2_DEPRECATED_ADDR A:0xfc990074
y.create.l HWIO_MSS_UIM0_UART_DM_TF_RF_3_DEPRECATED_ADDR A:0xfc990078
y.create.l HWIO_MSS_UIM0_UART_DM_TF_RF_4_DEPRECATED_ADDR A:0xfc99007c
y.create.l HWIO_MSS_UIM0_UART_DM_SIM_CFG_ADDR A:0xfc990080
y.create.l HWIO_MSS_UIM0_UART_DM_TEST_WR_ADDR_ADDR A:0xfc990084
y.create.l HWIO_MSS_UIM0_UART_DM_TEST_WR_DATA_ADDR A:0xfc990088
y.create.l HWIO_MSS_UIM0_UART_DM_TEST_RD_ADDR_ADDR A:0xfc99008c
y.create.l HWIO_MSS_UIM0_UART_DM_TEST_RD_DATA_ADDR A:0xfc990090
y.create.l HWIO_MSS_UIM0_UART_DM_CSR_ADDR A:0xfc9900a0
y.create.l HWIO_MSS_UIM0_UART_DM_SR_ADDR A:0xfc9900a4
y.create.l HWIO_MSS_UIM0_UART_DM_CR_ADDR A:0xfc9900a8
y.create.l HWIO_MSS_UIM0_UART_DM_MISR_ADDR A:0xfc9900ac
y.create.l HWIO_MSS_UIM0_UART_DM_IMR_ADDR A:0xfc9900b0
y.create.l HWIO_MSS_UIM0_UART_DM_ISR_ADDR A:0xfc9900b4
y.create.l HWIO_MSS_UIM0_UART_DM_IRDA_ADDR A:0xfc9900b8
y.create.l HWIO_MSS_UIM0_UART_DM_RX_TOTAL_SNAP_ADDR A:0xfc9900bc
y.create.l HWIO_MSS_UIM0_UART_DM_WWT_TIMEOUT_ADDR A:0xfc9900c0
y.create.l HWIO_MSS_UIM0_UART_DM_CLK_CTRL_ADDR A:0xfc9900c4
y.create.l HWIO_MSS_UIM0_UART_DM_BCR_ADDR A:0xfc9900c8
y.create.l HWIO_MSS_UIM0_UART_DM_RX_TRANS_CTRL_ADDR A:0xfc9900cc
y.create.l HWIO_MSS_UIM0_UART_DM_DMRX_DBG_ADDR A:0xfc9900d0
y.create.l HWIO_MSS_UIM0_UART_DM_FSM_STATUS_ADDR A:0xfc9900d4
y.create.l HWIO_MSS_UIM0_UART_DM_HW_VERSION_ADDR A:0xfc9900d8
y.create.l HWIO_MSS_UIM0_UART_DM_GENERICS_ADDR A:0xfc9900dc
y.create.l HWIO_MSS_UIM0_UART_DM_TF_ADDR A:0xfc990100
y.create.l HWIO_MSS_UIM0_UART_DM_TF_2_ADDR A:0xfc990104
y.create.l HWIO_MSS_UIM0_UART_DM_TF_3_ADDR A:0xfc990108
y.create.l HWIO_MSS_UIM0_UART_DM_TF_4_ADDR A:0xfc99010c
y.create.l HWIO_MSS_UIM0_UART_DM_TF_5_ADDR A:0xfc990110
y.create.l HWIO_MSS_UIM0_UART_DM_TF_6_ADDR A:0xfc990114
y.create.l HWIO_MSS_UIM0_UART_DM_TF_7_ADDR A:0xfc990118
y.create.l HWIO_MSS_UIM0_UART_DM_TF_8_ADDR A:0xfc99011c
y.create.l HWIO_MSS_UIM0_UART_DM_TF_9_ADDR A:0xfc990120
y.create.l HWIO_MSS_UIM0_UART_DM_TF_10_ADDR A:0xfc990124
y.create.l HWIO_MSS_UIM0_UART_DM_TF_11_ADDR A:0xfc990128
y.create.l HWIO_MSS_UIM0_UART_DM_TF_12_ADDR A:0xfc99012c
y.create.l HWIO_MSS_UIM0_UART_DM_TF_13_ADDR A:0xfc990130
y.create.l HWIO_MSS_UIM0_UART_DM_TF_14_ADDR A:0xfc990134
y.create.l HWIO_MSS_UIM0_UART_DM_TF_15_ADDR A:0xfc990138
y.create.l HWIO_MSS_UIM0_UART_DM_TF_16_ADDR A:0xfc99013c
y.create.l HWIO_MSS_UIM0_UART_DM_RF_ADDR A:0xfc990140
y.create.l HWIO_MSS_UIM0_UART_DM_RF_2_ADDR A:0xfc990144
y.create.l HWIO_MSS_UIM0_UART_DM_RF_3_ADDR A:0xfc990148
y.create.l HWIO_MSS_UIM0_UART_DM_RF_4_ADDR A:0xfc99014c
y.create.l HWIO_MSS_UIM0_UART_DM_RF_5_ADDR A:0xfc990150
y.create.l HWIO_MSS_UIM0_UART_DM_RF_6_ADDR A:0xfc990154
y.create.l HWIO_MSS_UIM0_UART_DM_RF_7_ADDR A:0xfc990158
y.create.l HWIO_MSS_UIM0_UART_DM_RF_8_ADDR A:0xfc99015c
y.create.l HWIO_MSS_UIM0_UART_DM_RF_9_ADDR A:0xfc990160
y.create.l HWIO_MSS_UIM0_UART_DM_RF_10_ADDR A:0xfc990164
y.create.l HWIO_MSS_UIM0_UART_DM_RF_11_ADDR A:0xfc990168
y.create.l HWIO_MSS_UIM0_UART_DM_RF_12_ADDR A:0xfc99016c
y.create.l HWIO_MSS_UIM0_UART_DM_RF_13_ADDR A:0xfc990170
y.create.l HWIO_MSS_UIM0_UART_DM_RF_14_ADDR A:0xfc990174
y.create.l HWIO_MSS_UIM0_UART_DM_RF_15_ADDR A:0xfc990178
y.create.l HWIO_MSS_UIM0_UART_DM_RF_16_ADDR A:0xfc99017c
y.create.l HWIO_MSS_UIM0_UART_DM_UIM_CFG_ADDR A:0xfc990180
y.create.l HWIO_MSS_UIM0_UART_DM_UIM_CMD_ADDR A:0xfc990184
y.create.l HWIO_MSS_UIM0_UART_DM_UIM_IO_STATUS_ADDR A:0xfc990188
y.create.l HWIO_MSS_UIM0_UART_DM_UIM_IRQ_ISR_ADDR A:0xfc99018c
y.create.l HWIO_MSS_UIM0_UART_DM_UIM_IRQ_MISR_ADDR A:0xfc990190
y.create.l HWIO_MSS_UIM0_UART_DM_UIM_IRQ_CLR_ADDR A:0xfc990194
y.create.l HWIO_MSS_UIM0_UART_DM_UIM_IRQ_IMR_ADDR A:0xfc990198
y.create.l HWIO_MSS_UIM0_UART_DM_UIM_IRQ_IMR_SET_ADDR A:0xfc99019c
y.create.l HWIO_MSS_UIM0_UART_DM_UIM_IRQ_IMR_CLR_ADDR A:0xfc9901a0
y.create.l HWIO_MSS_UIM1_UART_DM_MR1_ADDR A:0xfc994000
y.create.l HWIO_MSS_UIM1_UART_DM_MR2_ADDR A:0xfc994004
y.create.l HWIO_MSS_UIM1_UART_DM_CSR_SR_DEPRECATED_ADDR A:0xfc994008
y.create.l HWIO_MSS_UIM1_UART_DM_CR_MISR_DEPRECATED_ADDR A:0xfc994010
y.create.l HWIO_MSS_UIM1_UART_DM_IMR_ISR_DEPRECATED_ADDR A:0xfc994014
y.create.l HWIO_MSS_UIM1_UART_DM_IPR_ADDR A:0xfc994018
y.create.l HWIO_MSS_UIM1_UART_DM_TFWR_ADDR A:0xfc99401c
y.create.l HWIO_MSS_UIM1_UART_DM_RFWR_ADDR A:0xfc994020
y.create.l HWIO_MSS_UIM1_UART_DM_HCR_ADDR A:0xfc994024
y.create.l HWIO_MSS_UIM1_UART_DM_DMRX_ADDR A:0xfc994034
y.create.l HWIO_MSS_UIM1_UART_DM_IRDA_RX_TOTAL_SNAP_DEPRECATED_ADDR A:0xfc994038
y.create.l HWIO_MSS_UIM1_UART_DM_DMEN_ADDR A:0xfc99403c
y.create.l HWIO_MSS_UIM1_UART_DM_NO_CHARS_FOR_TX_ADDR A:0xfc994040
y.create.l HWIO_MSS_UIM1_UART_DM_BADR_ADDR A:0xfc994044
y.create.l HWIO_MSS_UIM1_UART_DM_TESTSL_ADDR A:0xfc994048
y.create.l HWIO_MSS_UIM1_UART_DM_TXFS_ADDR A:0xfc99404c
y.create.l HWIO_MSS_UIM1_UART_DM_RXFS_ADDR A:0xfc994050
y.create.l HWIO_MSS_UIM1_UART_DM_MISR_MODE_ADDR A:0xfc994060
y.create.l HWIO_MSS_UIM1_UART_DM_MISR_RESET_ADDR A:0xfc994064
y.create.l HWIO_MSS_UIM1_UART_DM_MISR_EXPORT_ADDR A:0xfc994068
y.create.l HWIO_MSS_UIM1_UART_DM_MISR_VAL_ADDR A:0xfc99406c
y.create.l HWIO_MSS_UIM1_UART_DM_TF_RF_DEPRECATED_ADDR A:0xfc994070
y.create.l HWIO_MSS_UIM1_UART_DM_TF_RF_2_DEPRECATED_ADDR A:0xfc994074
y.create.l HWIO_MSS_UIM1_UART_DM_TF_RF_3_DEPRECATED_ADDR A:0xfc994078
y.create.l HWIO_MSS_UIM1_UART_DM_TF_RF_4_DEPRECATED_ADDR A:0xfc99407c
y.create.l HWIO_MSS_UIM1_UART_DM_SIM_CFG_ADDR A:0xfc994080
y.create.l HWIO_MSS_UIM1_UART_DM_TEST_WR_ADDR_ADDR A:0xfc994084
y.create.l HWIO_MSS_UIM1_UART_DM_TEST_WR_DATA_ADDR A:0xfc994088
y.create.l HWIO_MSS_UIM1_UART_DM_TEST_RD_ADDR_ADDR A:0xfc99408c
y.create.l HWIO_MSS_UIM1_UART_DM_TEST_RD_DATA_ADDR A:0xfc994090
y.create.l HWIO_MSS_UIM1_UART_DM_CSR_ADDR A:0xfc9940a0
y.create.l HWIO_MSS_UIM1_UART_DM_SR_ADDR A:0xfc9940a4
y.create.l HWIO_MSS_UIM1_UART_DM_CR_ADDR A:0xfc9940a8
y.create.l HWIO_MSS_UIM1_UART_DM_MISR_ADDR A:0xfc9940ac
y.create.l HWIO_MSS_UIM1_UART_DM_IMR_ADDR A:0xfc9940b0
y.create.l HWIO_MSS_UIM1_UART_DM_ISR_ADDR A:0xfc9940b4
y.create.l HWIO_MSS_UIM1_UART_DM_IRDA_ADDR A:0xfc9940b8
y.create.l HWIO_MSS_UIM1_UART_DM_RX_TOTAL_SNAP_ADDR A:0xfc9940bc
y.create.l HWIO_MSS_UIM1_UART_DM_WWT_TIMEOUT_ADDR A:0xfc9940c0
y.create.l HWIO_MSS_UIM1_UART_DM_CLK_CTRL_ADDR A:0xfc9940c4
y.create.l HWIO_MSS_UIM1_UART_DM_BCR_ADDR A:0xfc9940c8
y.create.l HWIO_MSS_UIM1_UART_DM_RX_TRANS_CTRL_ADDR A:0xfc9940cc
y.create.l HWIO_MSS_UIM1_UART_DM_DMRX_DBG_ADDR A:0xfc9940d0
y.create.l HWIO_MSS_UIM1_UART_DM_FSM_STATUS_ADDR A:0xfc9940d4
y.create.l HWIO_MSS_UIM1_UART_DM_HW_VERSION_ADDR A:0xfc9940d8
y.create.l HWIO_MSS_UIM1_UART_DM_GENERICS_ADDR A:0xfc9940dc
y.create.l HWIO_MSS_UIM1_UART_DM_TF_ADDR A:0xfc994100
y.create.l HWIO_MSS_UIM1_UART_DM_TF_2_ADDR A:0xfc994104
y.create.l HWIO_MSS_UIM1_UART_DM_TF_3_ADDR A:0xfc994108
y.create.l HWIO_MSS_UIM1_UART_DM_TF_4_ADDR A:0xfc99410c
y.create.l HWIO_MSS_UIM1_UART_DM_TF_5_ADDR A:0xfc994110
y.create.l HWIO_MSS_UIM1_UART_DM_TF_6_ADDR A:0xfc994114
y.create.l HWIO_MSS_UIM1_UART_DM_TF_7_ADDR A:0xfc994118
y.create.l HWIO_MSS_UIM1_UART_DM_TF_8_ADDR A:0xfc99411c
y.create.l HWIO_MSS_UIM1_UART_DM_TF_9_ADDR A:0xfc994120
y.create.l HWIO_MSS_UIM1_UART_DM_TF_10_ADDR A:0xfc994124
y.create.l HWIO_MSS_UIM1_UART_DM_TF_11_ADDR A:0xfc994128
y.create.l HWIO_MSS_UIM1_UART_DM_TF_12_ADDR A:0xfc99412c
y.create.l HWIO_MSS_UIM1_UART_DM_TF_13_ADDR A:0xfc994130
y.create.l HWIO_MSS_UIM1_UART_DM_TF_14_ADDR A:0xfc994134
y.create.l HWIO_MSS_UIM1_UART_DM_TF_15_ADDR A:0xfc994138
y.create.l HWIO_MSS_UIM1_UART_DM_TF_16_ADDR A:0xfc99413c
y.create.l HWIO_MSS_UIM1_UART_DM_RF_ADDR A:0xfc994140
y.create.l HWIO_MSS_UIM1_UART_DM_RF_2_ADDR A:0xfc994144
y.create.l HWIO_MSS_UIM1_UART_DM_RF_3_ADDR A:0xfc994148
y.create.l HWIO_MSS_UIM1_UART_DM_RF_4_ADDR A:0xfc99414c
y.create.l HWIO_MSS_UIM1_UART_DM_RF_5_ADDR A:0xfc994150
y.create.l HWIO_MSS_UIM1_UART_DM_RF_6_ADDR A:0xfc994154
y.create.l HWIO_MSS_UIM1_UART_DM_RF_7_ADDR A:0xfc994158
y.create.l HWIO_MSS_UIM1_UART_DM_RF_8_ADDR A:0xfc99415c
y.create.l HWIO_MSS_UIM1_UART_DM_RF_9_ADDR A:0xfc994160
y.create.l HWIO_MSS_UIM1_UART_DM_RF_10_ADDR A:0xfc994164
y.create.l HWIO_MSS_UIM1_UART_DM_RF_11_ADDR A:0xfc994168
y.create.l HWIO_MSS_UIM1_UART_DM_RF_12_ADDR A:0xfc99416c
y.create.l HWIO_MSS_UIM1_UART_DM_RF_13_ADDR A:0xfc994170
y.create.l HWIO_MSS_UIM1_UART_DM_RF_14_ADDR A:0xfc994174
y.create.l HWIO_MSS_UIM1_UART_DM_RF_15_ADDR A:0xfc994178
y.create.l HWIO_MSS_UIM1_UART_DM_RF_16_ADDR A:0xfc99417c
y.create.l HWIO_MSS_UIM1_UART_DM_UIM_CFG_ADDR A:0xfc994180
y.create.l HWIO_MSS_UIM1_UART_DM_UIM_CMD_ADDR A:0xfc994184
y.create.l HWIO_MSS_UIM1_UART_DM_UIM_IO_STATUS_ADDR A:0xfc994188
y.create.l HWIO_MSS_UIM1_UART_DM_UIM_IRQ_ISR_ADDR A:0xfc99418c
y.create.l HWIO_MSS_UIM1_UART_DM_UIM_IRQ_MISR_ADDR A:0xfc994190
y.create.l HWIO_MSS_UIM1_UART_DM_UIM_IRQ_CLR_ADDR A:0xfc994194
y.create.l HWIO_MSS_UIM1_UART_DM_UIM_IRQ_IMR_ADDR A:0xfc994198
y.create.l HWIO_MSS_UIM1_UART_DM_UIM_IRQ_IMR_SET_ADDR A:0xfc99419c
y.create.l HWIO_MSS_UIM1_UART_DM_UIM_IRQ_IMR_CLR_ADDR A:0xfc9941a0
y.create.l HWIO_MSS_UIM2_UART_DM_MR1_ADDR A:0xfc998000
y.create.l HWIO_MSS_UIM2_UART_DM_MR2_ADDR A:0xfc998004
y.create.l HWIO_MSS_UIM2_UART_DM_CSR_SR_DEPRECATED_ADDR A:0xfc998008
y.create.l HWIO_MSS_UIM2_UART_DM_CR_MISR_DEPRECATED_ADDR A:0xfc998010
y.create.l HWIO_MSS_UIM2_UART_DM_IMR_ISR_DEPRECATED_ADDR A:0xfc998014
y.create.l HWIO_MSS_UIM2_UART_DM_IPR_ADDR A:0xfc998018
y.create.l HWIO_MSS_UIM2_UART_DM_TFWR_ADDR A:0xfc99801c
y.create.l HWIO_MSS_UIM2_UART_DM_RFWR_ADDR A:0xfc998020
y.create.l HWIO_MSS_UIM2_UART_DM_HCR_ADDR A:0xfc998024
y.create.l HWIO_MSS_UIM2_UART_DM_DMRX_ADDR A:0xfc998034
y.create.l HWIO_MSS_UIM2_UART_DM_IRDA_RX_TOTAL_SNAP_DEPRECATED_ADDR A:0xfc998038
y.create.l HWIO_MSS_UIM2_UART_DM_DMEN_ADDR A:0xfc99803c
y.create.l HWIO_MSS_UIM2_UART_DM_NO_CHARS_FOR_TX_ADDR A:0xfc998040
y.create.l HWIO_MSS_UIM2_UART_DM_BADR_ADDR A:0xfc998044
y.create.l HWIO_MSS_UIM2_UART_DM_TESTSL_ADDR A:0xfc998048
y.create.l HWIO_MSS_UIM2_UART_DM_TXFS_ADDR A:0xfc99804c
y.create.l HWIO_MSS_UIM2_UART_DM_RXFS_ADDR A:0xfc998050
y.create.l HWIO_MSS_UIM2_UART_DM_MISR_MODE_ADDR A:0xfc998060
y.create.l HWIO_MSS_UIM2_UART_DM_MISR_RESET_ADDR A:0xfc998064
y.create.l HWIO_MSS_UIM2_UART_DM_MISR_EXPORT_ADDR A:0xfc998068
y.create.l HWIO_MSS_UIM2_UART_DM_MISR_VAL_ADDR A:0xfc99806c
y.create.l HWIO_MSS_UIM2_UART_DM_TF_RF_DEPRECATED_ADDR A:0xfc998070
y.create.l HWIO_MSS_UIM2_UART_DM_TF_RF_2_DEPRECATED_ADDR A:0xfc998074
y.create.l HWIO_MSS_UIM2_UART_DM_TF_RF_3_DEPRECATED_ADDR A:0xfc998078
y.create.l HWIO_MSS_UIM2_UART_DM_TF_RF_4_DEPRECATED_ADDR A:0xfc99807c
y.create.l HWIO_MSS_UIM2_UART_DM_SIM_CFG_ADDR A:0xfc998080
y.create.l HWIO_MSS_UIM2_UART_DM_TEST_WR_ADDR_ADDR A:0xfc998084
y.create.l HWIO_MSS_UIM2_UART_DM_TEST_WR_DATA_ADDR A:0xfc998088
y.create.l HWIO_MSS_UIM2_UART_DM_TEST_RD_ADDR_ADDR A:0xfc99808c
y.create.l HWIO_MSS_UIM2_UART_DM_TEST_RD_DATA_ADDR A:0xfc998090
y.create.l HWIO_MSS_UIM2_UART_DM_CSR_ADDR A:0xfc9980a0
y.create.l HWIO_MSS_UIM2_UART_DM_SR_ADDR A:0xfc9980a4
y.create.l HWIO_MSS_UIM2_UART_DM_CR_ADDR A:0xfc9980a8
y.create.l HWIO_MSS_UIM2_UART_DM_MISR_ADDR A:0xfc9980ac
y.create.l HWIO_MSS_UIM2_UART_DM_IMR_ADDR A:0xfc9980b0
y.create.l HWIO_MSS_UIM2_UART_DM_ISR_ADDR A:0xfc9980b4
y.create.l HWIO_MSS_UIM2_UART_DM_IRDA_ADDR A:0xfc9980b8
y.create.l HWIO_MSS_UIM2_UART_DM_RX_TOTAL_SNAP_ADDR A:0xfc9980bc
y.create.l HWIO_MSS_UIM2_UART_DM_WWT_TIMEOUT_ADDR A:0xfc9980c0
y.create.l HWIO_MSS_UIM2_UART_DM_CLK_CTRL_ADDR A:0xfc9980c4
y.create.l HWIO_MSS_UIM2_UART_DM_BCR_ADDR A:0xfc9980c8
y.create.l HWIO_MSS_UIM2_UART_DM_RX_TRANS_CTRL_ADDR A:0xfc9980cc
y.create.l HWIO_MSS_UIM2_UART_DM_DMRX_DBG_ADDR A:0xfc9980d0
y.create.l HWIO_MSS_UIM2_UART_DM_FSM_STATUS_ADDR A:0xfc9980d4
y.create.l HWIO_MSS_UIM2_UART_DM_HW_VERSION_ADDR A:0xfc9980d8
y.create.l HWIO_MSS_UIM2_UART_DM_GENERICS_ADDR A:0xfc9980dc
y.create.l HWIO_MSS_UIM2_UART_DM_TF_ADDR A:0xfc998100
y.create.l HWIO_MSS_UIM2_UART_DM_TF_2_ADDR A:0xfc998104
y.create.l HWIO_MSS_UIM2_UART_DM_TF_3_ADDR A:0xfc998108
y.create.l HWIO_MSS_UIM2_UART_DM_TF_4_ADDR A:0xfc99810c
y.create.l HWIO_MSS_UIM2_UART_DM_TF_5_ADDR A:0xfc998110
y.create.l HWIO_MSS_UIM2_UART_DM_TF_6_ADDR A:0xfc998114
y.create.l HWIO_MSS_UIM2_UART_DM_TF_7_ADDR A:0xfc998118
y.create.l HWIO_MSS_UIM2_UART_DM_TF_8_ADDR A:0xfc99811c
y.create.l HWIO_MSS_UIM2_UART_DM_TF_9_ADDR A:0xfc998120
y.create.l HWIO_MSS_UIM2_UART_DM_TF_10_ADDR A:0xfc998124
y.create.l HWIO_MSS_UIM2_UART_DM_TF_11_ADDR A:0xfc998128
y.create.l HWIO_MSS_UIM2_UART_DM_TF_12_ADDR A:0xfc99812c
y.create.l HWIO_MSS_UIM2_UART_DM_TF_13_ADDR A:0xfc998130
y.create.l HWIO_MSS_UIM2_UART_DM_TF_14_ADDR A:0xfc998134
y.create.l HWIO_MSS_UIM2_UART_DM_TF_15_ADDR A:0xfc998138
y.create.l HWIO_MSS_UIM2_UART_DM_TF_16_ADDR A:0xfc99813c
y.create.l HWIO_MSS_UIM2_UART_DM_RF_ADDR A:0xfc998140
y.create.l HWIO_MSS_UIM2_UART_DM_RF_2_ADDR A:0xfc998144
y.create.l HWIO_MSS_UIM2_UART_DM_RF_3_ADDR A:0xfc998148
y.create.l HWIO_MSS_UIM2_UART_DM_RF_4_ADDR A:0xfc99814c
y.create.l HWIO_MSS_UIM2_UART_DM_RF_5_ADDR A:0xfc998150
y.create.l HWIO_MSS_UIM2_UART_DM_RF_6_ADDR A:0xfc998154
y.create.l HWIO_MSS_UIM2_UART_DM_RF_7_ADDR A:0xfc998158
y.create.l HWIO_MSS_UIM2_UART_DM_RF_8_ADDR A:0xfc99815c
y.create.l HWIO_MSS_UIM2_UART_DM_RF_9_ADDR A:0xfc998160
y.create.l HWIO_MSS_UIM2_UART_DM_RF_10_ADDR A:0xfc998164
y.create.l HWIO_MSS_UIM2_UART_DM_RF_11_ADDR A:0xfc998168
y.create.l HWIO_MSS_UIM2_UART_DM_RF_12_ADDR A:0xfc99816c
y.create.l HWIO_MSS_UIM2_UART_DM_RF_13_ADDR A:0xfc998170
y.create.l HWIO_MSS_UIM2_UART_DM_RF_14_ADDR A:0xfc998174
y.create.l HWIO_MSS_UIM2_UART_DM_RF_15_ADDR A:0xfc998178
y.create.l HWIO_MSS_UIM2_UART_DM_RF_16_ADDR A:0xfc99817c
y.create.l HWIO_MSS_UIM2_UART_DM_UIM_CFG_ADDR A:0xfc998180
y.create.l HWIO_MSS_UIM2_UART_DM_UIM_CMD_ADDR A:0xfc998184
y.create.l HWIO_MSS_UIM2_UART_DM_UIM_IO_STATUS_ADDR A:0xfc998188
y.create.l HWIO_MSS_UIM2_UART_DM_UIM_IRQ_ISR_ADDR A:0xfc99818c
y.create.l HWIO_MSS_UIM2_UART_DM_UIM_IRQ_MISR_ADDR A:0xfc998190
y.create.l HWIO_MSS_UIM2_UART_DM_UIM_IRQ_CLR_ADDR A:0xfc998194
y.create.l HWIO_MSS_UIM2_UART_DM_UIM_IRQ_IMR_ADDR A:0xfc998198
y.create.l HWIO_MSS_UIM2_UART_DM_UIM_IRQ_IMR_SET_ADDR A:0xfc99819c
y.create.l HWIO_MSS_UIM2_UART_DM_UIM_IRQ_IMR_CLR_ADDR A:0xfc9981a0
y.create.l HWIO_MSS_UIM3_UART_DM_MR1_ADDR A:0xfc99c000
y.create.l HWIO_MSS_UIM3_UART_DM_MR2_ADDR A:0xfc99c004
y.create.l HWIO_MSS_UIM3_UART_DM_CSR_SR_DEPRECATED_ADDR A:0xfc99c008
y.create.l HWIO_MSS_UIM3_UART_DM_CR_MISR_DEPRECATED_ADDR A:0xfc99c010
y.create.l HWIO_MSS_UIM3_UART_DM_IMR_ISR_DEPRECATED_ADDR A:0xfc99c014
y.create.l HWIO_MSS_UIM3_UART_DM_IPR_ADDR A:0xfc99c018
y.create.l HWIO_MSS_UIM3_UART_DM_TFWR_ADDR A:0xfc99c01c
y.create.l HWIO_MSS_UIM3_UART_DM_RFWR_ADDR A:0xfc99c020
y.create.l HWIO_MSS_UIM3_UART_DM_HCR_ADDR A:0xfc99c024
y.create.l HWIO_MSS_UIM3_UART_DM_DMRX_ADDR A:0xfc99c034
y.create.l HWIO_MSS_UIM3_UART_DM_IRDA_RX_TOTAL_SNAP_DEPRECATED_ADDR A:0xfc99c038
y.create.l HWIO_MSS_UIM3_UART_DM_DMEN_ADDR A:0xfc99c03c
y.create.l HWIO_MSS_UIM3_UART_DM_NO_CHARS_FOR_TX_ADDR A:0xfc99c040
y.create.l HWIO_MSS_UIM3_UART_DM_BADR_ADDR A:0xfc99c044
y.create.l HWIO_MSS_UIM3_UART_DM_TESTSL_ADDR A:0xfc99c048
y.create.l HWIO_MSS_UIM3_UART_DM_TXFS_ADDR A:0xfc99c04c
y.create.l HWIO_MSS_UIM3_UART_DM_RXFS_ADDR A:0xfc99c050
y.create.l HWIO_MSS_UIM3_UART_DM_MISR_MODE_ADDR A:0xfc99c060
y.create.l HWIO_MSS_UIM3_UART_DM_MISR_RESET_ADDR A:0xfc99c064
y.create.l HWIO_MSS_UIM3_UART_DM_MISR_EXPORT_ADDR A:0xfc99c068
y.create.l HWIO_MSS_UIM3_UART_DM_MISR_VAL_ADDR A:0xfc99c06c
y.create.l HWIO_MSS_UIM3_UART_DM_TF_RF_DEPRECATED_ADDR A:0xfc99c070
y.create.l HWIO_MSS_UIM3_UART_DM_TF_RF_2_DEPRECATED_ADDR A:0xfc99c074
y.create.l HWIO_MSS_UIM3_UART_DM_TF_RF_3_DEPRECATED_ADDR A:0xfc99c078
y.create.l HWIO_MSS_UIM3_UART_DM_TF_RF_4_DEPRECATED_ADDR A:0xfc99c07c
y.create.l HWIO_MSS_UIM3_UART_DM_SIM_CFG_ADDR A:0xfc99c080
y.create.l HWIO_MSS_UIM3_UART_DM_TEST_WR_ADDR_ADDR A:0xfc99c084
y.create.l HWIO_MSS_UIM3_UART_DM_TEST_WR_DATA_ADDR A:0xfc99c088
y.create.l HWIO_MSS_UIM3_UART_DM_TEST_RD_ADDR_ADDR A:0xfc99c08c
y.create.l HWIO_MSS_UIM3_UART_DM_TEST_RD_DATA_ADDR A:0xfc99c090
y.create.l HWIO_MSS_UIM3_UART_DM_CSR_ADDR A:0xfc99c0a0
y.create.l HWIO_MSS_UIM3_UART_DM_SR_ADDR A:0xfc99c0a4
y.create.l HWIO_MSS_UIM3_UART_DM_CR_ADDR A:0xfc99c0a8
y.create.l HWIO_MSS_UIM3_UART_DM_MISR_ADDR A:0xfc99c0ac
y.create.l HWIO_MSS_UIM3_UART_DM_IMR_ADDR A:0xfc99c0b0
y.create.l HWIO_MSS_UIM3_UART_DM_ISR_ADDR A:0xfc99c0b4
y.create.l HWIO_MSS_UIM3_UART_DM_IRDA_ADDR A:0xfc99c0b8
y.create.l HWIO_MSS_UIM3_UART_DM_RX_TOTAL_SNAP_ADDR A:0xfc99c0bc
y.create.l HWIO_MSS_UIM3_UART_DM_WWT_TIMEOUT_ADDR A:0xfc99c0c0
y.create.l HWIO_MSS_UIM3_UART_DM_CLK_CTRL_ADDR A:0xfc99c0c4
y.create.l HWIO_MSS_UIM3_UART_DM_BCR_ADDR A:0xfc99c0c8
y.create.l HWIO_MSS_UIM3_UART_DM_RX_TRANS_CTRL_ADDR A:0xfc99c0cc
y.create.l HWIO_MSS_UIM3_UART_DM_DMRX_DBG_ADDR A:0xfc99c0d0
y.create.l HWIO_MSS_UIM3_UART_DM_FSM_STATUS_ADDR A:0xfc99c0d4
y.create.l HWIO_MSS_UIM3_UART_DM_HW_VERSION_ADDR A:0xfc99c0d8
y.create.l HWIO_MSS_UIM3_UART_DM_GENERICS_ADDR A:0xfc99c0dc
y.create.l HWIO_MSS_UIM3_UART_DM_TF_ADDR A:0xfc99c100
y.create.l HWIO_MSS_UIM3_UART_DM_TF_2_ADDR A:0xfc99c104
y.create.l HWIO_MSS_UIM3_UART_DM_TF_3_ADDR A:0xfc99c108
y.create.l HWIO_MSS_UIM3_UART_DM_TF_4_ADDR A:0xfc99c10c
y.create.l HWIO_MSS_UIM3_UART_DM_TF_5_ADDR A:0xfc99c110
y.create.l HWIO_MSS_UIM3_UART_DM_TF_6_ADDR A:0xfc99c114
y.create.l HWIO_MSS_UIM3_UART_DM_TF_7_ADDR A:0xfc99c118
y.create.l HWIO_MSS_UIM3_UART_DM_TF_8_ADDR A:0xfc99c11c
y.create.l HWIO_MSS_UIM3_UART_DM_TF_9_ADDR A:0xfc99c120
y.create.l HWIO_MSS_UIM3_UART_DM_TF_10_ADDR A:0xfc99c124
y.create.l HWIO_MSS_UIM3_UART_DM_TF_11_ADDR A:0xfc99c128
y.create.l HWIO_MSS_UIM3_UART_DM_TF_12_ADDR A:0xfc99c12c
y.create.l HWIO_MSS_UIM3_UART_DM_TF_13_ADDR A:0xfc99c130
y.create.l HWIO_MSS_UIM3_UART_DM_TF_14_ADDR A:0xfc99c134
y.create.l HWIO_MSS_UIM3_UART_DM_TF_15_ADDR A:0xfc99c138
y.create.l HWIO_MSS_UIM3_UART_DM_TF_16_ADDR A:0xfc99c13c
y.create.l HWIO_MSS_UIM3_UART_DM_RF_ADDR A:0xfc99c140
y.create.l HWIO_MSS_UIM3_UART_DM_RF_2_ADDR A:0xfc99c144
y.create.l HWIO_MSS_UIM3_UART_DM_RF_3_ADDR A:0xfc99c148
y.create.l HWIO_MSS_UIM3_UART_DM_RF_4_ADDR A:0xfc99c14c
y.create.l HWIO_MSS_UIM3_UART_DM_RF_5_ADDR A:0xfc99c150
y.create.l HWIO_MSS_UIM3_UART_DM_RF_6_ADDR A:0xfc99c154
y.create.l HWIO_MSS_UIM3_UART_DM_RF_7_ADDR A:0xfc99c158
y.create.l HWIO_MSS_UIM3_UART_DM_RF_8_ADDR A:0xfc99c15c
y.create.l HWIO_MSS_UIM3_UART_DM_RF_9_ADDR A:0xfc99c160
y.create.l HWIO_MSS_UIM3_UART_DM_RF_10_ADDR A:0xfc99c164
y.create.l HWIO_MSS_UIM3_UART_DM_RF_11_ADDR A:0xfc99c168
y.create.l HWIO_MSS_UIM3_UART_DM_RF_12_ADDR A:0xfc99c16c
y.create.l HWIO_MSS_UIM3_UART_DM_RF_13_ADDR A:0xfc99c170
y.create.l HWIO_MSS_UIM3_UART_DM_RF_14_ADDR A:0xfc99c174
y.create.l HWIO_MSS_UIM3_UART_DM_RF_15_ADDR A:0xfc99c178
y.create.l HWIO_MSS_UIM3_UART_DM_RF_16_ADDR A:0xfc99c17c
y.create.l HWIO_MSS_UIM3_UART_DM_UIM_CFG_ADDR A:0xfc99c180
y.create.l HWIO_MSS_UIM3_UART_DM_UIM_CMD_ADDR A:0xfc99c184
y.create.l HWIO_MSS_UIM3_UART_DM_UIM_IO_STATUS_ADDR A:0xfc99c188
y.create.l HWIO_MSS_UIM3_UART_DM_UIM_IRQ_ISR_ADDR A:0xfc99c18c
y.create.l HWIO_MSS_UIM3_UART_DM_UIM_IRQ_MISR_ADDR A:0xfc99c190
y.create.l HWIO_MSS_UIM3_UART_DM_UIM_IRQ_CLR_ADDR A:0xfc99c194
y.create.l HWIO_MSS_UIM3_UART_DM_UIM_IRQ_IMR_ADDR A:0xfc99c198
y.create.l HWIO_MSS_UIM3_UART_DM_UIM_IRQ_IMR_SET_ADDR A:0xfc99c19c
y.create.l HWIO_MSS_UIM3_UART_DM_UIM_IRQ_IMR_CLR_ADDR A:0xfc99c1a0
y.create.l HWIO_MSS_CXM_UART_DM_MR1_ADDR A:0xfc9a0000
y.create.l HWIO_MSS_CXM_UART_DM_MR2_ADDR A:0xfc9a0004
y.create.l HWIO_MSS_CXM_UART_DM_CSR_SR_DEPRECATED_ADDR A:0xfc9a0008
y.create.l HWIO_MSS_CXM_UART_DM_CR_MISR_DEPRECATED_ADDR A:0xfc9a0010
y.create.l HWIO_MSS_CXM_UART_DM_IMR_ISR_DEPRECATED_ADDR A:0xfc9a0014
y.create.l HWIO_MSS_CXM_UART_DM_IPR_ADDR A:0xfc9a0018
y.create.l HWIO_MSS_CXM_UART_DM_TFWR_ADDR A:0xfc9a001c
y.create.l HWIO_MSS_CXM_UART_DM_RFWR_ADDR A:0xfc9a0020
y.create.l HWIO_MSS_CXM_UART_DM_HCR_ADDR A:0xfc9a0024
y.create.l HWIO_MSS_CXM_UART_DM_DMRX_ADDR A:0xfc9a0034
y.create.l HWIO_MSS_CXM_UART_DM_IRDA_RX_TOTAL_SNAP_DEPRECATED_ADDR A:0xfc9a0038
y.create.l HWIO_MSS_CXM_UART_DM_DMEN_ADDR A:0xfc9a003c
y.create.l HWIO_MSS_CXM_UART_DM_NO_CHARS_FOR_TX_ADDR A:0xfc9a0040
y.create.l HWIO_MSS_CXM_UART_DM_BADR_ADDR A:0xfc9a0044
y.create.l HWIO_MSS_CXM_UART_DM_TESTSL_ADDR A:0xfc9a0048
y.create.l HWIO_MSS_CXM_UART_DM_TXFS_ADDR A:0xfc9a004c
y.create.l HWIO_MSS_CXM_UART_DM_RXFS_ADDR A:0xfc9a0050
y.create.l HWIO_MSS_CXM_UART_DM_MISR_MODE_ADDR A:0xfc9a0060
y.create.l HWIO_MSS_CXM_UART_DM_MISR_RESET_ADDR A:0xfc9a0064
y.create.l HWIO_MSS_CXM_UART_DM_MISR_EXPORT_ADDR A:0xfc9a0068
y.create.l HWIO_MSS_CXM_UART_DM_MISR_VAL_ADDR A:0xfc9a006c
y.create.l HWIO_MSS_CXM_UART_DM_TF_RF_DEPRECATED_ADDR A:0xfc9a0070
y.create.l HWIO_MSS_CXM_UART_DM_TF_RF_2_DEPRECATED_ADDR A:0xfc9a0074
y.create.l HWIO_MSS_CXM_UART_DM_TF_RF_3_DEPRECATED_ADDR A:0xfc9a0078
y.create.l HWIO_MSS_CXM_UART_DM_TF_RF_4_DEPRECATED_ADDR A:0xfc9a007c
y.create.l HWIO_MSS_CXM_UART_DM_SIM_CFG_ADDR A:0xfc9a0080
y.create.l HWIO_MSS_CXM_UART_DM_TEST_WR_ADDR_ADDR A:0xfc9a0084
y.create.l HWIO_MSS_CXM_UART_DM_TEST_WR_DATA_ADDR A:0xfc9a0088
y.create.l HWIO_MSS_CXM_UART_DM_TEST_RD_ADDR_ADDR A:0xfc9a008c
y.create.l HWIO_MSS_CXM_UART_DM_TEST_RD_DATA_ADDR A:0xfc9a0090
y.create.l HWIO_MSS_CXM_UART_DM_CSR_ADDR A:0xfc9a00a0
y.create.l HWIO_MSS_CXM_UART_DM_SR_ADDR A:0xfc9a00a4
y.create.l HWIO_MSS_CXM_UART_DM_CR_ADDR A:0xfc9a00a8
y.create.l HWIO_MSS_CXM_UART_DM_MISR_ADDR A:0xfc9a00ac
y.create.l HWIO_MSS_CXM_UART_DM_IMR_ADDR A:0xfc9a00b0
y.create.l HWIO_MSS_CXM_UART_DM_ISR_ADDR A:0xfc9a00b4
y.create.l HWIO_MSS_CXM_UART_DM_IRDA_ADDR A:0xfc9a00b8
y.create.l HWIO_MSS_CXM_UART_DM_RX_TOTAL_SNAP_ADDR A:0xfc9a00bc
y.create.l HWIO_MSS_CXM_UART_DM_WWT_TIMEOUT_ADDR A:0xfc9a00c0
y.create.l HWIO_MSS_CXM_UART_DM_CLK_CTRL_ADDR A:0xfc9a00c4
y.create.l HWIO_MSS_CXM_UART_DM_BCR_ADDR A:0xfc9a00c8
y.create.l HWIO_MSS_CXM_UART_DM_RX_TRANS_CTRL_ADDR A:0xfc9a00cc
y.create.l HWIO_MSS_CXM_UART_DM_DMRX_DBG_ADDR A:0xfc9a00d0
y.create.l HWIO_MSS_CXM_UART_DM_FSM_STATUS_ADDR A:0xfc9a00d4
y.create.l HWIO_MSS_CXM_UART_DM_HW_VERSION_ADDR A:0xfc9a00d8
y.create.l HWIO_MSS_CXM_UART_DM_GENERICS_ADDR A:0xfc9a00dc
y.create.l HWIO_MSS_CXM_UART_DM_TF_ADDR A:0xfc9a0100
y.create.l HWIO_MSS_CXM_UART_DM_TF_2_ADDR A:0xfc9a0104
y.create.l HWIO_MSS_CXM_UART_DM_TF_3_ADDR A:0xfc9a0108
y.create.l HWIO_MSS_CXM_UART_DM_TF_4_ADDR A:0xfc9a010c
y.create.l HWIO_MSS_CXM_UART_DM_TF_5_ADDR A:0xfc9a0110
y.create.l HWIO_MSS_CXM_UART_DM_TF_6_ADDR A:0xfc9a0114
y.create.l HWIO_MSS_CXM_UART_DM_TF_7_ADDR A:0xfc9a0118
y.create.l HWIO_MSS_CXM_UART_DM_TF_8_ADDR A:0xfc9a011c
y.create.l HWIO_MSS_CXM_UART_DM_TF_9_ADDR A:0xfc9a0120
y.create.l HWIO_MSS_CXM_UART_DM_TF_10_ADDR A:0xfc9a0124
y.create.l HWIO_MSS_CXM_UART_DM_TF_11_ADDR A:0xfc9a0128
y.create.l HWIO_MSS_CXM_UART_DM_TF_12_ADDR A:0xfc9a012c
y.create.l HWIO_MSS_CXM_UART_DM_TF_13_ADDR A:0xfc9a0130
y.create.l HWIO_MSS_CXM_UART_DM_TF_14_ADDR A:0xfc9a0134
y.create.l HWIO_MSS_CXM_UART_DM_TF_15_ADDR A:0xfc9a0138
y.create.l HWIO_MSS_CXM_UART_DM_TF_16_ADDR A:0xfc9a013c
y.create.l HWIO_MSS_CXM_UART_DM_RF_ADDR A:0xfc9a0140
y.create.l HWIO_MSS_CXM_UART_DM_RF_2_ADDR A:0xfc9a0144
y.create.l HWIO_MSS_CXM_UART_DM_RF_3_ADDR A:0xfc9a0148
y.create.l HWIO_MSS_CXM_UART_DM_RF_4_ADDR A:0xfc9a014c
y.create.l HWIO_MSS_CXM_UART_DM_RF_5_ADDR A:0xfc9a0150
y.create.l HWIO_MSS_CXM_UART_DM_RF_6_ADDR A:0xfc9a0154
y.create.l HWIO_MSS_CXM_UART_DM_RF_7_ADDR A:0xfc9a0158
y.create.l HWIO_MSS_CXM_UART_DM_RF_8_ADDR A:0xfc9a015c
y.create.l HWIO_MSS_CXM_UART_DM_RF_9_ADDR A:0xfc9a0160
y.create.l HWIO_MSS_CXM_UART_DM_RF_10_ADDR A:0xfc9a0164
y.create.l HWIO_MSS_CXM_UART_DM_RF_11_ADDR A:0xfc9a0168
y.create.l HWIO_MSS_CXM_UART_DM_RF_12_ADDR A:0xfc9a016c
y.create.l HWIO_MSS_CXM_UART_DM_RF_13_ADDR A:0xfc9a0170
y.create.l HWIO_MSS_CXM_UART_DM_RF_14_ADDR A:0xfc9a0174
y.create.l HWIO_MSS_CXM_UART_DM_RF_15_ADDR A:0xfc9a0178
y.create.l HWIO_MSS_CXM_UART_DM_RF_16_ADDR A:0xfc9a017c
y.create.l HWIO_MSS_CXM_UART_DM_UIM_CFG_ADDR A:0xfc9a0180
y.create.l HWIO_MSS_CXM_UART_DM_UIM_CMD_ADDR A:0xfc9a0184
y.create.l HWIO_MSS_CXM_UART_DM_UIM_IO_STATUS_ADDR A:0xfc9a0188
y.create.l HWIO_MSS_CXM_UART_DM_UIM_IRQ_ISR_ADDR A:0xfc9a018c
y.create.l HWIO_MSS_CXM_UART_DM_UIM_IRQ_MISR_ADDR A:0xfc9a0190
y.create.l HWIO_MSS_CXM_UART_DM_UIM_IRQ_CLR_ADDR A:0xfc9a0194
y.create.l HWIO_MSS_CXM_UART_DM_UIM_IRQ_IMR_ADDR A:0xfc9a0198
y.create.l HWIO_MSS_CXM_UART_DM_UIM_IRQ_IMR_SET_ADDR A:0xfc9a019c
y.create.l HWIO_MSS_CXM_UART_DM_UIM_IRQ_IMR_CLR_ADDR A:0xfc9a01a0
y.create.l HWIO_MSS_CXM_CONFIG_ADDR A:0xfc9a01a4
y.create.l HWIO_MSS_CXM_TX_CONFIG_ADDR A:0xfc9a01a8
y.create.l HWIO_MSS_CXM_RX_STAT_ADDR A:0xfc9a01ac
y.create.l HWIO_MSS_CXM_DBG_STAT_ADDR A:0xfc9a01b0
y.create.l HWIO_MSS_CXM_DIR_UART_TR_ADDR A:0xfc9a01b4
y.create.l HWIO_MSS_CXM_TYP0_RESP_TOUT_DUR_ADDR A:0xfc9a01b8
y.create.l HWIO_MSS_CXM_TYP0_RESP_STAT_ADDR A:0xfc9a01bc
y.create.l HWIO_MSS_CXM_WCN_PRIORITY_REG_STAT_ADDR A:0xfc9a01c0
y.create.l HWIO_MSS_CXM_RX_WCI2_MSG_TYPE0_CONTENT_ADDR A:0xfc9a01c4
y.create.l HWIO_MSS_CXM_RX_WCI2_MSG_TYPE1_CONTENT_ADDR A:0xfc9a01c8
y.create.l HWIO_MSS_CXM_RX_WCI2_MSG_TYPE2_CONTENT_ADDR A:0xfc9a01cc
y.create.l HWIO_MSS_CXM_RX_WCI2_MSG_TYPE3_CONTENT_ADDR A:0xfc9a01d0
y.create.l HWIO_MSS_CXM_RX_WCI2_MSG_TYPE4_CONTENT_ADDR A:0xfc9a01d4
y.create.l HWIO_MSS_CXM_RX_WCI2_MSG_TYPE5_CONTENT_ADDR A:0xfc9a01d8
y.create.l HWIO_MSS_CXM_RX_WCI2_MSG_TYPE6_CONTENT_ADDR A:0xfc9a01dc
y.create.l HWIO_MSS_CXM_RX_WCI2_MSG_TYPE7_CONTENT_ADDR A:0xfc9a01e0
y.create.l HWIO_MSS_CXM_SPARE_BITS_ADDR A:0xfc9a01e4
y.create.l HWIO_MSS_CONF_ABT_HW_VERSION_ADDR A:0xfc9b0000
y.create.l HWIO_MSS_CONF_ABT_INST_ID_ADDR A:0xfc9b0004
y.create.l HWIO_MSS_CONF_ABT_NUM_SLAVES_ADDR A:0xfc9b0008
y.create.l HWIO_MSS_CONF_ABT_TIMER_LOADVAL_ADDR A:0xfc9b000c
y.create.l HWIO_MSS_CONF_ABT_TIMER_MODE_ADDR A:0xfc9b0010
y.create.l HWIO_MSS_CONF_ABT_INTR_STATUS_ADDR A:0xfc9b0014
y.create.l HWIO_MSS_CONF_ABT_INTR_CLEAR_ADDR A:0xfc9b0018
y.create.l HWIO_MSS_CONF_ABT_INTR_ENABLE_ADDR A:0xfc9b001c
y.create.l HWIO_MSS_CONF_ABT_SYND_VALID_ADDR A:0xfc9b0020
y.create.l HWIO_MSS_CONF_ABT_SYND_CLEAR_ADDR A:0xfc9b0024
y.create.l HWIO_MSS_CONF_ABT_SYND_ID_ADDR A:0xfc9b0028
y.create.l HWIO_MSS_CONF_ABT_SYND_ADDR0_ADDR A:0xfc9b002c
y.create.l HWIO_MSS_CONF_ABT_SYND_ADDR1_ADDR A:0xfc9b0030
y.create.l HWIO_MSS_CONF_ABT_SYND_HREADY_ADDR A:0xfc9b0034
y.create.l HWIO_MSS_RBCPR_VERSION_ADDR A:0xfc9b1000
y.create.l HWIO_MSS_RBCPR_SENSOR_MASK0_ADDR A:0xfc9b1020
y.create.l HWIO_MSS_RBCPR_SENSOR_MASK1_ADDR A:0xfc9b1024
y.create.l HWIO_MSS_RBCPR_SENSOR_MASK2_ADDR A:0xfc9b1028
y.create.l HWIO_MSS_RBCPR_SENSOR_MASK3_ADDR A:0xfc9b102c
y.create.l HWIO_MSS_RBCPR_SENSOR_BYPASS0_ADDR A:0xfc9b1030
y.create.l HWIO_MSS_RBCPR_SENSOR_BYPASS1_ADDR A:0xfc9b1034
y.create.l HWIO_MSS_RBCPR_SENSOR_BYPASS2_ADDR A:0xfc9b1038
y.create.l HWIO_MSS_RBCPR_SENSOR_BYPASS3_ADDR A:0xfc9b103c
y.create.l HWIO_MSS_RBIF_PMIC_ADDR_ADDR A:0xfc9b1040
y.create.l HWIO_MSS_RBCPR_TIMER_INTERVAL_ADDR A:0xfc9b1044
y.create.l HWIO_MSS_RBIF_LIMIT_ADDR A:0xfc9b1048
y.create.l HWIO_MSS_RBIF_TIMER_ADJUST_ADDR A:0xfc9b104c
y.create.l HWIO_MSS_RBCPR_GCNT_TARGET0_ADDR A:0xfc9b1060
y.create.l HWIO_MSS_RBCPR_GCNT_TARGET1_ADDR A:0xfc9b1064
y.create.l HWIO_MSS_RBCPR_GCNT_TARGET2_ADDR A:0xfc9b1068
y.create.l HWIO_MSS_RBCPR_GCNT_TARGET3_ADDR A:0xfc9b106c
y.create.l HWIO_MSS_RBCPR_GCNT_TARGET4_ADDR A:0xfc9b1070
y.create.l HWIO_MSS_RBCPR_GCNT_TARGET5_ADDR A:0xfc9b1074
y.create.l HWIO_MSS_RBCPR_GCNT_TARGET6_ADDR A:0xfc9b1078
y.create.l HWIO_MSS_RBCPR_GCNT_TARGET7_ADDR A:0xfc9b107c
y.create.l HWIO_MSS_RBCPR_STEP_QUOT_ADDR A:0xfc9b1080
y.create.l HWIO_MSS_RBCPR_CTL_ADDR A:0xfc9b1090
y.create.l HWIO_MSS_RBIF_SW_VLEVEL_ADDR A:0xfc9b1094
y.create.l HWIO_MSS_RBIF_CONT_ACK_CMD_ADDR A:0xfc9b1098
y.create.l HWIO_MSS_RBIF_CONT_NACK_CMD_ADDR A:0xfc9b109c
y.create.l HWIO_MSS_RBCPR_RESULT_0_ADDR A:0xfc9b10a0
y.create.l HWIO_MSS_RBCPR_RESULT_1_ADDR A:0xfc9b10a4
y.create.l HWIO_MSS_RBIF_IRQ_EN_0_ADDR A:0xfc9b1100
y.create.l HWIO_MSS_RBIF_IRQ_EN_1_ADDR A:0xfc9b1104
y.create.l HWIO_MSS_RBIF_IRQ_EN_2_ADDR A:0xfc9b1108
y.create.l HWIO_MSS_RBIF_IRQ_CLEAR_ADDR A:0xfc9b1110
y.create.l HWIO_MSS_RBIF_IRQ_STATUS_ADDR A:0xfc9b1114
y.create.l HWIO_MSS_RBCPR_QUOT_AVG_ADDR A:0xfc9b1118
y.create.l HWIO_MSS_RBCPR_DEBUG0_ADDR A:0xfc9b111c
y.create.l HWIO_MSS_RBCPR_DEBUG1_ADDR A:0xfc9b1120
y.create.l HWIO_MSS_RBCPR_DEBUG2_ADDR A:0xfc9b1124
y.create.l HWIO_MSS_RBCPR_BIST_MINMAX_ADDR A:0xfc9b1128
y.create.l HWIO_MSS_RBCPR_BIST_RESULT_ADDR A:0xfc9b112c
y.create.l HWIO_MSS_RBCPR_BIST_FAIL_MAP0_ADDR A:0xfc9b1130
y.create.l HWIO_MSS_RBCPR_BIST_FAIL_MAP1_ADDR A:0xfc9b1134
y.create.l HWIO_MSS_RBCPR_BIST_FAIL_MAP2_ADDR A:0xfc9b1138
y.create.l HWIO_MSS_RBCPR_BIST_FAIL_MAP3_ADDR A:0xfc9b113c
y.create.l HWIO_MSS_RBCPR_LOG_0_ADDR A:0xfc9b1140
y.create.l HWIO_MSS_RBCPR_LOG_1_ADDR A:0xfc9b1144
y.create.l HWIO_MSS_RBCPR_LOG_2_ADDR A:0xfc9b1148
y.create.l HWIO_MSS_RBCPR_LOG_3_ADDR A:0xfc9b114c
y.create.l HWIO_MSS_RBCPR_LOG_4_ADDR A:0xfc9b1150
y.create.l HWIO_MSS_RBCPR_LOG_5_ADDR A:0xfc9b1154
y.create.l HWIO_MSS_RBCPR_LOG_6_ADDR A:0xfc9b1158
y.create.l HWIO_MSS_RBCPR_LOG_7_ADDR A:0xfc9b115c
y.create.l HWIO_MSS_RBCPR_HTOL_AGE_ADDR A:0xfc9b1160
y.create.l HWIO_MSS_MGPI_PMIC_CONFIG0_ADDR A:0xfc9b2000
y.create.l HWIO_MSS_MGPI_PMIC_CONFIG1_ADDR A:0xfc9b2008
y.create.l HWIO_MSS_MGPI_PMIC_CONFIG2_ADDR A:0xfc9b2010
y.create.l HWIO_MSS_MGPI_PMIC_CONFIG3_ADDR A:0xfc9b2018
y.create.l HWIO_MSS_MGPI_PMIC_CONFIG4_ADDR A:0xfc9b2020
y.create.l HWIO_MSS_MGPI_PMIC_CONFIG5_ADDR A:0xfc9b2028
y.create.l HWIO_MSS_MGPI_PMIC_CONFIG6_ADDR A:0xfc9b2030
y.create.l HWIO_MSS_MGPI_PMIC_CONFIG7_ADDR A:0xfc9b2038
y.create.l HWIO_MSS_MGPI_PMIC_CONFIG8_ADDR A:0xfc9b2040
y.create.l HWIO_MSS_MGPI_PMIC_CONFIG9_ADDR A:0xfc9b2048
y.create.l HWIO_MSS_MGPI_CONF_STATUS0_ADDR A:0xfc9b2004
y.create.l HWIO_MSS_MGPI_CONF_STATUS1_ADDR A:0xfc9b200c
y.create.l HWIO_MSS_MGPI_CONF_STATUS2_ADDR A:0xfc9b2014
y.create.l HWIO_MSS_MGPI_CONF_STATUS3_ADDR A:0xfc9b201c
y.create.l HWIO_MSS_MGPI_CONF_STATUS4_ADDR A:0xfc9b2024
y.create.l HWIO_MSS_MGPI_CONF_STATUS5_ADDR A:0xfc9b202c
y.create.l HWIO_MSS_MGPI_CONF_STATUS6_ADDR A:0xfc9b2034
y.create.l HWIO_MSS_MGPI_CONF_STATUS7_ADDR A:0xfc9b203c
y.create.l HWIO_MSS_MGPI_CONF_STATUS8_ADDR A:0xfc9b2044
y.create.l HWIO_MSS_MGPI_CONF_STATUS9_ADDR A:0xfc9b204c
y.create.l HWIO_MSS_MGPI_MASTER_CSR_ADDR A:0xfc9b2100
y.create.l HWIO_MSS_MGPI_HW_VERSION_ADDR A:0xfc9b2104
y.create.l HWIO_MVC_ENABLE_ADDR A:0xfc9b3000
y.create.l HWIO_MVC_DELAY_ADDR A:0xfc9b3004
y.create.l HWIO_MVC_PMIC_PVC_PORT_SVS2_ADDR A:0xfc9b3008
y.create.l HWIO_MVC_PMIC_PVC_PORT_SVS_ADDR A:0xfc9b300c
y.create.l HWIO_MVC_PMIC_PVC_PORT_NOMINAL_ADDR A:0xfc9b3010
y.create.l HWIO_MVC_PMIC_PVC_PORT_TURBO_ADDR A:0xfc9b3014
y.create.l HWIO_MVC_PMIC_PVC_PORT_STATUS_ADDR A:0xfc9b3018
y.create.l HWIO_MVC_MEM_SVS_ADDR A:0xfc9b301c
y.create.l HWIO_MVC_Q6SS_INTERFACE_STATE_ADDR A:0xfc9b3020
y.create.l HWIO_MVC_PMU_INTERFACE_STATE_ADDR A:0xfc9b3024
y.create.l HWIO_MVC_STATE_MACHINE_ADDR A:0xfc9b3028
y.create.l HWIO_MVC_HW_VERSION_ADDR A:0xfc9b302c
y.create.l HWIO_MSS_STMR_TIME_RD_ADDR A:0xfc9b4000
y.create.l HWIO_MSS_STMR_EVT_MATCH_0_ADDR A:0xfc9b4004
y.create.l HWIO_MSS_STMR_EVT_MATCH_1_ADDR A:0xfc9b4008
y.create.l HWIO_MSS_STMR_EVT_MATCH_2_ADDR A:0xfc9b400c
y.create.l HWIO_MSS_STMR_EVT_MATCH_3_ADDR A:0xfc9b4010
y.create.l HWIO_MSS_STMR_EVT_MATCH_4_ADDR A:0xfc9b4014
y.create.l HWIO_MSS_STMR_EVT_MATCH_5_ADDR A:0xfc9b4018
y.create.l HWIO_MSS_STMR_EVT_MATCH_6_ADDR A:0xfc9b401c
y.create.l HWIO_MSS_STMR_EVT_MATCH_7_ADDR A:0xfc9b4020
y.create.l HWIO_MSS_STMR_EVT_MATCH_8_ADDR A:0xfc9b4024
y.create.l HWIO_MSS_STMR_EVT_MATCH_9_ADDR A:0xfc9b4028
y.create.l HWIO_MSS_CRYPTO_VERSION_ADDR A:0xfc9da000
y.create.l HWIO_MSS_CRYPTO_DATA_IN0_ADDR A:0xfc9da010
y.create.l HWIO_MSS_CRYPTO_DATA_IN1_ADDR A:0xfc9da014
y.create.l HWIO_MSS_CRYPTO_DATA_IN2_ADDR A:0xfc9da018
y.create.l HWIO_MSS_CRYPTO_DATA_IN3_ADDR A:0xfc9da01c
y.create.l HWIO_MSS_CRYPTO_DATA_OUT0_ADDR A:0xfc9da020
y.create.l HWIO_MSS_CRYPTO_DATA_OUT1_ADDR A:0xfc9da024
y.create.l HWIO_MSS_CRYPTO_DATA_OUT2_ADDR A:0xfc9da028
y.create.l HWIO_MSS_CRYPTO_DATA_OUT3_ADDR A:0xfc9da02c
y.create.l HWIO_MSS_CRYPTO_STATUS_ADDR A:0xfc9da100
y.create.l HWIO_MSS_CRYPTO_STATUS2_ADDR A:0xfc9da104
y.create.l HWIO_MSS_CRYPTO_ENGINES_AVAIL_ADDR A:0xfc9da108
y.create.l HWIO_MSS_CRYPTO_FIFO_SIZES_ADDR A:0xfc9da10c
y.create.l HWIO_MSS_CRYPTO_SEG_SIZE_ADDR A:0xfc9da110
y.create.l HWIO_MSS_CRYPTO_GOPROC_ADDR A:0xfc9da120
y.create.l HWIO_MSS_CRYPTO_GOPROC_QC_KEY_ADDR A:0xfc9db000
y.create.l HWIO_MSS_CRYPTO_GOPROC_OEM_KEY_ADDR A:0xfc9dc000
y.create.l HWIO_MSS_CRYPTO_ENCR_SEG_CFG_ADDR A:0xfc9da200
y.create.l HWIO_MSS_CRYPTO_ENCR_SEG_SIZE_ADDR A:0xfc9da204
y.create.l HWIO_MSS_CRYPTO_ENCR_SEG_START_ADDR A:0xfc9da208
y.create.l HWIO_MSS_CRYPTO_ENCR_KEY0_ADDR A:0xfc9dd000
y.create.l HWIO_MSS_CRYPTO_ENCR_KEY1_ADDR A:0xfc9dd004
y.create.l HWIO_MSS_CRYPTO_ENCR_KEY2_ADDR A:0xfc9dd008
y.create.l HWIO_MSS_CRYPTO_ENCR_KEY3_ADDR A:0xfc9dd00c
y.create.l HWIO_MSS_CRYPTO_ENCR_KEY4_ADDR A:0xfc9dd010
y.create.l HWIO_MSS_CRYPTO_ENCR_KEY5_ADDR A:0xfc9dd014
y.create.l HWIO_MSS_CRYPTO_ENCR_KEY6_ADDR A:0xfc9dd018
y.create.l HWIO_MSS_CRYPTO_ENCR_KEY7_ADDR A:0xfc9dd01c
y.create.l HWIO_MSS_CRYPTO_ENCR_XTS_KEY0_ADDR A:0xfc9dd020
y.create.l HWIO_MSS_CRYPTO_ENCR_XTS_KEY1_ADDR A:0xfc9dd024
y.create.l HWIO_MSS_CRYPTO_ENCR_XTS_KEY2_ADDR A:0xfc9dd028
y.create.l HWIO_MSS_CRYPTO_ENCR_XTS_KEY3_ADDR A:0xfc9dd02c
y.create.l HWIO_MSS_CRYPTO_ENCR_XTS_KEY4_ADDR A:0xfc9dd030
y.create.l HWIO_MSS_CRYPTO_ENCR_XTS_KEY5_ADDR A:0xfc9dd034
y.create.l HWIO_MSS_CRYPTO_ENCR_XTS_KEY6_ADDR A:0xfc9dd038
y.create.l HWIO_MSS_CRYPTO_ENCR_XTS_KEY7_ADDR A:0xfc9dd03c
y.create.l HWIO_MSS_CRYPTO_ENCR_CNTR0_IV0_ADDR A:0xfc9da20c
y.create.l HWIO_MSS_CRYPTO_ENCR_CNTR1_IV1_ADDR A:0xfc9da210
y.create.l HWIO_MSS_CRYPTO_ENCR_CNTR2_IV2_ADDR A:0xfc9da214
y.create.l HWIO_MSS_CRYPTO_ENCR_CNTR3_IV3_ADDR A:0xfc9da218
y.create.l HWIO_MSS_CRYPTO_ENCR_CNTR_MASK_ADDR A:0xfc9da21c
y.create.l HWIO_MSS_CRYPTO_ENCR_CNTR_MASK2_ADDR A:0xfc9da234
y.create.l HWIO_MSS_CRYPTO_ENCR_CNTR_MASK1_ADDR A:0xfc9da238
y.create.l HWIO_MSS_CRYPTO_ENCR_CNTR_MASK0_ADDR A:0xfc9da23c
y.create.l HWIO_MSS_CRYPTO_ENCR_CCM_INIT_CNTR0_ADDR A:0xfc9da220
y.create.l HWIO_MSS_CRYPTO_ENCR_CCM_INIT_CNTR1_ADDR A:0xfc9da224
y.create.l HWIO_MSS_CRYPTO_ENCR_CCM_INIT_CNTR2_ADDR A:0xfc9da228
y.create.l HWIO_MSS_CRYPTO_ENCR_CCM_INIT_CNTR3_ADDR A:0xfc9da22c
y.create.l HWIO_MSS_CRYPTO_ENCR_XTS_DU_SIZE_ADDR A:0xfc9da230
y.create.l HWIO_MSS_CRYPTO_AUTH_SEG_CFG_ADDR A:0xfc9da300
y.create.l HWIO_MSS_CRYPTO_AUTH_SEG_SIZE_ADDR A:0xfc9da304
y.create.l HWIO_MSS_CRYPTO_AUTH_SEG_START_ADDR A:0xfc9da308
y.create.l HWIO_MSS_CRYPTO_AUTH_KEY0_ADDR A:0xfc9dd040
y.create.l HWIO_MSS_CRYPTO_AUTH_KEY1_ADDR A:0xfc9dd044
y.create.l HWIO_MSS_CRYPTO_AUTH_KEY2_ADDR A:0xfc9dd048
y.create.l HWIO_MSS_CRYPTO_AUTH_KEY3_ADDR A:0xfc9dd04c
y.create.l HWIO_MSS_CRYPTO_AUTH_KEY4_ADDR A:0xfc9dd050
y.create.l HWIO_MSS_CRYPTO_AUTH_KEY5_ADDR A:0xfc9dd054
y.create.l HWIO_MSS_CRYPTO_AUTH_KEY6_ADDR A:0xfc9dd058
y.create.l HWIO_MSS_CRYPTO_AUTH_KEY7_ADDR A:0xfc9dd05c
y.create.l HWIO_MSS_CRYPTO_AUTH_KEY8_ADDR A:0xfc9dd060
y.create.l HWIO_MSS_CRYPTO_AUTH_KEY9_ADDR A:0xfc9dd064
y.create.l HWIO_MSS_CRYPTO_AUTH_IV0_ADDR A:0xfc9da310
y.create.l HWIO_MSS_CRYPTO_AUTH_IV1_ADDR A:0xfc9da314
y.create.l HWIO_MSS_CRYPTO_AUTH_IV2_ADDR A:0xfc9da318
y.create.l HWIO_MSS_CRYPTO_AUTH_IV3_ADDR A:0xfc9da31c
y.create.l HWIO_MSS_CRYPTO_AUTH_IV4_ADDR A:0xfc9da320
y.create.l HWIO_MSS_CRYPTO_AUTH_IV5_ADDR A:0xfc9da324
y.create.l HWIO_MSS_CRYPTO_AUTH_IV6_ADDR A:0xfc9da328
y.create.l HWIO_MSS_CRYPTO_AUTH_IV7_ADDR A:0xfc9da32c
y.create.l HWIO_MSS_CRYPTO_AUTH_INFO_NONCE0_ADDR A:0xfc9da350
y.create.l HWIO_MSS_CRYPTO_AUTH_INFO_NONCE1_ADDR A:0xfc9da354
y.create.l HWIO_MSS_CRYPTO_AUTH_INFO_NONCE2_ADDR A:0xfc9da358
y.create.l HWIO_MSS_CRYPTO_AUTH_INFO_NONCE3_ADDR A:0xfc9da35c
y.create.l HWIO_MSS_CRYPTO_AUTH_BYTECNT0_ADDR A:0xfc9da390
y.create.l HWIO_MSS_CRYPTO_AUTH_BYTECNT1_ADDR A:0xfc9da394
y.create.l HWIO_MSS_CRYPTO_AUTH_EXP_MAC0_ADDR A:0xfc9da3a0
y.create.l HWIO_MSS_CRYPTO_AUTH_EXP_MAC1_ADDR A:0xfc9da3a4
y.create.l HWIO_MSS_CRYPTO_AUTH_EXP_MAC2_ADDR A:0xfc9da3a8
y.create.l HWIO_MSS_CRYPTO_AUTH_EXP_MAC3_ADDR A:0xfc9da3ac
y.create.l HWIO_MSS_CRYPTO_AUTH_EXP_MAC4_ADDR A:0xfc9da3b0
y.create.l HWIO_MSS_CRYPTO_AUTH_EXP_MAC5_ADDR A:0xfc9da3b4
y.create.l HWIO_MSS_CRYPTO_AUTH_EXP_MAC6_ADDR A:0xfc9da3b8
y.create.l HWIO_MSS_CRYPTO_AUTH_EXP_MAC7_ADDR A:0xfc9da3bc
y.create.l HWIO_MSS_CRYPTO_CONFIG_ADDR A:0xfc9da400
y.create.l HWIO_MSS_CRYPTO_DEBUG_ENABLE_ADDR A:0xfc9df000
y.create.l HWIO_MSS_CRYPTO_DEBUG_ADDR A:0xfc9df004
y.create.l HWIO_MSS_CRYPTO_PWR_CTRL_ADDR A:0xfc9df008
y.create.l HWIO_MSS_CRYPTO_BAM_CTRL_ADDR A:0xfc9c4000
y.create.l HWIO_MSS_CRYPTO_BAM_REVISION_ADDR A:0xfc9c4004
y.create.l HWIO_MSS_CRYPTO_BAM_SW_VERSION_ADDR A:0xfc9c4080
y.create.l HWIO_MSS_CRYPTO_BAM_NUM_PIPES_ADDR A:0xfc9c403c
y.create.l HWIO_MSS_CRYPTO_BAM_TIMER_ADDR A:0xfc9c4040
y.create.l HWIO_MSS_CRYPTO_BAM_TIMER_CTRL_ADDR A:0xfc9c4044
y.create.l HWIO_MSS_CRYPTO_BAM_DESC_CNT_TRSHLD_ADDR A:0xfc9c4008
y.create.l HWIO_MSS_CRYPTO_BAM_IRQ_SRCS_ADDR A:0xfc9c400c
y.create.l HWIO_MSS_CRYPTO_BAM_IRQ_SRCS_MSK_ADDR A:0xfc9c4010
y.create.l HWIO_MSS_CRYPTO_BAM_IRQ_SRCS_UNMASKED_ADDR A:0xfc9c4030
y.create.l HWIO_MSS_CRYPTO_BAM_IRQ_STTS_ADDR A:0xfc9c4014
y.create.l HWIO_MSS_CRYPTO_BAM_IRQ_CLR_ADDR A:0xfc9c4018
y.create.l HWIO_MSS_CRYPTO_BAM_IRQ_EN_ADDR A:0xfc9c401c
y.create.l HWIO_MSS_CRYPTO_BAM_AHB_MASTER_ERR_CTRLS_ADDR A:0xfc9c4024
y.create.l HWIO_MSS_CRYPTO_BAM_AHB_MASTER_ERR_ADDR_ADDR A:0xfc9c4028
y.create.l HWIO_MSS_CRYPTO_BAM_AHB_MASTER_ERR_ADDR_LSB_ADDR A:0xfc9c4100
y.create.l HWIO_MSS_CRYPTO_BAM_AHB_MASTER_ERR_ADDR_MSB_ADDR A:0xfc9c4104
y.create.l HWIO_MSS_CRYPTO_BAM_AHB_MASTER_ERR_DATA_ADDR A:0xfc9c402c
y.create.l HWIO_MSS_CRYPTO_BAM_TRUST_REG_ADDR A:0xfc9c4070
y.create.l HWIO_MSS_CRYPTO_BAM_TEST_BUS_SEL_ADDR A:0xfc9c4074
y.create.l HWIO_MSS_CRYPTO_BAM_TEST_BUS_REG_ADDR A:0xfc9c4078
y.create.l HWIO_MSS_CRYPTO_BAM_CNFG_BITS_ADDR A:0xfc9c407c
y.create.l HWIO_MSS_CRYPTO_BAM_IRQ_SRCS_EE0_ADDR A:0xfc9c4800
y.create.l HWIO_MSS_CRYPTO_BAM_IRQ_SRCS_EE1_ADDR A:0xfc9c4880
y.create.l HWIO_MSS_CRYPTO_BAM_IRQ_SRCS_EE2_ADDR A:0xfc9c4900
y.create.l HWIO_MSS_CRYPTO_BAM_IRQ_SRCS_EE3_ADDR A:0xfc9c4980
y.create.l HWIO_MSS_CRYPTO_BAM_IRQ_SRCS_EE4_ADDR A:0xfc9c4a00
y.create.l HWIO_MSS_CRYPTO_BAM_IRQ_SRCS_EE5_ADDR A:0xfc9c4a80
y.create.l HWIO_MSS_CRYPTO_BAM_IRQ_SRCS_EE6_ADDR A:0xfc9c4b00
y.create.l HWIO_MSS_CRYPTO_BAM_IRQ_SRCS_EE7_ADDR A:0xfc9c4b80
y.create.l HWIO_MSS_CRYPTO_BAM_IRQ_SRCS_MSK_EE0_ADDR A:0xfc9c4804
y.create.l HWIO_MSS_CRYPTO_BAM_IRQ_SRCS_MSK_EE1_ADDR A:0xfc9c4884
y.create.l HWIO_MSS_CRYPTO_BAM_IRQ_SRCS_MSK_EE2_ADDR A:0xfc9c4904
y.create.l HWIO_MSS_CRYPTO_BAM_IRQ_SRCS_MSK_EE3_ADDR A:0xfc9c4984
y.create.l HWIO_MSS_CRYPTO_BAM_IRQ_SRCS_MSK_EE4_ADDR A:0xfc9c4a04
y.create.l HWIO_MSS_CRYPTO_BAM_IRQ_SRCS_MSK_EE5_ADDR A:0xfc9c4a84
y.create.l HWIO_MSS_CRYPTO_BAM_IRQ_SRCS_MSK_EE6_ADDR A:0xfc9c4b04
y.create.l HWIO_MSS_CRYPTO_BAM_IRQ_SRCS_MSK_EE7_ADDR A:0xfc9c4b84
y.create.l HWIO_MSS_CRYPTO_BAM_IRQ_SRCS_UNMASKED_EE0_ADDR A:0xfc9c4808
y.create.l HWIO_MSS_CRYPTO_BAM_IRQ_SRCS_UNMASKED_EE1_ADDR A:0xfc9c4888
y.create.l HWIO_MSS_CRYPTO_BAM_IRQ_SRCS_UNMASKED_EE2_ADDR A:0xfc9c4908
y.create.l HWIO_MSS_CRYPTO_BAM_IRQ_SRCS_UNMASKED_EE3_ADDR A:0xfc9c4988
y.create.l HWIO_MSS_CRYPTO_BAM_IRQ_SRCS_UNMASKED_EE4_ADDR A:0xfc9c4a08
y.create.l HWIO_MSS_CRYPTO_BAM_IRQ_SRCS_UNMASKED_EE5_ADDR A:0xfc9c4a88
y.create.l HWIO_MSS_CRYPTO_BAM_IRQ_SRCS_UNMASKED_EE6_ADDR A:0xfc9c4b08
y.create.l HWIO_MSS_CRYPTO_BAM_IRQ_SRCS_UNMASKED_EE7_ADDR A:0xfc9c4b88
y.create.l HWIO_MSS_CRYPTO_BAM_PIPE_ATTR_EE0_ADDR A:0xfc9c480c
y.create.l HWIO_MSS_CRYPTO_BAM_PIPE_ATTR_EE1_ADDR A:0xfc9c488c
y.create.l HWIO_MSS_CRYPTO_BAM_PIPE_ATTR_EE2_ADDR A:0xfc9c490c
y.create.l HWIO_MSS_CRYPTO_BAM_PIPE_ATTR_EE3_ADDR A:0xfc9c498c
y.create.l HWIO_MSS_CRYPTO_BAM_PIPE_ATTR_EE4_ADDR A:0xfc9c4a0c
y.create.l HWIO_MSS_CRYPTO_BAM_PIPE_ATTR_EE5_ADDR A:0xfc9c4a8c
y.create.l HWIO_MSS_CRYPTO_BAM_PIPE_ATTR_EE6_ADDR A:0xfc9c4b0c
y.create.l HWIO_MSS_CRYPTO_BAM_PIPE_ATTR_EE7_ADDR A:0xfc9c4b8c
y.create.l HWIO_MSS_CRYPTO_BAM_P_CTRL0_ADDR A:0xfc9c5000
y.create.l HWIO_MSS_CRYPTO_BAM_P_CTRL1_ADDR A:0xfc9c6000
y.create.l HWIO_MSS_CRYPTO_BAM_P_RST0_ADDR A:0xfc9c5004
y.create.l HWIO_MSS_CRYPTO_BAM_P_RST1_ADDR A:0xfc9c6004
y.create.l HWIO_MSS_CRYPTO_BAM_P_HALT0_ADDR A:0xfc9c5008
y.create.l HWIO_MSS_CRYPTO_BAM_P_HALT1_ADDR A:0xfc9c6008
y.create.l HWIO_MSS_CRYPTO_BAM_P_TRUST_REG0_ADDR A:0xfc9c5030
y.create.l HWIO_MSS_CRYPTO_BAM_P_TRUST_REG1_ADDR A:0xfc9c6030
y.create.l HWIO_MSS_CRYPTO_BAM_P_IRQ_STTS0_ADDR A:0xfc9c5010
y.create.l HWIO_MSS_CRYPTO_BAM_P_IRQ_STTS1_ADDR A:0xfc9c6010
y.create.l HWIO_MSS_CRYPTO_BAM_P_IRQ_CLR0_ADDR A:0xfc9c5014
y.create.l HWIO_MSS_CRYPTO_BAM_P_IRQ_CLR1_ADDR A:0xfc9c6014
y.create.l HWIO_MSS_CRYPTO_BAM_P_IRQ_EN0_ADDR A:0xfc9c5018
y.create.l HWIO_MSS_CRYPTO_BAM_P_IRQ_EN1_ADDR A:0xfc9c6018
y.create.l HWIO_MSS_CRYPTO_BAM_P_TIMER0_ADDR A:0xfc9c501c
y.create.l HWIO_MSS_CRYPTO_BAM_P_TIMER1_ADDR A:0xfc9c601c
y.create.l HWIO_MSS_CRYPTO_BAM_P_TIMER_CTRL0_ADDR A:0xfc9c5020
y.create.l HWIO_MSS_CRYPTO_BAM_P_TIMER_CTRL1_ADDR A:0xfc9c6020
y.create.l HWIO_MSS_CRYPTO_BAM_P_PRDCR_SDBND0_ADDR A:0xfc9c5024
y.create.l HWIO_MSS_CRYPTO_BAM_P_PRDCR_SDBND1_ADDR A:0xfc9c6024
y.create.l HWIO_MSS_CRYPTO_BAM_P_CNSMR_SDBND0_ADDR A:0xfc9c5028
y.create.l HWIO_MSS_CRYPTO_BAM_P_CNSMR_SDBND1_ADDR A:0xfc9c6028
y.create.l HWIO_MSS_CRYPTO_BAM_P_EVNT_DEST_ADDR0_ADDR A:0xfc9c582c
y.create.l HWIO_MSS_CRYPTO_BAM_P_EVNT_DEST_ADDR1_ADDR A:0xfc9c682c
y.create.l HWIO_MSS_CRYPTO_BAM_P_EVNT_DEST_ADDR_LSB0_ADDR A:0xfc9c5930
y.create.l HWIO_MSS_CRYPTO_BAM_P_EVNT_DEST_ADDR_LSB1_ADDR A:0xfc9c6930
y.create.l HWIO_MSS_CRYPTO_BAM_P_EVNT_DEST_ADDR_MSB0_ADDR A:0xfc9c5934
y.create.l HWIO_MSS_CRYPTO_BAM_P_EVNT_DEST_ADDR_MSB1_ADDR A:0xfc9c6934
y.create.l HWIO_MSS_CRYPTO_BAM_P_EVNT_REG0_ADDR A:0xfc9c5818
y.create.l HWIO_MSS_CRYPTO_BAM_P_EVNT_REG1_ADDR A:0xfc9c6818
y.create.l HWIO_MSS_CRYPTO_BAM_P_SW_OFSTS0_ADDR A:0xfc9c5800
y.create.l HWIO_MSS_CRYPTO_BAM_P_SW_OFSTS1_ADDR A:0xfc9c6800
y.create.l HWIO_MSS_CRYPTO_BAM_P_DATA_FIFO_ADDR0_ADDR A:0xfc9c5824
y.create.l HWIO_MSS_CRYPTO_BAM_P_DATA_FIFO_ADDR1_ADDR A:0xfc9c6824
y.create.l HWIO_MSS_CRYPTO_BAM_P_DATA_FIFO_ADDR_LSB0_ADDR A:0xfc9c5920
y.create.l HWIO_MSS_CRYPTO_BAM_P_DATA_FIFO_ADDR_LSB1_ADDR A:0xfc9c6920
y.create.l HWIO_MSS_CRYPTO_BAM_P_DATA_FIFO_ADDR_MSB0_ADDR A:0xfc9c5924
y.create.l HWIO_MSS_CRYPTO_BAM_P_DATA_FIFO_ADDR_MSB1_ADDR A:0xfc9c6924
y.create.l HWIO_MSS_CRYPTO_BAM_P_DESC_FIFO_ADDR0_ADDR A:0xfc9c581c
y.create.l HWIO_MSS_CRYPTO_BAM_P_DESC_FIFO_ADDR1_ADDR A:0xfc9c681c
y.create.l HWIO_MSS_CRYPTO_BAM_P_DESC_FIFO_ADDR_LSB0_ADDR A:0xfc9c5910
y.create.l HWIO_MSS_CRYPTO_BAM_P_DESC_FIFO_ADDR_LSB1_ADDR A:0xfc9c6910
y.create.l HWIO_MSS_CRYPTO_BAM_P_DESC_FIFO_ADDR_MSB0_ADDR A:0xfc9c5914
y.create.l HWIO_MSS_CRYPTO_BAM_P_DESC_FIFO_ADDR_MSB1_ADDR A:0xfc9c6914
y.create.l HWIO_MSS_CRYPTO_BAM_P_EVNT_GEN_TRSHLD0_ADDR A:0xfc9c5828
y.create.l HWIO_MSS_CRYPTO_BAM_P_EVNT_GEN_TRSHLD1_ADDR A:0xfc9c6828
y.create.l HWIO_MSS_CRYPTO_BAM_P_FIFO_SIZES0_ADDR A:0xfc9c5820
y.create.l HWIO_MSS_CRYPTO_BAM_P_FIFO_SIZES1_ADDR A:0xfc9c6820
y.create.l HWIO_MSS_CRYPTO_BAM_P_RETR_CNTXT_0_ADDR A:0xfc9c5834
y.create.l HWIO_MSS_CRYPTO_BAM_P_RETR_CNTXT_1_ADDR A:0xfc9c6834
y.create.l HWIO_MSS_CRYPTO_BAM_P_SI_CNTXT_0_ADDR A:0xfc9c5838
y.create.l HWIO_MSS_CRYPTO_BAM_P_SI_CNTXT_1_ADDR A:0xfc9c6838
y.create.l HWIO_MSS_CRYPTO_BAM_P_DF_CNTXT_0_ADDR A:0xfc9c5830
y.create.l HWIO_MSS_CRYPTO_BAM_P_DF_CNTXT_1_ADDR A:0xfc9c6830
y.create.l HWIO_MSS_CRYPTO_BAM_P_AU_PSM_CNTXT_1_0_ADDR A:0xfc9c5804
y.create.l HWIO_MSS_CRYPTO_BAM_P_AU_PSM_CNTXT_1_1_ADDR A:0xfc9c6804
y.create.l HWIO_MSS_CRYPTO_BAM_P_PSM_CNTXT_2_0_ADDR A:0xfc9c5808
y.create.l HWIO_MSS_CRYPTO_BAM_P_PSM_CNTXT_2_1_ADDR A:0xfc9c6808
y.create.l HWIO_MSS_CRYPTO_BAM_P_PSM_CNTXT_3_0_ADDR A:0xfc9c580c
y.create.l HWIO_MSS_CRYPTO_BAM_P_PSM_CNTXT_3_1_ADDR A:0xfc9c680c
y.create.l HWIO_MSS_CRYPTO_BAM_P_PSM_CNTXT_3_LSB0_ADDR A:0xfc9c5900
y.create.l HWIO_MSS_CRYPTO_BAM_P_PSM_CNTXT_3_LSB1_ADDR A:0xfc9c6900
y.create.l HWIO_MSS_CRYPTO_BAM_P_PSM_CNTXT_3_MSB0_ADDR A:0xfc9c5904
y.create.l HWIO_MSS_CRYPTO_BAM_P_PSM_CNTXT_3_MSB1_ADDR A:0xfc9c6904
y.create.l HWIO_MSS_CRYPTO_BAM_P_PSM_CNTXT_4_0_ADDR A:0xfc9c5810
y.create.l HWIO_MSS_CRYPTO_BAM_P_PSM_CNTXT_4_1_ADDR A:0xfc9c6810
y.create.l HWIO_MSS_CRYPTO_BAM_P_PSM_CNTXT_5_0_ADDR A:0xfc9c5814
y.create.l HWIO_MSS_CRYPTO_BAM_P_PSM_CNTXT_5_1_ADDR A:0xfc9c6814
y.create.l HWIO_MSS_PDMEM_MIN_ADDR A:0xfc9e0000
y.create.l HWIO_MSS_PDMEM_MAX_ADDR A:0xfc9e5ffc
y.create.l HWIO_MSS_RFC_MSTS_ADDR A:0xfc9e7e00
y.create.l HWIO_MSS_RFC_MCTL_ADDR A:0xfc9e7e04
y.create.l HWIO_MSS_RFC_IPC_ADDR A:0xfc9e7e08
y.create.l HWIO_MSS_RFC_PIC0MSK_ADDR A:0xfc9e7e0c
y.create.l HWIO_MSS_RFC_PIC0STS_ADDR A:0xfc9e7e10
y.create.l HWIO_MSS_RFC_PIC1MSK_ADDR A:0xfc9e7e14
y.create.l HWIO_MSS_RFC_PIC1STS_ADDR A:0xfc9e7e18
y.create.l HWIO_MSS_RFC_PIC2MSK_ADDR A:0xfc9e7e1c
y.create.l HWIO_MSS_RFC_PIC2STS_ADDR A:0xfc9e7e20
y.create.l HWIO_MSS_RFC_PIC3MSK_ADDR A:0xfc9e7e24
y.create.l HWIO_MSS_RFC_PIC3STS_ADDR A:0xfc9e7e28
y.create.l HWIO_MSS_RFC_UTIME_ADDR A:0xfc9e7e2c
y.create.l HWIO_MSS_RFC_MON_ADDR A:0xfc9e7e30
y.create.l HWIO_MSS_RFC_MON0_ADDR A:0xfc9e7e34
y.create.l HWIO_MSS_RFC_MON1_ADDR A:0xfc9e7e38
y.create.l HWIO_MSS_RFC_MON2_ADDR A:0xfc9e7e3c
y.create.l HWIO_MSS_RFC_MON3_ADDR A:0xfc9e7e40
y.create.l HWIO_MSS_RFC_MON4_ADDR A:0xfc9e7e44
y.create.l HWIO_MSS_RFC_MON5_ADDR A:0xfc9e7e48
y.create.l HWIO_MSS_RFC_MON6_ADDR A:0xfc9e7e4c
y.create.l HWIO_MSS_RFC_MON7_ADDR A:0xfc9e7e50
y.create.l HWIO_MSS_RFC_DMAC_ADDR A:0xfc9e7e54
y.create.l HWIO_MSS_RFC_DMAC0SRC_ADDR A:0xfc9e7e58
y.create.l HWIO_MSS_RFC_DMAC1SRC_ADDR A:0xfc9e7e68
y.create.l HWIO_MSS_RFC_DMAC2SRC_ADDR A:0xfc9e7e78
y.create.l HWIO_MSS_RFC_DMAC3SRC_ADDR A:0xfc9e7e88
y.create.l HWIO_MSS_RFC_DMAC4SRC_ADDR A:0xfc9e7e98
y.create.l HWIO_MSS_RFC_DMAC5SRC_ADDR A:0xfc9e7ea8
y.create.l HWIO_MSS_RFC_DMAC6SRC_ADDR A:0xfc9e7eb8
y.create.l HWIO_MSS_RFC_DMAC7SRC_ADDR A:0xfc9e7ec8
y.create.l HWIO_MSS_RFC_DMAC0DST_ADDR A:0xfc9e7e5c
y.create.l HWIO_MSS_RFC_DMAC1DST_ADDR A:0xfc9e7e6c
y.create.l HWIO_MSS_RFC_DMAC2DST_ADDR A:0xfc9e7e7c
y.create.l HWIO_MSS_RFC_DMAC3DST_ADDR A:0xfc9e7e8c
y.create.l HWIO_MSS_RFC_DMAC4DST_ADDR A:0xfc9e7e9c
y.create.l HWIO_MSS_RFC_DMAC5DST_ADDR A:0xfc9e7eac
y.create.l HWIO_MSS_RFC_DMAC6DST_ADDR A:0xfc9e7ebc
y.create.l HWIO_MSS_RFC_DMAC7DST_ADDR A:0xfc9e7ecc
y.create.l HWIO_MSS_RFC_DMAC0LNK_ADDR A:0xfc9e7e60
y.create.l HWIO_MSS_RFC_DMAC1LNK_ADDR A:0xfc9e7e70
y.create.l HWIO_MSS_RFC_DMAC2LNK_ADDR A:0xfc9e7e80
y.create.l HWIO_MSS_RFC_DMAC3LNK_ADDR A:0xfc9e7e90
y.create.l HWIO_MSS_RFC_DMAC4LNK_ADDR A:0xfc9e7ea0
y.create.l HWIO_MSS_RFC_DMAC5LNK_ADDR A:0xfc9e7eb0
y.create.l HWIO_MSS_RFC_DMAC6LNK_ADDR A:0xfc9e7ec0
y.create.l HWIO_MSS_RFC_DMAC7LNK_ADDR A:0xfc9e7ed0
y.create.l HWIO_MSS_RFC_DMAC0CTL_ADDR A:0xfc9e7e64
y.create.l HWIO_MSS_RFC_DMAC1CTL_ADDR A:0xfc9e7e74
y.create.l HWIO_MSS_RFC_DMAC2CTL_ADDR A:0xfc9e7e84
y.create.l HWIO_MSS_RFC_DMAC3CTL_ADDR A:0xfc9e7e94
y.create.l HWIO_MSS_RFC_DMAC4CTL_ADDR A:0xfc9e7ea4
y.create.l HWIO_MSS_RFC_DMAC5CTL_ADDR A:0xfc9e7eb4
y.create.l HWIO_MSS_RFC_DMAC6CTL_ADDR A:0xfc9e7ec4
y.create.l HWIO_MSS_RFC_DMAC7CTL_ADDR A:0xfc9e7ed4
y.create.l HWIO_MSS_RFC_RFI_ADDR A:0xfc9e7ed8
y.create.l HWIO_MSS_RFC_GRFC_SET_ADDR A:0xfc9e7edc
y.create.l HWIO_MSS_RFC_GRFC_CLR_ADDR A:0xfc9e7ee0
y.create.l HWIO_MSS_RFC_SSBI0_ADDR A:0xfc9e7ee4
y.create.l HWIO_MSS_RFC_SSBI1_ADDR A:0xfc9e7eec
y.create.l HWIO_MSS_RFC_SSBI0DAT_ADDR A:0xfc9e7ee8
y.create.l HWIO_MSS_RFC_SSBI1DAT_ADDR A:0xfc9e7ef0
y.create.l HWIO_MSS_RFC_RFFE0_ADDR A:0xfc9e7ef4
y.create.l HWIO_MSS_RFC_RFFE1_ADDR A:0xfc9e7efc
y.create.l HWIO_MSS_RFC_RFFE2_ADDR A:0xfc9e7f04
y.create.l HWIO_MSS_RFC_RFFE3_ADDR A:0xfc9e7f0c
y.create.l HWIO_MSS_RFC_RFFE4_ADDR A:0xfc9e7f14
y.create.l HWIO_MSS_RFC_RFFE0DAT_ADDR A:0xfc9e7ef8
y.create.l HWIO_MSS_RFC_RFFE1DAT_ADDR A:0xfc9e7f00
y.create.l HWIO_MSS_RFC_RFFE2DAT_ADDR A:0xfc9e7f08
y.create.l HWIO_MSS_RFC_RFFE3DAT_ADDR A:0xfc9e7f10
y.create.l HWIO_MSS_RFC_RFFE4DAT_ADDR A:0xfc9e7f18
y.create.l HWIO_MSS_RFC_BP0_ADDR A:0xfc9e7f1c
y.create.l HWIO_MSS_RFC_BP1_ADDR A:0xfc9e7f20
y.create.l HWIO_MSS_RC_CONTROL_ADDR A:0xfca00000
y.create.l HWIO_MSS_RC_CONFIG_ADDR A:0xfca00004
y.create.l HWIO_MSS_RC_LPM_RTC_CONTROL_ADDR A:0xfca00008
y.create.l HWIO_MSS_RC_PPSO_ASSERT_ADDR A:0xfca0000c
y.create.l HWIO_MSS_RC_PPSO_DEASSERT_ADDR A:0xfca00010
y.create.l HWIO_MSS_RC_GPS_ON_ADDR A:0xfca00014
y.create.l HWIO_MSS_RC_TIME_TRANSFER_ADDR A:0xfca00018
y.create.l HWIO_MSS_RC_GNSS_RTC_STATUS_ADDR A:0xfca0001c
y.create.l HWIO_MSS_RC_BP1_COUNT_STATUS_ADDR A:0xfca00020
y.create.l HWIO_MSS_RC_BP1_PHASE_STATUS_ADDR A:0xfca00024
y.create.l HWIO_MSS_RC_BP2_COUNT_STATUS_ADDR A:0xfca00028
y.create.l HWIO_MSS_RC_BP2_PHASE_STATUS_ADDR A:0xfca0002c
y.create.l HWIO_MSS_RC_BP3_COUNT_STATUS_ADDR A:0xfca00030
y.create.l HWIO_MSS_RC_BP3_PHASE_STATUS_ADDR A:0xfca00034
y.create.l HWIO_MSS_RC_BP4_COUNT_STATUS_ADDR A:0xfca00038
y.create.l HWIO_MSS_RC_BP4_PHASE_STATUS_ADDR A:0xfca0003c
y.create.l HWIO_MSS_RC_TT_STATUS_ADDR A:0xfca00040
y.create.l HWIO_MSS_RC_IRQ_STATUS_ADDR A:0xfca00044
y.create.l HWIO_MSS_RC_PPSI_RTC_ADDR A:0xfca00048
y.create.l HWIO_MSS_RC_NAV_TT_RTC_ADDR A:0xfca0004c
y.create.l HWIO_MSS_RC_CDMA_TT_RTC_ADDR A:0xfca00050
y.create.l HWIO_MSS_RC_GNSS_TT_CNT_ADDR A:0xfca00054
y.create.l HWIO_MSS_RC_NAV_TEST_BUS_ADDR A:0xfca00058
y.create.l HWIO_MSS_RC_B1_POLYNOMIAL_MASK_ADDR A:0xfca0005c
y.create.l HWIO_MSS_AD_MODE_ADDR A:0xfca00080
y.create.l HWIO_MSS_AD_RX1_CONFIG_ADDR A:0xfca00084
y.create.l HWIO_MSS_AD_RX2_CONFIG_ADDR A:0xfca00088
y.create.l HWIO_MSS_AD_RX1_QUANTMAP_ADDR A:0xfca0008c
y.create.l HWIO_MSS_AD_RX2_QUANTMAP_ADDR A:0xfca00090
y.create.l HWIO_MSS_AD_MEAS_STATUS_ADDR A:0xfca00094
y.create.l HWIO_MSS_AD_RX1_MEAN_MON_ADDR A:0xfca00098
y.create.l HWIO_MSS_AD_RX2_MEAN_MON_ADDR A:0xfca0009c
y.create.l HWIO_MSS_AD_RX1_BLANK_MONITOR_ADDR A:0xfca000a0
y.create.l HWIO_MSS_AD_RX2_BLANK_MONITOR_ADDR A:0xfca000a4
y.create.l HWIO_MSS_AD_SL_INDEX_ADDR A:0xfca000a8
y.create.l HWIO_MSS_AD_RX1_AMPL_MON_ADDR A:0xfca000ac
y.create.l HWIO_MSS_AD_RX2_AMPL_MON_ADDR A:0xfca000b0
y.create.l HWIO_MSS_AD_SPEC_ANALYZER_CMD_ADDR A:0xfca000b4
y.create.l HWIO_MSS_AD_SPEC_ANALYZER_STATUS_ADDR A:0xfca000b8
y.create.l HWIO_MSS_BP1_CONFIG_ADDR A:0xfca00200
y.create.l HWIO_MSS_BP1_IF_FREQ_ADDR A:0xfca00204
y.create.l HWIO_MSS_BP1_RS_RATE_ADDR A:0xfca00208
y.create.l HWIO_MSS_BP1_OFFSET_ADDR A:0xfca0020c
y.create.l HWIO_MSS_BP1_NOTCH1_ADDR A:0xfca00210
y.create.l HWIO_MSS_BP1_NOTCH2_ADDR A:0xfca00214
y.create.l HWIO_MSS_BP1_NOTCH3_ADDR A:0xfca00218
y.create.l HWIO_MSS_BP1_NOTCH4_ADDR A:0xfca0021c
y.create.l HWIO_MSS_BP1_NOTCH5_ADDR A:0xfca00220
y.create.l HWIO_MSS_BP1_NOTCH6_ADDR A:0xfca00224
y.create.l HWIO_MSS_BP1_EQ_COEF_REAL_ADDR A:0xfca00228
y.create.l HWIO_MSS_BP1_EQ_COEF_IMAG_ADDR A:0xfca0022c
y.create.l HWIO_MSS_BP1_FREQ_ADDR A:0xfca00230
y.create.l HWIO_MSS_BP1_THRESH_ADDR A:0xfca00234
y.create.l HWIO_MSS_BP1_PRE_NOTCH_ADDR A:0xfca00238
y.create.l HWIO_MSS_BP1_RS_PHASE_ADDR A:0xfca0023c
y.create.l HWIO_MSS_BP1_PRE_AMPL_MON_ADDR A:0xfca00240
y.create.l HWIO_MSS_BP1_MEAN_MON_ADDR A:0xfca00244
y.create.l HWIO_MSS_BP1_SCH2_AMPL_MON_ADDR A:0xfca00248
y.create.l HWIO_MSS_BP1_SCH3_AMPL_MON_ADDR A:0xfca0024c
y.create.l HWIO_MSS_BP2_CONFIG_ADDR A:0xfca00300
y.create.l HWIO_MSS_BP2_IF_FREQ_ADDR A:0xfca00304
y.create.l HWIO_MSS_BP2_RS_RATE_ADDR A:0xfca00308
y.create.l HWIO_MSS_BP2_OFFSET_ADDR A:0xfca0030c
y.create.l HWIO_MSS_BP2_NOTCH1_ADDR A:0xfca00310
y.create.l HWIO_MSS_BP2_NOTCH2_ADDR A:0xfca00314
y.create.l HWIO_MSS_BP2_NOTCH3_ADDR A:0xfca00318
y.create.l HWIO_MSS_BP2_NOTCH4_ADDR A:0xfca0031c
y.create.l HWIO_MSS_BP2_NOTCH5_ADDR A:0xfca00320
y.create.l HWIO_MSS_BP2_NOTCH6_ADDR A:0xfca00324
y.create.l HWIO_MSS_BP2_EQ_COEF_REAL_ADDR A:0xfca00328
y.create.l HWIO_MSS_BP2_EQ_COEF_IMAG_ADDR A:0xfca0032c
y.create.l HWIO_MSS_BP2_FREQ_ADDR A:0xfca00330
y.create.l HWIO_MSS_BP2_THRESH_ADDR A:0xfca00334
y.create.l HWIO_MSS_BP2_PRE_NOTCH_ADDR A:0xfca00338
y.create.l HWIO_MSS_BP2_RS_PHASE_ADDR A:0xfca0033c
y.create.l HWIO_MSS_BP2_PRE_AMPL_MON_ADDR A:0xfca00340
y.create.l HWIO_MSS_BP2_MEAN_MON_ADDR A:0xfca00344
y.create.l HWIO_MSS_BP2_SCH2_AMPL_MON_ADDR A:0xfca00348
y.create.l HWIO_MSS_BP2_SCH3_AMPL_MON_ADDR A:0xfca0034c
y.create.l HWIO_MSS_BP3_CONFIG_ADDR A:0xfca00400
y.create.l HWIO_MSS_BP3_IF_FREQ_ADDR A:0xfca00404
y.create.l HWIO_MSS_BP3_RS_RATE_ADDR A:0xfca00408
y.create.l HWIO_MSS_BP3_OFFSET_ADDR A:0xfca0040c
y.create.l HWIO_MSS_BP3_NOTCH1_ADDR A:0xfca00410
y.create.l HWIO_MSS_BP3_NOTCH2_ADDR A:0xfca00414
y.create.l HWIO_MSS_BP3_NOTCH3_ADDR A:0xfca00418
y.create.l HWIO_MSS_BP3_NOTCH4_ADDR A:0xfca0041c
y.create.l HWIO_MSS_BP3_NOTCH5_ADDR A:0xfca00420
y.create.l HWIO_MSS_BP3_NOTCH6_ADDR A:0xfca00424
y.create.l HWIO_MSS_BP3_EQ_COEF_REAL_ADDR A:0xfca00428
y.create.l HWIO_MSS_BP3_EQ_COEF_IMAG_ADDR A:0xfca0042c
y.create.l HWIO_MSS_BP3_RS_PHASE_ADDR A:0xfca00430
y.create.l HWIO_MSS_BP3_SCH1_FREQ_ADDR A:0xfca00434
y.create.l HWIO_MSS_BP3_SCH2_FREQ_ADDR A:0xfca00438
y.create.l HWIO_MSS_BP3_SCH3_FREQ_ADDR A:0xfca0043c
y.create.l HWIO_MSS_BP3_SCH4_FREQ_ADDR A:0xfca00440
y.create.l HWIO_MSS_BP3_SCH5_FREQ_ADDR A:0xfca00444
y.create.l HWIO_MSS_BP3_SCH6_FREQ_ADDR A:0xfca00448
y.create.l HWIO_MSS_BP3_SCH7_FREQ_ADDR A:0xfca0044c
y.create.l HWIO_MSS_BP3_SCH8_FREQ_ADDR A:0xfca00450
y.create.l HWIO_MSS_BP3_SCH9_FREQ_ADDR A:0xfca00454
y.create.l HWIO_MSS_BP3_SCH10_FREQ_ADDR A:0xfca00458
y.create.l HWIO_MSS_BP3_SCH11_FREQ_ADDR A:0xfca0045c
y.create.l HWIO_MSS_BP3_SCH12_FREQ_ADDR A:0xfca00460
y.create.l HWIO_MSS_BP3_THRESH_A_ADDR A:0xfca00464
y.create.l HWIO_MSS_BP3_THRESH_B_ADDR A:0xfca00468
y.create.l HWIO_MSS_BP3_THRESH_C_ADDR A:0xfca0046c
y.create.l HWIO_MSS_BP3_THRESH_D_ADDR A:0xfca00470
y.create.l HWIO_MSS_BP3_THRESH_E_ADDR A:0xfca00474
y.create.l HWIO_MSS_BP3_THRESH_F_ADDR A:0xfca00478
y.create.l HWIO_MSS_BP3_PRE_AMPL_MON_ADDR A:0xfca0047c
y.create.l HWIO_MSS_BP3_MEAN_MON_ADDR A:0xfca00480
y.create.l HWIO_MSS_BP3_SCH1_AMPL_MON_ADDR A:0xfca00484
y.create.l HWIO_MSS_BP3_SCH2_AMPL_MON_ADDR A:0xfca00488
y.create.l HWIO_MSS_BP3_SCH3_AMPL_MON_ADDR A:0xfca0048c
y.create.l HWIO_MSS_BP3_SCH4_AMPL_MON_ADDR A:0xfca00490
y.create.l HWIO_MSS_BP3_SCH5_AMPL_MON_ADDR A:0xfca00494
y.create.l HWIO_MSS_BP3_SCH6_AMPL_MON_ADDR A:0xfca00498
y.create.l HWIO_MSS_BP3_SCH7_AMPL_MON_ADDR A:0xfca0049c
y.create.l HWIO_MSS_BP3_SCH8_AMPL_MON_ADDR A:0xfca004a0
y.create.l HWIO_MSS_BP3_SCH9_AMPL_MON_ADDR A:0xfca004a4
y.create.l HWIO_MSS_BP3_SCH10_AMPL_MON_ADDR A:0xfca004a8
y.create.l HWIO_MSS_BP3_SCH11_AMPL_MON_ADDR A:0xfca004ac
y.create.l HWIO_MSS_BP3_SCH12_AMPL_MON_ADDR A:0xfca004b0
y.create.l HWIO_MSS_BP3_SCH_MODE_ADDR A:0xfca004b4
y.create.l HWIO_MSS_BP3_PRE_NOTCH_ADDR A:0xfca004b8
y.create.l HWIO_MSS_BP3_NOTCH7_ADDR A:0xfca004bc
y.create.l HWIO_MSS_BP3_NOTCH8_ADDR A:0xfca004c0
y.create.l HWIO_MSS_BP3_NOTCH9_ADDR A:0xfca004c4
y.create.l HWIO_MSS_BP3_NOTCH10_ADDR A:0xfca004c8
y.create.l HWIO_MSS_BP3_NOTCH11_ADDR A:0xfca004cc
y.create.l HWIO_MSS_BP3_NOTCH12_ADDR A:0xfca004d0
y.create.l HWIO_MSS_BP4_CONFIG_ADDR A:0xfca00500
y.create.l HWIO_MSS_BP4_IF_FREQ_ADDR A:0xfca00504
y.create.l HWIO_MSS_BP4_RS_RATE_ADDR A:0xfca00508
y.create.l HWIO_MSS_BP4_OFFSET_ADDR A:0xfca0050c
y.create.l HWIO_MSS_BP4_NOTCH1_ADDR A:0xfca00510
y.create.l HWIO_MSS_BP4_NOTCH2_ADDR A:0xfca00514
y.create.l HWIO_MSS_BP4_NOTCH3_ADDR A:0xfca00518
y.create.l HWIO_MSS_BP4_NOTCH4_ADDR A:0xfca0051c
y.create.l HWIO_MSS_BP4_NOTCH5_ADDR A:0xfca00520
y.create.l HWIO_MSS_BP4_NOTCH6_ADDR A:0xfca00524
y.create.l HWIO_MSS_BP4_EQ_COEF_REAL_ADDR A:0xfca00528
y.create.l HWIO_MSS_BP4_EQ_COEF_IMAG_ADDR A:0xfca0052c
y.create.l HWIO_MSS_BP4_FREQ_ADDR A:0xfca00530
y.create.l HWIO_MSS_BP4_THRESH_ADDR A:0xfca00534
y.create.l HWIO_MSS_BP4_RS_PHASE_ADDR A:0xfca00538
y.create.l HWIO_MSS_BP4_PRE_AMPL_MON_ADDR A:0xfca0053c
y.create.l HWIO_MSS_BP4_MEAN_MON_ADDR A:0xfca00540
y.create.l HWIO_MSS_BP4_AMPL_MON_ADDR A:0xfca00544
y.create.l HWIO_MSS_BP4_PRE_NOTCH_ADDR A:0xfca00548
y.create.l HWIO_MSS_LTE1_CONFIG_ADDR A:0xfca002e0
y.create.l HWIO_MSS_LTE1_IF_FREQ_ADDR A:0xfca002e4
y.create.l HWIO_MSS_LTE3_CONFIG_ADDR A:0xfca004e0
y.create.l HWIO_MSS_LTE3_IF_FREQ_ADDR A:0xfca004e4
y.create.l HWIO_MSS_TSG_CMD0_ADDR A:0xfca00100
y.create.l HWIO_MSS_TSG_CH1_CONFIG_ADDR A:0xfca00104
y.create.l HWIO_MSS_TSG_CH1_RS_RATE_ADDR A:0xfca00108
y.create.l HWIO_MSS_TSG_CH1_INIT_COUNT_ADDR A:0xfca0010c
y.create.l HWIO_MSS_TSG_CH1_FREQ_ADDR A:0xfca00110
y.create.l HWIO_MSS_TSG_CH1_DATA_SEED_ADDR A:0xfca00114
y.create.l HWIO_MSS_TSG_CH1_PILOT_SEED_ADDR A:0xfca00118
y.create.l HWIO_MSS_TSG_CH2_CONFIG_ADDR A:0xfca0011c
y.create.l HWIO_MSS_TSG_CH2_RS_RATE_ADDR A:0xfca00120
y.create.l HWIO_MSS_TSG_CH2_INIT_COUNT_ADDR A:0xfca00124
y.create.l HWIO_MSS_TSG_CH2_FREQ_ADDR A:0xfca00128
y.create.l HWIO_MSS_TSG_CH2_DATA_SEED_ADDR A:0xfca0012c
y.create.l HWIO_MSS_TSG_CH2_PILOT_SEED_ADDR A:0xfca00130
y.create.l HWIO_MSS_TSG_RX1_CONFIG_ADDR A:0xfca00134
y.create.l HWIO_MSS_TSG_RX1_OFFSET_ADDR A:0xfca00138
y.create.l HWIO_MSS_TSG_RX2_CONFIG_ADDR A:0xfca0013c
y.create.l HWIO_MSS_TSG_RX2_OFFSET_ADDR A:0xfca00140
y.create.l HWIO_MSS_TSG_FIRST_CODE_ADDR A:0xfca00144
y.create.l HWIO_MSS_TSG_CH1_COUNT_STATUS_ADDR A:0xfca00148
y.create.l HWIO_MSS_TSG_CH2_COUNT_STATUS_ADDR A:0xfca0014c
y.create.l HWIO_MSS_SMI_MODE_ADDR A:0xfca00600
y.create.l HWIO_MSS_SMI_BASEADDR1_ADDR A:0xfca00604
y.create.l HWIO_MSS_SMI_BASEADDR2_ADDR A:0xfca00608
y.create.l HWIO_MSS_SMI_BASEADDR3A_ADDR A:0xfca0060c
y.create.l HWIO_MSS_SMI_BASEADDR3B_ADDR A:0xfca00610
y.create.l HWIO_MSS_SMI_BASEADDR3C_ADDR A:0xfca00614
y.create.l HWIO_MSS_SMI_BASEADDR4_ADDR A:0xfca00618
y.create.l HWIO_MSS_CP_START_ADDR A:0xfca00700
y.create.l HWIO_MSS_CP_CONFIG1_ADDR A:0xfca00704
y.create.l HWIO_MSS_CP_CONFIG2_ADDR A:0xfca00708
y.create.l HWIO_MSS_CP_SAMPLE_INDEX_ADDR A:0xfca0070c
y.create.l HWIO_MSS_CP_PHASE_ADDR A:0xfca00710
y.create.l HWIO_MSS_CP_FREQ_ADDR A:0xfca00714
y.create.l HWIO_MSS_CP_DATA_SEED_ADDR A:0xfca00718
y.create.l HWIO_MSS_CP_PILOT_SEED_ADDR A:0xfca0071c
y.create.l HWIO_MSS_CP_CODE_INDEX_ADDR A:0xfca00720
y.create.l HWIO_MSS_CP_COEF1_ADDR A:0xfca00724
y.create.l HWIO_MSS_CP_COEF2_ADDR A:0xfca00728
y.create.l HWIO_MSS_CP_COEF3_ADDR A:0xfca0072c
y.create.l HWIO_MSS_CP_COEF4_ADDR A:0xfca00730
y.create.l HWIO_MSS_CP_COEF5_ADDR A:0xfca00734
y.create.l HWIO_MSS_CP_COEF6_ADDR A:0xfca00738
y.create.l HWIO_MSS_CP_STATUS_ADDR A:0xfca0073c
y.create.l HWIO_MSS_CCP_BREAKPOINT_ADDR A:0xfca00800
y.create.l HWIO_MSS_CCP_BREAK_STATE_ADDR A:0xfca00804
y.create.l HWIO_MSS_CCP_PROG_STATUS_ADDR A:0xfca00808
y.create.l HWIO_MSS_CCP_G10_STATUS_ADDR A:0xfca0080c
y.create.l HWIO_MSS_CCP_G32_STATUS_ADDR A:0xfca00810
y.create.l HWIO_MSS_CCP_G54_STATUS_ADDR A:0xfca00814
y.create.l HWIO_MSS_CCP_G76_STATUS_ADDR A:0xfca00818
y.create.l HWIO_MSS_CCP_P10_STATUS_ADDR A:0xfca0081c
y.create.l HWIO_MSS_CCP_P2_STATUS_ADDR A:0xfca00820
y.create.l HWIO_MSS_SM_ADDR_BEGIN_ADDR A:0xfca40000
y.create.l HWIO_MSS_SM_ADDR_END_ADDR A:0xfca6affc
y.create.l HWIO_MSS_GPM_ADDR_BEGIN_ADDR A:0xfca04000
y.create.l HWIO_MSS_GPM_ADDR_END_ADDR A:0xfca047fc
y.create.l HWIO_MSS_GDM_ADDR_BEGIN_ADDR A:0xfca08000
y.create.l HWIO_MSS_GDM_ADDR_END_ADDR A:0xfca087fc
y.create.l HWIO_MSS_CMA_ADDR_BEGIN_ADDR A:0xfca0c000
y.create.l HWIO_MSS_CMA_ADDR_END_ADDR A:0xfca0edfc
y.create.l HWIO_MSS_CMB_ADDR_BEGIN_ADDR A:0xfca10000
y.create.l HWIO_MSS_CMB_ADDR_END_ADDR A:0xfca12dfc
y.create.l HWIO_MSS_VM_ADDR_BEGIN_ADDR A:0xfca18000
y.create.l HWIO_MSS_VM_ADDR_END_ADDR A:0xfca18ffc
y.create.l HWIO_MSS_PM_ADDR_BEGIN_ADDR A:0xfca1c000
y.create.l HWIO_MSS_PM_ADDR_END_ADDR A:0xfca1cffc
y.create.l HWIO_MSS_CCM_START_CMD_ADDR A:0xfca14000
y.create.l HWIO_MSS_CCM_WORD1_CMD_ADDR A:0xfca14004
y.create.l HWIO_MSS_CCM_WORD2_CMD_ADDR A:0xfca14008
y.create.l HWIO_MSS_CCM_WORD3_CMD_ADDR A:0xfca1400c
y.create.l HWIO_MSS_CCM_WORD4_CMD_ADDR A:0xfca14010
y.create.l HWIO_MSS_CCM_WORD5_CMD_ADDR A:0xfca14014
y.create.l HWIO_MSS_CCM_WORD6_CMD_ADDR A:0xfca14018
y.create.l HWIO_MSS_CCM_WORD7_CMD_ADDR A:0xfca1401c
y.create.l HWIO_MSS_CCM_END_CMD_ADDR A:0xfca14020
y.create.l HWIO_MSS_CCM_STOP_CMD_ADDR A:0xfca147dc
y.create.l HWIO_MSS_CCM_LOAD_CMD_ADDR A:0xfca147e0
y.create.l HWIO_MSS_CCM_ERROR_CLEAR_CMD_ADDR A:0xfca147e4
y.create.l HWIO_MSS_CCM_TIME_MARGIN_CMD_ADDR A:0xfca147e8
y.create.l HWIO_MSS_CCM_LATE_TASK_ERROR_STATUS_ADDR A:0xfca147ec
y.create.l HWIO_MSS_CCM_OVERRUN_ERROR_STATUS_ADDR A:0xfca147f0
y.create.l HWIO_MSS_CCM_SEQ_NUMBER_STATUS_ADDR A:0xfca147f4
y.create.l HWIO_MSS_CCM_DONE_RTC_STATUS_ADDR A:0xfca147f8
y.create.l HWIO_MSS_CCM_STALL_COUNT_STATUS_ADDR A:0xfca147fc
y.create.l HWIO_MSS_TPM_ADDR_BEGIN_ADDR A:0xfca20000
y.create.l HWIO_MSS_TPM_ADDR_END_ADDR A:0xfca201fc
y.create.l HWIO_MSS_TDM_ADDR_BEGIN_ADDR A:0xfca24000
y.create.l HWIO_MSS_TDM_ADDR_END_ADDR A:0xfca241fc
y.create.l HWIO_MSS_GACC_CLK_CTL_ADDR A:0xfca00a00
y.create.l HWIO_MSS_GACC_RTC_WAIT_ADDR A:0xfca00a04
y.create.l HWIO_MSS_GACC_START_ADDR_ADDR A:0xfca00a08
y.create.l HWIO_MSS_GACC_COUNT_ADDR A:0xfca00a0c
y.create.l HWIO_MSS_GACC_INCR_ADDR A:0xfca00a10
y.create.l HWIO_MSS_GACC_FREQ_ADDR A:0xfca00a14
y.create.l HWIO_MSS_GACC_CONFIG_ADDR A:0xfca00a18
y.create.l HWIO_MSS_GACC_PEAK_ADDR A:0xfca00a1c
y.create.l HWIO_MSS_GACC_DONE_ADDR A:0xfca00a20
y.create.l HWIO_MSS_GACC_RTC_ADDR A:0xfca00a24
y.create.l HWIO_MSS_GACC_TEST_BUS_OUT_ADDR A:0xfca00a28
y.create.l HWIO_MSS_GACC_SAMPLE_MEM_START_ADDR_ADDR A:0xfca28000
y.create.l HWIO_MSS_GACC_SAMPLE_MEM_END_ADDR_ADDR A:0xfca289fc
y.create.l HWIO_MSS_GACC_ENERGY_MEM_START_ADDR_ADDR A:0xfca2c000
y.create.l HWIO_MSS_GACC_ENERGY_MEM_END_ADDR_ADDR A:0xfca2c9fc
y.create.l HWIO_MSS_HI0_CH0_CMD_PTR_SD0_ADDR A:0xfca00b00
y.create.l HWIO_MSS_HI0_CH0_CMD_PTR_SD1_ADDR A:0xfca00f00
y.create.l HWIO_MSS_HI0_CH0_CMD_PTR_SD2_ADDR A:0xfca01300
y.create.l HWIO_MSS_HI0_CH0_CMD_PTR_SD3_ADDR A:0xfca01700
y.create.l HWIO_MSS_HI0_CH1_CMD_PTR_SD0_ADDR A:0xfca00b04
y.create.l HWIO_MSS_HI0_CH1_CMD_PTR_SD1_ADDR A:0xfca00f04
y.create.l HWIO_MSS_HI0_CH1_CMD_PTR_SD2_ADDR A:0xfca01304
y.create.l HWIO_MSS_HI0_CH1_CMD_PTR_SD3_ADDR A:0xfca01704
y.create.l HWIO_MSS_HI0_CH2_CMD_PTR_SD0_ADDR A:0xfca00b08
y.create.l HWIO_MSS_HI0_CH2_CMD_PTR_SD1_ADDR A:0xfca00f08
y.create.l HWIO_MSS_HI0_CH2_CMD_PTR_SD2_ADDR A:0xfca01308
y.create.l HWIO_MSS_HI0_CH2_CMD_PTR_SD3_ADDR A:0xfca01708
y.create.l HWIO_MSS_HI0_CH3_CMD_PTR_SD0_ADDR A:0xfca00b0c
y.create.l HWIO_MSS_HI0_CH3_CMD_PTR_SD1_ADDR A:0xfca00f0c
y.create.l HWIO_MSS_HI0_CH3_CMD_PTR_SD2_ADDR A:0xfca0130c
y.create.l HWIO_MSS_HI0_CH3_CMD_PTR_SD3_ADDR A:0xfca0170c
y.create.l HWIO_MSS_HI0_CH4_CMD_PTR_SD0_ADDR A:0xfca00b10
y.create.l HWIO_MSS_HI0_CH4_CMD_PTR_SD1_ADDR A:0xfca00f10
y.create.l HWIO_MSS_HI0_CH4_CMD_PTR_SD2_ADDR A:0xfca01310
y.create.l HWIO_MSS_HI0_CH4_CMD_PTR_SD3_ADDR A:0xfca01710
y.create.l HWIO_MSS_HI0_CH5_CMD_PTR_SD0_ADDR A:0xfca00b14
y.create.l HWIO_MSS_HI0_CH5_CMD_PTR_SD1_ADDR A:0xfca00f14
y.create.l HWIO_MSS_HI0_CH5_CMD_PTR_SD2_ADDR A:0xfca01314
y.create.l HWIO_MSS_HI0_CH5_CMD_PTR_SD3_ADDR A:0xfca01714
y.create.l HWIO_MSS_HI0_CH6_CMD_PTR_SD0_ADDR A:0xfca00b18
y.create.l HWIO_MSS_HI0_CH6_CMD_PTR_SD1_ADDR A:0xfca00f18
y.create.l HWIO_MSS_HI0_CH6_CMD_PTR_SD2_ADDR A:0xfca01318
y.create.l HWIO_MSS_HI0_CH6_CMD_PTR_SD3_ADDR A:0xfca01718
y.create.l HWIO_MSS_HI0_CH7_CMD_PTR_SD0_ADDR A:0xfca00b1c
y.create.l HWIO_MSS_HI0_CH7_CMD_PTR_SD1_ADDR A:0xfca00f1c
y.create.l HWIO_MSS_HI0_CH7_CMD_PTR_SD2_ADDR A:0xfca0131c
y.create.l HWIO_MSS_HI0_CH7_CMD_PTR_SD3_ADDR A:0xfca0171c
y.create.l HWIO_MSS_HI0_CH0_RSLT_SD0_ADDR A:0xfca00b40
y.create.l HWIO_MSS_HI0_CH0_RSLT_SD1_ADDR A:0xfca00f40
y.create.l HWIO_MSS_HI0_CH0_RSLT_SD2_ADDR A:0xfca01340
y.create.l HWIO_MSS_HI0_CH0_RSLT_SD3_ADDR A:0xfca01740
y.create.l HWIO_MSS_HI0_CH1_RSLT_SD0_ADDR A:0xfca00b44
y.create.l HWIO_MSS_HI0_CH1_RSLT_SD1_ADDR A:0xfca00f44
y.create.l HWIO_MSS_HI0_CH1_RSLT_SD2_ADDR A:0xfca01344
y.create.l HWIO_MSS_HI0_CH1_RSLT_SD3_ADDR A:0xfca01744
y.create.l HWIO_MSS_HI0_CH2_RSLT_SD0_ADDR A:0xfca00b48
y.create.l HWIO_MSS_HI0_CH2_RSLT_SD1_ADDR A:0xfca00f48
y.create.l HWIO_MSS_HI0_CH2_RSLT_SD2_ADDR A:0xfca01348
y.create.l HWIO_MSS_HI0_CH2_RSLT_SD3_ADDR A:0xfca01748
y.create.l HWIO_MSS_HI0_CH3_RSLT_SD0_ADDR A:0xfca00b4c
y.create.l HWIO_MSS_HI0_CH3_RSLT_SD1_ADDR A:0xfca00f4c
y.create.l HWIO_MSS_HI0_CH3_RSLT_SD2_ADDR A:0xfca0134c
y.create.l HWIO_MSS_HI0_CH3_RSLT_SD3_ADDR A:0xfca0174c
y.create.l HWIO_MSS_HI0_CH4_RSLT_SD0_ADDR A:0xfca00b50
y.create.l HWIO_MSS_HI0_CH4_RSLT_SD1_ADDR A:0xfca00f50
y.create.l HWIO_MSS_HI0_CH4_RSLT_SD2_ADDR A:0xfca01350
y.create.l HWIO_MSS_HI0_CH4_RSLT_SD3_ADDR A:0xfca01750
y.create.l HWIO_MSS_HI0_CH5_RSLT_SD0_ADDR A:0xfca00b54
y.create.l HWIO_MSS_HI0_CH5_RSLT_SD1_ADDR A:0xfca00f54
y.create.l HWIO_MSS_HI0_CH5_RSLT_SD2_ADDR A:0xfca01354
y.create.l HWIO_MSS_HI0_CH5_RSLT_SD3_ADDR A:0xfca01754
y.create.l HWIO_MSS_HI0_CH6_RSLT_SD0_ADDR A:0xfca00b58
y.create.l HWIO_MSS_HI0_CH6_RSLT_SD1_ADDR A:0xfca00f58
y.create.l HWIO_MSS_HI0_CH6_RSLT_SD2_ADDR A:0xfca01358
y.create.l HWIO_MSS_HI0_CH6_RSLT_SD3_ADDR A:0xfca01758
y.create.l HWIO_MSS_HI0_CH7_RSLT_SD0_ADDR A:0xfca00b5c
y.create.l HWIO_MSS_HI0_CH7_RSLT_SD1_ADDR A:0xfca00f5c
y.create.l HWIO_MSS_HI0_CH7_RSLT_SD2_ADDR A:0xfca0135c
y.create.l HWIO_MSS_HI0_CH7_RSLT_SD3_ADDR A:0xfca0175c
y.create.l HWIO_MSS_HI0_CH0_FLUSH_STATE0_SD0_ADDR A:0xfca00b80
y.create.l HWIO_MSS_HI0_CH0_FLUSH_STATE0_SD1_ADDR A:0xfca00f80
y.create.l HWIO_MSS_HI0_CH0_FLUSH_STATE0_SD2_ADDR A:0xfca01380
y.create.l HWIO_MSS_HI0_CH0_FLUSH_STATE0_SD3_ADDR A:0xfca01780
y.create.l HWIO_MSS_HI0_CH1_FLUSH_STATE0_SD0_ADDR A:0xfca00b84
y.create.l HWIO_MSS_HI0_CH1_FLUSH_STATE0_SD1_ADDR A:0xfca00f84
y.create.l HWIO_MSS_HI0_CH1_FLUSH_STATE0_SD2_ADDR A:0xfca01384
y.create.l HWIO_MSS_HI0_CH1_FLUSH_STATE0_SD3_ADDR A:0xfca01784
y.create.l HWIO_MSS_HI0_CH2_FLUSH_STATE0_SD0_ADDR A:0xfca00b88
y.create.l HWIO_MSS_HI0_CH2_FLUSH_STATE0_SD1_ADDR A:0xfca00f88
y.create.l HWIO_MSS_HI0_CH2_FLUSH_STATE0_SD2_ADDR A:0xfca01388
y.create.l HWIO_MSS_HI0_CH2_FLUSH_STATE0_SD3_ADDR A:0xfca01788
y.create.l HWIO_MSS_HI0_CH3_FLUSH_STATE0_SD0_ADDR A:0xfca00b8c
y.create.l HWIO_MSS_HI0_CH3_FLUSH_STATE0_SD1_ADDR A:0xfca00f8c
y.create.l HWIO_MSS_HI0_CH3_FLUSH_STATE0_SD2_ADDR A:0xfca0138c
y.create.l HWIO_MSS_HI0_CH3_FLUSH_STATE0_SD3_ADDR A:0xfca0178c
y.create.l HWIO_MSS_HI0_CH4_FLUSH_STATE0_SD0_ADDR A:0xfca00b90
y.create.l HWIO_MSS_HI0_CH4_FLUSH_STATE0_SD1_ADDR A:0xfca00f90
y.create.l HWIO_MSS_HI0_CH4_FLUSH_STATE0_SD2_ADDR A:0xfca01390
y.create.l HWIO_MSS_HI0_CH4_FLUSH_STATE0_SD3_ADDR A:0xfca01790
y.create.l HWIO_MSS_HI0_CH5_FLUSH_STATE0_SD0_ADDR A:0xfca00b94
y.create.l HWIO_MSS_HI0_CH5_FLUSH_STATE0_SD1_ADDR A:0xfca00f94
y.create.l HWIO_MSS_HI0_CH5_FLUSH_STATE0_SD2_ADDR A:0xfca01394
y.create.l HWIO_MSS_HI0_CH5_FLUSH_STATE0_SD3_ADDR A:0xfca01794
y.create.l HWIO_MSS_HI0_CH6_FLUSH_STATE0_SD0_ADDR A:0xfca00b98
y.create.l HWIO_MSS_HI0_CH6_FLUSH_STATE0_SD1_ADDR A:0xfca00f98
y.create.l HWIO_MSS_HI0_CH6_FLUSH_STATE0_SD2_ADDR A:0xfca01398
y.create.l HWIO_MSS_HI0_CH6_FLUSH_STATE0_SD3_ADDR A:0xfca01798
y.create.l HWIO_MSS_HI0_CH7_FLUSH_STATE0_SD0_ADDR A:0xfca00b9c
y.create.l HWIO_MSS_HI0_CH7_FLUSH_STATE0_SD1_ADDR A:0xfca00f9c
y.create.l HWIO_MSS_HI0_CH7_FLUSH_STATE0_SD2_ADDR A:0xfca0139c
y.create.l HWIO_MSS_HI0_CH7_FLUSH_STATE0_SD3_ADDR A:0xfca0179c
y.create.l HWIO_MSS_HI0_CH0_FLUSH_STATE1_SD0_ADDR A:0xfca00bc0
y.create.l HWIO_MSS_HI0_CH0_FLUSH_STATE1_SD1_ADDR A:0xfca00fc0
y.create.l HWIO_MSS_HI0_CH0_FLUSH_STATE1_SD2_ADDR A:0xfca013c0
y.create.l HWIO_MSS_HI0_CH0_FLUSH_STATE1_SD3_ADDR A:0xfca017c0
y.create.l HWIO_MSS_HI0_CH1_FLUSH_STATE1_SD0_ADDR A:0xfca00bc4
y.create.l HWIO_MSS_HI0_CH1_FLUSH_STATE1_SD1_ADDR A:0xfca00fc4
y.create.l HWIO_MSS_HI0_CH1_FLUSH_STATE1_SD2_ADDR A:0xfca013c4
y.create.l HWIO_MSS_HI0_CH1_FLUSH_STATE1_SD3_ADDR A:0xfca017c4
y.create.l HWIO_MSS_HI0_CH2_FLUSH_STATE1_SD0_ADDR A:0xfca00bc8
y.create.l HWIO_MSS_HI0_CH2_FLUSH_STATE1_SD1_ADDR A:0xfca00fc8
y.create.l HWIO_MSS_HI0_CH2_FLUSH_STATE1_SD2_ADDR A:0xfca013c8
y.create.l HWIO_MSS_HI0_CH2_FLUSH_STATE1_SD3_ADDR A:0xfca017c8
y.create.l HWIO_MSS_HI0_CH3_FLUSH_STATE1_SD0_ADDR A:0xfca00bcc
y.create.l HWIO_MSS_HI0_CH3_FLUSH_STATE1_SD1_ADDR A:0xfca00fcc
y.create.l HWIO_MSS_HI0_CH3_FLUSH_STATE1_SD2_ADDR A:0xfca013cc
y.create.l HWIO_MSS_HI0_CH3_FLUSH_STATE1_SD3_ADDR A:0xfca017cc
y.create.l HWIO_MSS_HI0_CH4_FLUSH_STATE1_SD0_ADDR A:0xfca00bd0
y.create.l HWIO_MSS_HI0_CH4_FLUSH_STATE1_SD1_ADDR A:0xfca00fd0
y.create.l HWIO_MSS_HI0_CH4_FLUSH_STATE1_SD2_ADDR A:0xfca013d0
y.create.l HWIO_MSS_HI0_CH4_FLUSH_STATE1_SD3_ADDR A:0xfca017d0
y.create.l HWIO_MSS_HI0_CH5_FLUSH_STATE1_SD0_ADDR A:0xfca00bd4
y.create.l HWIO_MSS_HI0_CH5_FLUSH_STATE1_SD1_ADDR A:0xfca00fd4
y.create.l HWIO_MSS_HI0_CH5_FLUSH_STATE1_SD2_ADDR A:0xfca013d4
y.create.l HWIO_MSS_HI0_CH5_FLUSH_STATE1_SD3_ADDR A:0xfca017d4
y.create.l HWIO_MSS_HI0_CH6_FLUSH_STATE1_SD0_ADDR A:0xfca00bd8
y.create.l HWIO_MSS_HI0_CH6_FLUSH_STATE1_SD1_ADDR A:0xfca00fd8
y.create.l HWIO_MSS_HI0_CH6_FLUSH_STATE1_SD2_ADDR A:0xfca013d8
y.create.l HWIO_MSS_HI0_CH6_FLUSH_STATE1_SD3_ADDR A:0xfca017d8
y.create.l HWIO_MSS_HI0_CH7_FLUSH_STATE1_SD0_ADDR A:0xfca00bdc
y.create.l HWIO_MSS_HI0_CH7_FLUSH_STATE1_SD1_ADDR A:0xfca00fdc
y.create.l HWIO_MSS_HI0_CH7_FLUSH_STATE1_SD2_ADDR A:0xfca013dc
y.create.l HWIO_MSS_HI0_CH7_FLUSH_STATE1_SD3_ADDR A:0xfca017dc
y.create.l HWIO_MSS_HI0_CH0_FLUSH_STATE3_SD0_ADDR A:0xfca00c40
y.create.l HWIO_MSS_HI0_CH0_FLUSH_STATE3_SD1_ADDR A:0xfca01040
y.create.l HWIO_MSS_HI0_CH0_FLUSH_STATE3_SD2_ADDR A:0xfca01440
y.create.l HWIO_MSS_HI0_CH0_FLUSH_STATE3_SD3_ADDR A:0xfca01840
y.create.l HWIO_MSS_HI0_CH1_FLUSH_STATE3_SD0_ADDR A:0xfca00c44
y.create.l HWIO_MSS_HI0_CH1_FLUSH_STATE3_SD1_ADDR A:0xfca01044
y.create.l HWIO_MSS_HI0_CH1_FLUSH_STATE3_SD2_ADDR A:0xfca01444
y.create.l HWIO_MSS_HI0_CH1_FLUSH_STATE3_SD3_ADDR A:0xfca01844
y.create.l HWIO_MSS_HI0_CH2_FLUSH_STATE3_SD0_ADDR A:0xfca00c48
y.create.l HWIO_MSS_HI0_CH2_FLUSH_STATE3_SD1_ADDR A:0xfca01048
y.create.l HWIO_MSS_HI0_CH2_FLUSH_STATE3_SD2_ADDR A:0xfca01448
y.create.l HWIO_MSS_HI0_CH2_FLUSH_STATE3_SD3_ADDR A:0xfca01848
y.create.l HWIO_MSS_HI0_CH3_FLUSH_STATE3_SD0_ADDR A:0xfca00c4c
y.create.l HWIO_MSS_HI0_CH3_FLUSH_STATE3_SD1_ADDR A:0xfca0104c
y.create.l HWIO_MSS_HI0_CH3_FLUSH_STATE3_SD2_ADDR A:0xfca0144c
y.create.l HWIO_MSS_HI0_CH3_FLUSH_STATE3_SD3_ADDR A:0xfca0184c
y.create.l HWIO_MSS_HI0_CH4_FLUSH_STATE3_SD0_ADDR A:0xfca00c50
y.create.l HWIO_MSS_HI0_CH4_FLUSH_STATE3_SD1_ADDR A:0xfca01050
y.create.l HWIO_MSS_HI0_CH4_FLUSH_STATE3_SD2_ADDR A:0xfca01450
y.create.l HWIO_MSS_HI0_CH4_FLUSH_STATE3_SD3_ADDR A:0xfca01850
y.create.l HWIO_MSS_HI0_CH5_FLUSH_STATE3_SD0_ADDR A:0xfca00c54
y.create.l HWIO_MSS_HI0_CH5_FLUSH_STATE3_SD1_ADDR A:0xfca01054
y.create.l HWIO_MSS_HI0_CH5_FLUSH_STATE3_SD2_ADDR A:0xfca01454
y.create.l HWIO_MSS_HI0_CH5_FLUSH_STATE3_SD3_ADDR A:0xfca01854
y.create.l HWIO_MSS_HI0_CH6_FLUSH_STATE3_SD0_ADDR A:0xfca00c58
y.create.l HWIO_MSS_HI0_CH6_FLUSH_STATE3_SD1_ADDR A:0xfca01058
y.create.l HWIO_MSS_HI0_CH6_FLUSH_STATE3_SD2_ADDR A:0xfca01458
y.create.l HWIO_MSS_HI0_CH6_FLUSH_STATE3_SD3_ADDR A:0xfca01858
y.create.l HWIO_MSS_HI0_CH7_FLUSH_STATE3_SD0_ADDR A:0xfca00c5c
y.create.l HWIO_MSS_HI0_CH7_FLUSH_STATE3_SD1_ADDR A:0xfca0105c
y.create.l HWIO_MSS_HI0_CH7_FLUSH_STATE3_SD2_ADDR A:0xfca0145c
y.create.l HWIO_MSS_HI0_CH7_FLUSH_STATE3_SD3_ADDR A:0xfca0185c
y.create.l HWIO_MSS_HI0_CH0_FLUSH_STATE4_SD0_ADDR A:0xfca00c80
y.create.l HWIO_MSS_HI0_CH0_FLUSH_STATE4_SD1_ADDR A:0xfca01080
y.create.l HWIO_MSS_HI0_CH0_FLUSH_STATE4_SD2_ADDR A:0xfca01480
y.create.l HWIO_MSS_HI0_CH0_FLUSH_STATE4_SD3_ADDR A:0xfca01880
y.create.l HWIO_MSS_HI0_CH1_FLUSH_STATE4_SD0_ADDR A:0xfca00c84
y.create.l HWIO_MSS_HI0_CH1_FLUSH_STATE4_SD1_ADDR A:0xfca01084
y.create.l HWIO_MSS_HI0_CH1_FLUSH_STATE4_SD2_ADDR A:0xfca01484
y.create.l HWIO_MSS_HI0_CH1_FLUSH_STATE4_SD3_ADDR A:0xfca01884
y.create.l HWIO_MSS_HI0_CH2_FLUSH_STATE4_SD0_ADDR A:0xfca00c88
y.create.l HWIO_MSS_HI0_CH2_FLUSH_STATE4_SD1_ADDR A:0xfca01088
y.create.l HWIO_MSS_HI0_CH2_FLUSH_STATE4_SD2_ADDR A:0xfca01488
y.create.l HWIO_MSS_HI0_CH2_FLUSH_STATE4_SD3_ADDR A:0xfca01888
y.create.l HWIO_MSS_HI0_CH3_FLUSH_STATE4_SD0_ADDR A:0xfca00c8c
y.create.l HWIO_MSS_HI0_CH3_FLUSH_STATE4_SD1_ADDR A:0xfca0108c
y.create.l HWIO_MSS_HI0_CH3_FLUSH_STATE4_SD2_ADDR A:0xfca0148c
y.create.l HWIO_MSS_HI0_CH3_FLUSH_STATE4_SD3_ADDR A:0xfca0188c
y.create.l HWIO_MSS_HI0_CH4_FLUSH_STATE4_SD0_ADDR A:0xfca00c90
y.create.l HWIO_MSS_HI0_CH4_FLUSH_STATE4_SD1_ADDR A:0xfca01090
y.create.l HWIO_MSS_HI0_CH4_FLUSH_STATE4_SD2_ADDR A:0xfca01490
y.create.l HWIO_MSS_HI0_CH4_FLUSH_STATE4_SD3_ADDR A:0xfca01890
y.create.l HWIO_MSS_HI0_CH5_FLUSH_STATE4_SD0_ADDR A:0xfca00c94
y.create.l HWIO_MSS_HI0_CH5_FLUSH_STATE4_SD1_ADDR A:0xfca01094
y.create.l HWIO_MSS_HI0_CH5_FLUSH_STATE4_SD2_ADDR A:0xfca01494
y.create.l HWIO_MSS_HI0_CH5_FLUSH_STATE4_SD3_ADDR A:0xfca01894
y.create.l HWIO_MSS_HI0_CH6_FLUSH_STATE4_SD0_ADDR A:0xfca00c98
y.create.l HWIO_MSS_HI0_CH6_FLUSH_STATE4_SD1_ADDR A:0xfca01098
y.create.l HWIO_MSS_HI0_CH6_FLUSH_STATE4_SD2_ADDR A:0xfca01498
y.create.l HWIO_MSS_HI0_CH6_FLUSH_STATE4_SD3_ADDR A:0xfca01898
y.create.l HWIO_MSS_HI0_CH7_FLUSH_STATE4_SD0_ADDR A:0xfca00c9c
y.create.l HWIO_MSS_HI0_CH7_FLUSH_STATE4_SD1_ADDR A:0xfca0109c
y.create.l HWIO_MSS_HI0_CH7_FLUSH_STATE4_SD2_ADDR A:0xfca0149c
y.create.l HWIO_MSS_HI0_CH7_FLUSH_STATE4_SD3_ADDR A:0xfca0189c
y.create.l HWIO_MSS_HI0_CH0_FLUSH_STATE5_SD0_ADDR A:0xfca00cc0
y.create.l HWIO_MSS_HI0_CH0_FLUSH_STATE5_SD1_ADDR A:0xfca010c0
y.create.l HWIO_MSS_HI0_CH0_FLUSH_STATE5_SD2_ADDR A:0xfca014c0
y.create.l HWIO_MSS_HI0_CH0_FLUSH_STATE5_SD3_ADDR A:0xfca018c0
y.create.l HWIO_MSS_HI0_CH1_FLUSH_STATE5_SD0_ADDR A:0xfca00cc4
y.create.l HWIO_MSS_HI0_CH1_FLUSH_STATE5_SD1_ADDR A:0xfca010c4
y.create.l HWIO_MSS_HI0_CH1_FLUSH_STATE5_SD2_ADDR A:0xfca014c4
y.create.l HWIO_MSS_HI0_CH1_FLUSH_STATE5_SD3_ADDR A:0xfca018c4
y.create.l HWIO_MSS_HI0_CH2_FLUSH_STATE5_SD0_ADDR A:0xfca00cc8
y.create.l HWIO_MSS_HI0_CH2_FLUSH_STATE5_SD1_ADDR A:0xfca010c8
y.create.l HWIO_MSS_HI0_CH2_FLUSH_STATE5_SD2_ADDR A:0xfca014c8
y.create.l HWIO_MSS_HI0_CH2_FLUSH_STATE5_SD3_ADDR A:0xfca018c8
y.create.l HWIO_MSS_HI0_CH3_FLUSH_STATE5_SD0_ADDR A:0xfca00ccc
y.create.l HWIO_MSS_HI0_CH3_FLUSH_STATE5_SD1_ADDR A:0xfca010cc
y.create.l HWIO_MSS_HI0_CH3_FLUSH_STATE5_SD2_ADDR A:0xfca014cc
y.create.l HWIO_MSS_HI0_CH3_FLUSH_STATE5_SD3_ADDR A:0xfca018cc
y.create.l HWIO_MSS_HI0_CH4_FLUSH_STATE5_SD0_ADDR A:0xfca00cd0
y.create.l HWIO_MSS_HI0_CH4_FLUSH_STATE5_SD1_ADDR A:0xfca010d0
y.create.l HWIO_MSS_HI0_CH4_FLUSH_STATE5_SD2_ADDR A:0xfca014d0
y.create.l HWIO_MSS_HI0_CH4_FLUSH_STATE5_SD3_ADDR A:0xfca018d0
y.create.l HWIO_MSS_HI0_CH5_FLUSH_STATE5_SD0_ADDR A:0xfca00cd4
y.create.l HWIO_MSS_HI0_CH5_FLUSH_STATE5_SD1_ADDR A:0xfca010d4
y.create.l HWIO_MSS_HI0_CH5_FLUSH_STATE5_SD2_ADDR A:0xfca014d4
y.create.l HWIO_MSS_HI0_CH5_FLUSH_STATE5_SD3_ADDR A:0xfca018d4
y.create.l HWIO_MSS_HI0_CH6_FLUSH_STATE5_SD0_ADDR A:0xfca00cd8
y.create.l HWIO_MSS_HI0_CH6_FLUSH_STATE5_SD1_ADDR A:0xfca010d8
y.create.l HWIO_MSS_HI0_CH6_FLUSH_STATE5_SD2_ADDR A:0xfca014d8
y.create.l HWIO_MSS_HI0_CH6_FLUSH_STATE5_SD3_ADDR A:0xfca018d8
y.create.l HWIO_MSS_HI0_CH7_FLUSH_STATE5_SD0_ADDR A:0xfca00cdc
y.create.l HWIO_MSS_HI0_CH7_FLUSH_STATE5_SD1_ADDR A:0xfca010dc
y.create.l HWIO_MSS_HI0_CH7_FLUSH_STATE5_SD2_ADDR A:0xfca014dc
y.create.l HWIO_MSS_HI0_CH7_FLUSH_STATE5_SD3_ADDR A:0xfca018dc
y.create.l HWIO_MSS_HI0_SEC_DOMAIN_IRQ_STATUS_SD0_ADDR A:0xfca00e80
y.create.l HWIO_MSS_HI0_SEC_DOMAIN_IRQ_STATUS_SD1_ADDR A:0xfca01280
y.create.l HWIO_MSS_HI0_SEC_DOMAIN_IRQ_STATUS_SD2_ADDR A:0xfca01680
y.create.l HWIO_MSS_HI0_SEC_DOMAIN_IRQ_STATUS_SD3_ADDR A:0xfca01a80
y.create.l HWIO_MSS_HI0_CH0_RSLT_CONF_SD0_ADDR A:0xfca00e00
y.create.l HWIO_MSS_HI0_CH0_RSLT_CONF_SD1_ADDR A:0xfca01200
y.create.l HWIO_MSS_HI0_CH0_RSLT_CONF_SD2_ADDR A:0xfca01600
y.create.l HWIO_MSS_HI0_CH0_RSLT_CONF_SD3_ADDR A:0xfca01a00
y.create.l HWIO_MSS_HI0_CH1_RSLT_CONF_SD0_ADDR A:0xfca00e04
y.create.l HWIO_MSS_HI0_CH1_RSLT_CONF_SD1_ADDR A:0xfca01204
y.create.l HWIO_MSS_HI0_CH1_RSLT_CONF_SD2_ADDR A:0xfca01604
y.create.l HWIO_MSS_HI0_CH1_RSLT_CONF_SD3_ADDR A:0xfca01a04
y.create.l HWIO_MSS_HI0_CH2_RSLT_CONF_SD0_ADDR A:0xfca00e08
y.create.l HWIO_MSS_HI0_CH2_RSLT_CONF_SD1_ADDR A:0xfca01208
y.create.l HWIO_MSS_HI0_CH2_RSLT_CONF_SD2_ADDR A:0xfca01608
y.create.l HWIO_MSS_HI0_CH2_RSLT_CONF_SD3_ADDR A:0xfca01a08
y.create.l HWIO_MSS_HI0_CH3_RSLT_CONF_SD0_ADDR A:0xfca00e0c
y.create.l HWIO_MSS_HI0_CH3_RSLT_CONF_SD1_ADDR A:0xfca0120c
y.create.l HWIO_MSS_HI0_CH3_RSLT_CONF_SD2_ADDR A:0xfca0160c
y.create.l HWIO_MSS_HI0_CH3_RSLT_CONF_SD3_ADDR A:0xfca01a0c
y.create.l HWIO_MSS_HI0_CH4_RSLT_CONF_SD0_ADDR A:0xfca00e10
y.create.l HWIO_MSS_HI0_CH4_RSLT_CONF_SD1_ADDR A:0xfca01210
y.create.l HWIO_MSS_HI0_CH4_RSLT_CONF_SD2_ADDR A:0xfca01610
y.create.l HWIO_MSS_HI0_CH4_RSLT_CONF_SD3_ADDR A:0xfca01a10
y.create.l HWIO_MSS_HI0_CH5_RSLT_CONF_SD0_ADDR A:0xfca00e14
y.create.l HWIO_MSS_HI0_CH5_RSLT_CONF_SD1_ADDR A:0xfca01214
y.create.l HWIO_MSS_HI0_CH5_RSLT_CONF_SD2_ADDR A:0xfca01614
y.create.l HWIO_MSS_HI0_CH5_RSLT_CONF_SD3_ADDR A:0xfca01a14
y.create.l HWIO_MSS_HI0_CH6_RSLT_CONF_SD0_ADDR A:0xfca00e18
y.create.l HWIO_MSS_HI0_CH6_RSLT_CONF_SD1_ADDR A:0xfca01218
y.create.l HWIO_MSS_HI0_CH6_RSLT_CONF_SD2_ADDR A:0xfca01618
y.create.l HWIO_MSS_HI0_CH6_RSLT_CONF_SD3_ADDR A:0xfca01a18
y.create.l HWIO_MSS_HI0_CH7_RSLT_CONF_SD0_ADDR A:0xfca00e1c
y.create.l HWIO_MSS_HI0_CH7_RSLT_CONF_SD1_ADDR A:0xfca0121c
y.create.l HWIO_MSS_HI0_CH7_RSLT_CONF_SD2_ADDR A:0xfca0161c
y.create.l HWIO_MSS_HI0_CH7_RSLT_CONF_SD3_ADDR A:0xfca01a1c
y.create.l HWIO_MSS_HI0_CH0_STATUS_SD0_ADDR A:0xfca00d00
y.create.l HWIO_MSS_HI0_CH0_STATUS_SD1_ADDR A:0xfca01100
y.create.l HWIO_MSS_HI0_CH0_STATUS_SD2_ADDR A:0xfca01500
y.create.l HWIO_MSS_HI0_CH0_STATUS_SD3_ADDR A:0xfca01900
y.create.l HWIO_MSS_HI0_CH1_STATUS_SD0_ADDR A:0xfca00d04
y.create.l HWIO_MSS_HI0_CH1_STATUS_SD1_ADDR A:0xfca01104
y.create.l HWIO_MSS_HI0_CH1_STATUS_SD2_ADDR A:0xfca01504
y.create.l HWIO_MSS_HI0_CH1_STATUS_SD3_ADDR A:0xfca01904
y.create.l HWIO_MSS_HI0_CH2_STATUS_SD0_ADDR A:0xfca00d08
y.create.l HWIO_MSS_HI0_CH2_STATUS_SD1_ADDR A:0xfca01108
y.create.l HWIO_MSS_HI0_CH2_STATUS_SD2_ADDR A:0xfca01508
y.create.l HWIO_MSS_HI0_CH2_STATUS_SD3_ADDR A:0xfca01908
y.create.l HWIO_MSS_HI0_CH3_STATUS_SD0_ADDR A:0xfca00d0c
y.create.l HWIO_MSS_HI0_CH3_STATUS_SD1_ADDR A:0xfca0110c
y.create.l HWIO_MSS_HI0_CH3_STATUS_SD2_ADDR A:0xfca0150c
y.create.l HWIO_MSS_HI0_CH3_STATUS_SD3_ADDR A:0xfca0190c
y.create.l HWIO_MSS_HI0_CH4_STATUS_SD0_ADDR A:0xfca00d10
y.create.l HWIO_MSS_HI0_CH4_STATUS_SD1_ADDR A:0xfca01110
y.create.l HWIO_MSS_HI0_CH4_STATUS_SD2_ADDR A:0xfca01510
y.create.l HWIO_MSS_HI0_CH4_STATUS_SD3_ADDR A:0xfca01910
y.create.l HWIO_MSS_HI0_CH5_STATUS_SD0_ADDR A:0xfca00d14
y.create.l HWIO_MSS_HI0_CH5_STATUS_SD1_ADDR A:0xfca01114
y.create.l HWIO_MSS_HI0_CH5_STATUS_SD2_ADDR A:0xfca01514
y.create.l HWIO_MSS_HI0_CH5_STATUS_SD3_ADDR A:0xfca01914
y.create.l HWIO_MSS_HI0_CH6_STATUS_SD0_ADDR A:0xfca00d18
y.create.l HWIO_MSS_HI0_CH6_STATUS_SD1_ADDR A:0xfca01118
y.create.l HWIO_MSS_HI0_CH6_STATUS_SD2_ADDR A:0xfca01518
y.create.l HWIO_MSS_HI0_CH6_STATUS_SD3_ADDR A:0xfca01918
y.create.l HWIO_MSS_HI0_CH7_STATUS_SD0_ADDR A:0xfca00d1c
y.create.l HWIO_MSS_HI0_CH7_STATUS_SD1_ADDR A:0xfca0111c
y.create.l HWIO_MSS_HI0_CH7_STATUS_SD2_ADDR A:0xfca0151c
y.create.l HWIO_MSS_HI0_CH7_STATUS_SD3_ADDR A:0xfca0191c
y.create.l HWIO_MSS_HI0_CH0_CONF_ADDR A:0xfca00d40
y.create.l HWIO_MSS_HI0_CH1_CONF_ADDR A:0xfca00d44
y.create.l HWIO_MSS_HI0_CH2_CONF_ADDR A:0xfca00d48
y.create.l HWIO_MSS_HI0_CH3_CONF_ADDR A:0xfca00d4c
y.create.l HWIO_MSS_HI0_CH4_CONF_ADDR A:0xfca00d50
y.create.l HWIO_MSS_HI0_CH5_CONF_ADDR A:0xfca00d54
y.create.l HWIO_MSS_HI0_CH6_CONF_ADDR A:0xfca00d58
y.create.l HWIO_MSS_HI0_CH7_CONF_ADDR A:0xfca00d5c
y.create.l HWIO_MSS_HI0_CH0_DBG_0_ADDR A:0xfca00d80
y.create.l HWIO_MSS_HI0_CH1_DBG_0_ADDR A:0xfca00d84
y.create.l HWIO_MSS_HI0_CH2_DBG_0_ADDR A:0xfca00d88
y.create.l HWIO_MSS_HI0_CH3_DBG_0_ADDR A:0xfca00d8c
y.create.l HWIO_MSS_HI0_CH4_DBG_0_ADDR A:0xfca00d90
y.create.l HWIO_MSS_HI0_CH5_DBG_0_ADDR A:0xfca00d94
y.create.l HWIO_MSS_HI0_CH6_DBG_0_ADDR A:0xfca00d98
y.create.l HWIO_MSS_HI0_CH7_DBG_0_ADDR A:0xfca00d9c
y.create.l HWIO_MSS_HI0_CH0_DBG_1_ADDR A:0xfca00dc0
y.create.l HWIO_MSS_HI0_CH1_DBG_1_ADDR A:0xfca00dc4
y.create.l HWIO_MSS_HI0_CH2_DBG_1_ADDR A:0xfca00dc8
y.create.l HWIO_MSS_HI0_CH3_DBG_1_ADDR A:0xfca00dcc
y.create.l HWIO_MSS_HI0_CH4_DBG_1_ADDR A:0xfca00dd0
y.create.l HWIO_MSS_HI0_CH5_DBG_1_ADDR A:0xfca00dd4
y.create.l HWIO_MSS_HI0_CH6_DBG_1_ADDR A:0xfca00dd8
y.create.l HWIO_MSS_HI0_CH7_DBG_1_ADDR A:0xfca00ddc
y.create.l HWIO_MSS_HI0_CI0_CONF_ADDR A:0xfca00e90
y.create.l HWIO_MSS_HI0_CI1_CONF_ADDR A:0xfca00e94
y.create.l HWIO_MSS_HI0_CI2_CONF_ADDR A:0xfca00e98
y.create.l HWIO_MSS_HI0_CI3_CONF_ADDR A:0xfca00e9c
y.create.l HWIO_MSS_HI0_CI4_CONF_ADDR A:0xfca00ea0
y.create.l HWIO_MSS_HI0_CI5_CONF_ADDR A:0xfca00ea4
y.create.l HWIO_MSS_HI0_CI6_CONF_ADDR A:0xfca00ea8
y.create.l HWIO_MSS_HI0_CI7_CONF_ADDR A:0xfca00eac
y.create.l HWIO_MSS_HI0_CI0_DBG_ERR_ADDR A:0xfca00eb0
y.create.l HWIO_MSS_HI0_CI1_DBG_ERR_ADDR A:0xfca00eb4
y.create.l HWIO_MSS_HI0_CI2_DBG_ERR_ADDR A:0xfca00eb8
y.create.l HWIO_MSS_HI0_CI3_DBG_ERR_ADDR A:0xfca00ebc
y.create.l HWIO_MSS_HI0_CI4_DBG_ERR_ADDR A:0xfca00ec0
y.create.l HWIO_MSS_HI0_CI5_DBG_ERR_ADDR A:0xfca00ec4
y.create.l HWIO_MSS_HI0_CI6_DBG_ERR_ADDR A:0xfca00ec8
y.create.l HWIO_MSS_HI0_CI7_DBG_ERR_ADDR A:0xfca00ecc
y.create.l HWIO_MSS_HI0_CRCI_DBG_ADDR A:0xfca00ed0
y.create.l HWIO_MSS_HI0_CRCI_STATUS_ADDR A:0xfca00ed4
y.create.l HWIO_MSS_HI0_GP_CTL_ADDR A:0xfca00ed8
y.create.l HWIO_MSS_HI0_GP_STATUS_ADDR A:0xfca00edc
y.create.l HWIO_MSS_HI0_GLBL_DBG_CMD_ENG_ADDR A:0xfca00ee0
y.create.l HWIO_MSS_HI0_GLBL_DBG_REQ_ENG_ADDR A:0xfca00ee4
y.create.l HWIO_MSS_HI0_GLBL_DBG_XFR_ENG_ADDR A:0xfca00ee8
y.create.l HWIO_MSS_HI0_GLBL_DBG_CHAN_BLK_ADDR A:0xfca00eec
y.create.l HWIO_MSS_HI0_GLBL_DBG_CHAN_BLK_CLR_ADDR A:0xfca00ef0
y.create.l HWIO_MSS_HI0_GLBL_DBG_TEST_SEL_ADDR A:0xfca00ef4
y.create.l HWIO_MSS_NAV_CLK_ENABLE_ADDR A:0xfcaf8000
y.create.l HWIO_MSS_NAV_CLK_RESET_ADDR A:0xfcaf8004
y.create.l HWIO_MSS_NAV_CLK_CTL_ADDR A:0xfcaf8008
y.create.l HWIO_MSS_NAV_CLK_FRAC31_M_ADDR A:0xfcaf800c
y.create.l HWIO_MSS_NAV_CLK_FRAC31_NOT_2D_ADDR A:0xfcaf8010
y.create.l HWIO_MSS_NAV_CLK_FRAC31_NOT_N_MINUS_M_ADDR A:0xfcaf8014
y.create.l HWIO_MSS_NAV_CLK_FRAC31_UPDATE_ADDR A:0xfcaf8018
y.create.l HWIO_MSS_NAV_CLK_GDS_ADDR A:0xfcaf801c
y.create.l HWIO_MSS_NAV_CLK_IPCAT_ADDR A:0xfcaf8020
y.create.l HWIO_MSS_NAV_CLK_AXI_BRIDGE_STATUS_ADDR A:0xfcaf8024
y.create.l HWIO_MSS_GNSS_ADC_CMD0_ADDR A:0xfcaf0000
y.create.l HWIO_MSS_GNSS_ADC_CMD1_ADDR A:0xfcaf0004
y.create.l HWIO_MSS_GNSS_ADC_CMD2_ADDR A:0xfcaf0008
y.create.l HWIO_MSS_GNSS_ADC_CMD3_ADDR A:0xfcaf000c
y.create.l HWIO_MSS_GNSS_ADC_IDDQ_ADDR A:0xfcaf0010
y.create.l HWIO_MSS_NAV_PLL4_PLLMODE_ADDR A:0xfcaf8800
y.create.l HWIO_MSS_NAV_PLL4_L_VAL_ADDR A:0xfcaf8804
y.create.l HWIO_MSS_NAV_PLL4_ALPHA_VAL_L_ADDR A:0xfcaf8808
y.create.l HWIO_MSS_NAV_PLL4_ALPHA_VAL_H_ADDR A:0xfcaf880c
y.create.l HWIO_MSS_NAV_PLL4_USER_CTL_ADDR A:0xfcaf8810
y.create.l HWIO_MSS_NAV_PLL4_USER_CTL_H_ADDR A:0xfcaf8814
y.create.l HWIO_MSS_NAV_PLL4_CONFIG_CTL_ADDR A:0xfcaf8818
y.create.l HWIO_MSS_NAV_PLL4_TEST_CTL_ADDR A:0xfcaf881c
y.create.l HWIO_MSS_NAV_PLL4_STATUS_ADDR A:0xfcaf8824
y.create.l HWIO_MSS_STMR_STATUS0_RD_ADDR A:0xfca000c0
y.create.l HWIO_MSS_STMR_STATUS1_RD_ADDR A:0xfca000c4
y.create.l HWIO_MSS_STMR_STATUS2_RD_ADDR A:0xfca000c8
y.create.l HWIO_MSS_STMR_STATUS3_RD_ADDR A:0xfca000cc
y.create.l HWIO_MSS_STMR_STATUS4_RD_ADDR A:0xfca000d0
y.create.l HWIO_MSS_STMR_STATUS5_RD_ADDR A:0xfca000d4
y.create.l HWIO_MSS_STMR_STATUS6_RD_ADDR A:0xfca000d8
y.create.l HWIO_MSS_STMR_STATUS7_RD_ADDR A:0xfca000dc
y.create.l HWIO_MSS_STMR_STATUS8_RD_ADDR A:0xfca000e0
y.create.l HWIO_MSS_STMR_STATUS9_RD_ADDR A:0xfca000e4
y.create.l HWIO_MSS_STMR_STATUS10_RD_ADDR A:0xfca000e8
y.create.l HWIO_MSS_STMR_STATUS11_RD_ADDR A:0xfca000ec
y.create.l HWIO_MPM2_MPM_PMIC_VDD_ON_CFG_1_ADDR A:0xfc4a0000
y.create.l HWIO_MPM2_MPM_PMIC_VDD_ON_CFG_2_ADDR A:0xfc4a0004
y.create.l HWIO_MPM2_MPM_PMIC_VDD_ON_CFG_3_ADDR A:0xfc4a0008
y.create.l HWIO_MPM2_MPM_PMIC_VDD_ON_CFG_4_ADDR A:0xfc4a000c
y.create.l HWIO_MPM2_MPM_PMIC_VDD_ON_CFG_5_ADDR A:0xfc4a0010
y.create.l HWIO_MPM2_MPM_PMIC_VDD_ON_CFG_6_ADDR A:0xfc4a0014
y.create.l HWIO_MPM2_MPM_PMIC_VDD_ON_CFG_7_ADDR A:0xfc4a0018
y.create.l HWIO_MPM2_MPM_PMIC_VDD_ON_CFG_8_ADDR A:0xfc4a001c
y.create.l HWIO_MPM2_MPM_PMIC_VDD_ON_CFG_9_ADDR A:0xfc4a0020
y.create.l HWIO_MPM2_MPM_PMIC_VDD_ON_CFG_10_ADDR A:0xfc4a0024
y.create.l HWIO_MPM2_MPM_PMIC_VDD_ON_CFG_11_ADDR A:0xfc4a0028
y.create.l HWIO_MPM2_MPM_PMIC_VDD_ON_CFG_12_ADDR A:0xfc4a002c
y.create.l HWIO_MPM2_MPM_PMIC_VDD_OFF_CFG_1_ADDR A:0xfc4a0030
y.create.l HWIO_MPM2_MPM_PMIC_VDD_OFF_CFG_2_ADDR A:0xfc4a0034
y.create.l HWIO_MPM2_MPM_PMIC_VDD_OFF_CFG_3_ADDR A:0xfc4a0038
y.create.l HWIO_MPM2_MPM_PMIC_VDD_OFF_CFG_4_ADDR A:0xfc4a003c
y.create.l HWIO_MPM2_MPM_PMIC_VDD_OFF_CFG_5_ADDR A:0xfc4a0040
y.create.l HWIO_MPM2_MPM_PMIC_VDD_OFF_CFG_6_ADDR A:0xfc4a0044
y.create.l HWIO_MPM2_MPM_PMIC_VDD_OFF_CFG_7_ADDR A:0xfc4a0048
y.create.l HWIO_MPM2_MPM_PMIC_VDD_OFF_CFG_8_ADDR A:0xfc4a004c
y.create.l HWIO_MPM2_MPM_PMIC_VDD_OFF_CFG_9_ADDR A:0xfc4a0050
y.create.l HWIO_MPM2_MPM_PMIC_VDD_OFF_CFG_10_ADDR A:0xfc4a0054
y.create.l HWIO_MPM2_MPM_PMIC_VDD_OFF_CFG_11_ADDR A:0xfc4a0058
y.create.l HWIO_MPM2_MPM_PMIC_VDD_OFF_CFG_12_ADDR A:0xfc4a005c
y.create.l HWIO_MPM2_MPM_SPMI_CMD_CFG_ADDR A:0xfc4a0060
y.create.l HWIO_MPM2_MPM_SPMI_CDIV_CNTRL_ADDR A:0xfc4a0064
y.create.l HWIO_MPM2_MPM_CXO_CTRL_ADDR A:0xfc4a0068
y.create.l HWIO_MPM2_MPM_PXO_OSC_CTRL_ADDR A:0xfc4a006c
y.create.l HWIO_MPM2_MPM_LOW_POWER_CFG_ADDR A:0xfc4a0070
y.create.l HWIO_MPM2_MPM_LOW_POWER_STATUS_ADDR A:0xfc4a0074
y.create.l HWIO_MPM2_MPM_CXO_POWER_RAMPUP_TIME_ADDR A:0xfc4a0078
y.create.l HWIO_MPM2_MPM_PXO_WARMUP_TIME_ADDR A:0xfc4a007c
y.create.l HWIO_MPM2_MPM_HARDWARE_RESTORED_ADDR A:0xfc4a0080
y.create.l HWIO_MPM2_MPM_INT_CLEAR_1_ADDR A:0xfc4a0084
y.create.l HWIO_MPM2_MPM_INT_CLEAR_2_ADDR A:0xfc4a0088
y.create.l HWIO_MPM2_MPM_INT_EN_1_ADDR A:0xfc4a008c
y.create.l HWIO_MPM2_MPM_INT_EN_2_ADDR A:0xfc4a0090
y.create.l HWIO_MPM2_MPM_INT_POLARITY_1_ADDR A:0xfc4a0094
y.create.l HWIO_MPM2_MPM_INT_POLARITY_2_ADDR A:0xfc4a0098
y.create.l HWIO_MPM2_MPM_DETECT_CTL_1_ADDR A:0xfc4a009c
y.create.l HWIO_MPM2_MPM_DETECT_CTL_2_ADDR A:0xfc4a00a0
y.create.l HWIO_MPM2_MPM_DETECT_CTL_3_ADDR A:0xfc4a00a4
y.create.l HWIO_MPM2_MPM_DETECT_CTL_4_ADDR A:0xfc4a00a8
y.create.l HWIO_MPM2_MPM_INT_STATUS_1_ADDR A:0xfc4a00ac
y.create.l HWIO_MPM2_MPM_INT_STATUS_2_ADDR A:0xfc4a00b0
y.create.l HWIO_MPM2_MPM_INT_WKUP_CLK_SEL_1_ADDR A:0xfc4a00b4
y.create.l HWIO_MPM2_MPM_INT_WKUP_CLK_SEL_2_ADDR A:0xfc4a00b8
y.create.l HWIO_MPM2_MPM_DEBUG_BUS_EN_ADDR A:0xfc4a00bc
y.create.l HWIO_MPM2_MPM_PEN_DEBOUNCE_CTL_ADDR A:0xfc4a00c0
y.create.l HWIO_MPM2_MPM_WARM_BOOT_CFG_ADDR A:0xfc4a00c4
y.create.l HWIO_MPM2_MPM_REG0_FILE_ADDR A:0xfc4a00c8
y.create.l HWIO_MPM2_MPM_REG1_FILE_ADDR A:0xfc4a00cc
y.create.l HWIO_MPM2_MPM_REG2_FILE_ADDR A:0xfc4a00d0
y.create.l HWIO_MPM2_MPM_REG3_FILE_ADDR A:0xfc4a00d4
y.create.l HWIO_MPM2_MPM_REG4_FILE_ADDR A:0xfc4a00d8
y.create.l HWIO_MPM2_MPM_REG5_FILE_ADDR A:0xfc4a00dc
y.create.l HWIO_MPM2_MPM_REG6_FILE_ADDR A:0xfc4a00e0
y.create.l HWIO_MPM2_MPM_REG7_FILE_ADDR A:0xfc4a00e4
y.create.l HWIO_MPM2_MPM_REG8_FILE_ADDR A:0xfc4a00e8
y.create.l HWIO_MPM2_MPM_CNTR_CLK_CONTROL_ADDR A:0xfc4a00ec
y.create.l HWIO_MPM2_MPM_CNTR_FRAC_ADDR A:0xfc4a00f0
y.create.l HWIO_MPM2_MPM_CNTR_INCR_DATA_ADDR A:0xfc4a00f4
y.create.l HWIO_MPM2_MPM_HW_ID_ADDR A:0xfc4a00f8
y.create.l HWIO_MPM2_MPM_CONTROL_CNTCR_ADDR A:0xfc4a1000
y.create.l HWIO_MPM2_MPM_CONTROL_CNTSR_ADDR A:0xfc4a1004
y.create.l HWIO_MPM2_MPM_CONTROL_CNTCV_LO_ADDR A:0xfc4a1008
y.create.l HWIO_MPM2_MPM_CONTROL_CNTCV_HI_ADDR A:0xfc4a100c
y.create.l HWIO_MPM2_MPM_CONTROL_CNTFID0_ADDR A:0xfc4a1020
y.create.l HWIO_MPM2_MPM_CONTROL_ID_ADDR A:0xfc4a1fd0
y.create.l HWIO_MPM2_MPM_READ_CNTCV_LO_ADDR A:0xfc4a2000
y.create.l HWIO_MPM2_MPM_READ_CNTCV_HI_ADDR A:0xfc4a2004
y.create.l HWIO_MPM2_MPM_READ_ID_ADDR A:0xfc4a2fd0
y.create.l HWIO_MPM2_MPM_SLEEP_TIMETICK_COUNT_VAL_ADDR A:0xfc4a3000
y.create.l HWIO_MPM2_QTMR_AC_CNTFRQ_ADDR A:0xfc4a4000
y.create.l HWIO_MPM2_QTMR_AC_CNTSR_ADDR A:0xfc4a4004
y.create.l HWIO_MPM2_QTMR_AC_CNTTID_ADDR A:0xfc4a4008
y.create.l HWIO_MPM2_QTMR_AC_CNTACR_0_ADDR A:0xfc4a4040
y.create.l HWIO_MPM2_QTMR_AC_CNTVOFF_LO_0_ADDR A:0xfc4a4080
y.create.l HWIO_MPM2_QTMR_AC_CNTVOFF_HI_0_ADDR A:0xfc4a4084
y.create.l HWIO_MPM2_QTMR_AC_CFG_ADDR A:0xfc4a4fc0
y.create.l HWIO_MPM2_QTMR_AC_VERSION_ADDR A:0xfc4a4fd0
y.create.l HWIO_MPM2_QTMR_V1_CNTPCT_LO_ADDR A:0xfc4a5000
y.create.l HWIO_MPM2_QTMR_V1_CNTPCT_HI_ADDR A:0xfc4a5004
y.create.l HWIO_MPM2_QTMR_V1_CNTVCT_LO_ADDR A:0xfc4a5008
y.create.l HWIO_MPM2_QTMR_V1_CNTVCT_HI_ADDR A:0xfc4a500c
y.create.l HWIO_MPM2_QTMR_V1_CNTFRQ_ADDR A:0xfc4a5010
y.create.l HWIO_MPM2_QTMR_V1_CNTPL0ACR_ADDR A:0xfc4a5014
y.create.l HWIO_MPM2_QTMR_V1_CNTVOFF_LO_ADDR A:0xfc4a5018
y.create.l HWIO_MPM2_QTMR_V1_CNTVOFF_HI_ADDR A:0xfc4a501c
y.create.l HWIO_MPM2_QTMR_V1_CNTP_CVAL_LO_ADDR A:0xfc4a5020
y.create.l HWIO_MPM2_QTMR_V1_CNTP_CVAL_HI_ADDR A:0xfc4a5024
y.create.l HWIO_MPM2_QTMR_V1_CNTP_TVAL_ADDR A:0xfc4a5028
y.create.l HWIO_MPM2_QTMR_V1_CNTP_CTL_ADDR A:0xfc4a502c
y.create.l HWIO_MPM2_QTMR_V1_CNTV_CVAL_LO_ADDR A:0xfc4a5030
y.create.l HWIO_MPM2_QTMR_V1_CNTV_CVAL_HI_ADDR A:0xfc4a5034
y.create.l HWIO_MPM2_QTMR_V1_CNTV_TVAL_ADDR A:0xfc4a5038
y.create.l HWIO_MPM2_QTMR_V1_CNTV_CTL_ADDR A:0xfc4a503c
y.create.l HWIO_MPM2_QTMR_V1_VERSION_ADDR A:0xfc4a5fd0
y.create.l HWIO_MPM2_MPM_TSYNC_CTL_ADDR A:0xfc4a6000
y.create.l HWIO_MPM2_MPM_TSYNC_CMD_ADDR A:0xfc4a6004
y.create.l HWIO_MPM2_MPM_TSYNC_START_ADDR A:0xfc4a6008
y.create.l HWIO_MPM2_MPM_TSYNC_START_PHASE_ADDR A:0xfc4a600c
y.create.l HWIO_MPM2_MPM_TSYNC_PERIOD_ADDR A:0xfc4a6010
y.create.l HWIO_MPM2_MPM_TSYNC_PERIOD_PHASE_ADDR A:0xfc4a6014
y.create.l HWIO_MPM2_MPM_TSYNC_STATUS_TIME_ADDR A:0xfc4a6018
y.create.l HWIO_MPM2_MPM_TSYNC_STATUS_PHASE_ADDR A:0xfc4a601c
y.create.l HWIO_MPM2_MPM_GRFC_CXO_EN_ADDR A:0xfc4a6020
y.create.l HWIO_MPM2_XPU_SCR_ADDR A:0xfc4a7000
y.create.l HWIO_MPM2_XPU_SWDR_ADDR A:0xfc4a7004
y.create.l HWIO_MPM2_XPU_SEAR0_ADDR A:0xfc4a7040
y.create.l HWIO_MPM2_XPU_SESR_ADDR A:0xfc4a7048
y.create.l HWIO_MPM2_XPU_SESRRESTORE_ADDR A:0xfc4a704c
y.create.l HWIO_MPM2_XPU_SESYNR0_ADDR A:0xfc4a7050
y.create.l HWIO_MPM2_XPU_SESYNR1_ADDR A:0xfc4a7054
y.create.l HWIO_MPM2_XPU_SESYNR2_ADDR A:0xfc4a7058
y.create.l HWIO_MPM2_XPU_MCR_ADDR A:0xfc4a7100
y.create.l HWIO_MPM2_XPU_MEAR0_ADDR A:0xfc4a7140
y.create.l HWIO_MPM2_XPU_MESR_ADDR A:0xfc4a7148
y.create.l HWIO_MPM2_XPU_MESRRESTORE_ADDR A:0xfc4a714c
y.create.l HWIO_MPM2_XPU_MESYNR0_ADDR A:0xfc4a7150
y.create.l HWIO_MPM2_XPU_MESYNR1_ADDR A:0xfc4a7154
y.create.l HWIO_MPM2_XPU_MESYNR2_ADDR A:0xfc4a7158
y.create.l HWIO_MPM2_XPU_CR_ADDR A:0xfc4a7080
y.create.l HWIO_MPM2_XPU_RPU_ACR0_ADDR A:0xfc4a70a0
y.create.l HWIO_MPM2_XPU_EAR0_ADDR A:0xfc4a70c0
y.create.l HWIO_MPM2_XPU_ESR_ADDR A:0xfc4a70c8
y.create.l HWIO_MPM2_XPU_ESRRESTORE_ADDR A:0xfc4a70cc
y.create.l HWIO_MPM2_XPU_ESYNR0_ADDR A:0xfc4a70d0
y.create.l HWIO_MPM2_XPU_ESYNR1_ADDR A:0xfc4a70d4
y.create.l HWIO_MPM2_XPU_ESYNR2_ADDR A:0xfc4a70d8
y.create.l HWIO_MPM2_XPU_IDR0_ADDR A:0xfc4a7074
y.create.l HWIO_MPM2_XPU_IDR1_ADDR A:0xfc4a7078
y.create.l HWIO_MPM2_XPU_REV_ADDR A:0xfc4a707c
y.create.l HWIO_MPM2_XPU_RG0_RACR0_ADDR A:0xfc4a7200
y.create.l HWIO_MPM2_XPU_RG1_RACR0_ADDR A:0xfc4a7280
y.create.l HWIO_MPM2_XPU_RG2_RACR0_ADDR A:0xfc4a7300
y.create.l HWIO_MPM2_XPU_RG3_RACR0_ADDR A:0xfc4a7380
y.create.l HWIO_MPM2_XPU_RG4_RACR0_ADDR A:0xfc4a7400
y.create.l HWIO_MPM2_XPU_RG5_RACR0_ADDR A:0xfc4a7480
y.create.l HWIO_MPM2_XPU_RG6_RACR0_ADDR A:0xfc4a7500
y.create.l HWIO_MPM2_XPU_RG7_RACR0_ADDR A:0xfc4a7580
y.create.l HWIO_MPM2_XPU_RG8_RACR0_ADDR A:0xfc4a7600
y.create.l HWIO_MPM2_XPU_RG9_RACR0_ADDR A:0xfc4a7680
y.create.l HWIO_MPM2_XPU_RG0_SCR_ADDR A:0xfc4a7250
y.create.l HWIO_MPM2_XPU_RG1_SCR_ADDR A:0xfc4a72d0
y.create.l HWIO_MPM2_XPU_RG2_SCR_ADDR A:0xfc4a7350
y.create.l HWIO_MPM2_XPU_RG3_SCR_ADDR A:0xfc4a73d0
y.create.l HWIO_MPM2_XPU_RG4_SCR_ADDR A:0xfc4a7450
y.create.l HWIO_MPM2_XPU_RG5_SCR_ADDR A:0xfc4a74d0
y.create.l HWIO_MPM2_XPU_RG6_SCR_ADDR A:0xfc4a7550
y.create.l HWIO_MPM2_XPU_RG7_SCR_ADDR A:0xfc4a75d0
y.create.l HWIO_MPM2_XPU_RG8_SCR_ADDR A:0xfc4a7650
y.create.l HWIO_MPM2_XPU_RG9_SCR_ADDR A:0xfc4a76d0
y.create.l HWIO_MPM2_XPU_RG0_MCR_ADDR A:0xfc4a7254
y.create.l HWIO_MPM2_XPU_RG1_MCR_ADDR A:0xfc4a72d4
y.create.l HWIO_MPM2_XPU_RG2_MCR_ADDR A:0xfc4a7354
y.create.l HWIO_MPM2_XPU_RG3_MCR_ADDR A:0xfc4a73d4
y.create.l HWIO_MPM2_XPU_RG4_MCR_ADDR A:0xfc4a7454
y.create.l HWIO_MPM2_XPU_RG5_MCR_ADDR A:0xfc4a74d4
y.create.l HWIO_MPM2_XPU_RG6_MCR_ADDR A:0xfc4a7554
y.create.l HWIO_MPM2_XPU_RG7_MCR_ADDR A:0xfc4a75d4
y.create.l HWIO_MPM2_XPU_RG8_MCR_ADDR A:0xfc4a7654
y.create.l HWIO_MPM2_XPU_RG9_MCR_ADDR A:0xfc4a76d4
y.create.l HWIO_MPM2_TSENS_HW_VER_ADDR A:0xfc4a8000
y.create.l HWIO_MPM2_TSENS_CTRL_ADDR A:0xfc4a8004
y.create.l HWIO_MPM2_TSENS_TEST_CTRL_ADDR A:0xfc4a8008
y.create.l HWIO_MPM2_TSENS_S0_MIN_MAX_STATUS_CTRL_ADDR A:0xfc4a800c
y.create.l HWIO_MPM2_TSENS_S1_MIN_MAX_STATUS_CTRL_ADDR A:0xfc4a8010
y.create.l HWIO_MPM2_TSENS_S2_MIN_MAX_STATUS_CTRL_ADDR A:0xfc4a8014
y.create.l HWIO_MPM2_TSENS_S3_MIN_MAX_STATUS_CTRL_ADDR A:0xfc4a8018
y.create.l HWIO_MPM2_TSENS_S4_MIN_MAX_STATUS_CTRL_ADDR A:0xfc4a801c
y.create.l HWIO_MPM2_TSENS_S5_MIN_MAX_STATUS_CTRL_ADDR A:0xfc4a8020
y.create.l HWIO_MPM2_TSENS_S6_MIN_MAX_STATUS_CTRL_ADDR A:0xfc4a8024
y.create.l HWIO_MPM2_TSENS_S7_MIN_MAX_STATUS_CTRL_ADDR A:0xfc4a8028
y.create.l HWIO_MPM2_TSENS_S8_MIN_MAX_STATUS_CTRL_ADDR A:0xfc4a802c
y.create.l HWIO_MPM2_TSENS_S9_MIN_MAX_STATUS_CTRL_ADDR A:0xfc4a8030
y.create.l HWIO_MPM2_TSENS_GLOBAL_CONFIG_ADDR A:0xfc4a804c
y.create.l HWIO_MPM2_TSENS_SENSOR_CONFIG_ADDR A:0xfc4a8050
y.create.l HWIO_MPM2_TSENS_CONFIG_REMOTE_IN_ADDR A:0xfc4a8054
y.create.l HWIO_MPM2_TSENS_UPPER_LOWER_INTERRUPT_CTRL_ADDR A:0xfc4a9000
y.create.l HWIO_MPM2_TSENS_S0_UPPER_LOWER_STATUS_CTRL_ADDR A:0xfc4a9004
y.create.l HWIO_MPM2_TSENS_S1_UPPER_LOWER_STATUS_CTRL_ADDR A:0xfc4a9008
y.create.l HWIO_MPM2_TSENS_S2_UPPER_LOWER_STATUS_CTRL_ADDR A:0xfc4a900c
y.create.l HWIO_MPM2_TSENS_S3_UPPER_LOWER_STATUS_CTRL_ADDR A:0xfc4a9010
y.create.l HWIO_MPM2_TSENS_S4_UPPER_LOWER_STATUS_CTRL_ADDR A:0xfc4a9014
y.create.l HWIO_MPM2_TSENS_S5_UPPER_LOWER_STATUS_CTRL_ADDR A:0xfc4a9018
y.create.l HWIO_MPM2_TSENS_S6_UPPER_LOWER_STATUS_CTRL_ADDR A:0xfc4a901c
y.create.l HWIO_MPM2_TSENS_S7_UPPER_LOWER_STATUS_CTRL_ADDR A:0xfc4a9020
y.create.l HWIO_MPM2_TSENS_S8_UPPER_LOWER_STATUS_CTRL_ADDR A:0xfc4a9024
y.create.l HWIO_MPM2_TSENS_S9_UPPER_LOWER_STATUS_CTRL_ADDR A:0xfc4a9028
y.create.l HWIO_MPM2_TSENS_S0_STATUS_ADDR A:0xfc4a9044
y.create.l HWIO_MPM2_TSENS_S1_STATUS_ADDR A:0xfc4a9048
y.create.l HWIO_MPM2_TSENS_S2_STATUS_ADDR A:0xfc4a904c
y.create.l HWIO_MPM2_TSENS_S3_STATUS_ADDR A:0xfc4a9050
y.create.l HWIO_MPM2_TSENS_S4_STATUS_ADDR A:0xfc4a9054
y.create.l HWIO_MPM2_TSENS_S5_STATUS_ADDR A:0xfc4a9058
y.create.l HWIO_MPM2_TSENS_S6_STATUS_ADDR A:0xfc4a905c
y.create.l HWIO_MPM2_TSENS_S7_STATUS_ADDR A:0xfc4a9060
y.create.l HWIO_MPM2_TSENS_S8_STATUS_ADDR A:0xfc4a9064
y.create.l HWIO_MPM2_TSENS_S9_STATUS_ADDR A:0xfc4a9068
y.create.l HWIO_MPM2_TSENS_TRDY_ADDR A:0xfc4a9084
y.create.l HWIO_MPM2_WDOG_RESET_REG_ADDR A:0xfc4aa000
y.create.l HWIO_MPM2_WDOG_CTL_REG_ADDR A:0xfc4aa004
y.create.l HWIO_MPM2_WDOG_STATUS_REG_ADDR A:0xfc4aa008
y.create.l HWIO_MPM2_WDOG_BARK_VAL_REG_ADDR A:0xfc4aa00c
y.create.l HWIO_MPM2_WDOG_BITE_VAL_REG_ADDR A:0xfc4aa010
y.create.l HWIO_MPM2_MPM_PS_HOLD_ADDR A:0xfc4ab000
y.create.l HWIO_MX_RBCPR_VERSION_ADDR A:0xfc450000
y.create.l HWIO_MX_RBCPR_SENSOR_MASK0_ADDR A:0xfc450020
y.create.l HWIO_MX_RBCPR_SENSOR_MASK1_ADDR A:0xfc450024
y.create.l HWIO_MX_RBCPR_SENSOR_MASK2_ADDR A:0xfc450028
y.create.l HWIO_MX_RBCPR_SENSOR_MASK3_ADDR A:0xfc45002c
y.create.l HWIO_MX_RBCPR_SENSOR_BYPASS0_ADDR A:0xfc450030
y.create.l HWIO_MX_RBCPR_SENSOR_BYPASS1_ADDR A:0xfc450034
y.create.l HWIO_MX_RBCPR_SENSOR_BYPASS2_ADDR A:0xfc450038
y.create.l HWIO_MX_RBCPR_SENSOR_BYPASS3_ADDR A:0xfc45003c
y.create.l HWIO_MX_RBIF_PMIC_ADDR_ADDR A:0xfc450040
y.create.l HWIO_MX_RBCPR_TIMER_INTERVAL_ADDR A:0xfc450044
y.create.l HWIO_MX_RBIF_LIMIT_ADDR A:0xfc450048
y.create.l HWIO_MX_RBIF_TIMER_ADJUST_ADDR A:0xfc45004c
y.create.l HWIO_MX_RBCPR_GCNT_TARGET0_ADDR A:0xfc450060
y.create.l HWIO_MX_RBCPR_GCNT_TARGET1_ADDR A:0xfc450064
y.create.l HWIO_MX_RBCPR_GCNT_TARGET2_ADDR A:0xfc450068
y.create.l HWIO_MX_RBCPR_GCNT_TARGET3_ADDR A:0xfc45006c
y.create.l HWIO_MX_RBCPR_GCNT_TARGET4_ADDR A:0xfc450070
y.create.l HWIO_MX_RBCPR_GCNT_TARGET5_ADDR A:0xfc450074
y.create.l HWIO_MX_RBCPR_GCNT_TARGET6_ADDR A:0xfc450078
y.create.l HWIO_MX_RBCPR_GCNT_TARGET7_ADDR A:0xfc45007c
y.create.l HWIO_MX_RBCPR_STEP_QUOT_ADDR A:0xfc450080
y.create.l HWIO_MX_RBCPR_CTL_ADDR A:0xfc450090
y.create.l HWIO_MX_RBIF_SW_VLEVEL_ADDR A:0xfc450094
y.create.l HWIO_MX_RBIF_CONT_ACK_CMD_ADDR A:0xfc450098
y.create.l HWIO_MX_RBIF_CONT_NACK_CMD_ADDR A:0xfc45009c
y.create.l HWIO_MX_RBCPR_RESULT_0_ADDR A:0xfc4500a0
y.create.l HWIO_MX_RBCPR_RESULT_1_ADDR A:0xfc4500a4
y.create.l HWIO_MX_RBIF_IRQ_EN_0_ADDR A:0xfc450100
y.create.l HWIO_MX_RBIF_IRQ_EN_1_ADDR A:0xfc450104
y.create.l HWIO_MX_RBIF_IRQ_EN_2_ADDR A:0xfc450108
y.create.l HWIO_MX_RBIF_IRQ_CLEAR_ADDR A:0xfc450110
y.create.l HWIO_MX_RBIF_IRQ_STATUS_ADDR A:0xfc450114
y.create.l HWIO_MX_RBCPR_QUOT_AVG_ADDR A:0xfc450118
y.create.l HWIO_MX_RBCPR_DEBUG0_ADDR A:0xfc45011c
y.create.l HWIO_MX_RBCPR_DEBUG1_ADDR A:0xfc450120
y.create.l HWIO_MX_RBCPR_DEBUG2_ADDR A:0xfc450124
y.create.l HWIO_MX_RBCPR_BIST_MINMAX_ADDR A:0xfc450128
y.create.l HWIO_MX_RBCPR_BIST_RESULT_ADDR A:0xfc45012c
y.create.l HWIO_MX_RBCPR_BIST_FAIL_MAP0_ADDR A:0xfc450130
y.create.l HWIO_MX_RBCPR_BIST_FAIL_MAP1_ADDR A:0xfc450134
y.create.l HWIO_MX_RBCPR_BIST_FAIL_MAP2_ADDR A:0xfc450138
y.create.l HWIO_MX_RBCPR_BIST_FAIL_MAP3_ADDR A:0xfc45013c
y.create.l HWIO_MX_RBCPR_LOG_0_ADDR A:0xfc450140
y.create.l HWIO_MX_RBCPR_LOG_1_ADDR A:0xfc450144
y.create.l HWIO_MX_RBCPR_LOG_2_ADDR A:0xfc450148
y.create.l HWIO_MX_RBCPR_LOG_3_ADDR A:0xfc45014c
y.create.l HWIO_MX_RBCPR_LOG_4_ADDR A:0xfc450150
y.create.l HWIO_MX_RBCPR_LOG_5_ADDR A:0xfc450154
y.create.l HWIO_MX_RBCPR_LOG_6_ADDR A:0xfc450158
y.create.l HWIO_MX_RBCPR_LOG_7_ADDR A:0xfc45015c
y.create.l HWIO_MX_RBCPR_HTOL_AGE_ADDR A:0xfc450160
y.create.l HWIO_OCIMEM_HW_VERSION_ADDR A:0xfc488000
y.create.l HWIO_OCIMEM_HW_PROFILE_ADDR A:0xfc488004
y.create.l HWIO_OCIMEM_GEN_CTL_ADDR A:0xfc488008
y.create.l HWIO_OCIMEM_GEN_STAT_ADDR A:0xfc48800c
y.create.l HWIO_OCIMEM_INTC_CLR_ADDR A:0xfc488010
y.create.l HWIO_OCIMEM_INTC_MASK_ADDR A:0xfc488014
y.create.l HWIO_OCIMEM_INTC_STAT_ADDR A:0xfc488018
y.create.l HWIO_OCIMEM_OSW_STATUS_ADDR A:0xfc48801c
y.create.l HWIO_OCIMEM_PSCGC_TIMERS_ADDR A:0xfc488034
y.create.l HWIO_OCIMEM_PSCGC_STAT_ADDR A:0xfc488038
y.create.l HWIO_OCIMEM_PSCGC_M0_M7_CTL_ADDR A:0xfc48803c
y.create.l HWIO_OCIMEM_ERR_ADDRESS_ADDR A:0xfc488060
y.create.l HWIO_OCIMEM_AXI_ERR_SYNDROME_ADDR A:0xfc488064
y.create.l HWIO_OCIMEM_DEBUG_CTL_ADDR A:0xfc488068
y.create.l HWIO_OCIMEM_APU_XPU_SCR_ADDR A:0xfc48a000
y.create.l HWIO_OCIMEM_APU_XPU_SWDR_ADDR A:0xfc48a004
y.create.l HWIO_OCIMEM_APU_XPU_SEAR0_ADDR A:0xfc48a040
y.create.l HWIO_OCIMEM_APU_XPU_SESR_ADDR A:0xfc48a048
y.create.l HWIO_OCIMEM_APU_XPU_SESRRESTORE_ADDR A:0xfc48a04c
y.create.l HWIO_OCIMEM_APU_XPU_SESYNR0_ADDR A:0xfc48a050
y.create.l HWIO_OCIMEM_APU_XPU_SESYNR1_ADDR A:0xfc48a054
y.create.l HWIO_OCIMEM_APU_XPU_SESYNR2_ADDR A:0xfc48a058
y.create.l HWIO_OCIMEM_APU_XPU_MCR_ADDR A:0xfc48a100
y.create.l HWIO_OCIMEM_APU_XPU_MEAR0_ADDR A:0xfc48a140
y.create.l HWIO_OCIMEM_APU_XPU_MESR_ADDR A:0xfc48a148
y.create.l HWIO_OCIMEM_APU_XPU_MESRRESTORE_ADDR A:0xfc48a14c
y.create.l HWIO_OCIMEM_APU_XPU_MESYNR0_ADDR A:0xfc48a150
y.create.l HWIO_OCIMEM_APU_XPU_MESYNR1_ADDR A:0xfc48a154
y.create.l HWIO_OCIMEM_APU_XPU_MESYNR2_ADDR A:0xfc48a158
y.create.l HWIO_OCIMEM_APU_XPU_CR_ADDR A:0xfc48a080
y.create.l HWIO_OCIMEM_APU_XPU_RPU_ACR0_ADDR A:0xfc48a0a0
y.create.l HWIO_OCIMEM_APU_XPU_EAR0_ADDR A:0xfc48a0c0
y.create.l HWIO_OCIMEM_APU_XPU_ESR_ADDR A:0xfc48a0c8
y.create.l HWIO_OCIMEM_APU_XPU_ESRRESTORE_ADDR A:0xfc48a0cc
y.create.l HWIO_OCIMEM_APU_XPU_ESYNR0_ADDR A:0xfc48a0d0
y.create.l HWIO_OCIMEM_APU_XPU_ESYNR1_ADDR A:0xfc48a0d4
y.create.l HWIO_OCIMEM_APU_XPU_ESYNR2_ADDR A:0xfc48a0d8
y.create.l HWIO_OCIMEM_APU_XPU_IDR0_ADDR A:0xfc48a074
y.create.l HWIO_OCIMEM_APU_XPU_IDR1_ADDR A:0xfc48a078
y.create.l HWIO_OCIMEM_APU_XPU_REV_ADDR A:0xfc48a07c
y.create.l HWIO_OCIMEM_APU_XPU_RG0_RACR0_ADDR A:0xfc48a200
y.create.l HWIO_OCIMEM_APU_XPU_RG1_RACR0_ADDR A:0xfc48a280
y.create.l HWIO_OCIMEM_APU_XPU_RG0_WACR0_ADDR A:0xfc48a220
y.create.l HWIO_OCIMEM_APU_XPU_RG1_WACR0_ADDR A:0xfc48a2a0
y.create.l HWIO_OCIMEM_APU_XPU_RG0_SCR_ADDR A:0xfc48a250
y.create.l HWIO_OCIMEM_APU_XPU_RG1_SCR_ADDR A:0xfc48a2d0
y.create.l HWIO_OCIMEM_APU_XPU_RG0_MCR_ADDR A:0xfc48a254
y.create.l HWIO_OCIMEM_APU_XPU_RG1_MCR_ADDR A:0xfc48a2d4
y.create.l HWIO_OCIMEM_MPU_XPU_SCR_ADDR A:0xfc48b000
y.create.l HWIO_OCIMEM_MPU_XPU_SWDR_ADDR A:0xfc48b004
y.create.l HWIO_OCIMEM_MPU_XPU_PRTN_RACR_SSHADOW_ADDR A:0xfc48b008
y.create.l HWIO_OCIMEM_MPU_XPU_PRTN_WACR_SSHADOW_ADDR A:0xfc48b00c
y.create.l HWIO_OCIMEM_MPU_XPU_PRTN_START_SSHADOW0_ADDR A:0xfc48b010
y.create.l HWIO_OCIMEM_MPU_XPU_PRTN_END_SSHADOW0_ADDR A:0xfc48b018
y.create.l HWIO_OCIMEM_MPU_XPU_SEAR0_ADDR A:0xfc48b040
y.create.l HWIO_OCIMEM_MPU_XPU_SESR_ADDR A:0xfc48b048
y.create.l HWIO_OCIMEM_MPU_XPU_SESRRESTORE_ADDR A:0xfc48b04c
y.create.l HWIO_OCIMEM_MPU_XPU_SESYNR0_ADDR A:0xfc48b050
y.create.l HWIO_OCIMEM_MPU_XPU_SESYNR1_ADDR A:0xfc48b054
y.create.l HWIO_OCIMEM_MPU_XPU_SESYNR2_ADDR A:0xfc48b058
y.create.l HWIO_OCIMEM_MPU_XPU_MCR_ADDR A:0xfc48b100
y.create.l HWIO_OCIMEM_MPU_XPU_MEAR0_ADDR A:0xfc48b140
y.create.l HWIO_OCIMEM_MPU_XPU_MESR_ADDR A:0xfc48b148
y.create.l HWIO_OCIMEM_MPU_XPU_MESRRESTORE_ADDR A:0xfc48b14c
y.create.l HWIO_OCIMEM_MPU_XPU_MESYNR0_ADDR A:0xfc48b150
y.create.l HWIO_OCIMEM_MPU_XPU_MESYNR1_ADDR A:0xfc48b154
y.create.l HWIO_OCIMEM_MPU_XPU_MESYNR2_ADDR A:0xfc48b158
y.create.l HWIO_OCIMEM_MPU_XPU_CR_ADDR A:0xfc48b080
y.create.l HWIO_OCIMEM_MPU_XPU_PRTN_RACR_SHADOW_ADDR A:0xfc48b088
y.create.l HWIO_OCIMEM_MPU_XPU_PRTN_WACR_SHADOW_ADDR A:0xfc48b08c
y.create.l HWIO_OCIMEM_MPU_XPU_PRTN_START_SHADOW0_ADDR A:0xfc48b090
y.create.l HWIO_OCIMEM_MPU_XPU_PRTN_END_SHADOW0_ADDR A:0xfc48b098
y.create.l HWIO_OCIMEM_MPU_XPU_RPU_ACR0_ADDR A:0xfc48b0a0
y.create.l HWIO_OCIMEM_MPU_XPU_EAR0_ADDR A:0xfc48b0c0
y.create.l HWIO_OCIMEM_MPU_XPU_ESR_ADDR A:0xfc48b0c8
y.create.l HWIO_OCIMEM_MPU_XPU_ESRRESTORE_ADDR A:0xfc48b0cc
y.create.l HWIO_OCIMEM_MPU_XPU_ESYNR0_ADDR A:0xfc48b0d0
y.create.l HWIO_OCIMEM_MPU_XPU_ESYNR1_ADDR A:0xfc48b0d4
y.create.l HWIO_OCIMEM_MPU_XPU_ESYNR2_ADDR A:0xfc48b0d8
y.create.l HWIO_OCIMEM_MPU_XPU_UMR_RACR_ADDR A:0xfc48b0e0
y.create.l HWIO_OCIMEM_MPU_XPU_UMR_WACR_ADDR A:0xfc48b0e4
y.create.l HWIO_OCIMEM_MPU_XPU_IDR0_ADDR A:0xfc48b074
y.create.l HWIO_OCIMEM_MPU_XPU_IDR1_ADDR A:0xfc48b078
y.create.l HWIO_OCIMEM_MPU_XPU_REV_ADDR A:0xfc48b07c
y.create.l HWIO_OCIMEM_MPU_XPU_PRT0_RACR0_ADDR A:0xfc48b200
y.create.l HWIO_OCIMEM_MPU_XPU_PRT1_RACR0_ADDR A:0xfc48b280
y.create.l HWIO_OCIMEM_MPU_XPU_PRT2_RACR0_ADDR A:0xfc48b300
y.create.l HWIO_OCIMEM_MPU_XPU_PRT3_RACR0_ADDR A:0xfc48b380
y.create.l HWIO_OCIMEM_MPU_XPU_PRT4_RACR0_ADDR A:0xfc48b400
y.create.l HWIO_OCIMEM_MPU_XPU_PRT5_RACR0_ADDR A:0xfc48b480
y.create.l HWIO_OCIMEM_MPU_XPU_PRT6_RACR0_ADDR A:0xfc48b500
y.create.l HWIO_OCIMEM_MPU_XPU_PRT7_RACR0_ADDR A:0xfc48b580
y.create.l HWIO_OCIMEM_MPU_XPU_PRT0_WACR0_ADDR A:0xfc48b220
y.create.l HWIO_OCIMEM_MPU_XPU_PRT1_WACR0_ADDR A:0xfc48b2a0
y.create.l HWIO_OCIMEM_MPU_XPU_PRT2_WACR0_ADDR A:0xfc48b320
y.create.l HWIO_OCIMEM_MPU_XPU_PRT3_WACR0_ADDR A:0xfc48b3a0
y.create.l HWIO_OCIMEM_MPU_XPU_PRT4_WACR0_ADDR A:0xfc48b420
y.create.l HWIO_OCIMEM_MPU_XPU_PRT5_WACR0_ADDR A:0xfc48b4a0
y.create.l HWIO_OCIMEM_MPU_XPU_PRT6_WACR0_ADDR A:0xfc48b520
y.create.l HWIO_OCIMEM_MPU_XPU_PRT7_WACR0_ADDR A:0xfc48b5a0
y.create.l HWIO_OCIMEM_MPU_XPU_PRT0_START0_ADDR A:0xfc48b240
y.create.l HWIO_OCIMEM_MPU_XPU_PRT1_START0_ADDR A:0xfc48b2c0
y.create.l HWIO_OCIMEM_MPU_XPU_PRT2_START0_ADDR A:0xfc48b340
y.create.l HWIO_OCIMEM_MPU_XPU_PRT3_START0_ADDR A:0xfc48b3c0
y.create.l HWIO_OCIMEM_MPU_XPU_PRT4_START0_ADDR A:0xfc48b440
y.create.l HWIO_OCIMEM_MPU_XPU_PRT5_START0_ADDR A:0xfc48b4c0
y.create.l HWIO_OCIMEM_MPU_XPU_PRT6_START0_ADDR A:0xfc48b540
y.create.l HWIO_OCIMEM_MPU_XPU_PRT7_START0_ADDR A:0xfc48b5c0
y.create.l HWIO_OCIMEM_MPU_XPU_PRT0_END0_ADDR A:0xfc48b248
y.create.l HWIO_OCIMEM_MPU_XPU_PRT1_END0_ADDR A:0xfc48b2c8
y.create.l HWIO_OCIMEM_MPU_XPU_PRT2_END0_ADDR A:0xfc48b348
y.create.l HWIO_OCIMEM_MPU_XPU_PRT3_END0_ADDR A:0xfc48b3c8
y.create.l HWIO_OCIMEM_MPU_XPU_PRT4_END0_ADDR A:0xfc48b448
y.create.l HWIO_OCIMEM_MPU_XPU_PRT5_END0_ADDR A:0xfc48b4c8
y.create.l HWIO_OCIMEM_MPU_XPU_PRT6_END0_ADDR A:0xfc48b548
y.create.l HWIO_OCIMEM_MPU_XPU_PRT7_END0_ADDR A:0xfc48b5c8
y.create.l HWIO_OCIMEM_MPU_XPU_PRT0_SCR_ADDR A:0xfc48b250
y.create.l HWIO_OCIMEM_MPU_XPU_PRT1_SCR_ADDR A:0xfc48b2d0
y.create.l HWIO_OCIMEM_MPU_XPU_PRT2_SCR_ADDR A:0xfc48b350
y.create.l HWIO_OCIMEM_MPU_XPU_PRT3_SCR_ADDR A:0xfc48b3d0
y.create.l HWIO_OCIMEM_MPU_XPU_PRT4_SCR_ADDR A:0xfc48b450
y.create.l HWIO_OCIMEM_MPU_XPU_PRT5_SCR_ADDR A:0xfc48b4d0
y.create.l HWIO_OCIMEM_MPU_XPU_PRT6_SCR_ADDR A:0xfc48b550
y.create.l HWIO_OCIMEM_MPU_XPU_PRT7_SCR_ADDR A:0xfc48b5d0
y.create.l HWIO_OCIMEM_MPU_XPU_PRT0_MCR_ADDR A:0xfc48b254
y.create.l HWIO_OCIMEM_MPU_XPU_PRT1_MCR_ADDR A:0xfc48b2d4
y.create.l HWIO_OCIMEM_MPU_XPU_PRT2_MCR_ADDR A:0xfc48b354
y.create.l HWIO_OCIMEM_MPU_XPU_PRT3_MCR_ADDR A:0xfc48b3d4
y.create.l HWIO_OCIMEM_MPU_XPU_PRT4_MCR_ADDR A:0xfc48b454
y.create.l HWIO_OCIMEM_MPU_XPU_PRT5_MCR_ADDR A:0xfc48b4d4
y.create.l HWIO_OCIMEM_MPU_XPU_PRT6_MCR_ADDR A:0xfc48b554
y.create.l HWIO_OCIMEM_MPU_XPU_PRT7_MCR_ADDR A:0xfc48b5d4
y.create.l HWIO_OCIMEM_MPU_XPU_PRT0_CNTL0_ADDR A:0xfc48b258
y.create.l HWIO_OCIMEM_MPU_XPU_PRT1_CNTL0_ADDR A:0xfc48b2d8
y.create.l HWIO_OCIMEM_MPU_XPU_PRT2_CNTL0_ADDR A:0xfc48b358
y.create.l HWIO_OCIMEM_MPU_XPU_PRT3_CNTL0_ADDR A:0xfc48b3d8
y.create.l HWIO_OCIMEM_MPU_XPU_PRT4_CNTL0_ADDR A:0xfc48b458
y.create.l HWIO_OCIMEM_MPU_XPU_PRT5_CNTL0_ADDR A:0xfc48b4d8
y.create.l HWIO_OCIMEM_MPU_XPU_PRT6_CNTL0_ADDR A:0xfc48b558
y.create.l HWIO_OCIMEM_MPU_XPU_PRT7_CNTL0_ADDR A:0xfc48b5d8
y.create.l HWIO_OCIMEM_MPU_XPU_PRT0_CNTL1_ADDR A:0xfc48b25c
y.create.l HWIO_OCIMEM_MPU_XPU_PRT1_CNTL1_ADDR A:0xfc48b2dc
y.create.l HWIO_OCIMEM_MPU_XPU_PRT2_CNTL1_ADDR A:0xfc48b35c
y.create.l HWIO_OCIMEM_MPU_XPU_PRT3_CNTL1_ADDR A:0xfc48b3dc
y.create.l HWIO_OCIMEM_MPU_XPU_PRT4_CNTL1_ADDR A:0xfc48b45c
y.create.l HWIO_OCIMEM_MPU_XPU_PRT5_CNTL1_ADDR A:0xfc48b4dc
y.create.l HWIO_OCIMEM_MPU_XPU_PRT6_CNTL1_ADDR A:0xfc48b55c
y.create.l HWIO_OCIMEM_MPU_XPU_PRT7_CNTL1_ADDR A:0xfc48b5dc
y.create.l HWIO_PCIE_PCIE20_PARF_SYS_CTRL_ADDR A:0xfc520000
y.create.l HWIO_PCIE_PCIE20_PARF_PHY_LATENCY_ADDR A:0xfc520004
y.create.l HWIO_PCIE_PCIE20_PARF_BRIDGE_ERR_MAP_ADDR A:0xfc520008
y.create.l HWIO_PCIE_PCIE20_PARF_DB_CTRL_ADDR A:0xfc520010
y.create.l HWIO_PCIE_PCIE20_PARF_PREDET_DB_INSR_ADDR A:0xfc520014
y.create.l HWIO_PCIE_PCIE20_PARF_PREDET_DB_RMVL_ADDR A:0xfc520018
y.create.l HWIO_PCIE_PCIE20_PARF_WKP_DB_RMVL_ADDR A:0xfc52001c
y.create.l HWIO_PCIE_PCIE20_PARF_PM_CTRL_ADDR A:0xfc520020
y.create.l HWIO_PCIE_PCIE20_PARF_PM_STTS_ADDR A:0xfc520024
y.create.l HWIO_PCIE_PCIE20_PARF_PM_STTS_1_ADDR A:0xfc520028
y.create.l HWIO_PCIE_PCIE20_PARF_PHY_CTRL_ADDR A:0xfc520040
y.create.l HWIO_PCIE_PCIE20_PARF_PHY_STTS_ADDR A:0xfc520044
y.create.l HWIO_PCIE_PCIE20_PARF_AXI_CONFIG_ADDR A:0xfc520054
y.create.l HWIO_PCIE_PCIE20_PARF_HW_EV_0_ADDR A:0xfc520058
y.create.l HWIO_PCIE_PCIE20_PARF_HW_EV_1_ADDR A:0xfc52005c
y.create.l HWIO_PCIE_PCIE20_PARF_HW_EV_2_ADDR A:0xfc520060
y.create.l HWIO_PCIE_PCIE20_PARF_HW_EV_3_ADDR A:0xfc520064
y.create.l HWIO_PCIE_PCIE20_PARF_HW_EV_4_ADDR A:0xfc520068
y.create.l HWIO_PCIE_PCIE20_PARF_HW_EV_5_ADDR A:0xfc52006c
y.create.l HWIO_PCIE_PCIE20_PARF_HW_EV_6_ADDR A:0xfc520070
y.create.l HWIO_PCIE_PCIE20_PARF_HW_EV_7_ADDR A:0xfc520074
y.create.l HWIO_PCIE_PCIE20_PARF_HW_EV_8_ADDR A:0xfc520078
y.create.l HWIO_PCIE_PCIE20_PARF_HW_EV_9_ADDR A:0xfc52007c
y.create.l HWIO_PCIE_PCIE20_PARF_PHY_RESET_CTRL_ADDR A:0xfc5200d8
y.create.l HWIO_PCIE_PCIE20_PARF_Q2A_BRIDGE_CTRL_ADDR A:0xfc5200dc
y.create.l HWIO_PCIE_PCIE20_PARF_SLV_BASE_ADDR_ADDR A:0xfc5200e0
y.create.l HWIO_PCIE_PCIE20_PARF_TEST_BUS_ADDR A:0xfc5200e4
y.create.l HWIO_PCIE_PCIE20_PARF_MSG_ADDR_0_ADDR A:0xfc5200e8
y.create.l HWIO_PCIE_PCIE20_PARF_MSG_ADDR_1_ADDR A:0xfc5200ec
y.create.l HWIO_PCIE_PCIE20_PARF_MSG_ADDR_2_ADDR A:0xfc5200f0
y.create.l HWIO_PCIE_PCIE20_PARF_MSG_ADDR_3_ADDR A:0xfc5200f4
y.create.l HWIO_PCIE_PCIE20_PARF_MSG_ADDR_4_ADDR A:0xfc5200f8
y.create.l HWIO_PCIE_PCIE20_PARF_MSG_ADDR_5_ADDR A:0xfc5200fc
y.create.l HWIO_PCIE_PCIE20_PARF_MSG_ADDR_6_ADDR A:0xfc520100
y.create.l HWIO_PCIE_PCIE20_PARF_MSG_ADDR_7_ADDR A:0xfc520104
y.create.l HWIO_PCIE_PCIE20_PARF_MSG_ADDR_8_ADDR A:0xfc520108
y.create.l HWIO_PCIE_PCIE20_PARF_MSG_ADDR_9_ADDR A:0xfc52010c
y.create.l HWIO_PCIE_PCIE20_PARF_MSG_PARAMS_0_ADDR A:0xfc520128
y.create.l HWIO_PCIE_PCIE20_PARF_MSG_PARAMS_1_ADDR A:0xfc52012c
y.create.l HWIO_PCIE_PCIE20_PARF_MSG_PARAMS_2_ADDR A:0xfc520130
y.create.l HWIO_PCIE_PCIE20_PARF_MSG_PARAMS_3_ADDR A:0xfc520134
y.create.l HWIO_PCIE_PCIE20_PARF_MSG_PARAMS_4_ADDR A:0xfc520138
y.create.l HWIO_PCIE_PCIE20_PARF_MSG_PARAMS_5_ADDR A:0xfc52013c
y.create.l HWIO_PCIE_PCIE20_PARF_MSG_PARAMS_6_ADDR A:0xfc520140
y.create.l HWIO_PCIE_PCIE20_PARF_MSG_PARAMS_7_ADDR A:0xfc520144
y.create.l HWIO_PCIE_PCIE20_PARF_MSG_PARAMS_8_ADDR A:0xfc520148
y.create.l HWIO_PCIE_PCIE20_PARF_MSG_PARAMS_9_ADDR A:0xfc52014c
y.create.l HWIO_PCIE_PCIE20_PARF_DBI_BASE_ADDR_ADDR A:0xfc520168
y.create.l HWIO_PCIE_PCIE20_PARF_SLV_ADDR_SPACE_SIZE_ADDR A:0xfc52016c
y.create.l HWIO_PCIE_PCIE20_PARF_VERSION_ADDR A:0xfc520170
y.create.l HWIO_PCIE_PCIE20_PARF_MHI_CLOCK_RESET_CTRL_ADDR A:0xfc520174
y.create.l HWIO_PCIE_PCIE20_PARF_MHI_BASE_ADDR_LOWER_ADDR A:0xfc520178
y.create.l HWIO_PCIE_PCIE20_PARF_MHI_BASE_ADDR_UPPER_ADDR A:0xfc52017c
y.create.l HWIO_PCIE_PCIE20_PARF_L1SUB_AHB_CLK_MAX_TIMER_ADDR A:0xfc520180
y.create.l HWIO_PCIE_PCIE20_PARF_LTR_MSG_GEN_ADDR A:0xfc520184
y.create.l HWIO_PCIE_PCIE20_PARF_MSI_GEN_ADDR A:0xfc520188
y.create.l HWIO_PCIE_PCIE20_PARF_AXI_MSTR_OUTST_LIMIT_ADDR A:0xfc52018c
y.create.l HWIO_PCIE_PCIE20_PARF_DEBUG_INT_EN_ADDR A:0xfc520190
y.create.l HWIO_PCIE_PCIE20_PARF_MHI_BAR_KB_SIZE_ADDR A:0xfc520194
y.create.l HWIO_PCIE_PCIE20_PARF_MHI_IPA_DBS_ADDR A:0xfc520198
y.create.l HWIO_PCIE_PCIE20_PARF_MHI_IPA_CDB_TARGET_LOWER_ADDR A:0xfc52019c
y.create.l HWIO_PCIE_PCIE20_PARF_MHI_IPA_EDB_TARGET_LOWER_ADDR A:0xfc5201a0
y.create.l HWIO_PCIE_PCIE20_PARF_AXI_MSTR_RD_HALT_NO_WRITES_ADDR A:0xfc5201a4
y.create.l HWIO_PCIE_PCIE20_PARF_AXI_MSTR_WR_ADDR_HALT_ADDR A:0xfc5201a8
y.create.l HWIO_PCIE_PCIE20_PARF_Q2A_FLUSH_ADDR A:0xfc5201ac
y.create.l HWIO_PCIE_PCIE20_PARF_DEVICE_TYPE_ADDR A:0xfc521000
y.create.l HWIO_PCIE_VMIDMT_SCR0_ADDR A:0xfc522000
y.create.l HWIO_PCIE_VMIDMT_SCR1_ADDR A:0xfc522004
y.create.l HWIO_PCIE_VMIDMT_SCR2_ADDR A:0xfc522008
y.create.l HWIO_PCIE_VMIDMT_SACR_ADDR A:0xfc522010
y.create.l HWIO_PCIE_VMIDMT_SIDR0_ADDR A:0xfc522020
y.create.l HWIO_PCIE_VMIDMT_SIDR1_ADDR A:0xfc522024
y.create.l HWIO_PCIE_VMIDMT_SIDR2_ADDR A:0xfc522028
y.create.l HWIO_PCIE_VMIDMT_SIDR4_ADDR A:0xfc522030
y.create.l HWIO_PCIE_VMIDMT_SIDR5_ADDR A:0xfc522034
y.create.l HWIO_PCIE_VMIDMT_SIDR7_ADDR A:0xfc52203c
y.create.l HWIO_PCIE_VMIDMT_SGFAR0_ADDR A:0xfc522040
y.create.l HWIO_PCIE_VMIDMT_SGFAR1_ADDR A:0xfc522044
y.create.l HWIO_PCIE_VMIDMT_SGFSR_ADDR A:0xfc522048
y.create.l HWIO_PCIE_VMIDMT_SGFSRRESTORE_ADDR A:0xfc52204c
y.create.l HWIO_PCIE_VMIDMT_SGFSYNDR0_ADDR A:0xfc522050
y.create.l HWIO_PCIE_VMIDMT_SGFSYNDR1_ADDR A:0xfc522054
y.create.l HWIO_PCIE_VMIDMT_SGFSYNDR2_ADDR A:0xfc522058
y.create.l HWIO_PCIE_VMIDMT_VMIDMTSCR0_ADDR A:0xfc522090
y.create.l HWIO_PCIE_VMIDMT_CR0_ADDR A:0xfc522000
y.create.l HWIO_PCIE_VMIDMT_CR2_ADDR A:0xfc522008
y.create.l HWIO_PCIE_VMIDMT_ACR_ADDR A:0xfc522010
y.create.l HWIO_PCIE_VMIDMT_IDR0_ADDR A:0xfc522020
y.create.l HWIO_PCIE_VMIDMT_IDR1_ADDR A:0xfc522024
y.create.l HWIO_PCIE_VMIDMT_IDR2_ADDR A:0xfc522028
y.create.l HWIO_PCIE_VMIDMT_IDR4_ADDR A:0xfc522030
y.create.l HWIO_PCIE_VMIDMT_IDR5_ADDR A:0xfc522034
y.create.l HWIO_PCIE_VMIDMT_IDR7_ADDR A:0xfc52203c
y.create.l HWIO_PCIE_VMIDMT_GFAR0_ADDR A:0xfc522040
y.create.l HWIO_PCIE_VMIDMT_GFAR1_ADDR A:0xfc522044
y.create.l HWIO_PCIE_VMIDMT_GFSR_ADDR A:0xfc522048
y.create.l HWIO_PCIE_VMIDMT_GFSRRESTORE_ADDR A:0xfc52204c
y.create.l HWIO_PCIE_VMIDMT_GFSYNDR0_ADDR A:0xfc522050
y.create.l HWIO_PCIE_VMIDMT_GFSYNDR1_ADDR A:0xfc522054
y.create.l HWIO_PCIE_VMIDMT_GFSYNDR2_ADDR A:0xfc522058
y.create.l HWIO_PCIE_VMIDMT_VMIDMTCR0_ADDR A:0xfc522090
y.create.l HWIO_PCIE_VMIDMT_VMIDMTACR_ADDR A:0xfc52209c
y.create.l HWIO_PCIE_VMIDMT_NSCR0_ADDR A:0xfc522400
y.create.l HWIO_PCIE_VMIDMT_NSCR2_ADDR A:0xfc522408
y.create.l HWIO_PCIE_VMIDMT_NSACR_ADDR A:0xfc522410
y.create.l HWIO_PCIE_VMIDMT_NSGFAR0_ADDR A:0xfc522440
y.create.l HWIO_PCIE_VMIDMT_NSGFAR1_ADDR A:0xfc522444
y.create.l HWIO_PCIE_VMIDMT_NSGFSR_ADDR A:0xfc522448
y.create.l HWIO_PCIE_VMIDMT_NSGFSRRESTORE_ADDR A:0xfc52244c
y.create.l HWIO_PCIE_VMIDMT_NSGFSYNDR0_ADDR A:0xfc522450
y.create.l HWIO_PCIE_VMIDMT_NSGFSYNDR1_ADDR A:0xfc522454
y.create.l HWIO_PCIE_VMIDMT_NSGFSYNDR2_ADDR A:0xfc522458
y.create.l HWIO_PCIE_VMIDMT_NSVMIDMTCR0_ADDR A:0xfc522490
y.create.l HWIO_PCIE_VMIDMT_SSDR0_ADDR A:0xfc522080
y.create.l HWIO_PCIE_VMIDMT_SSDR1_ADDR A:0xfc522084
y.create.l HWIO_PCIE_VMIDMT_SSDR2_ADDR A:0xfc522088
y.create.l HWIO_PCIE_VMIDMT_SSDR3_ADDR A:0xfc52208c
y.create.l HWIO_PCIE_VMIDMT_MSDR0_ADDR A:0xfc522480
y.create.l HWIO_PCIE_VMIDMT_MCR_ADDR A:0xfc522494
y.create.l HWIO_PCIE_VMIDMT_S2VR0_ADDR A:0xfc522c00
y.create.l HWIO_PCIE_VMIDMT_S2VR1_ADDR A:0xfc522c04
y.create.l HWIO_PCIE_VMIDMT_S2VR2_ADDR A:0xfc522c08
y.create.l HWIO_PCIE_VMIDMT_S2VR3_ADDR A:0xfc522c0c
y.create.l HWIO_PCIE_VMIDMT_S2VR4_ADDR A:0xfc522c10
y.create.l HWIO_PCIE_VMIDMT_S2VR5_ADDR A:0xfc522c14
y.create.l HWIO_PCIE_VMIDMT_S2VR6_ADDR A:0xfc522c18
y.create.l HWIO_PCIE_VMIDMT_S2VR7_ADDR A:0xfc522c1c
y.create.l HWIO_PCIE_VMIDMT_AS2VR0_ADDR A:0xfc522e00
y.create.l HWIO_PCIE_VMIDMT_AS2VR1_ADDR A:0xfc522e04
y.create.l HWIO_PCIE_VMIDMT_AS2VR2_ADDR A:0xfc522e08
y.create.l HWIO_PCIE_VMIDMT_AS2VR3_ADDR A:0xfc522e0c
y.create.l HWIO_PCIE_VMIDMT_AS2VR4_ADDR A:0xfc522e10
y.create.l HWIO_PCIE_VMIDMT_AS2VR5_ADDR A:0xfc522e14
y.create.l HWIO_PCIE_VMIDMT_AS2VR6_ADDR A:0xfc522e18
y.create.l HWIO_PCIE_VMIDMT_AS2VR7_ADDR A:0xfc522e1c
y.create.l HWIO_PCIE_VMIDMT_SMR0_ADDR A:0xfc522800
y.create.l HWIO_PCIE_VMIDMT_SMR1_ADDR A:0xfc522804
y.create.l HWIO_PCIE_VMIDMT_SMR2_ADDR A:0xfc522808
y.create.l HWIO_PCIE_VMIDMT_SMR3_ADDR A:0xfc52280c
y.create.l HWIO_PCIE_VMIDMT_SMR4_ADDR A:0xfc522810
y.create.l HWIO_PCIE_VMIDMT_SMR5_ADDR A:0xfc522814
y.create.l HWIO_PCIE_VMIDMT_SMR6_ADDR A:0xfc522818
y.create.l HWIO_PCIE_VMIDMT_SMR7_ADDR A:0xfc52281c
y.create.l HWIO_PCIE_APU_XPU_SCR_ADDR A:0xfc523000
y.create.l HWIO_PCIE_APU_XPU_SWDR_ADDR A:0xfc523004
y.create.l HWIO_PCIE_APU_XPU_SEAR0_ADDR A:0xfc523040
y.create.l HWIO_PCIE_APU_XPU_SESR_ADDR A:0xfc523048
y.create.l HWIO_PCIE_APU_XPU_SESRRESTORE_ADDR A:0xfc52304c
y.create.l HWIO_PCIE_APU_XPU_SESYNR0_ADDR A:0xfc523050
y.create.l HWIO_PCIE_APU_XPU_SESYNR1_ADDR A:0xfc523054
y.create.l HWIO_PCIE_APU_XPU_SESYNR2_ADDR A:0xfc523058
y.create.l HWIO_PCIE_APU_XPU_MCR_ADDR A:0xfc523100
y.create.l HWIO_PCIE_APU_XPU_MEAR0_ADDR A:0xfc523140
y.create.l HWIO_PCIE_APU_XPU_MESR_ADDR A:0xfc523148
y.create.l HWIO_PCIE_APU_XPU_MESRRESTORE_ADDR A:0xfc52314c
y.create.l HWIO_PCIE_APU_XPU_MESYNR0_ADDR A:0xfc523150
y.create.l HWIO_PCIE_APU_XPU_MESYNR1_ADDR A:0xfc523154
y.create.l HWIO_PCIE_APU_XPU_MESYNR2_ADDR A:0xfc523158
y.create.l HWIO_PCIE_APU_XPU_CR_ADDR A:0xfc523080
y.create.l HWIO_PCIE_APU_XPU_RPU_ACR0_ADDR A:0xfc5230a0
y.create.l HWIO_PCIE_APU_XPU_EAR0_ADDR A:0xfc5230c0
y.create.l HWIO_PCIE_APU_XPU_ESR_ADDR A:0xfc5230c8
y.create.l HWIO_PCIE_APU_XPU_ESRRESTORE_ADDR A:0xfc5230cc
y.create.l HWIO_PCIE_APU_XPU_ESYNR0_ADDR A:0xfc5230d0
y.create.l HWIO_PCIE_APU_XPU_ESYNR1_ADDR A:0xfc5230d4
y.create.l HWIO_PCIE_APU_XPU_ESYNR2_ADDR A:0xfc5230d8
y.create.l HWIO_PCIE_APU_XPU_IDR0_ADDR A:0xfc523074
y.create.l HWIO_PCIE_APU_XPU_IDR1_ADDR A:0xfc523078
y.create.l HWIO_PCIE_APU_XPU_REV_ADDR A:0xfc52307c
y.create.l HWIO_PCIE_APU_XPU_RG0_RACR0_ADDR A:0xfc523200
y.create.l HWIO_PCIE_APU_XPU_RG1_RACR0_ADDR A:0xfc523280
y.create.l HWIO_PCIE_APU_XPU_RG2_RACR0_ADDR A:0xfc523300
y.create.l HWIO_PCIE_APU_XPU_RG3_RACR0_ADDR A:0xfc523380
y.create.l HWIO_PCIE_APU_XPU_RG4_RACR0_ADDR A:0xfc523400
y.create.l HWIO_PCIE_APU_XPU_RG5_RACR0_ADDR A:0xfc523480
y.create.l HWIO_PCIE_APU_XPU_RG0_SCR_ADDR A:0xfc523250
y.create.l HWIO_PCIE_APU_XPU_RG1_SCR_ADDR A:0xfc5232d0
y.create.l HWIO_PCIE_APU_XPU_RG2_SCR_ADDR A:0xfc523350
y.create.l HWIO_PCIE_APU_XPU_RG3_SCR_ADDR A:0xfc5233d0
y.create.l HWIO_PCIE_APU_XPU_RG4_SCR_ADDR A:0xfc523450
y.create.l HWIO_PCIE_APU_XPU_RG5_SCR_ADDR A:0xfc5234d0
y.create.l HWIO_PCIE_APU_XPU_RG0_MCR_ADDR A:0xfc523254
y.create.l HWIO_PCIE_APU_XPU_RG1_MCR_ADDR A:0xfc5232d4
y.create.l HWIO_PCIE_APU_XPU_RG2_MCR_ADDR A:0xfc523354
y.create.l HWIO_PCIE_APU_XPU_RG3_MCR_ADDR A:0xfc5233d4
y.create.l HWIO_PCIE_APU_XPU_RG4_MCR_ADDR A:0xfc523454
y.create.l HWIO_PCIE_APU_XPU_RG5_MCR_ADDR A:0xfc5234d4
y.create.l HWIO_PCIE_MPU_XPU_SCR_ADDR A:0xfc524000
y.create.l HWIO_PCIE_MPU_XPU_SWDR_ADDR A:0xfc524004
y.create.l HWIO_PCIE_MPU_XPU_PRTN_RACR_SSHADOW_ADDR A:0xfc524008
y.create.l HWIO_PCIE_MPU_XPU_PRTN_START_SSHADOW0_ADDR A:0xfc524010
y.create.l HWIO_PCIE_MPU_XPU_PRTN_END_SSHADOW0_ADDR A:0xfc524018
y.create.l HWIO_PCIE_MPU_XPU_SEAR0_ADDR A:0xfc524040
y.create.l HWIO_PCIE_MPU_XPU_SESR_ADDR A:0xfc524048
y.create.l HWIO_PCIE_MPU_XPU_SESRRESTORE_ADDR A:0xfc52404c
y.create.l HWIO_PCIE_MPU_XPU_SESYNR0_ADDR A:0xfc524050
y.create.l HWIO_PCIE_MPU_XPU_SESYNR1_ADDR A:0xfc524054
y.create.l HWIO_PCIE_MPU_XPU_SESYNR2_ADDR A:0xfc524058
y.create.l HWIO_PCIE_MPU_XPU_MCR_ADDR A:0xfc524100
y.create.l HWIO_PCIE_MPU_XPU_MEAR0_ADDR A:0xfc524140
y.create.l HWIO_PCIE_MPU_XPU_MESR_ADDR A:0xfc524148
y.create.l HWIO_PCIE_MPU_XPU_MESRRESTORE_ADDR A:0xfc52414c
y.create.l HWIO_PCIE_MPU_XPU_MESYNR0_ADDR A:0xfc524150
y.create.l HWIO_PCIE_MPU_XPU_MESYNR1_ADDR A:0xfc524154
y.create.l HWIO_PCIE_MPU_XPU_MESYNR2_ADDR A:0xfc524158
y.create.l HWIO_PCIE_MPU_XPU_CR_ADDR A:0xfc524080
y.create.l HWIO_PCIE_MPU_XPU_PRTN_RACR_SHADOW_ADDR A:0xfc524088
y.create.l HWIO_PCIE_MPU_XPU_PRTN_START_SHADOW0_ADDR A:0xfc524090
y.create.l HWIO_PCIE_MPU_XPU_PRTN_END_SHADOW0_ADDR A:0xfc524098
y.create.l HWIO_PCIE_MPU_XPU_RPU_ACR0_ADDR A:0xfc5240a0
y.create.l HWIO_PCIE_MPU_XPU_EAR0_ADDR A:0xfc5240c0
y.create.l HWIO_PCIE_MPU_XPU_ESR_ADDR A:0xfc5240c8
y.create.l HWIO_PCIE_MPU_XPU_ESRRESTORE_ADDR A:0xfc5240cc
y.create.l HWIO_PCIE_MPU_XPU_ESYNR0_ADDR A:0xfc5240d0
y.create.l HWIO_PCIE_MPU_XPU_ESYNR1_ADDR A:0xfc5240d4
y.create.l HWIO_PCIE_MPU_XPU_ESYNR2_ADDR A:0xfc5240d8
y.create.l HWIO_PCIE_MPU_XPU_UMR_RACR_ADDR A:0xfc5240e0
y.create.l HWIO_PCIE_MPU_XPU_UMR_WACR_ADDR A:0xfc5240e4
y.create.l HWIO_PCIE_MPU_XPU_IDR0_ADDR A:0xfc524074
y.create.l HWIO_PCIE_MPU_XPU_IDR1_ADDR A:0xfc524078
y.create.l HWIO_PCIE_MPU_XPU_REV_ADDR A:0xfc52407c
y.create.l HWIO_PCIE_MPU_XPU_PRT0_RACR0_ADDR A:0xfc524200
y.create.l HWIO_PCIE_MPU_XPU_PRT1_RACR0_ADDR A:0xfc524280
y.create.l HWIO_PCIE_MPU_XPU_PRT2_RACR0_ADDR A:0xfc524300
y.create.l HWIO_PCIE_MPU_XPU_PRT3_RACR0_ADDR A:0xfc524380
y.create.l HWIO_PCIE_MPU_XPU_PRT4_RACR0_ADDR A:0xfc524400
y.create.l HWIO_PCIE_MPU_XPU_PRT5_RACR0_ADDR A:0xfc524480
y.create.l HWIO_PCIE_MPU_XPU_PRT6_RACR0_ADDR A:0xfc524500
y.create.l HWIO_PCIE_MPU_XPU_PRT7_RACR0_ADDR A:0xfc524580
y.create.l HWIO_PCIE_MPU_XPU_PRT8_RACR0_ADDR A:0xfc524600
y.create.l HWIO_PCIE_MPU_XPU_PRT9_RACR0_ADDR A:0xfc524680
y.create.l HWIO_PCIE_MPU_XPU_PRT0_START0_ADDR A:0xfc524240
y.create.l HWIO_PCIE_MPU_XPU_PRT1_START0_ADDR A:0xfc5242c0
y.create.l HWIO_PCIE_MPU_XPU_PRT2_START0_ADDR A:0xfc524340
y.create.l HWIO_PCIE_MPU_XPU_PRT3_START0_ADDR A:0xfc5243c0
y.create.l HWIO_PCIE_MPU_XPU_PRT4_START0_ADDR A:0xfc524440
y.create.l HWIO_PCIE_MPU_XPU_PRT5_START0_ADDR A:0xfc5244c0
y.create.l HWIO_PCIE_MPU_XPU_PRT6_START0_ADDR A:0xfc524540
y.create.l HWIO_PCIE_MPU_XPU_PRT7_START0_ADDR A:0xfc5245c0
y.create.l HWIO_PCIE_MPU_XPU_PRT8_START0_ADDR A:0xfc524640
y.create.l HWIO_PCIE_MPU_XPU_PRT9_START0_ADDR A:0xfc5246c0
y.create.l HWIO_PCIE_MPU_XPU_PRT0_END0_ADDR A:0xfc524248
y.create.l HWIO_PCIE_MPU_XPU_PRT1_END0_ADDR A:0xfc5242c8
y.create.l HWIO_PCIE_MPU_XPU_PRT2_END0_ADDR A:0xfc524348
y.create.l HWIO_PCIE_MPU_XPU_PRT3_END0_ADDR A:0xfc5243c8
y.create.l HWIO_PCIE_MPU_XPU_PRT4_END0_ADDR A:0xfc524448
y.create.l HWIO_PCIE_MPU_XPU_PRT5_END0_ADDR A:0xfc5244c8
y.create.l HWIO_PCIE_MPU_XPU_PRT6_END0_ADDR A:0xfc524548
y.create.l HWIO_PCIE_MPU_XPU_PRT7_END0_ADDR A:0xfc5245c8
y.create.l HWIO_PCIE_MPU_XPU_PRT8_END0_ADDR A:0xfc524648
y.create.l HWIO_PCIE_MPU_XPU_PRT9_END0_ADDR A:0xfc5246c8
y.create.l HWIO_PCIE_MPU_XPU_PRT0_SCR_ADDR A:0xfc524250
y.create.l HWIO_PCIE_MPU_XPU_PRT1_SCR_ADDR A:0xfc5242d0
y.create.l HWIO_PCIE_MPU_XPU_PRT2_SCR_ADDR A:0xfc524350
y.create.l HWIO_PCIE_MPU_XPU_PRT3_SCR_ADDR A:0xfc5243d0
y.create.l HWIO_PCIE_MPU_XPU_PRT4_SCR_ADDR A:0xfc524450
y.create.l HWIO_PCIE_MPU_XPU_PRT5_SCR_ADDR A:0xfc5244d0
y.create.l HWIO_PCIE_MPU_XPU_PRT6_SCR_ADDR A:0xfc524550
y.create.l HWIO_PCIE_MPU_XPU_PRT7_SCR_ADDR A:0xfc5245d0
y.create.l HWIO_PCIE_MPU_XPU_PRT8_SCR_ADDR A:0xfc524650
y.create.l HWIO_PCIE_MPU_XPU_PRT9_SCR_ADDR A:0xfc5246d0
y.create.l HWIO_PCIE_MPU_XPU_PRT0_MCR_ADDR A:0xfc524254
y.create.l HWIO_PCIE_MPU_XPU_PRT1_MCR_ADDR A:0xfc5242d4
y.create.l HWIO_PCIE_MPU_XPU_PRT2_MCR_ADDR A:0xfc524354
y.create.l HWIO_PCIE_MPU_XPU_PRT3_MCR_ADDR A:0xfc5243d4
y.create.l HWIO_PCIE_MPU_XPU_PRT4_MCR_ADDR A:0xfc524454
y.create.l HWIO_PCIE_MPU_XPU_PRT5_MCR_ADDR A:0xfc5244d4
y.create.l HWIO_PCIE_MPU_XPU_PRT6_MCR_ADDR A:0xfc524554
y.create.l HWIO_PCIE_MPU_XPU_PRT7_MCR_ADDR A:0xfc5245d4
y.create.l HWIO_PCIE_MPU_XPU_PRT8_MCR_ADDR A:0xfc524654
y.create.l HWIO_PCIE_MPU_XPU_PRT9_MCR_ADDR A:0xfc5246d4
y.create.l HWIO_PCIE_MPU_XPU_PRT0_CNTL0_ADDR A:0xfc524258
y.create.l HWIO_PCIE_MPU_XPU_PRT1_CNTL0_ADDR A:0xfc5242d8
y.create.l HWIO_PCIE_MPU_XPU_PRT2_CNTL0_ADDR A:0xfc524358
y.create.l HWIO_PCIE_MPU_XPU_PRT3_CNTL0_ADDR A:0xfc5243d8
y.create.l HWIO_PCIE_MPU_XPU_PRT4_CNTL0_ADDR A:0xfc524458
y.create.l HWIO_PCIE_MPU_XPU_PRT5_CNTL0_ADDR A:0xfc5244d8
y.create.l HWIO_PCIE_MPU_XPU_PRT6_CNTL0_ADDR A:0xfc524558
y.create.l HWIO_PCIE_MPU_XPU_PRT7_CNTL0_ADDR A:0xfc5245d8
y.create.l HWIO_PCIE_MPU_XPU_PRT8_CNTL0_ADDR A:0xfc524658
y.create.l HWIO_PCIE_MPU_XPU_PRT9_CNTL0_ADDR A:0xfc5246d8
y.create.l HWIO_PCIE_MPU_XPU_PRT0_CNTL1_ADDR A:0xfc52425c
y.create.l HWIO_PCIE_MPU_XPU_PRT1_CNTL1_ADDR A:0xfc5242dc
y.create.l HWIO_PCIE_MPU_XPU_PRT2_CNTL1_ADDR A:0xfc52435c
y.create.l HWIO_PCIE_MPU_XPU_PRT3_CNTL1_ADDR A:0xfc5243dc
y.create.l HWIO_PCIE_MPU_XPU_PRT4_CNTL1_ADDR A:0xfc52445c
y.create.l HWIO_PCIE_MPU_XPU_PRT5_CNTL1_ADDR A:0xfc5244dc
y.create.l HWIO_PCIE_MPU_XPU_PRT6_CNTL1_ADDR A:0xfc52455c
y.create.l HWIO_PCIE_MPU_XPU_PRT7_CNTL1_ADDR A:0xfc5245dc
y.create.l HWIO_PCIE_MPU_XPU_PRT8_CNTL1_ADDR A:0xfc52465c
y.create.l HWIO_PCIE_MPU_XPU_PRT9_CNTL1_ADDR A:0xfc5246dc
y.create.l HWIO_PCIE_QSERDES_COM_SYS_CLK_CTRL_ADDR A:0xfc526000
y.create.l HWIO_PCIE_QSERDES_COM_PLL_VCOTAIL_EN_ADDR A:0xfc526004
y.create.l HWIO_PCIE_QSERDES_COM_CMN_MODE_ADDR A:0xfc526008
y.create.l HWIO_PCIE_QSERDES_COM_IE_TRIM_ADDR A:0xfc52600c
y.create.l HWIO_PCIE_QSERDES_COM_IP_TRIM_ADDR A:0xfc526010
y.create.l HWIO_PCIE_QSERDES_COM_PLL_CNTRL_ADDR A:0xfc526014
y.create.l HWIO_PCIE_QSERDES_COM_PLL_PHSEL_CONTROL_ADDR A:0xfc526018
y.create.l HWIO_PCIE_QSERDES_COM_IPTAT_TRIM_VCCA_TX_SEL_ADDR A:0xfc52601c
y.create.l HWIO_PCIE_QSERDES_COM_PLL_PHSEL_DC_ADDR A:0xfc526020
y.create.l HWIO_PCIE_QSERDES_COM_PLL_IP_SETI_ADDR A:0xfc526024
y.create.l HWIO_PCIE_QSERDES_COM_CORE_CLK_IN_SYNC_SEL_ADDR A:0xfc526028
y.create.l HWIO_PCIE_QSERDES_COM_PLL_BKG_KVCO_CAL_EN_ADDR A:0xfc52602c
y.create.l HWIO_PCIE_QSERDES_COM_BIAS_EN_CLKBUFLR_EN_ADDR A:0xfc526030
y.create.l HWIO_PCIE_QSERDES_COM_PLL_CP_SETI_ADDR A:0xfc526034
y.create.l HWIO_PCIE_QSERDES_COM_PLL_IP_SETP_ADDR A:0xfc526038
y.create.l HWIO_PCIE_QSERDES_COM_PLL_CP_SETP_ADDR A:0xfc52603c
y.create.l HWIO_PCIE_QSERDES_COM_ATB_SEL1_ADDR A:0xfc526040
y.create.l HWIO_PCIE_QSERDES_COM_ATB_SEL2_ADDR A:0xfc526044
y.create.l HWIO_PCIE_QSERDES_COM_SYSCLK_EN_SEL_TXBAND_ADDR A:0xfc526048
y.create.l HWIO_PCIE_QSERDES_COM_RESETSM_CNTRL_ADDR A:0xfc52604c
y.create.l HWIO_PCIE_QSERDES_COM_RESETSM_CNTRL2_ADDR A:0xfc526050
y.create.l HWIO_PCIE_QSERDES_COM_RESETSM_CNTRL3_ADDR A:0xfc526054
y.create.l HWIO_PCIE_QSERDES_COM_DIV_REF1_ADDR A:0xfc526058
y.create.l HWIO_PCIE_QSERDES_COM_DIV_REF2_ADDR A:0xfc52605c
y.create.l HWIO_PCIE_QSERDES_COM_KVCO_COUNT1_ADDR A:0xfc526060
y.create.l HWIO_PCIE_QSERDES_COM_KVCO_COUNT2_ADDR A:0xfc526064
y.create.l HWIO_PCIE_QSERDES_COM_KVCO_CAL_CNTRL_ADDR A:0xfc526068
y.create.l HWIO_PCIE_QSERDES_COM_KVCO_CODE_ADDR A:0xfc52606c
y.create.l HWIO_PCIE_QSERDES_COM_VREF_CFG1_ADDR A:0xfc526070
y.create.l HWIO_PCIE_QSERDES_COM_VREF_CFG2_ADDR A:0xfc526074
y.create.l HWIO_PCIE_QSERDES_COM_VREF_CFG3_ADDR A:0xfc526078
y.create.l HWIO_PCIE_QSERDES_COM_VREF_CFG4_ADDR A:0xfc52607c
y.create.l HWIO_PCIE_QSERDES_COM_VREF_CFG5_ADDR A:0xfc526080
y.create.l HWIO_PCIE_QSERDES_COM_VREF_CFG6_ADDR A:0xfc526084
y.create.l HWIO_PCIE_QSERDES_COM_PLLLOCK_CMP1_ADDR A:0xfc526088
y.create.l HWIO_PCIE_QSERDES_COM_PLLLOCK_CMP2_ADDR A:0xfc52608c
y.create.l HWIO_PCIE_QSERDES_COM_PLLLOCK_CMP3_ADDR A:0xfc526090
y.create.l HWIO_PCIE_QSERDES_COM_PLLLOCK_CMP_EN_ADDR A:0xfc526094
y.create.l HWIO_PCIE_QSERDES_COM_BGTC_ADDR A:0xfc526098
y.create.l HWIO_PCIE_QSERDES_COM_PLL_TEST_UPDN_ADDR A:0xfc52609c
y.create.l HWIO_PCIE_QSERDES_COM_PLL_VCO_TUNE_ADDR A:0xfc5260a0
y.create.l HWIO_PCIE_QSERDES_COM_DEC_START1_ADDR A:0xfc5260a4
y.create.l HWIO_PCIE_QSERDES_COM_PLL_AMP_OS_ADDR A:0xfc5260a8
y.create.l HWIO_PCIE_QSERDES_COM_SSC_EN_CENTER_ADDR A:0xfc5260ac
y.create.l HWIO_PCIE_QSERDES_COM_SSC_ADJ_PER1_ADDR A:0xfc5260b0
y.create.l HWIO_PCIE_QSERDES_COM_SSC_ADJ_PER2_ADDR A:0xfc5260b4
y.create.l HWIO_PCIE_QSERDES_COM_SSC_PER1_ADDR A:0xfc5260b8
y.create.l HWIO_PCIE_QSERDES_COM_SSC_PER2_ADDR A:0xfc5260bc
y.create.l HWIO_PCIE_QSERDES_COM_SSC_STEP_SIZE1_ADDR A:0xfc5260c0
y.create.l HWIO_PCIE_QSERDES_COM_SSC_STEP_SIZE2_ADDR A:0xfc5260c4
y.create.l HWIO_PCIE_QSERDES_COM_RES_CODE_UP_ADDR A:0xfc5260c8
y.create.l HWIO_PCIE_QSERDES_COM_RES_CODE_DN_ADDR A:0xfc5260cc
y.create.l HWIO_PCIE_QSERDES_COM_RES_CODE_UP_OFFSET_ADDR A:0xfc5260d0
y.create.l HWIO_PCIE_QSERDES_COM_RES_CODE_DN_OFFSET_ADDR A:0xfc5260d4
y.create.l HWIO_PCIE_QSERDES_COM_RES_CODE_START_SEG1_ADDR A:0xfc5260d8
y.create.l HWIO_PCIE_QSERDES_COM_RES_CODE_START_SEG2_ADDR A:0xfc5260dc
y.create.l HWIO_PCIE_QSERDES_COM_RES_CODE_CAL_CSR_ADDR A:0xfc5260e0
y.create.l HWIO_PCIE_QSERDES_COM_RES_CODE_ADDR A:0xfc5260e4
y.create.l HWIO_PCIE_QSERDES_COM_RES_TRIM_CONTROL_ADDR A:0xfc5260e8
y.create.l HWIO_PCIE_QSERDES_COM_RES_TRIM_CONTROL2_ADDR A:0xfc5260ec
y.create.l HWIO_PCIE_QSERDES_COM_RES_TRIM_EN_VCOCALDONE_ADDR A:0xfc5260f0
y.create.l HWIO_PCIE_QSERDES_COM_FAUX_EN_ADDR A:0xfc5260f4
y.create.l HWIO_PCIE_QSERDES_COM_DIV_FRAC_START1_ADDR A:0xfc5260f8
y.create.l HWIO_PCIE_QSERDES_COM_DIV_FRAC_START2_ADDR A:0xfc5260fc
y.create.l HWIO_PCIE_QSERDES_COM_DIV_FRAC_START3_ADDR A:0xfc526100
y.create.l HWIO_PCIE_QSERDES_COM_DEC_START2_ADDR A:0xfc526104
y.create.l HWIO_PCIE_QSERDES_COM_PLL_RXTXEPCLK_EN_ADDR A:0xfc526108
y.create.l HWIO_PCIE_QSERDES_COM_PLL_CRCTRL_ADDR A:0xfc52610c
y.create.l HWIO_PCIE_QSERDES_COM_PLL_CLKEPDIV_ADDR A:0xfc526110
y.create.l HWIO_PCIE_QSERDES_COM_PLL_FREQUPDATE_ADDR A:0xfc526114
y.create.l HWIO_PCIE_QSERDES_COM_PLL_BKGCAL_TRIM_UP_ADDR A:0xfc526118
y.create.l HWIO_PCIE_QSERDES_COM_PLL_BKGCAL_TRIM_DN_ADDR A:0xfc52611c
y.create.l HWIO_PCIE_QSERDES_COM_PLL_BKGCAL_TRIM_MUX_ADDR A:0xfc526120
y.create.l HWIO_PCIE_QSERDES_COM_PLL_BKGCAL_VREF_CFG_ADDR A:0xfc526124
y.create.l HWIO_PCIE_QSERDES_COM_PLL_BKGCAL_DIV_REF1_ADDR A:0xfc526128
y.create.l HWIO_PCIE_QSERDES_COM_PLL_BKGCAL_DIV_REF2_ADDR A:0xfc52612c
y.create.l HWIO_PCIE_QSERDES_COM_MUXADDR_ADDR A:0xfc526130
y.create.l HWIO_PCIE_QSERDES_COM_LOW_POWER_RO_CONTROL_ADDR A:0xfc526134
y.create.l HWIO_PCIE_QSERDES_COM_POST_DIVIDER_CONTROL_ADDR A:0xfc526138
y.create.l HWIO_PCIE_QSERDES_COM_HR_OCLK2_DIVIDER_ADDR A:0xfc52613c
y.create.l HWIO_PCIE_QSERDES_COM_HR_OCLK3_DIVIDER_ADDR A:0xfc526140
y.create.l HWIO_PCIE_QSERDES_COM_PLL_VCO_HIGH_ADDR A:0xfc526144
y.create.l HWIO_PCIE_QSERDES_COM_RESET_SM_ADDR A:0xfc526148
y.create.l HWIO_PCIE_QSERDES_COM_MUXVAL_ADDR A:0xfc52614c
y.create.l HWIO_PCIE_QSERDES_TX_BIST_MODE_LANENO_ADDR A:0xfc526200
y.create.l HWIO_PCIE_QSERDES_TX_CLKBUF_ENABLE_ADDR A:0xfc526204
y.create.l HWIO_PCIE_QSERDES_TX_TX_EMP_POST1_LVL_ADDR A:0xfc526208
y.create.l HWIO_PCIE_QSERDES_TX_TX_DRV_LVL_ADDR A:0xfc52620c
y.create.l HWIO_PCIE_QSERDES_TX_RESET_TSYNC_EN_ADDR A:0xfc526210
y.create.l HWIO_PCIE_QSERDES_TX_LPB_EN_ADDR A:0xfc526214
y.create.l HWIO_PCIE_QSERDES_TX_RES_CODE_UP_ADDR A:0xfc526218
y.create.l HWIO_PCIE_QSERDES_TX_RES_CODE_DN_ADDR A:0xfc52621c
y.create.l HWIO_PCIE_QSERDES_TX_PERL_LENGTH1_ADDR A:0xfc526220
y.create.l HWIO_PCIE_QSERDES_TX_PERL_LENGTH2_ADDR A:0xfc526224
y.create.l HWIO_PCIE_QSERDES_TX_SERDES_BYP_EN_OUT_ADDR A:0xfc526228
y.create.l HWIO_PCIE_QSERDES_TX_HIGHZ_TRANSCEIVEREN_BIAS_DRVR_EN_ADDR A:0xfc52622c
y.create.l HWIO_PCIE_QSERDES_TX_PARRATE_REC_DETECT_IDLE_EN_ADDR A:0xfc526230
y.create.l HWIO_PCIE_QSERDES_TX_BIST_PATTERN1_ADDR A:0xfc526234
y.create.l HWIO_PCIE_QSERDES_TX_BIST_PATTERN2_ADDR A:0xfc526238
y.create.l HWIO_PCIE_QSERDES_TX_BIST_PATTERN3_ADDR A:0xfc52623c
y.create.l HWIO_PCIE_QSERDES_TX_BIST_PATTERN4_ADDR A:0xfc526240
y.create.l HWIO_PCIE_QSERDES_TX_BIST_PATTERN5_ADDR A:0xfc526244
y.create.l HWIO_PCIE_QSERDES_TX_BIST_PATTERN6_ADDR A:0xfc526248
y.create.l HWIO_PCIE_QSERDES_TX_BIST_PATTERN7_ADDR A:0xfc52624c
y.create.l HWIO_PCIE_QSERDES_TX_BIST_PATTERN8_ADDR A:0xfc526250
y.create.l HWIO_PCIE_QSERDES_TX_LANE_MODE_ADDR A:0xfc526254
y.create.l HWIO_PCIE_QSERDES_TX_IDAC_CAL_LANE_MODE_ADDR A:0xfc526258
y.create.l HWIO_PCIE_QSERDES_TX_IDAC_CAL_LANE_MODE_CONFIGURATION_ADDR A:0xfc52625c
y.create.l HWIO_PCIE_QSERDES_TX_ATB_SEL1_ADDR A:0xfc526260
y.create.l HWIO_PCIE_QSERDES_TX_ATB_SEL2_ADDR A:0xfc526264
y.create.l HWIO_PCIE_QSERDES_TX_RCV_DETECT_LVL_ADDR A:0xfc526268
y.create.l HWIO_PCIE_QSERDES_TX_PRBS_SEED1_ADDR A:0xfc52626c
y.create.l HWIO_PCIE_QSERDES_TX_PRBS_SEED2_ADDR A:0xfc526270
y.create.l HWIO_PCIE_QSERDES_TX_PRBS_SEED3_ADDR A:0xfc526274
y.create.l HWIO_PCIE_QSERDES_TX_PRBS_SEED4_ADDR A:0xfc526278
y.create.l HWIO_PCIE_QSERDES_TX_RESET_GEN_ADDR A:0xfc52627c
y.create.l HWIO_PCIE_QSERDES_TX_TRAN_DRVR_EMP_EN_ADDR A:0xfc526280
y.create.l HWIO_PCIE_QSERDES_TX_TX_INTERFACE_MODE_ADDR A:0xfc526284
y.create.l HWIO_PCIE_QSERDES_TX_PWM_CTRL_ADDR A:0xfc526288
y.create.l HWIO_PCIE_QSERDES_TX_PWM_DATA_ADDR A:0xfc52628c
y.create.l HWIO_PCIE_QSERDES_TX_PWM_ENC_DIV_CTRL_ADDR A:0xfc526290
y.create.l HWIO_PCIE_QSERDES_TX_VMODE_CTRL1_ADDR A:0xfc526294
y.create.l HWIO_PCIE_QSERDES_TX_VMODE_CTRL2_ADDR A:0xfc526298
y.create.l HWIO_PCIE_QSERDES_TX_VMODE_CTRL3_ADDR A:0xfc52629c
y.create.l HWIO_PCIE_QSERDES_TX_VMODE_CTRL4_ADDR A:0xfc5262a0
y.create.l HWIO_PCIE_QSERDES_TX_VMODE_CTRL5_ADDR A:0xfc5262a4
y.create.l HWIO_PCIE_QSERDES_TX_VMODE_CTRL6_ADDR A:0xfc5262a8
y.create.l HWIO_PCIE_QSERDES_TX_VMODE_CTRL7_ADDR A:0xfc5262ac
y.create.l HWIO_PCIE_QSERDES_TX_TX_ALOG_INTF_OBSV_CNTL_ADDR A:0xfc5262b0
y.create.l HWIO_PCIE_QSERDES_TX_BIST_STATUS_ADDR A:0xfc5262b4
y.create.l HWIO_PCIE_QSERDES_TX_BIST_ERROR_COUNT1_ADDR A:0xfc5262b8
y.create.l HWIO_PCIE_QSERDES_TX_BIST_ERROR_COUNT2_ADDR A:0xfc5262bc
y.create.l HWIO_PCIE_QSERDES_TX_TX_ALOG_INTF_OBSV_ADDR A:0xfc5262c0
y.create.l HWIO_PCIE_QSERDES_TX_PWM_DEC_STATUS_ADDR A:0xfc5262c4
y.create.l HWIO_PCIE_QSERDES_RX_CDR_CONTROL1_ADDR A:0xfc526400
y.create.l HWIO_PCIE_QSERDES_RX_CDR_CONTROL2_ADDR A:0xfc526404
y.create.l HWIO_PCIE_QSERDES_RX_CDR_CONTROL_HALF_ADDR A:0xfc526408
y.create.l HWIO_PCIE_QSERDES_RX_CDR_CONTROL_QUARTER_ADDR A:0xfc52640c
y.create.l HWIO_PCIE_QSERDES_RX_CDR_CONTROL_EIGHTH_ADDR A:0xfc526410
y.create.l HWIO_PCIE_QSERDES_RX_UCDR_FO_GAIN_ADDR A:0xfc526414
y.create.l HWIO_PCIE_QSERDES_RX_UCDR_SO_GAIN_ADDR A:0xfc526418
y.create.l HWIO_PCIE_QSERDES_RX_UCDR_SO_SATURATION_AND_ENABLE_ADDR A:0xfc52641c
y.create.l HWIO_PCIE_QSERDES_RX_UCDR_FO_TO_SO_DELAY_ADDR A:0xfc526420
y.create.l HWIO_PCIE_QSERDES_RX_AUX_CONTROL_ADDR A:0xfc526424
y.create.l HWIO_PCIE_QSERDES_RX_AUX_DATA_TCOARSE_ADDR A:0xfc526428
y.create.l HWIO_PCIE_QSERDES_RX_AUX_DATA_TFINE_LSB_ADDR A:0xfc52642c
y.create.l HWIO_PCIE_QSERDES_RX_AUX_DATA_TFINE_MSB_ADDR A:0xfc526430
y.create.l HWIO_PCIE_QSERDES_RX_RCLK_AUXDATA_SEL_ADDR A:0xfc526434
y.create.l HWIO_PCIE_QSERDES_RX_AC_JTAG_ENABLE_ADDR A:0xfc526438
y.create.l HWIO_PCIE_QSERDES_RX_AC_JTAG_INITP_ADDR A:0xfc52643c
y.create.l HWIO_PCIE_QSERDES_RX_AC_JTAG_INITN_ADDR A:0xfc526440
y.create.l HWIO_PCIE_QSERDES_RX_AC_JTAG_LVL_ADDR A:0xfc526444
y.create.l HWIO_PCIE_QSERDES_RX_AC_JTAG_MODE_ADDR A:0xfc526448
y.create.l HWIO_PCIE_QSERDES_RX_AC_JTAG_RESET_ADDR A:0xfc52644c
y.create.l HWIO_PCIE_QSERDES_RX_RX_RCVR_IQ_EN_ADDR A:0xfc526450
y.create.l HWIO_PCIE_QSERDES_RX_RX_IDAC_I_DC_OFFSETS_ADDR A:0xfc526454
y.create.l HWIO_PCIE_QSERDES_RX_RX_IDAC_Q_DC_OFFSETS_ADDR A:0xfc526458
y.create.l HWIO_PCIE_QSERDES_RX_RX_IDAC_A_DC_OFFSETS_ADDR A:0xfc52645c
y.create.l HWIO_PCIE_QSERDES_RX_RX_IDAC_EN_ADDR A:0xfc526460
y.create.l HWIO_PCIE_QSERDES_RX_RX_IDAC_CTRL0_ADDR A:0xfc526464
y.create.l HWIO_PCIE_QSERDES_RX_RX_IDAC_CTRL1_ADDR A:0xfc526468
y.create.l HWIO_PCIE_QSERDES_RX_RX_EOM_EN_ADDR A:0xfc52646c
y.create.l HWIO_PCIE_QSERDES_RX_RX_EOM_CTRL0_ADDR A:0xfc526470
y.create.l HWIO_PCIE_QSERDES_RX_RX_EOM_CTRL1_ADDR A:0xfc526474
y.create.l HWIO_PCIE_QSERDES_RX_RX_EOM_CTRL2_ADDR A:0xfc526478
y.create.l HWIO_PCIE_QSERDES_RX_RX_EOM_CTRL3_ADDR A:0xfc52647c
y.create.l HWIO_PCIE_QSERDES_RX_RX_EOM_CTRL4_ADDR A:0xfc526480
y.create.l HWIO_PCIE_QSERDES_RX_RX_EOM_CTRL5_ADDR A:0xfc526484
y.create.l HWIO_PCIE_QSERDES_RX_RX_EOM_CTRL6_ADDR A:0xfc526488
y.create.l HWIO_PCIE_QSERDES_RX_RX_EOM_CTRL7_ADDR A:0xfc52648c
y.create.l HWIO_PCIE_QSERDES_RX_RX_EOM_CTRL8_ADDR A:0xfc526490
y.create.l HWIO_PCIE_QSERDES_RX_RX_EOM_CTRL9_ADDR A:0xfc526494
y.create.l HWIO_PCIE_QSERDES_RX_RX_EOM_CTRL10_ADDR A:0xfc526498
y.create.l HWIO_PCIE_QSERDES_RX_RX_EOM_CTRL11_ADDR A:0xfc52649c
y.create.l HWIO_PCIE_QSERDES_RX_RX_HIGHZ_HIGHRATE_ADDR A:0xfc5264a0
y.create.l HWIO_PCIE_QSERDES_RX_RX_TERM_AC_BYPASS_DC_COUPLE_OFFSET_ADDR A:0xfc5264a4
y.create.l HWIO_PCIE_QSERDES_RX_RX_EQ_GAIN1_LSB_ADDR A:0xfc5264a8
y.create.l HWIO_PCIE_QSERDES_RX_RX_EQ_GAIN1_MSB_ADDR A:0xfc5264ac
y.create.l HWIO_PCIE_QSERDES_RX_RX_EQ_GAIN2_LSB_ADDR A:0xfc5264b0
y.create.l HWIO_PCIE_QSERDES_RX_RX_EQ_GAIN2_MSB_ADDR A:0xfc5264b4
y.create.l HWIO_PCIE_QSERDES_RX_RX_EQU_ADAPTOR_CNTRL1_ADDR A:0xfc5264b8
y.create.l HWIO_PCIE_QSERDES_RX_RX_EQU_ADAPTOR_CNTRL2_ADDR A:0xfc5264bc
y.create.l HWIO_PCIE_QSERDES_RX_RX_EQU_ADAPTOR_CNTRL3_ADDR A:0xfc5264c0
y.create.l HWIO_PCIE_QSERDES_RX_RX_EQU_ADAPTOR_CNTRL4_ADDR A:0xfc5264c4
y.create.l HWIO_PCIE_QSERDES_RX_RX_IDAC_CAL_CONFIGURATION_ADDR A:0xfc5264c8
y.create.l HWIO_PCIE_QSERDES_RX_RX_IDAC_CAL_CONFIGURATION_2_ADDR A:0xfc5264cc
y.create.l HWIO_PCIE_QSERDES_RX_RX_IDAC_TSETTLE_LOW_ADDR A:0xfc5264d0
y.create.l HWIO_PCIE_QSERDES_RX_RX_IDAC_TSETTLE_HIGH_ADDR A:0xfc5264d4
y.create.l HWIO_PCIE_QSERDES_RX_RX_IDAC_ENDSAMP_LOW_ADDR A:0xfc5264d8
y.create.l HWIO_PCIE_QSERDES_RX_RX_IDAC_ENDSAMP_HIGH_ADDR A:0xfc5264dc
y.create.l HWIO_PCIE_QSERDES_RX_RX_IDAC_MIDPOINT_LOW_ADDR A:0xfc5264e0
y.create.l HWIO_PCIE_QSERDES_RX_RX_IDAC_MIDPOINT_HIGH_ADDR A:0xfc5264e4
y.create.l HWIO_PCIE_QSERDES_RX_RX_EQ_OFFSET_LSB_ADDR A:0xfc5264e8
y.create.l HWIO_PCIE_QSERDES_RX_RX_EQ_OFFSET_MSB_ADDR A:0xfc5264ec
y.create.l HWIO_PCIE_QSERDES_RX_RX_EQ_OFFSET_ADAPTOR_CNTRL1_ADDR A:0xfc5264f0
y.create.l HWIO_PCIE_QSERDES_RX_RX_OFFSET_ADAPTOR_CNTRL2_ADDR A:0xfc5264f4
y.create.l HWIO_PCIE_QSERDES_RX_SIGDET_ENABLES_ADDR A:0xfc5264f8
y.create.l HWIO_PCIE_QSERDES_RX_SIGDET_ENABLES_2_ADDR A:0xfc5264fc
y.create.l HWIO_PCIE_QSERDES_RX_SIGDET_CNTRL_ADDR A:0xfc526500
y.create.l HWIO_PCIE_QSERDES_RX_SIGDET_DEGLITCH_CNTRL_ADDR A:0xfc526504
y.create.l HWIO_PCIE_QSERDES_RX_SIGDET_TIMER_LIMIT_ADDR A:0xfc526508
y.create.l HWIO_PCIE_QSERDES_RX_RX_BAND_ADDR A:0xfc52650c
y.create.l HWIO_PCIE_QSERDES_RX_CDR_FREEZE_UP_DN_ADDR A:0xfc526510
y.create.l HWIO_PCIE_QSERDES_RX_RX_INTERFACE_MODE_ADDR A:0xfc526514
y.create.l HWIO_PCIE_QSERDES_RX_JITTER_GEN_MODE_ADDR A:0xfc526518
y.create.l HWIO_PCIE_QSERDES_RX_BUJ_AMP_ADDR A:0xfc52651c
y.create.l HWIO_PCIE_QSERDES_RX_SJ_AMP1_ADDR A:0xfc526520
y.create.l HWIO_PCIE_QSERDES_RX_SJ_AMP2_ADDR A:0xfc526524
y.create.l HWIO_PCIE_QSERDES_RX_SJ_PER1_ADDR A:0xfc526528
y.create.l HWIO_PCIE_QSERDES_RX_SJ_PER2_ADDR A:0xfc52652c
y.create.l HWIO_PCIE_QSERDES_RX_BUJ_STEP_FREQ1_ADDR A:0xfc526530
y.create.l HWIO_PCIE_QSERDES_RX_BUJ_STEP_FREQ2_ADDR A:0xfc526534
y.create.l HWIO_PCIE_QSERDES_RX_PPM_OFFSET1_ADDR A:0xfc526538
y.create.l HWIO_PCIE_QSERDES_RX_PPM_OFFSET2_ADDR A:0xfc52653c
y.create.l HWIO_PCIE_QSERDES_RX_SIGN_PPM_PERIOD1_ADDR A:0xfc526540
y.create.l HWIO_PCIE_QSERDES_RX_SIGN_PPM_PERIOD2_ADDR A:0xfc526544
y.create.l HWIO_PCIE_QSERDES_RX_SSC_CTRL_ADDR A:0xfc526548
y.create.l HWIO_PCIE_QSERDES_RX_SSC_COUNT1_ADDR A:0xfc52654c
y.create.l HWIO_PCIE_QSERDES_RX_SSC_COUNT2_ADDR A:0xfc526550
y.create.l HWIO_PCIE_QSERDES_RX_RX_ALOG_INTF_OBSV_CNTL_ADDR A:0xfc526554
y.create.l HWIO_PCIE_QSERDES_RX_PI_CTRL1_ADDR A:0xfc526558
y.create.l HWIO_PCIE_QSERDES_RX_PI_CTRL2_ADDR A:0xfc52655c
y.create.l HWIO_PCIE_QSERDES_RX_PI_QUAD_ADDR A:0xfc526560
y.create.l HWIO_PCIE_QSERDES_RX_IDATA1_ADDR A:0xfc526564
y.create.l HWIO_PCIE_QSERDES_RX_IDATA2_ADDR A:0xfc526568
y.create.l HWIO_PCIE_QSERDES_RX_AUX_DATA1_ADDR A:0xfc52656c
y.create.l HWIO_PCIE_QSERDES_RX_AUX_DATA2_ADDR A:0xfc526570
y.create.l HWIO_PCIE_QSERDES_RX_AC_JTAG_OUTP_ADDR A:0xfc526574
y.create.l HWIO_PCIE_QSERDES_RX_AC_JTAG_OUTN_ADDR A:0xfc526578
y.create.l HWIO_PCIE_QSERDES_RX_RX_SIGDET_ADDR A:0xfc52657c
y.create.l HWIO_PCIE_QSERDES_RX_RX_VDCOFF_ADDR A:0xfc526580
y.create.l HWIO_PCIE_QSERDES_RX_IDAC_CAL_ON_ADDR A:0xfc526584
y.create.l HWIO_PCIE_QSERDES_RX_IDAC_STATUS_I_ADDR A:0xfc526588
y.create.l HWIO_PCIE_QSERDES_RX_IDAC_STATUS_Q_ADDR A:0xfc52658c
y.create.l HWIO_PCIE_QSERDES_RX_IDAC_STATUS_A_ADDR A:0xfc526590
y.create.l HWIO_PCIE_QSERDES_RX_CALST_STATUS_I_ADDR A:0xfc526594
y.create.l HWIO_PCIE_QSERDES_RX_CALST_STATUS_Q_ADDR A:0xfc526598
y.create.l HWIO_PCIE_QSERDES_RX_CALST_STATUS_A_ADDR A:0xfc52659c
y.create.l HWIO_PCIE_QSERDES_RX_EOM_STATUS0_ADDR A:0xfc5265a0
y.create.l HWIO_PCIE_QSERDES_RX_EOM_STATUS1_ADDR A:0xfc5265a4
y.create.l HWIO_PCIE_QSERDES_RX_EOM_STATUS2_ADDR A:0xfc5265a8
y.create.l HWIO_PCIE_QSERDES_RX_EOM_STATUS3_ADDR A:0xfc5265ac
y.create.l HWIO_PCIE_QSERDES_RX_EOM_STATUS4_ADDR A:0xfc5265b0
y.create.l HWIO_PCIE_QSERDES_RX_EOM_STATUS5_ADDR A:0xfc5265b4
y.create.l HWIO_PCIE_QSERDES_RX_EOM_STATUS6_ADDR A:0xfc5265b8
y.create.l HWIO_PCIE_QSERDES_RX_EOM_STATUS7_ADDR A:0xfc5265bc
y.create.l HWIO_PCIE_QSERDES_RX_EOM_STATUS8_ADDR A:0xfc5265c0
y.create.l HWIO_PCIE_QSERDES_RX_EOM_STATUS9_ADDR A:0xfc5265c4
y.create.l HWIO_PCIE_QSERDES_RX_RX_ALOG_INTF_OBSV_ADDR A:0xfc5265c8
y.create.l HWIO_PCIE_QSERDES_RX_READ_EQCODE_ADDR A:0xfc5265cc
y.create.l HWIO_PCIE_QSERDES_RX_READ_OFFSETCODE_ADDR A:0xfc5265d0
y.create.l HWIO_PCIE_PCIE_USB3_PHY_SW_RESET_ADDR A:0xfc526600
y.create.l HWIO_PCIE_PCIE_USB3_PHY_POWER_DOWN_CONTROL_ADDR A:0xfc526604
y.create.l HWIO_PCIE_PCIE_USB3_PHY_START_ADDR A:0xfc526608
y.create.l HWIO_PCIE_PCIE_USB3_PHY_TXMGN_V1_V0_ADDR A:0xfc52660c
y.create.l HWIO_PCIE_PCIE_USB3_PHY_TXMGN_V3_V2_ADDR A:0xfc526610
y.create.l HWIO_PCIE_PCIE_USB3_PHY_TXMGN_LS_V4_ADDR A:0xfc526614
y.create.l HWIO_PCIE_PCIE_USB3_PHY_TXDEEMPH_M6DB_V0_ADDR A:0xfc526618
y.create.l HWIO_PCIE_PCIE_USB3_PHY_TXDEEMPH_M3P5DB_V0_ADDR A:0xfc52661c
y.create.l HWIO_PCIE_PCIE_USB3_PHY_TXDEEMPH_M6DB_V1_ADDR A:0xfc526620
y.create.l HWIO_PCIE_PCIE_USB3_PHY_TXDEEMPH_M3P5DB_V1_ADDR A:0xfc526624
y.create.l HWIO_PCIE_PCIE_USB3_PHY_TXDEEMPH_M6DB_V2_ADDR A:0xfc526628
y.create.l HWIO_PCIE_PCIE_USB3_PHY_TXDEEMPH_M3P5DB_V2_ADDR A:0xfc52662c
y.create.l HWIO_PCIE_PCIE_USB3_PHY_TXDEEMPH_M6DB_V3_ADDR A:0xfc526630
y.create.l HWIO_PCIE_PCIE_USB3_PHY_TXDEEMPH_M3P5DB_V3_ADDR A:0xfc526634
y.create.l HWIO_PCIE_PCIE_USB3_PHY_TXDEEMPH_M6DB_V4_ADDR A:0xfc526638
y.create.l HWIO_PCIE_PCIE_USB3_PHY_TXDEEMPH_M3P5DB_V4_ADDR A:0xfc52663c
y.create.l HWIO_PCIE_PCIE_USB3_PHY_TXDEEMPH_M6DB_LS_ADDR A:0xfc526640
y.create.l HWIO_PCIE_PCIE_USB3_PHY_TXDEEMPH_M3P5DB_LS_ADDR A:0xfc526644
y.create.l HWIO_PCIE_PCIE_USB3_PHY_ENDPOINT_REFCLK_DRIVE_ADDR A:0xfc526648
y.create.l HWIO_PCIE_PCIE_USB3_PHY_RX_IDLE_DTCT_CNTRL_ADDR A:0xfc52664c
y.create.l HWIO_PCIE_PCIE_USB3_PHY_POWER_STATE_CONFIG1_ADDR A:0xfc526650
y.create.l HWIO_PCIE_PCIE_USB3_PHY_POWER_STATE_CONFIG2_ADDR A:0xfc526654
y.create.l HWIO_PCIE_PCIE_USB3_PHY_POWER_STATE_CONFIG3_ADDR A:0xfc526658
y.create.l HWIO_PCIE_PCIE_USB3_PHY_RCVR_DTCT_DLY_P1U2_L_ADDR A:0xfc52665c
y.create.l HWIO_PCIE_PCIE_USB3_PHY_RCVR_DTCT_DLY_P1U2_H_ADDR A:0xfc526660
y.create.l HWIO_PCIE_PCIE_USB3_PHY_RCVR_DTCT_DLY_U3_L_ADDR A:0xfc526664
y.create.l HWIO_PCIE_PCIE_USB3_PHY_RCVR_DTCT_DLY_U3_H_ADDR A:0xfc526668
y.create.l HWIO_PCIE_PCIE_USB3_PHY_LOCK_DETECT_CONFIG1_ADDR A:0xfc52666c
y.create.l HWIO_PCIE_PCIE_USB3_PHY_LOCK_DETECT_CONFIG2_ADDR A:0xfc526670
y.create.l HWIO_PCIE_PCIE_USB3_PHY_LOCK_DETECT_CONFIG3_ADDR A:0xfc526674
y.create.l HWIO_PCIE_PCIE_USB3_PHY_TSYNC_RSYNC_TIME_ADDR A:0xfc526678
y.create.l HWIO_PCIE_PCIE_USB3_PHY_SIGDET_LOW_2_IDLE_TIME_ADDR A:0xfc52667c
y.create.l HWIO_PCIE_PCIE_USB3_PHY_BEACON_2_IDLE_TIME_L_ADDR A:0xfc526680
y.create.l HWIO_PCIE_PCIE_USB3_PHY_BEACON_2_IDLE_TIME_H_ADDR A:0xfc526684
y.create.l HWIO_PCIE_PCIE_USB3_PHY_PWRUP_RESET_DLY_TIME_SYSCLK_ADDR A:0xfc526688
y.create.l HWIO_PCIE_PCIE_USB3_PHY_PWRUP_RESET_DLY_TIME_AUXCLK_ADDR A:0xfc52668c
y.create.l HWIO_PCIE_PCIE_USB3_PHY_LFPS_DET_HIGH_COUNT_VAL_ADDR A:0xfc526690
y.create.l HWIO_PCIE_PCIE_USB3_PHY_LFPS_TX_ECSTART_EQTLOCK_ADDR A:0xfc526694
y.create.l HWIO_PCIE_PCIE_USB3_PHY_LFPS_TX_END_CNT_P2U3_START_ADDR A:0xfc526698
y.create.l HWIO_PCIE_PCIE_USB3_PHY_RXEQTRAINING_WAIT_TIME_ADDR A:0xfc52669c
y.create.l HWIO_PCIE_PCIE_USB3_PHY_RXEQTRAINING_RUN_TIME_ADDR A:0xfc5266a0
y.create.l HWIO_PCIE_PCIE_USB3_PHY_TXONESZEROS_RUN_LENGTH_ADDR A:0xfc5266a4
y.create.l HWIO_PCIE_PCIE_USB3_PHY_FLL_CNTRL1_ADDR A:0xfc5266a8
y.create.l HWIO_PCIE_PCIE_USB3_PHY_FLL_CNTRL2_ADDR A:0xfc5266ac
y.create.l HWIO_PCIE_PCIE_USB3_PHY_FLL_CNT_VAL_L_ADDR A:0xfc5266b0
y.create.l HWIO_PCIE_PCIE_USB3_PHY_FLL_CNT_VAL_H_TOL_ADDR A:0xfc5266b4
y.create.l HWIO_PCIE_PCIE_USB3_PHY_FLL_MAN_CODE_ADDR A:0xfc5266b8
y.create.l HWIO_PCIE_PCIE_USB3_PHY_AUTONOMOUS_MODE_CTRL_ADDR A:0xfc5266bc
y.create.l HWIO_PCIE_PCIE_USB3_PHY_LFPS_RXTERM_IRQ_CLEAR_ADDR A:0xfc5266c0
y.create.l HWIO_PCIE_PCIE_USB3_PHY_ARCVR_DTCT_EN_PERIOD_ADDR A:0xfc5266c4
y.create.l HWIO_PCIE_PCIE_USB3_PHY_ARCVR_DTCT_CM_DLY_ADDR A:0xfc5266c8
y.create.l HWIO_PCIE_PCIE_USB3_PHY_ALFPS_DEGLITCH_VAL_ADDR A:0xfc5266cc
y.create.l HWIO_PCIE_PCIE_USB3_PHY_INSIG_SW_CTRL1_ADDR A:0xfc5266d0
y.create.l HWIO_PCIE_PCIE_USB3_PHY_INSIG_SW_CTRL2_ADDR A:0xfc5266d4
y.create.l HWIO_PCIE_PCIE_USB3_PHY_INSIG_SW_CTRL3_ADDR A:0xfc5266d8
y.create.l HWIO_PCIE_PCIE_USB3_PHY_INSIG_MX_CTRL1_ADDR A:0xfc5266dc
y.create.l HWIO_PCIE_PCIE_USB3_PHY_INSIG_MX_CTRL2_ADDR A:0xfc5266e0
y.create.l HWIO_PCIE_PCIE_USB3_PHY_INSIG_MX_CTRL3_ADDR A:0xfc5266e4
y.create.l HWIO_PCIE_PCIE_USB3_PHY_TEST_CONTROL_ADDR A:0xfc5266e8
y.create.l HWIO_PCIE_PCIE_USB3_PHY_BIST_CTRL_ADDR A:0xfc5266ec
y.create.l HWIO_PCIE_PCIE_USB3_PHY_PRBS_POLY0_ADDR A:0xfc5266f0
y.create.l HWIO_PCIE_PCIE_USB3_PHY_PRBS_POLY1_ADDR A:0xfc5266f4
y.create.l HWIO_PCIE_PCIE_USB3_PHY_PRBS_SEED0_ADDR A:0xfc5266f8
y.create.l HWIO_PCIE_PCIE_USB3_PHY_PRBS_SEED1_ADDR A:0xfc5266fc
y.create.l HWIO_PCIE_PCIE_USB3_PHY_FIXED_PAT_CTRL_ADDR A:0xfc526700
y.create.l HWIO_PCIE_PCIE_USB3_PHY_FIXED_PAT0_ADDR A:0xfc526704
y.create.l HWIO_PCIE_PCIE_USB3_PHY_FIXED_PAT1_ADDR A:0xfc526708
y.create.l HWIO_PCIE_PCIE_USB3_PHY_FIXED_PAT2_ADDR A:0xfc52670c
y.create.l HWIO_PCIE_PCIE_USB3_PHY_FIXED_PAT3_ADDR A:0xfc526710
y.create.l HWIO_PCIE_PCIE_USB3_PHY_SPARE1_ADDR A:0xfc526714
y.create.l HWIO_PCIE_PCIE_USB3_PHY_BIST_CHK_ERR_CNT_L_ADDR A:0xfc526718
y.create.l HWIO_PCIE_PCIE_USB3_PHY_BIST_CHK_ERR_CNT_H_ADDR A:0xfc52671c
y.create.l HWIO_PCIE_PCIE_USB3_PHY_BIST_CHK_STATUS_ADDR A:0xfc526720
y.create.l HWIO_PCIE_PCIE_USB3_PHY_LFPS_RXTERM_IRQ_SOURCE_ADDR A:0xfc526724
y.create.l HWIO_PCIE_PCIE_USB3_PHY_PCS_STATUS_ADDR A:0xfc526728
y.create.l HWIO_PCIE_PCIE_USB3_PHY_PCS_STATUS2_ADDR A:0xfc52672c
y.create.l HWIO_PCIE_PCIE_USB3_PHY_REVISION_ID0_ADDR A:0xfc526730
y.create.l HWIO_PCIE_PCIE_USB3_PHY_REVISION_ID1_ADDR A:0xfc526734
y.create.l HWIO_PCIE_PCIE_USB3_PHY_REVISION_ID2_ADDR A:0xfc526738
y.create.l HWIO_PCIE_PCIE_USB3_PHY_REVISION_ID3_ADDR A:0xfc52673c
y.create.l HWIO_PCIE_PCIE_USB3_PHY_DEBUG_BUS_0_STATUS_ADDR A:0xfc526740
y.create.l HWIO_PCIE_PCIE_USB3_PHY_DEBUG_BUS_1_STATUS_ADDR A:0xfc526744
y.create.l HWIO_PCIE_PCIE_USB3_PHY_DEBUG_BUS_2_STATUS_ADDR A:0xfc526748
y.create.l HWIO_PCIE_PCIE_USB3_PHY_DEBUG_BUS_3_STATUS_ADDR A:0xfc52674c
y.create.l HWIO_PCIE_PCIE20_MHI_MMIO_CTRL_INT_STATUS_Q6_ADDR A:0xfc527000
y.create.l HWIO_PCIE_PCIE20_MHI_MMIO_CTRL_INT_STATUS_A7_ADDR A:0xfc527004
y.create.l HWIO_PCIE_PCIE20_MHI_CHDB_INT_STATUS_Q6_0_ADDR A:0xfc527008
y.create.l HWIO_PCIE_PCIE20_MHI_CHDB_INT_STATUS_Q6_1_ADDR A:0xfc52700c
y.create.l HWIO_PCIE_PCIE20_MHI_CHDB_INT_STATUS_Q6_2_ADDR A:0xfc527010
y.create.l HWIO_PCIE_PCIE20_MHI_CHDB_INT_STATUS_Q6_3_ADDR A:0xfc527014
y.create.l HWIO_PCIE_PCIE20_MHI_ERDB_INT_STATUS_Q6_0_ADDR A:0xfc527018
y.create.l HWIO_PCIE_PCIE20_MHI_ERDB_INT_STATUS_Q6_1_ADDR A:0xfc52701c
y.create.l HWIO_PCIE_PCIE20_MHI_ERDB_INT_STATUS_Q6_2_ADDR A:0xfc527020
y.create.l HWIO_PCIE_PCIE20_MHI_ERDB_INT_STATUS_Q6_3_ADDR A:0xfc527024
y.create.l HWIO_PCIE_PCIE20_MHI_CHDB_INT_STATUS_A7_0_ADDR A:0xfc527028
y.create.l HWIO_PCIE_PCIE20_MHI_CHDB_INT_STATUS_A7_1_ADDR A:0xfc52702c
y.create.l HWIO_PCIE_PCIE20_MHI_CHDB_INT_STATUS_A7_2_ADDR A:0xfc527030
y.create.l HWIO_PCIE_PCIE20_MHI_CHDB_INT_STATUS_A7_3_ADDR A:0xfc527034
y.create.l HWIO_PCIE_PCIE20_MHI_ERDB_INT_STATUS_A7_0_ADDR A:0xfc527038
y.create.l HWIO_PCIE_PCIE20_MHI_ERDB_INT_STATUS_A7_1_ADDR A:0xfc52703c
y.create.l HWIO_PCIE_PCIE20_MHI_ERDB_INT_STATUS_A7_2_ADDR A:0xfc527040
y.create.l HWIO_PCIE_PCIE20_MHI_ERDB_INT_STATUS_A7_3_ADDR A:0xfc527044
y.create.l HWIO_PCIE_PCIE20_MHI_MMIO_CTRL_INT_CLEAR_Q6_ADDR A:0xfc527048
y.create.l HWIO_PCIE_PCIE20_MHI_MMIO_CTRL_INT_CLEAR_A7_ADDR A:0xfc52704c
y.create.l HWIO_PCIE_PCIE20_MHI_CHDB_INT_CLEAR_Q6_0_ADDR A:0xfc527050
y.create.l HWIO_PCIE_PCIE20_MHI_CHDB_INT_CLEAR_Q6_1_ADDR A:0xfc527054
y.create.l HWIO_PCIE_PCIE20_MHI_CHDB_INT_CLEAR_Q6_2_ADDR A:0xfc527058
y.create.l HWIO_PCIE_PCIE20_MHI_CHDB_INT_CLEAR_Q6_3_ADDR A:0xfc52705c
y.create.l HWIO_PCIE_PCIE20_MHI_ERDB_INT_CLEAR_Q6_0_ADDR A:0xfc527060
y.create.l HWIO_PCIE_PCIE20_MHI_ERDB_INT_CLEAR_Q6_1_ADDR A:0xfc527064
y.create.l HWIO_PCIE_PCIE20_MHI_ERDB_INT_CLEAR_Q6_2_ADDR A:0xfc527068
y.create.l HWIO_PCIE_PCIE20_MHI_ERDB_INT_CLEAR_Q6_3_ADDR A:0xfc52706c
y.create.l HWIO_PCIE_PCIE20_MHI_CHDB_INT_CLEAR_A7_0_ADDR A:0xfc527070
y.create.l HWIO_PCIE_PCIE20_MHI_CHDB_INT_CLEAR_A7_1_ADDR A:0xfc527074
y.create.l HWIO_PCIE_PCIE20_MHI_CHDB_INT_CLEAR_A7_2_ADDR A:0xfc527078
y.create.l HWIO_PCIE_PCIE20_MHI_CHDB_INT_CLEAR_A7_3_ADDR A:0xfc52707c
y.create.l HWIO_PCIE_PCIE20_MHI_ERDB_INT_CLEAR_A7_0_ADDR A:0xfc527080
y.create.l HWIO_PCIE_PCIE20_MHI_ERDB_INT_CLEAR_A7_1_ADDR A:0xfc527084
y.create.l HWIO_PCIE_PCIE20_MHI_ERDB_INT_CLEAR_A7_2_ADDR A:0xfc527088
y.create.l HWIO_PCIE_PCIE20_MHI_ERDB_INT_CLEAR_A7_3_ADDR A:0xfc52708c
y.create.l HWIO_PCIE_PCIE20_MHI_MMIO_CTRL_INT_MASK_Q6_ADDR A:0xfc527090
y.create.l HWIO_PCIE_PCIE20_MHI_MMIO_CTRL_INT_MASK_A7_ADDR A:0xfc527094
y.create.l HWIO_PCIE_PCIE20_MHI_CHDB_INT_MASK_Q6_0_ADDR A:0xfc527098
y.create.l HWIO_PCIE_PCIE20_MHI_CHDB_INT_MASK_Q6_1_ADDR A:0xfc52709c
y.create.l HWIO_PCIE_PCIE20_MHI_CHDB_INT_MASK_Q6_2_ADDR A:0xfc5270a0
y.create.l HWIO_PCIE_PCIE20_MHI_CHDB_INT_MASK_Q6_3_ADDR A:0xfc5270a4
y.create.l HWIO_PCIE_PCIE20_MHI_ERDB_INT_MASK_Q6_0_ADDR A:0xfc5270a8
y.create.l HWIO_PCIE_PCIE20_MHI_ERDB_INT_MASK_Q6_1_ADDR A:0xfc5270ac
y.create.l HWIO_PCIE_PCIE20_MHI_ERDB_INT_MASK_Q6_2_ADDR A:0xfc5270b0
y.create.l HWIO_PCIE_PCIE20_MHI_ERDB_INT_MASK_Q6_3_ADDR A:0xfc5270b4
y.create.l HWIO_PCIE_PCIE20_MHI_CHDB_INT_MASK_A7_0_ADDR A:0xfc5270b8
y.create.l HWIO_PCIE_PCIE20_MHI_CHDB_INT_MASK_A7_1_ADDR A:0xfc5270bc
y.create.l HWIO_PCIE_PCIE20_MHI_CHDB_INT_MASK_A7_2_ADDR A:0xfc5270c0
y.create.l HWIO_PCIE_PCIE20_MHI_CHDB_INT_MASK_A7_3_ADDR A:0xfc5270c4
y.create.l HWIO_PCIE_PCIE20_MHI_ERDB_INT_MASK_A7_0_ADDR A:0xfc5270c8
y.create.l HWIO_PCIE_PCIE20_MHI_ERDB_INT_MASK_A7_1_ADDR A:0xfc5270cc
y.create.l HWIO_PCIE_PCIE20_MHI_ERDB_INT_MASK_A7_2_ADDR A:0xfc5270d0
y.create.l HWIO_PCIE_PCIE20_MHI_ERDB_INT_MASK_A7_3_ADDR A:0xfc5270d4
y.create.l HWIO_PCIE_PCIE20_MHIREGLEN_ADDR A:0xfc527100
y.create.l HWIO_PCIE_PCIE20_MHIVER_ADDR A:0xfc527108
y.create.l HWIO_PCIE_PCIE20_MHICFG_ADDR A:0xfc527110
y.create.l HWIO_PCIE_PCIE20_CHDBOFF_ADDR A:0xfc527118
y.create.l HWIO_PCIE_PCIE20_ERDBOFF_ADDR A:0xfc527120
y.create.l HWIO_PCIE_PCIE20_BHIOFF_ADDR A:0xfc527128
y.create.l HWIO_PCIE_PCIE20_DEBUGOFF_ADDR A:0xfc527130
y.create.l HWIO_PCIE_PCIE20_MHICTRL_ADDR A:0xfc527138
y.create.l HWIO_PCIE_PCIE20_MHISTATUS_ADDR A:0xfc527148
y.create.l HWIO_PCIE_PCIE20_MHIERROR_ADDR A:0xfc527150
y.create.l HWIO_PCIE_PCIE20_CCABAP_LOWER_ADDR A:0xfc527158
y.create.l HWIO_PCIE_PCIE20_CCABAP_UPPER_ADDR A:0xfc52715c
y.create.l HWIO_PCIE_PCIE20_ECABAP_LOWER_ADDR A:0xfc527160
y.create.l HWIO_PCIE_PCIE20_ECABAP_UPPER_ADDR A:0xfc527164
y.create.l HWIO_PCIE_PCIE20_CRCBAP_LOWER_ADDR A:0xfc527168
y.create.l HWIO_PCIE_PCIE20_CRCBAP_UPPER_ADDR A:0xfc52716c
y.create.l HWIO_PCIE_PCIE20_CRDB_LOWER_ADDR A:0xfc527170
y.create.l HWIO_PCIE_PCIE20_CRDB_UPPER_ADDR A:0xfc527174
y.create.l HWIO_PCIE_PCIE20_MHICTRLBASE_LOWER_ADDR A:0xfc527180
y.create.l HWIO_PCIE_PCIE20_MHICTRLBASE_UPPER_ADDR A:0xfc527184
y.create.l HWIO_PCIE_PCIE20_MHICTRLLIMIT_LOWER_ADDR A:0xfc527188
y.create.l HWIO_PCIE_PCIE20_MHICTRLLIMIT_UPPER_ADDR A:0xfc52718c
y.create.l HWIO_PCIE_PCIE20_MHIDATABASE_LOWER_ADDR A:0xfc527198
y.create.l HWIO_PCIE_PCIE20_MHIDATABASE_UPPER_ADDR A:0xfc52719c
y.create.l HWIO_PCIE_PCIE20_MHIDATALIMIT_LOWER_ADDR A:0xfc5271a0
y.create.l HWIO_PCIE_PCIE20_MHIDATALIMIT_UPPER_ADDR A:0xfc5271a4
y.create.l HWIO_PCIE_PCIE20_BHI_VERSION_LOWER_ADDR A:0xfc527200
y.create.l HWIO_PCIE_PCIE20_BHI_VERSION_UPPER_ADDR A:0xfc527204
y.create.l HWIO_PCIE_PCIE20_BHI_IMGADDR_LOWER_ADDR A:0xfc527208
y.create.l HWIO_PCIE_PCIE20_BHI_IMGADDR_UPPER_ADDR A:0xfc52720c
y.create.l HWIO_PCIE_PCIE20_BHI_IMGSIZE_ADDR A:0xfc527210
y.create.l HWIO_PCIE_PCIE20_BHI_IMGTXDB_ADDR A:0xfc527218
y.create.l HWIO_PCIE_PCIE20_BHI_INTVEC_ADDR A:0xfc527220
y.create.l HWIO_PCIE_PCIE20_BHI_EXECENV_ADDR A:0xfc527228
y.create.l HWIO_PCIE_PCIE20_BHI_STATUS_ADDR A:0xfc52722c
y.create.l HWIO_PCIE_PCIE20_BHI_ERRCODE_ADDR A:0xfc527230
y.create.l HWIO_PCIE_PCIE20_BHI_ERRDBG1_ADDR A:0xfc527234
y.create.l HWIO_PCIE_PCIE20_BHI_ERRDBG2_ADDR A:0xfc527238
y.create.l HWIO_PCIE_PCIE20_BHI_ERRDBG3_ADDR A:0xfc52723c
y.create.l HWIO_PCIE_PCIE20_BHI_SERIALNUM_ADDR A:0xfc527240
y.create.l HWIO_PCIE_PCIE20_BHI_SBLANTIROLLVER_ADDR A:0xfc527244
y.create.l HWIO_PCIE_PCIE20_BHI_NUMSEG_ADDR A:0xfc527248
y.create.l HWIO_PCIE_PCIE20_BHI_MSMHWID_0_ADDR A:0xfc52724c
y.create.l HWIO_PCIE_PCIE20_BHI_MSMHWID_1_ADDR A:0xfc527250
y.create.l HWIO_PCIE_PCIE20_BHI_MSMHWID_2_ADDR A:0xfc527254
y.create.l HWIO_PCIE_PCIE20_BHI_MSMHWID_3_ADDR A:0xfc527258
y.create.l HWIO_PCIE_PCIE20_BHI_MSMHWID_4_ADDR A:0xfc52725c
y.create.l HWIO_PCIE_PCIE20_BHI_MSMHWID_5_ADDR A:0xfc527260
y.create.l HWIO_PCIE_PCIE20_BHI_OEMPKHASH_0_ADDR A:0xfc527264
y.create.l HWIO_PCIE_PCIE20_BHI_OEMPKHASH_1_ADDR A:0xfc527268
y.create.l HWIO_PCIE_PCIE20_BHI_OEMPKHASH_2_ADDR A:0xfc52726c
y.create.l HWIO_PCIE_PCIE20_BHI_OEMPKHASH_3_ADDR A:0xfc527270
y.create.l HWIO_PCIE_PCIE20_BHI_OEMPKHASH_4_ADDR A:0xfc527274
y.create.l HWIO_PCIE_PCIE20_BHI_OEMPKHASH_5_ADDR A:0xfc527278
y.create.l HWIO_PCIE_PCIE20_BHI_OEMPKHASH_6_ADDR A:0xfc52727c
y.create.l HWIO_PCIE_PCIE20_BHI_OEMPKHASH_7_ADDR A:0xfc527280
y.create.l HWIO_PCIE_PCIE20_BHI_OEMPKHASH_8_ADDR A:0xfc527284
y.create.l HWIO_PCIE_PCIE20_BHI_OEMPKHASH_9_ADDR A:0xfc527288
y.create.l HWIO_PCIE_PCIE20_CHDB_LOWER_0_ADDR A:0xfc527400
y.create.l HWIO_PCIE_PCIE20_CHDB_LOWER_1_ADDR A:0xfc527408
y.create.l HWIO_PCIE_PCIE20_CHDB_LOWER_2_ADDR A:0xfc527410
y.create.l HWIO_PCIE_PCIE20_CHDB_LOWER_3_ADDR A:0xfc527418
y.create.l HWIO_PCIE_PCIE20_CHDB_LOWER_4_ADDR A:0xfc527420
y.create.l HWIO_PCIE_PCIE20_CHDB_LOWER_5_ADDR A:0xfc527428
y.create.l HWIO_PCIE_PCIE20_CHDB_LOWER_6_ADDR A:0xfc527430
y.create.l HWIO_PCIE_PCIE20_CHDB_LOWER_7_ADDR A:0xfc527438
y.create.l HWIO_PCIE_PCIE20_CHDB_LOWER_8_ADDR A:0xfc527440
y.create.l HWIO_PCIE_PCIE20_CHDB_LOWER_9_ADDR A:0xfc527448
y.create.l HWIO_PCIE_PCIE20_CHDB_UPPER_0_ADDR A:0xfc527404
y.create.l HWIO_PCIE_PCIE20_CHDB_UPPER_1_ADDR A:0xfc52740c
y.create.l HWIO_PCIE_PCIE20_CHDB_UPPER_2_ADDR A:0xfc527414
y.create.l HWIO_PCIE_PCIE20_CHDB_UPPER_3_ADDR A:0xfc52741c
y.create.l HWIO_PCIE_PCIE20_CHDB_UPPER_4_ADDR A:0xfc527424
y.create.l HWIO_PCIE_PCIE20_CHDB_UPPER_5_ADDR A:0xfc52742c
y.create.l HWIO_PCIE_PCIE20_CHDB_UPPER_6_ADDR A:0xfc527434
y.create.l HWIO_PCIE_PCIE20_CHDB_UPPER_7_ADDR A:0xfc52743c
y.create.l HWIO_PCIE_PCIE20_CHDB_UPPER_8_ADDR A:0xfc527444
y.create.l HWIO_PCIE_PCIE20_CHDB_UPPER_9_ADDR A:0xfc52744c
y.create.l HWIO_PCIE_PCIE20_ERDB_LOWER_0_ADDR A:0xfc527800
y.create.l HWIO_PCIE_PCIE20_ERDB_LOWER_1_ADDR A:0xfc527808
y.create.l HWIO_PCIE_PCIE20_ERDB_LOWER_2_ADDR A:0xfc527810
y.create.l HWIO_PCIE_PCIE20_ERDB_LOWER_3_ADDR A:0xfc527818
y.create.l HWIO_PCIE_PCIE20_ERDB_LOWER_4_ADDR A:0xfc527820
y.create.l HWIO_PCIE_PCIE20_ERDB_LOWER_5_ADDR A:0xfc527828
y.create.l HWIO_PCIE_PCIE20_ERDB_LOWER_6_ADDR A:0xfc527830
y.create.l HWIO_PCIE_PCIE20_ERDB_LOWER_7_ADDR A:0xfc527838
y.create.l HWIO_PCIE_PCIE20_ERDB_LOWER_8_ADDR A:0xfc527840
y.create.l HWIO_PCIE_PCIE20_ERDB_LOWER_9_ADDR A:0xfc527848
y.create.l HWIO_PCIE_PCIE20_ERDB_UPPER_0_ADDR A:0xfc527804
y.create.l HWIO_PCIE_PCIE20_ERDB_UPPER_1_ADDR A:0xfc52780c
y.create.l HWIO_PCIE_PCIE20_ERDB_UPPER_2_ADDR A:0xfc527814
y.create.l HWIO_PCIE_PCIE20_ERDB_UPPER_3_ADDR A:0xfc52781c
y.create.l HWIO_PCIE_PCIE20_ERDB_UPPER_4_ADDR A:0xfc527824
y.create.l HWIO_PCIE_PCIE20_ERDB_UPPER_5_ADDR A:0xfc52782c
y.create.l HWIO_PCIE_PCIE20_ERDB_UPPER_6_ADDR A:0xfc527834
y.create.l HWIO_PCIE_PCIE20_ERDB_UPPER_7_ADDR A:0xfc52783c
y.create.l HWIO_PCIE_PCIE20_ERDB_UPPER_8_ADDR A:0xfc527844
y.create.l HWIO_PCIE_PCIE20_ERDB_UPPER_9_ADDR A:0xfc52784c
y.create.l HWIO_PCIE_PCIE20_PARF_DEBUG_CNT_INT_SLV_XPU2_MSA_ADDR A:0xfc527c00
y.create.l HWIO_PCIE_PCIE20_PARF_DEBUG_CNT_PM_LINKST_IN_L2_ADDR A:0xfc527c04
y.create.l HWIO_PCIE_PCIE20_PARF_DEBUG_CNT_PM_LINKST_IN_L1SUB_ADDR A:0xfc527c08
y.create.l HWIO_PCIE_PCIE20_PARF_DEBUG_CNT_PM_LINKST_IN_L1_ADDR A:0xfc527c0c
y.create.l HWIO_PCIE_PCIE20_PARF_DEBUG_CNT_PM_LINKST_IN_L0S_ADDR A:0xfc527c10
y.create.l HWIO_PCIE_PCIE20_PARF_DEBUG_CNT_AUX_CLK_APP_REQ_EXIT_L1_ADDR A:0xfc527c14
y.create.l HWIO_PCIE_PCIE20_PARF_DEBUG_CNT_AUX_CLK_APP_READY_ENTER_L23_ADDR A:0xfc527c18
y.create.l HWIO_PCIE_PCIE20_PARF_DEBUG_CNT_AUX_CLK_APP_READY_ENTER_L1_ADDR A:0xfc527c1c
y.create.l HWIO_PCIE_PCIE20_PARF_DEBUG_CNT_INT_BRIDGE_FLUSH_ADDR A:0xfc527c20
y.create.l HWIO_PCIE_PCIE20_PARF_DEBUG_CNT_ECRC_ERR_ASSERTED_ADDR A:0xfc527c24
y.create.l HWIO_PCIE_PCIE20_PARF_DEBUG_CNT_LCRC_ERR_ASSERTED_ADDR A:0xfc527c28
y.create.l HWIO_PCIE_PCIE20_PARF_DEBUG_CNT_RMLH_RDLH_PKTERR_1_ADDR A:0xfc527c2c
y.create.l HWIO_PCIE_PCIE20_PARF_DEBUG_CNT_RMLH_RDLH_PKTERR_0_ADDR A:0xfc527c30
y.create.l HWIO_PCIE_PCIE20_PARF_DEBUG_CNT_RMLH_DESKEW_ALIGN_ERR_ADDR A:0xfc527c34
y.create.l HWIO_PCIE_PCIE20_PARF_DEBUG_CNT_RMLK_TS_RCV_ERR_ADDR A:0xfc527c38
y.create.l HWIO_PCIE_PCIE20_PARF_DEBUG_CNT_UNEXP_CPL_ERR_ADDR A:0xfc527c3c
y.create.l HWIO_PCIE_PCIE20_PARF_DEBUG_CNT_CPL_CA_ERR_ADDR A:0xfc527c40
y.create.l HWIO_PCIE_PCIE20_PARF_DEBUG_CNT_CPL_UR_ERR_ADDR A:0xfc527c44
y.create.l HWIO_PCIE_PCIE20_PARF_DEBUG_CNT_CPL_MLF_ERR_ADDR A:0xfc527c48
y.create.l HWIO_PCIE_PCIE20_PARF_DEBUG_CNT_FORM_FILT_ECRC_ERR_ADDR A:0xfc527c4c
y.create.l HWIO_PCIE_PCIE20_PARF_DEBUG_CNT_FORM_FILT_MALFORM_TLP_ERR_ADDR A:0xfc527c50
y.create.l HWIO_PCIE_PCIE20_PARF_DEBUG_CNT_FORM_FILT_DLLP_ERR_ADDR A:0xfc527c54
y.create.l HWIO_PCIE_PCIE20_PARF_DEBUG_CNT_XDLH_REPLAY_TIMEOUT_ERR_ADDR A:0xfc527c58
y.create.l HWIO_PCIE_PCIE20_PARF_DEBUG_CNT_XDLH_REPLAY_NUM_RLOVER_ERR_ADDR A:0xfc527c5c
y.create.l HWIO_PCIE_PCIE20_PARF_DEBUG_CNT_RDLH_BAD_DLLP_ERR_ADDR A:0xfc527c60
y.create.l HWIO_PCIE_PCIE20_PARF_DEBUG_CNT_RDLH_BAD_TLP_ERR_ADDR A:0xfc527c64
y.create.l HWIO_PCIE_PCIE20_PARF_DEBUG_CNT_RDLH_PROT_ERR_ADDR A:0xfc527c68
y.create.l HWIO_PCIE_PCIE20_PARF_DEBUG_CNT_RMLH_RCVD_ERR_ADDR A:0xfc527c6c
y.create.l HWIO_PCIE_PCIE20_PARF_DEBUG_CNT_RADM_CPL_TIMEOUT_ADDR A:0xfc527c70
y.create.l HWIO_PCIE_PCIE20_PARF_DEBUG_CNT_RADM_QOVERFLOW_ADDR A:0xfc527c74
y.create.l HWIO_PCIE_PCIE20_PARF_DEBUG_CNT_RADM_UNEXP_CPL_ERR_ADDR A:0xfc527c78
y.create.l HWIO_PCIE_PCIE20_PARF_DEBUG_CNT_RADM_ECRC_ERR_ADDR A:0xfc527c7c
y.create.l HWIO_PCIE_PCIE20_PARF_DEBUG_CNT_RADM_MLF_TLP_ERR_ADDR A:0xfc527c80
y.create.l HWIO_PCIE_TYPE1_DEV_ID_VEND_ID_REG_ADDR A:0x80ffe000
y.create.l HWIO_PCIE_TYPE1_STATUS_COMMAND_REG_ADDR A:0x80ffe004
y.create.l HWIO_PCIE_TYPE1_CLASS_CODE_REV_ID_REG_ADDR A:0x80ffe008
y.create.l HWIO_PCIE_TYPE1_BIST_HDR_TYPE_LAT_CACHE_LINE_SIZE_REG_ADDR A:0x80ffe00c
y.create.l HWIO_PCIE_BAR0_REG_ADDR A:0x80ffe010
y.create.l HWIO_PCIE_BAR1_REG_ADDR A:0x80ffe014
y.create.l HWIO_PCIE_SEC_LAT_TIMER_SUB_BUS_SEC_BUS_PRI_BUS_REG_ADDR A:0x80ffe018
y.create.l HWIO_PCIE_SEC_STAT_IO_LIMIT_IO_BASE_REG_ADDR A:0x80ffe01c
y.create.l HWIO_PCIE_MEM_LIMIT_MEM_BASE_REG_ADDR A:0x80ffe020
y.create.l HWIO_PCIE_PREF_MEM_LIMIT_PREF_MEM_BASE_REG_ADDR A:0x80ffe024
y.create.l HWIO_PCIE_PREF_BASE_UPPER_REG_ADDR A:0x80ffe028
y.create.l HWIO_PCIE_PREF_LIMIT_UPPER_REG_ADDR A:0x80ffe02c
y.create.l HWIO_PCIE_IO_LIMIT_UPPER_IO_BASE_UPPER_REG_ADDR A:0x80ffe030
y.create.l HWIO_PCIE_TYPE1_CAP_PTR_REG_ADDR A:0x80ffe034
y.create.l HWIO_PCIE_TYPE1_EXP_ROM_BASE_REG_ADDR A:0x80ffe038
y.create.l HWIO_PCIE_BRIDGE_CTRL_INT_PIN_INT_LINE_REG_ADDR A:0x80ffe03c
y.create.l HWIO_PCIE_L1SUB_CAP_HEADER_REG_ADDR A:0x80ffe150
y.create.l HWIO_PCIE_L1SUB_CAPABILITY_REG_ADDR A:0x80ffe154
y.create.l HWIO_PCIE_L1SUB_CONTROL1_REG_ADDR A:0x80ffe158
y.create.l HWIO_PCIE_L1SUB_CONTROL2_REG_ADDR A:0x80ffe15c
y.create.l HWIO_PCIE_CAP_ID_NXT_PTR_REG_ADDR A:0x80ffe040
y.create.l HWIO_PCIE_CON_STATUS_REG_ADDR A:0x80ffe044
y.create.l HWIO_PCIE_PCIE_CAP_ID_PCIE_NEXT_CAP_PTR_PCIE_CAP_REG_ADDR A:0x80ffe070
y.create.l HWIO_PCIE_DEVICE_CAPABILITIES_REG_ADDR A:0x80ffe074
y.create.l HWIO_PCIE_DEVICE_CONTROL_DEVICE_STATUS_ADDR A:0x80ffe078
y.create.l HWIO_PCIE_LINK_CAPABILITIES_REG_ADDR A:0x80ffe07c
y.create.l HWIO_PCIE_LINK_CONTROL_LINK_STATUS_REG_ADDR A:0x80ffe080
y.create.l HWIO_PCIE_ROOT_CONTROL_ROOT_CAPABILITIES_REG_ADDR A:0x80ffe08c
y.create.l HWIO_PCIE_ROOT_STATUS_REG_ADDR A:0x80ffe090
y.create.l HWIO_PCIE_DEVICE_CAPABILITIES2_REG_ADDR A:0x80ffe094
y.create.l HWIO_PCIE_DEVICE_CONTROL2_DEVICE_STATUS2_REG_ADDR A:0x80ffe098
y.create.l HWIO_PCIE_LINK_CAPABILITIES2_REG_ADDR A:0x80ffe09c
y.create.l HWIO_PCIE_LINK_CONTROL2_LINK_STATUS2_REG_ADDR A:0x80ffe0a0
y.create.l HWIO_PCIE_AER_EXT_CAP_HDR_REG_ADDR A:0x80ffe100
y.create.l HWIO_PCIE_UNCORR_ERR_STATUS_REG_ADDR A:0x80ffe104
y.create.l HWIO_PCIE_UNCORR_ERR_MASK_REG_ADDR A:0x80ffe108
y.create.l HWIO_PCIE_UNCORR_ERR_SEV_REG_ADDR A:0x80ffe10c
y.create.l HWIO_PCIE_CORR_ERR_STATUS_REG_ADDR A:0x80ffe110
y.create.l HWIO_PCIE_CORR_ERR_MASK_REG_ADDR A:0x80ffe114
y.create.l HWIO_PCIE_ADV_ERR_CAP_CTRL_REG_ADDR A:0x80ffe118
y.create.l HWIO_PCIE_HDR_LOG_REG_0_ADDR A:0x80ffe11c
y.create.l HWIO_PCIE_HDR_LOG_REG_1_ADDR A:0x80ffe120
y.create.l HWIO_PCIE_HDR_LOG_REG_2_ADDR A:0x80ffe124
y.create.l HWIO_PCIE_HDR_LOG_REG_3_ADDR A:0x80ffe128
y.create.l HWIO_PCIE_ROOT_ERR_CMD_REG_ADDR A:0x80ffe12c
y.create.l HWIO_PCIE_ROOT_ERR_STATUS_REG_ADDR A:0x80ffe130
y.create.l HWIO_PCIE_ERR_SRC_ID_REG_ADDR A:0x80ffe134
y.create.l HWIO_PCIE_TLP_PREFIX_LOG_REG_ADDR A:0x80ffe138
y.create.l HWIO_PCIE_PCI_MSI_CAP_ID_NEXT_CTRL_REG_ADDR A:0x80ffe050
y.create.l HWIO_PCIE_MSI_LOWER_32_ADDR A:0x80ffe054
y.create.l HWIO_PCIE_MSI_UPPER_32_ADDR A:0x80ffe058
y.create.l HWIO_PCIE_MSI_DATA_REG_ADDR A:0x80ffe05c
y.create.l HWIO_PCIE_MSI_MASK_REG_ADDR A:0x80ffe060
y.create.l HWIO_PCIE_MSI_PENDING_BIT_REG_ADDR A:0x80ffe064
y.create.l HWIO_PCIE_LTR_CAP_HDR_REG_ADDR A:0x80ffe148
y.create.l HWIO_PCIE_LTR_LATENCY_REG_ADDR A:0x80ffe14c
y.create.l HWIO_PCIE_ACK_LATENCY_TIMER_ADDR A:0x80ffe700
y.create.l HWIO_PCIE_VENDOR_SPEC_DLLP_REG_ADDR A:0x80ffe704
y.create.l HWIO_PCIE_PORT_FORCE_REG_ADDR A:0x80ffe708
y.create.l HWIO_PCIE_ACK_F_ASPM_CTRL_REG_ADDR A:0x80ffe70c
y.create.l HWIO_PCIE_PORT_LINK_CTRL_REG_ADDR A:0x80ffe710
y.create.l HWIO_PCIE_LANE_SKEW_REG_ADDR A:0x80ffe714
y.create.l HWIO_PCIE_TIMER_CTRL_MAX_FUNC_NUM_ADDR A:0x80ffe718
y.create.l HWIO_PCIE_SYMBOL_TIMER_FILTER_1_REG_ADDR A:0x80ffe71c
y.create.l HWIO_PCIE_FILTER_MASK_REG_2_ADDR A:0x80ffe720
y.create.l HWIO_PCIE_AMBA_MUL_OB_DECOMP_NP_SUB_REQ_CTRL_REG_ADDR A:0x80ffe724
y.create.l HWIO_PCIE_DEBUG_REG_0_ADDR A:0x80ffe728
y.create.l HWIO_PCIE_DEBUG_REG_1_ADDR A:0x80ffe72c
y.create.l HWIO_PCIE_TX_P_FC_CREDIT_STATUS_ADDR A:0x80ffe730
y.create.l HWIO_PCIE_TX_NP_FC_CREDIT_STATUS_ADDR A:0x80ffe734
y.create.l HWIO_PCIE_TX_CPL_FC_CREDIT_STATUS_ADDR A:0x80ffe738
y.create.l HWIO_PCIE_Q_STATUS_ADDR A:0x80ffe73c
y.create.l HWIO_PCIE_VC_TX_ARBI_REG_1_ADDR A:0x80ffe740
y.create.l HWIO_PCIE_VC_TX_ARBI_REG_2_ADDR A:0x80ffe744
y.create.l HWIO_PCIE_VC0_P_RX_Q_CTRL_ADDR A:0x80ffe748
y.create.l HWIO_PCIE_VC0_NP_RX_Q_CTRL_ADDR A:0x80ffe74c
y.create.l HWIO_PCIE_VC0_CPL_RX_Q_CTRL_ADDR A:0x80ffe750
y.create.l HWIO_PCIE_VC1_P_RX_Q_CTRL_ADDR A:0x80ffe754
y.create.l HWIO_PCIE_VC1_NP_RX_Q_CTRL_ADDR A:0x80ffe758
y.create.l HWIO_PCIE_VC1_CPL_RX_Q_CTRL_ADDR A:0x80ffe75c
y.create.l HWIO_PCIE_VC2_P_RX_Q_CTRL_ADDR A:0x80ffe760
y.create.l HWIO_PCIE_VC2_NP_RX_Q_CTRL_ADDR A:0x80ffe764
y.create.l HWIO_PCIE_VC2_CPL_RX_Q_CTRL_ADDR A:0x80ffe768
y.create.l HWIO_PCIE_VC3_P_RX_Q_CTRL_ADDR A:0x80ffe76c
y.create.l HWIO_PCIE_VC3_NP_RX_Q_CTRL_ADDR A:0x80ffe770
y.create.l HWIO_PCIE_VC3_CPL_RX_Q_CTRL_ADDR A:0x80ffe774
y.create.l HWIO_PCIE_VC4_P_RX_Q_CTRL_ADDR A:0x80ffe778
y.create.l HWIO_PCIE_VC4_NP_RX_Q_CTRL_ADDR A:0x80ffe77c
y.create.l HWIO_PCIE_VC4_CPL_RX_Q_CTRL_ADDR A:0x80ffe780
y.create.l HWIO_PCIE_VC5_P_RX_Q_CTRL_ADDR A:0x80ffe784
y.create.l HWIO_PCIE_VC5_NP_RX_Q_CTRL_ADDR A:0x80ffe788
y.create.l HWIO_PCIE_VC5_CPL_RX_Q_CTRL_ADDR A:0x80ffe78c
y.create.l HWIO_PCIE_VC6_P_RX_Q_CTRL_ADDR A:0x80ffe790
y.create.l HWIO_PCIE_VC6_NP_RX_Q_CTRL_ADDR A:0x80ffe794
y.create.l HWIO_PCIE_VC6_CPL_RX_Q_CTRL_ADDR A:0x80ffe798
y.create.l HWIO_PCIE_VC7_P_RX_Q_CTRL_ADDR A:0x80ffe79c
y.create.l HWIO_PCIE_VC7_NP_RX_Q_CTRL_ADDR A:0x80ffe7a0
y.create.l HWIO_PCIE_VC7_CPL_RX_Q_CTRL_ADDR A:0x80ffe7a4
y.create.l HWIO_PCIE_GEN2_CTRL_REG_ADDR A:0x80ffe80c
y.create.l HWIO_PCIE_PHY_STATUS_REG_ADDR A:0x80ffe810
y.create.l HWIO_PCIE_PHY_CONTROL_REG_ADDR A:0x80ffe814
y.create.l HWIO_PCIE_AXI_MASTER_CTRL_REG_0_ADDR A:0x80ffe818
y.create.l HWIO_PCIE_AXI_MASTER_CTRL_REG_1_ADDR A:0x80ffe81c
y.create.l HWIO_PCIE_MSI_CTRL_ADDR_REG_ADDR A:0x80ffe820
y.create.l HWIO_PCIE_MSI_CTRL_UPPER_ADDR_REG_ADDR A:0x80ffe824
y.create.l HWIO_PCIE_MSI_CTRL_INT_0_EN_REG_ADDR A:0x80ffe828
y.create.l HWIO_PCIE_MSI_CTRL_INT_0_MASK_REG_ADDR A:0x80ffe82c
y.create.l HWIO_PCIE_MSI_CTRL_INT_0_STATUS_REG_ADDR A:0x80ffe830
y.create.l HWIO_PCIE_MSI_CTRL_INT_1_EN_REG_ADDR A:0x80ffe834
y.create.l HWIO_PCIE_MSI_CTRL_INT_1_MASK_REG_ADDR A:0x80ffe838
y.create.l HWIO_PCIE_MSI_CTRL_INT_1_STATUS_REG_ADDR A:0x80ffe83c
y.create.l HWIO_PCIE_MSI_CTRL_INT_2_EN_REG_ADDR A:0x80ffe840
y.create.l HWIO_PCIE_MSI_CTRL_INT_2_MASK_REG_ADDR A:0x80ffe844
y.create.l HWIO_PCIE_MSI_CTRL_INT_2_STATUS_REG_ADDR A:0x80ffe848
y.create.l HWIO_PCIE_MSI_CTRL_INT_3_EN_REG_ADDR A:0x80ffe84c
y.create.l HWIO_PCIE_MSI_CTRL_INT_3_MASK_REG_ADDR A:0x80ffe850
y.create.l HWIO_PCIE_MSI_CTRL_INT_3_STATUS_REG_ADDR A:0x80ffe854
y.create.l HWIO_PCIE_MSI_CTRL_INT_4_EN_REG_ADDR A:0x80ffe858
y.create.l HWIO_PCIE_MSI_CTRL_INT_4_MASK_REG_ADDR A:0x80ffe85c
y.create.l HWIO_PCIE_MSI_CTRL_INT_4_STATUS_REG_ADDR A:0x80ffe860
y.create.l HWIO_PCIE_MSI_CTRL_INT_5_EN_REG_ADDR A:0x80ffe864
y.create.l HWIO_PCIE_MSI_CTRL_INT_5_MASK_REG_ADDR A:0x80ffe868
y.create.l HWIO_PCIE_MSI_CTRL_INT_5_STATUS_REG_ADDR A:0x80ffe86c
y.create.l HWIO_PCIE_MSI_CTRL_INT_6_EN_REG_ADDR A:0x80ffe870
y.create.l HWIO_PCIE_MSI_CTRL_INT_6_MASK_REG_ADDR A:0x80ffe874
y.create.l HWIO_PCIE_MSI_CTRL_INT_6_STATUS_REG_ADDR A:0x80ffe878
y.create.l HWIO_PCIE_MSI_CTRL_INT_7_EN_REG_ADDR A:0x80ffe87c
y.create.l HWIO_PCIE_MSI_CTRL_INT_7_MASK_REG_ADDR A:0x80ffe880
y.create.l HWIO_PCIE_MSI_CTRL_INT_7_STATUS_REG_ADDR A:0x80ffe884
y.create.l HWIO_PCIE_MSI_GPIO_IO_REG_ADDR A:0x80ffe888
y.create.l HWIO_PCIE_GEN3_RELATED_REG_ADDR A:0x80ffe890
y.create.l HWIO_PCIE_GEN3_EQ_LOCAL_FS_LF_REG_ADDR A:0x80ffe894
y.create.l HWIO_PCIE_GEN3_EQ_PSET_COEF_MAP_0_ADDR A:0x80ffe898
y.create.l HWIO_PCIE_GEN3_EQ_PSET_INDEX_REG_ADDR A:0x80ffe89c
y.create.l HWIO_PCIE_GEN3_EQ_COEFF_LEGALITY_STATUS_REG_ADDR A:0x80ffe8a4
y.create.l HWIO_PCIE_GEN3_EQ_CONTROL_REG_ADDR A:0x80ffe8a8
y.create.l HWIO_PCIE_GEN3_EQ_FB_MODE_DIR_CHANGE_REG_ADDR A:0x80ffe8ac
y.create.l HWIO_PCIE_PIPE_LOOPBACK_CONTROL_ADDR A:0x80ffe8b8
y.create.l HWIO_PCIE_MISC_CONTROL_1_REG_ADDR A:0x80ffe8bc
y.create.l HWIO_PCIE_AMBA_ERROR_RESPONSE_DEFAULT_REG_ADDR A:0x80ffe8d0
y.create.l HWIO_PCIE_AMBA_LINK_TIMEOUT_REG_ADDR A:0x80ffe8d4
y.create.l HWIO_PCIE_PL_LAST_REG_ADDR A:0x80ffe8fc
y.create.l HWIO_PCIE_IATU_VIEWPORT_REG_ADDR A:0x80ffe900
y.create.l HWIO_PCIE_PL_IATU_REGION_CTRL_REG_1_OUTBOUND_0_ADDR A:0x80ffe904
y.create.l HWIO_PCIE_PL_IATU_REGION_CTRL_REG_2_OUTBOUND_0_ADDR A:0x80ffe908
y.create.l HWIO_PCIE_PL_IATU_LWR_BASE_ADDR_REG_OUTBOUND_0_ADDR A:0x80ffe90c
y.create.l HWIO_PCIE_PL_IATU_UPPER_BASE_ADDR_REG_OUTBOUND_0_ADDR A:0x80ffe910
y.create.l HWIO_PCIE_PL_IATU_LIMIT_ADDR_REG_OUTBOUND_0_ADDR A:0x80ffe914
y.create.l HWIO_PCIE_PL_IATU_LWR_TARGET_ADDR_REG_OUTBOUND_0_ADDR A:0x80ffe918
y.create.l HWIO_PCIE_PL_IATU_UPPER_TARGET_ADDR_REG_OUTBOUND_0_ADDR A:0x80ffe91c
y.create.l HWIO_PCIE_PL_IATU_REGION_CTRL_REG_3_OUTBOUND_0_ADDR A:0x80ffe920
y.create.l HWIO_PCIE_DMA_CTRL_REG_ADDR A:0x80ffee00
y.create.l HWIO_PCIE_DMA_WRITE_ENGINE_EN_ADDR A:0x80ffee04
y.create.l HWIO_PCIE_DMA_WRITE_DOORBELL_REG_ADDR A:0x80ffee08
y.create.l HWIO_PCIE_DMA_WRITE_CHANNEL_ARB_WEIGHT_LOW_REG_ADDR A:0x80ffee10
y.create.l HWIO_PCIE_DMA_WRITE_CHANNEL_ARB_WEIGHT_HIGH_REG_ADDR A:0x80ffee14
y.create.l HWIO_PCIE_DMA_WRITE_P_REQ_TIMER_REG_ADDR A:0x80ffee20
y.create.l HWIO_PCIE_DMA_READ_ENGINE_EN_ADDR A:0x80ffee24
y.create.l HWIO_PCIE_DMA_READ_DOORBELL_REG_ADDR A:0x80ffee28
y.create.l HWIO_PCIE_DMA_READ_CHANNEL_ARB_WEIGHT_LOW_REG_ADDR A:0x80ffee30
y.create.l HWIO_PCIE_DMA_READ_CHANNEL_ARB_WEIGHT_HIGH_REG_ADDR A:0x80ffee34
y.create.l HWIO_PCIE_DMA_WRITE_INT_STATUS_REG_ADDR A:0x80ffee44
y.create.l HWIO_PCIE_DMA_WRITE_INT_MASK_REG_ADDR A:0x80ffee4c
y.create.l HWIO_PCIE_DMA_WRITE_INT_CLEAR_REG_ADDR A:0x80ffee50
y.create.l HWIO_PCIE_DMA_WRITE_ERR_STATUS_REG_ADDR A:0x80ffee54
y.create.l HWIO_PCIE_DMA_WRITE_DONE_IMWR_LOW_REG_ADDR A:0x80ffee58
y.create.l HWIO_PCIE_DMA_WRITE_DONE_IMWR_HIGH_REG_ADDR A:0x80ffee5c
y.create.l HWIO_PCIE_DMA_WRITE_ABORT_IMWR_LOW_REG_ADDR A:0x80ffee60
y.create.l HWIO_PCIE_DMA_WRITE_ABORT_IMWR_HIGH_REG_ADDR A:0x80ffee64
y.create.l HWIO_PCIE_DMA_WRITE_CH01_IMWR_DATA_REG_ADDR A:0x80ffee68
y.create.l HWIO_PCIE_DMA_WRITE_LINKED_LIST_ERR_EN_REG_ADDR A:0x80ffee88
y.create.l HWIO_PCIE_DMA_READ_INT_STATUS_REG_ADDR A:0x80ffee98
y.create.l HWIO_PCIE_DMA_READ_INT_MASK_REG_ADDR A:0x80ffeea0
y.create.l HWIO_PCIE_DMA_READ_INT_CLEAR_REG_ADDR A:0x80ffeea4
y.create.l HWIO_PCIE_DMA_READ_ERR_STATUS_LOW_REG_ADDR A:0x80ffeeac
y.create.l HWIO_PCIE_DMA_READ_ERR_STATUS_HIGH_REG_ADDR A:0x80ffeeb0
y.create.l HWIO_PCIE_DMA_READ_LINKED_LIST_ERR_EN_REG_ADDR A:0x80ffeebc
y.create.l HWIO_PCIE_DMA_READ_DONE_IMWR_LOW_REG_ADDR A:0x80ffeec4
y.create.l HWIO_PCIE_DMA_READ_DONE_IMWR_HIGH_REG_ADDR A:0x80ffeec8
y.create.l HWIO_PCIE_DMA_READ_ABORT_IMWR_LOW_REG_ADDR A:0x80ffeecc
y.create.l HWIO_PCIE_DMA_READ_ABORT_IMWR_HIGH_REG_ADDR A:0x80ffeed0
y.create.l HWIO_PCIE_DMA_READ_CH01_IMWR_DATA_REG_ADDR A:0x80ffeed4
y.create.l HWIO_PCIE_DMA_VIEWPORT_SEL_REG_ADDR A:0x80ffeef4
y.create.l HWIO_PCIE_DMA_CH_CONTROL1_REG_WRCH_0_ADDR A:0x80ffeef8
y.create.l HWIO_PCIE_DMA_CH_CONTROL2_REG_WRCH_0_ADDR A:0x80ffeefc
y.create.l HWIO_PCIE_DMA_TRANSFER_SIZE_REG_WRCH_0_ADDR A:0x80ffef00
y.create.l HWIO_PCIE_DMA_SAR_LOW_REG_WRCH_0_ADDR A:0x80ffef04
y.create.l HWIO_PCIE_DMA_SAR_HIGH_REG_WRCH_0_ADDR A:0x80ffef08
y.create.l HWIO_PCIE_DMA_DAR_LOW_REG_WRCH_0_ADDR A:0x80ffef0c
y.create.l HWIO_PCIE_DMA_DAR_HIGH_REG_WRCH_0_ADDR A:0x80ffef10
y.create.l HWIO_PCIE_DMA_LLP_LOW_REG_WRCH_0_ADDR A:0x80ffef14
y.create.l HWIO_PCIE_DMA_LLP_HIGH_REG_WRCH_0_ADDR A:0x80ffef18
y.create.l HWIO_PCIE_PL_LTR_LATENCY_REG_ADDR A:0x80ffeb30
y.create.l HWIO_PCIE_AUX_CLK_FREQ_REG_ADDR A:0x80ffeb40
y.create.l HWIO_PCIE_L1_SUBSTATES_REG_ADDR A:0x80ffeb44
y.create.l HWIO_PCIE_TYPE0_DEVICE_ID_VENDOR_ID_REG_1_ADDR A:0x80ffe000
y.create.l HWIO_PCIE_TYPE0_STATUS_COMMAND_REG_1_ADDR A:0x80ffe004
y.create.l HWIO_PCIE_TYPE0_CLASS_CODE_REVISION_ID_1_ADDR A:0x80ffe008
y.create.l HWIO_PCIE_TYPE0_BIST_HEADER_TYPE_LATENCY_CACHE_LINE_SIZE_REG_1_ADDR A:0x80ffe00c
y.create.l HWIO_PCIE_TYPE0_BAR0_REG_1_ADDR A:0x80ffe010
y.create.l HWIO_PCIE_TYPE0_BAR1_REG_1_ADDR A:0x80ffe014
y.create.l HWIO_PCIE_TYPE0_BAR2_REG_1_ADDR A:0x80ffe018
y.create.l HWIO_PCIE_TYPE0_BAR3_REG_1_ADDR A:0x80ffe01c
y.create.l HWIO_PCIE_TYPE0_BAR4_REG_1_ADDR A:0x80ffe020
y.create.l HWIO_PCIE_TYPE0_BAR5_REG_1_ADDR A:0x80ffe024
y.create.l HWIO_PCIE_TYPE0_CARDBUS_CIS_PTR_REG_1_ADDR A:0x80ffe028
y.create.l HWIO_PCIE_TYPE0_SUBSYSTEM_ID_SUBSYSTEM_VENDOR_ID_REG_1_ADDR A:0x80ffe02c
y.create.l HWIO_PCIE_TYPE0_EXP_ROM_BASE_ADDR_REG_1_ADDR A:0x80ffe030
y.create.l HWIO_PCIE_TYPE0_PCI_CAP_PTR_REG_1_ADDR A:0x80ffe034
y.create.l HWIO_PCIE_TYPE0_MAX_LATENCY_MIN_GRANT_INTERRUPT_PIN_INTERRUPT_LINE_REG_1_ADDR A:0x80ffe03c
y.create.l HWIO_PCIE_TYPE0_L1SUB_CAP_HEADER_REG_1_ADDR A:0x80ffe150
y.create.l HWIO_PCIE_TYPE0_L1SUB_CAPABILITY_REG_1_ADDR A:0x80ffe154
y.create.l HWIO_PCIE_TYPE0_L1SUB_CONTROL1_REG_1_ADDR A:0x80ffe158
y.create.l HWIO_PCIE_TYPE0_L1SUB_CONTROL2_REG_1_ADDR A:0x80ffe15c
y.create.l HWIO_PCIE_TYPE0_CAP_ID_NXT_PTR_REG_1_ADDR A:0x80ffe040
y.create.l HWIO_PCIE_TYPE0_CON_STATUS_REG_1_ADDR A:0x80ffe044
y.create.l HWIO_PCIE_TYPE0_PCIE_CAP_ID_PCIE_NEXT_CAP_PTR_PCIE_CAP_REG_1_ADDR A:0x80ffe070
y.create.l HWIO_PCIE_TYPE0_DEVICE_CAPABILITIES_REG_1_ADDR A:0x80ffe074
y.create.l HWIO_PCIE_TYPE0_DEVICE_CONTROL_DEVICE_STATUS_1_ADDR A:0x80ffe078
y.create.l HWIO_PCIE_TYPE0_LINK_CAPABILITIES_REG_1_ADDR A:0x80ffe07c
y.create.l HWIO_PCIE_TYPE0_LINK_CONTROL_LINK_STATUS_REG_1_ADDR A:0x80ffe080
y.create.l HWIO_PCIE_TYPE0_DEVICE_CAPABILITIES2_REG_1_ADDR A:0x80ffe094
y.create.l HWIO_PCIE_TYPE0_DEVICE_CONTROL2_DEVICE_STATUS2_REG_1_ADDR A:0x80ffe098
y.create.l HWIO_PCIE_TYPE0_LINK_CAPABILITIES2_REG_1_ADDR A:0x80ffe09c
y.create.l HWIO_PCIE_TYPE0_LINK_CONTROL2_LINK_STATUS2_REG_1_ADDR A:0x80ffe0a0
y.create.l HWIO_PCIE_TYPE0_AER_EXT_CAP_HDR_REG_1_ADDR A:0x80ffe100
y.create.l HWIO_PCIE_TYPE0_UNCORR_ERR_STATUS_REG_1_ADDR A:0x80ffe104
y.create.l HWIO_PCIE_TYPE0_UNCORR_ERR_MASK_REG_1_ADDR A:0x80ffe108
y.create.l HWIO_PCIE_TYPE0_UNCORR_ERR_SEV_REG_1_ADDR A:0x80ffe10c
y.create.l HWIO_PCIE_TYPE0_CORR_ERR_STATUS_REG_1_ADDR A:0x80ffe110
y.create.l HWIO_PCIE_TYPE0_CORR_ERR_MASK_REG_1_ADDR A:0x80ffe114
y.create.l HWIO_PCIE_TYPE0_ADV_ERR_CAP_CTRL_REG_1_ADDR A:0x80ffe118
y.create.l HWIO_PCIE_TYPE0_HDR_LOG_REG_0_1_ADDR A:0x80ffe11c
y.create.l HWIO_PCIE_TYPE0_HDR_LOG_REG_1_1_ADDR A:0x80ffe120
y.create.l HWIO_PCIE_TYPE0_HDR_LOG_REG_2_1_ADDR A:0x80ffe124
y.create.l HWIO_PCIE_TYPE0_HDR_LOG_REG_3_1_ADDR A:0x80ffe128
y.create.l HWIO_PCIE_TYPE0_TLP_PREFIX_LOG_REG_1_ADDR A:0x80ffe138
y.create.l HWIO_PCIE_TYPE0_PCI_MSI_CAP_ID_NEXT_CTRL_REG_1_ADDR A:0x80ffe050
y.create.l HWIO_PCIE_TYPE0_MSI_LOWER_32_1_ADDR A:0x80ffe054
y.create.l HWIO_PCIE_TYPE0_MSI_UPPER_32_1_ADDR A:0x80ffe058
y.create.l HWIO_PCIE_TYPE0_MSI_DATA_REG_1_ADDR A:0x80ffe05c
y.create.l HWIO_PCIE_TYPE0_MSI_MASK_REG_1_ADDR A:0x80ffe060
y.create.l HWIO_PCIE_TYPE0_MSI_PENDING_BIT_REG_1_ADDR A:0x80ffe064
y.create.l HWIO_PCIE_TYPE0_LTR_CAP_HDR_REG_1_ADDR A:0x80ffe148
y.create.l HWIO_PCIE_TYPE0_LTR_LATENCY_REG_1_ADDR A:0x80ffe14c
y.create.l HWIO_PCIE_TYPE0_ACK_LATENCY_TIMER_ADDR A:0x80ffe700
y.create.l HWIO_PCIE_TYPE0_VENDOR_SPEC_DLLP_REG_ADDR A:0x80ffe704
y.create.l HWIO_PCIE_TYPE0_PORT_FORCE_REG_ADDR A:0x80ffe708
y.create.l HWIO_PCIE_TYPE0_ACK_F_ASPM_CTRL_REG_ADDR A:0x80ffe70c
y.create.l HWIO_PCIE_TYPE0_PORT_LINK_CTRL_REG_ADDR A:0x80ffe710
y.create.l HWIO_PCIE_TYPE0_LANE_SKEW_REG_ADDR A:0x80ffe714
y.create.l HWIO_PCIE_TYPE0_TIMER_CTRL_MAX_FUNC_NUM_ADDR A:0x80ffe718
y.create.l HWIO_PCIE_TYPE0_SYMBOL_TIMER_FILTER_1_REG_ADDR A:0x80ffe71c
y.create.l HWIO_PCIE_TYPE0_FILTER_MASK_REG_2_ADDR A:0x80ffe720
y.create.l HWIO_PCIE_TYPE0_AMBA_MUL_OB_DECOMP_NP_SUB_REQ_CTRL_REG_ADDR A:0x80ffe724
y.create.l HWIO_PCIE_TYPE0_DEBUG_REG_0_ADDR A:0x80ffe728
y.create.l HWIO_PCIE_TYPE0_DEBUG_REG_1_ADDR A:0x80ffe72c
y.create.l HWIO_PCIE_TYPE0_TX_P_FC_CREDIT_STATUS_ADDR A:0x80ffe730
y.create.l HWIO_PCIE_TYPE0_TX_NP_FC_CREDIT_STATUS_ADDR A:0x80ffe734
y.create.l HWIO_PCIE_TYPE0_TX_CPL_FC_CREDIT_STATUS_ADDR A:0x80ffe738
y.create.l HWIO_PCIE_TYPE0_Q_STATUS_ADDR A:0x80ffe73c
y.create.l HWIO_PCIE_TYPE0_VC_TX_ARBI_REG_1_ADDR A:0x80ffe740
y.create.l HWIO_PCIE_TYPE0_VC_TX_ARBI_REG_2_ADDR A:0x80ffe744
y.create.l HWIO_PCIE_TYPE0_VC0_P_RX_Q_CTRL_ADDR A:0x80ffe748
y.create.l HWIO_PCIE_TYPE0_VC0_NP_RX_Q_CTRL_ADDR A:0x80ffe74c
y.create.l HWIO_PCIE_TYPE0_VC0_CPL_RX_Q_CTRL_ADDR A:0x80ffe750
y.create.l HWIO_PCIE_TYPE0_VC1_P_RX_Q_CTRL_ADDR A:0x80ffe754
y.create.l HWIO_PCIE_TYPE0_VC1_NP_RX_Q_CTRL_ADDR A:0x80ffe758
y.create.l HWIO_PCIE_TYPE0_VC1_CPL_RX_Q_CTRL_ADDR A:0x80ffe75c
y.create.l HWIO_PCIE_TYPE0_VC2_P_RX_Q_CTRL_ADDR A:0x80ffe760
y.create.l HWIO_PCIE_TYPE0_VC2_NP_RX_Q_CTRL_ADDR A:0x80ffe764
y.create.l HWIO_PCIE_TYPE0_VC2_CPL_RX_Q_CTRL_ADDR A:0x80ffe768
y.create.l HWIO_PCIE_TYPE0_VC3_P_RX_Q_CTRL_ADDR A:0x80ffe76c
y.create.l HWIO_PCIE_TYPE0_VC3_NP_RX_Q_CTRL_ADDR A:0x80ffe770
y.create.l HWIO_PCIE_TYPE0_VC3_CPL_RX_Q_CTRL_ADDR A:0x80ffe774
y.create.l HWIO_PCIE_TYPE0_VC4_P_RX_Q_CTRL_ADDR A:0x80ffe778
y.create.l HWIO_PCIE_TYPE0_VC4_NP_RX_Q_CTRL_ADDR A:0x80ffe77c
y.create.l HWIO_PCIE_TYPE0_VC4_CPL_RX_Q_CTRL_ADDR A:0x80ffe780
y.create.l HWIO_PCIE_TYPE0_VC5_P_RX_Q_CTRL_ADDR A:0x80ffe784
y.create.l HWIO_PCIE_TYPE0_VC5_NP_RX_Q_CTRL_ADDR A:0x80ffe788
y.create.l HWIO_PCIE_TYPE0_VC5_CPL_RX_Q_CTRL_ADDR A:0x80ffe78c
y.create.l HWIO_PCIE_TYPE0_VC6_P_RX_Q_CTRL_ADDR A:0x80ffe790
y.create.l HWIO_PCIE_TYPE0_VC6_NP_RX_Q_CTRL_ADDR A:0x80ffe794
y.create.l HWIO_PCIE_TYPE0_VC6_CPL_RX_Q_CTRL_ADDR A:0x80ffe798
y.create.l HWIO_PCIE_TYPE0_VC7_P_RX_Q_CTRL_ADDR A:0x80ffe79c
y.create.l HWIO_PCIE_TYPE0_VC7_NP_RX_Q_CTRL_ADDR A:0x80ffe7a0
y.create.l HWIO_PCIE_TYPE0_VC7_CPL_RX_Q_CTRL_ADDR A:0x80ffe7a4
y.create.l HWIO_PCIE_TYPE0_GEN2_CTRL_REG_ADDR A:0x80ffe80c
y.create.l HWIO_PCIE_TYPE0_PHY_STATUS_REG_ADDR A:0x80ffe810
y.create.l HWIO_PCIE_TYPE0_PHY_CONTROL_REG_ADDR A:0x80ffe814
y.create.l HWIO_PCIE_TYPE0_AXI_MASTER_CTRL_REG_0_ADDR A:0x80ffe818
y.create.l HWIO_PCIE_TYPE0_AXI_MASTER_CTRL_REG_1_ADDR A:0x80ffe81c
y.create.l HWIO_PCIE_TYPE0_MSI_CTRL_ADDR_REG_ADDR A:0x80ffe820
y.create.l HWIO_PCIE_TYPE0_MSI_CTRL_UPPER_ADDR_REG_ADDR A:0x80ffe824
y.create.l HWIO_PCIE_TYPE0_MSI_CTRL_INT_0_EN_REG_ADDR A:0x80ffe828
y.create.l HWIO_PCIE_TYPE0_MSI_CTRL_INT_0_MASK_REG_ADDR A:0x80ffe82c
y.create.l HWIO_PCIE_TYPE0_MSI_CTRL_INT_0_STATUS_REG_ADDR A:0x80ffe830
y.create.l HWIO_PCIE_TYPE0_MSI_CTRL_INT_1_EN_REG_ADDR A:0x80ffe834
y.create.l HWIO_PCIE_TYPE0_MSI_CTRL_INT_1_MASK_REG_ADDR A:0x80ffe838
y.create.l HWIO_PCIE_TYPE0_MSI_CTRL_INT_1_STATUS_REG_ADDR A:0x80ffe83c
y.create.l HWIO_PCIE_TYPE0_MSI_CTRL_INT_2_EN_REG_ADDR A:0x80ffe840
y.create.l HWIO_PCIE_TYPE0_MSI_CTRL_INT_2_MASK_REG_ADDR A:0x80ffe844
y.create.l HWIO_PCIE_TYPE0_MSI_CTRL_INT_2_STATUS_REG_ADDR A:0x80ffe848
y.create.l HWIO_PCIE_TYPE0_MSI_CTRL_INT_3_EN_REG_ADDR A:0x80ffe84c
y.create.l HWIO_PCIE_TYPE0_MSI_CTRL_INT_3_MASK_REG_ADDR A:0x80ffe850
y.create.l HWIO_PCIE_TYPE0_MSI_CTRL_INT_3_STATUS_REG_ADDR A:0x80ffe854
y.create.l HWIO_PCIE_TYPE0_MSI_CTRL_INT_4_EN_REG_ADDR A:0x80ffe858
y.create.l HWIO_PCIE_TYPE0_MSI_CTRL_INT_4_MASK_REG_ADDR A:0x80ffe85c
y.create.l HWIO_PCIE_TYPE0_MSI_CTRL_INT_4_STATUS_REG_ADDR A:0x80ffe860
y.create.l HWIO_PCIE_TYPE0_MSI_CTRL_INT_5_EN_REG_ADDR A:0x80ffe864
y.create.l HWIO_PCIE_TYPE0_MSI_CTRL_INT_5_MASK_REG_ADDR A:0x80ffe868
y.create.l HWIO_PCIE_TYPE0_MSI_CTRL_INT_5_STATUS_REG_ADDR A:0x80ffe86c
y.create.l HWIO_PCIE_TYPE0_MSI_CTRL_INT_6_EN_REG_ADDR A:0x80ffe870
y.create.l HWIO_PCIE_TYPE0_MSI_CTRL_INT_6_MASK_REG_ADDR A:0x80ffe874
y.create.l HWIO_PCIE_TYPE0_MSI_CTRL_INT_6_STATUS_REG_ADDR A:0x80ffe878
y.create.l HWIO_PCIE_TYPE0_MSI_CTRL_INT_7_EN_REG_ADDR A:0x80ffe87c
y.create.l HWIO_PCIE_TYPE0_MSI_CTRL_INT_7_MASK_REG_ADDR A:0x80ffe880
y.create.l HWIO_PCIE_TYPE0_MSI_CTRL_INT_7_STATUS_REG_ADDR A:0x80ffe884
y.create.l HWIO_PCIE_TYPE0_MSI_GPIO_IO_REG_ADDR A:0x80ffe888
y.create.l HWIO_PCIE_TYPE0_GEN3_RELATED_REG_ADDR A:0x80ffe890
y.create.l HWIO_PCIE_TYPE0_GEN3_EQ_LOCAL_FS_LF_REG_ADDR A:0x80ffe894
y.create.l HWIO_PCIE_TYPE0_GEN3_EQ_PSET_COEF_MAP_0_ADDR A:0x80ffe898
y.create.l HWIO_PCIE_TYPE0_GEN3_EQ_PSET_INDEX_REG_ADDR A:0x80ffe89c
y.create.l HWIO_PCIE_TYPE0_PF_HIDDEN_REG_ADDR A:0x80ffe8a0
y.create.l HWIO_PCIE_TYPE0_GEN3_EQ_COEFF_LEGALITY_STATUS_REG_ADDR A:0x80ffe8a4
y.create.l HWIO_PCIE_TYPE0_GEN3_EQ_CONTROL_REG_ADDR A:0x80ffe8a8
y.create.l HWIO_PCIE_TYPE0_GEN3_EQ_FB_MODE_DIR_CHANGE_REG_ADDR A:0x80ffe8ac
y.create.l HWIO_PCIE_TYPE0_PIPE_LOOPBACK_CONTROL_ADDR A:0x80ffe8b8
y.create.l HWIO_PCIE_TYPE0_MISC_CONTROL_1_REG_ADDR A:0x80ffe8bc
y.create.l HWIO_PCIE_TYPE0_AMBA_ERROR_RESPONSE_DEFAULT_REG_ADDR A:0x80ffe8d0
y.create.l HWIO_PCIE_TYPE0_PL_LAST_REG_ADDR A:0x80ffe8fc
y.create.l HWIO_PCIE_TYPE0_IATU_VIEWPORT_REG_ADDR A:0x80ffe900
y.create.l HWIO_PCIE_TYPE0_PL_IATU_REGION_CTRL_REG_1_OUTBOUND_0_ADDR A:0x80ffe904
y.create.l HWIO_PCIE_TYPE0_PL_IATU_REGION_CTRL_REG_2_OUTBOUND_0_ADDR A:0x80ffe908
y.create.l HWIO_PCIE_TYPE0_PL_IATU_LWR_BASE_ADDR_REG_OUTBOUND_0_ADDR A:0x80ffe90c
y.create.l HWIO_PCIE_TYPE0_PL_IATU_UPPER_BASE_ADDR_REG_OUTBOUND_0_ADDR A:0x80ffe910
y.create.l HWIO_PCIE_TYPE0_PL_IATU_LIMIT_ADDR_REG_OUTBOUND_0_ADDR A:0x80ffe914
y.create.l HWIO_PCIE_TYPE0_PL_IATU_LWR_TARGET_ADDR_REG_OUTBOUND_0_ADDR A:0x80ffe918
y.create.l HWIO_PCIE_TYPE0_PL_IATU_UPPER_TARGET_ADDR_REG_OUTBOUND_0_ADDR A:0x80ffe91c
y.create.l HWIO_PCIE_TYPE0_PL_IATU_REGION_CTRL_REG_3_OUTBOUND_0_ADDR A:0x80ffe920
y.create.l HWIO_PCIE_TYPE0_DMA_CTRL_REG_ADDR A:0x80ffee00
y.create.l HWIO_PCIE_TYPE0_DMA_WRITE_ENGINE_EN_ADDR A:0x80ffee04
y.create.l HWIO_PCIE_TYPE0_DMA_WRITE_DOORBELL_REG_ADDR A:0x80ffee08
y.create.l HWIO_PCIE_TYPE0_DMA_WRITE_CHANNEL_ARB_WEIGHT_LOW_REG_ADDR A:0x80ffee10
y.create.l HWIO_PCIE_TYPE0_DMA_WRITE_CHANNEL_ARB_WEIGHT_HIGH_REG_ADDR A:0x80ffee14
y.create.l HWIO_PCIE_TYPE0_DMA_WRITE_P_REQ_TIMER_REG_ADDR A:0x80ffee20
y.create.l HWIO_PCIE_TYPE0_DMA_READ_ENGINE_EN_ADDR A:0x80ffee24
y.create.l HWIO_PCIE_TYPE0_DMA_READ_DOORBELL_REG_ADDR A:0x80ffee28
y.create.l HWIO_PCIE_TYPE0_DMA_READ_CHANNEL_ARB_WEIGHT_LOW_REG_ADDR A:0x80ffee30
y.create.l HWIO_PCIE_TYPE0_DMA_READ_CHANNEL_ARB_WEIGHT_HIGH_REG_ADDR A:0x80ffee34
y.create.l HWIO_PCIE_TYPE0_DMA_WRITE_INT_STATUS_REG_ADDR A:0x80ffee44
y.create.l HWIO_PCIE_TYPE0_DMA_WRITE_INT_MASK_REG_ADDR A:0x80ffee4c
y.create.l HWIO_PCIE_TYPE0_DMA_WRITE_INT_CLEAR_REG_ADDR A:0x80ffee50
y.create.l HWIO_PCIE_TYPE0_DMA_WRITE_ERR_STATUS_REG_ADDR A:0x80ffee54
y.create.l HWIO_PCIE_TYPE0_DMA_WRITE_DONE_IMWR_LOW_REG_ADDR A:0x80ffee58
y.create.l HWIO_PCIE_TYPE0_DMA_WRITE_DONE_IMWR_HIGH_REG_ADDR A:0x80ffee5c
y.create.l HWIO_PCIE_TYPE0_DMA_WRITE_ABORT_IMWR_LOW_REG_ADDR A:0x80ffee60
y.create.l HWIO_PCIE_TYPE0_DMA_WRITE_ABORT_IMWR_HIGH_REG_ADDR A:0x80ffee64
y.create.l HWIO_PCIE_TYPE0_DMA_WRITE_CH01_IMWR_DATA_REG_ADDR A:0x80ffee68
y.create.l HWIO_PCIE_TYPE0_DMA_WRITE_LINKED_LIST_ERR_EN_REG_ADDR A:0x80ffee88
y.create.l HWIO_PCIE_TYPE0_DMA_READ_INT_STATUS_REG_ADDR A:0x80ffee98
y.create.l HWIO_PCIE_TYPE0_DMA_READ_INT_MASK_REG_ADDR A:0x80ffeea0
y.create.l HWIO_PCIE_TYPE0_DMA_READ_INT_CLEAR_REG_ADDR A:0x80ffeea4
y.create.l HWIO_PCIE_TYPE0_DMA_READ_ERR_STATUS_LOW_REG_ADDR A:0x80ffeeac
y.create.l HWIO_PCIE_TYPE0_DMA_READ_ERR_STATUS_HIGH_REG_ADDR A:0x80ffeeb0
y.create.l HWIO_PCIE_TYPE0_DMA_READ_LINKED_LIST_ERR_EN_REG_ADDR A:0x80ffeebc
y.create.l HWIO_PCIE_TYPE0_DMA_READ_DONE_IMWR_LOW_REG_ADDR A:0x80ffeec4
y.create.l HWIO_PCIE_TYPE0_DMA_READ_DONE_IMWR_HIGH_REG_ADDR A:0x80ffeec8
y.create.l HWIO_PCIE_TYPE0_DMA_READ_ABORT_IMWR_LOW_REG_ADDR A:0x80ffeecc
y.create.l HWIO_PCIE_TYPE0_DMA_READ_ABORT_IMWR_HIGH_REG_ADDR A:0x80ffeed0
y.create.l HWIO_PCIE_TYPE0_DMA_READ_CH01_IMWR_DATA_REG_ADDR A:0x80ffeed4
y.create.l HWIO_PCIE_TYPE0_DMA_VIEWPORT_SEL_REG_ADDR A:0x80ffeef4
y.create.l HWIO_PCIE_TYPE0_DMA_CH_CONTROL1_REG_WRCH_0_ADDR A:0x80ffeef8
y.create.l HWIO_PCIE_TYPE0_DMA_CH_CONTROL2_REG_WRCH_0_ADDR A:0x80ffeefc
y.create.l HWIO_PCIE_TYPE0_DMA_TRANSFER_SIZE_REG_WRCH_0_ADDR A:0x80ffef00
y.create.l HWIO_PCIE_TYPE0_DMA_SAR_LOW_REG_WRCH_0_ADDR A:0x80ffef04
y.create.l HWIO_PCIE_TYPE0_DMA_SAR_HIGH_REG_WRCH_0_ADDR A:0x80ffef08
y.create.l HWIO_PCIE_TYPE0_DMA_DAR_LOW_REG_WRCH_0_ADDR A:0x80ffef0c
y.create.l HWIO_PCIE_TYPE0_DMA_DAR_HIGH_REG_WRCH_0_ADDR A:0x80ffef10
y.create.l HWIO_PCIE_TYPE0_DMA_LLP_LOW_REG_WRCH_0_ADDR A:0x80ffef14
y.create.l HWIO_PCIE_TYPE0_DMA_LLP_HIGH_REG_WRCH_0_ADDR A:0x80ffef18
y.create.l HWIO_PCIE_TYPE0_PL_LTR_LATENCY_REG_ADDR A:0x80ffeb30
y.create.l HWIO_PCIE_TYPE0_AUX_CLK_FREQ_REG_ADDR A:0x80ffeb40
y.create.l HWIO_PCIE_TYPE0_L1_SUBSTATES_REG_ADDR A:0x80ffeb44
y.create.l HWIO_PCIE_PCIE20_ELBI_VERSION_ADDR A:0x80fff000
y.create.l HWIO_PCIE_PCIE20_ELBI_SYS_CTRL_ADDR A:0x80fff004
y.create.l HWIO_PCIE_PCIE20_ELBI_SYS_STTS_ADDR A:0x80fff008
y.create.l HWIO_PCIE_PCIE20_ELBI_SYS_CLR_ADDR A:0x80fff00c
y.create.l HWIO_PCIE_PCIE20_ELBI_TESTBUS_CTRL_ADDR A:0x80fff020
y.create.l HWIO_PCIE_PCIE20_ELBI_DEBUG_INFO_0_ADDR A:0x80fff030
y.create.l HWIO_PCIE_PCIE20_ELBI_DEBUG_INFO_1_ADDR A:0x80fff034
y.create.l HWIO_PCIE_PCIE20_ELBI_TB_DIAG_0_ADDR A:0x80fff040
y.create.l HWIO_PCIE_PCIE20_ELBI_TB_DIAG_1_ADDR A:0x80fff044
y.create.l HWIO_PCIE_PCIE20_ELBI_TB_DIAG_2_ADDR A:0x80fff048
y.create.l HWIO_PCIE_PCIE20_ELBI_TB_DIAG_3_ADDR A:0x80fff04c
y.create.l HWIO_PCIE_PCIE20_ELBI_TB_DIAG_4_ADDR A:0x80fff050
y.create.l HWIO_PCIE_PCIE20_ELBI_TB_DIAG_5_ADDR A:0x80fff054
y.create.l HWIO_PCIE_PCIE20_ELBI_TB_DIAG_6_ADDR A:0x80fff058
y.create.l HWIO_PCIE_PCIE20_ELBI_TB_DIAG_7_ADDR A:0x80fff05c
y.create.l HWIO_PCIE_PCIE20_ELBI_TB_DIAG_8_ADDR A:0x80fff060
y.create.l HWIO_PCIE_PCIE20_ELBI_TB_DIAG_9_ADDR A:0x80fff064
y.create.l HWIO_PCIE_PCIE20_ELBI_DEBUG_INFO_EI_ADDR A:0x80fff0a0
y.create.l HWIO_PCIE_PCIE20_ELBI_CS2_ENABLE_ADDR A:0x80fff0a4
y.create.l HWIO_PCIE_PCIE20_EP_MEM_DEBUG_0_ADDR A:0x80000100
y.create.l HWIO_PCIE_PCIE20_EP_MEM_DEBUG_1_ADDR A:0x80000200
y.create.l HWIO_PCIE_PCIE20_EP_MEM_DEBUG_2_ADDR A:0x80000400
y.create.l HWIO_PCIE_PCIE20_EP_MEM_DEBUG_3_ADDR A:0x80000800
y.create.l HWIO_PCIE_PCIE20_EP_MEM_DEBUG_4_ADDR A:0x80001000
y.create.l HWIO_PCIE_PCIE20_EP_MEM_DEBUG_5_ADDR A:0x80002000
y.create.l HWIO_PCIE_PCIE20_EP_MEM_DEBUG_6_ADDR A:0x80004000
y.create.l HWIO_PCIE_PCIE20_EP_MEM_DEBUG_7_ADDR A:0x80008000
y.create.l HWIO_PCIE_PCIE20_EP_MEM_DEBUG_8_ADDR A:0x80010000
y.create.l HWIO_PCIE_PCIE20_EP_MEM_DEBUG_9_ADDR A:0x80020000
y.create.l HWIO_PCIE_PCIE20_EP_MEM_DEBUG_10_ADDR A:0x80040000
y.create.l HWIO_PCIE_PCIE20_EP_MEM_DEBUG_11_ADDR A:0x80080000
y.create.l HWIO_PCIE_PCIE20_EP_MEM_DEBUG_12_ADDR A:0x80100000
y.create.l HWIO_PCIE_PCIE20_EP_MEM_DEBUG_13_ADDR A:0x80200000
y.create.l HWIO_PCIE_PCIE20_EP_MEM_DEBUG_14_ADDR A:0x80400000
y.create.l HWIO_PNOC_OBS_ID_COREID_ADDR A:0xfc468000
y.create.l HWIO_PNOC_OBS_ID_REVISIONID_ADDR A:0xfc468004
y.create.l HWIO_PNOC_OBS_FAULTEN_ADDR A:0xfc468008
y.create.l HWIO_PNOC_OBS_ERRVLD_ADDR A:0xfc46800c
y.create.l HWIO_PNOC_OBS_ERRCLR_ADDR A:0xfc468010
y.create.l HWIO_PNOC_OBS_ERRLOG0_ADDR A:0xfc468014
y.create.l HWIO_PNOC_OBS_ERRLOG1_ADDR A:0xfc468018
y.create.l HWIO_PNOC_OBS_ERRLOG3_ADDR A:0xfc468020
y.create.l HWIO_PNOC_OBS_ERRLOG4_ADDR A:0xfc468024
y.create.l HWIO_PNOC_OBS_ERRLOG5_ADDR A:0xfc468028
y.create.l HWIO_PNOC_OBS_DBG_ID_COREID_ADDR A:0xfc468080
y.create.l HWIO_PNOC_OBS_DBG_ID_REVISIONID_ADDR A:0xfc468084
y.create.l HWIO_PNOC_OBS_DBG_ATBID_ADDR A:0xfc468088
y.create.l HWIO_PNOC_OBS_DBG_ATBEN_ADDR A:0xfc46808c
y.create.l HWIO_PNOC_OBS_DBG_SYNCPERIOD_ADDR A:0xfc468090
y.create.l HWIO_PNOC_QHM0_TFILT_ID_COREID_ADDR A:0xfc469000
y.create.l HWIO_PNOC_QHM0_TFILT_ID_REVISIONID_ADDR A:0xfc469004
y.create.l HWIO_PNOC_QHM0_TFILT_MODE_ADDR A:0xfc469008
y.create.l HWIO_PNOC_QHM0_TFILT_ADDRBASE_LOW_ADDR A:0xfc46900c
y.create.l HWIO_PNOC_QHM0_TFILT_ADDRWINDOWSIZE_ADDR A:0xfc469014
y.create.l HWIO_PNOC_QHM0_TFILT_SRCIDBASE_ADDR A:0xfc469018
y.create.l HWIO_PNOC_QHM0_TFILT_SRCIDMASK_ADDR A:0xfc46901c
y.create.l HWIO_PNOC_QHM0_TFILT_OPCODE_ADDR A:0xfc469020
y.create.l HWIO_PNOC_QHM0_TFILT_USERBASE_ADDR A:0xfc469024
y.create.l HWIO_PNOC_QHM0_TFILT_USERMASK_ADDR A:0xfc469028
y.create.l HWIO_PNOC_QHM1_TFILT_ID_COREID_ADDR A:0xfc469180
y.create.l HWIO_PNOC_QHM1_TFILT_ID_REVISIONID_ADDR A:0xfc469184
y.create.l HWIO_PNOC_QHM1_TFILT_MODE_ADDR A:0xfc469188
y.create.l HWIO_PNOC_QHM1_TFILT_ADDRBASE_LOW_ADDR A:0xfc46918c
y.create.l HWIO_PNOC_QHM1_TFILT_ADDRWINDOWSIZE_ADDR A:0xfc469194
y.create.l HWIO_PNOC_QHM1_TFILT_SRCIDBASE_ADDR A:0xfc469198
y.create.l HWIO_PNOC_QHM1_TFILT_SRCIDMASK_ADDR A:0xfc46919c
y.create.l HWIO_PNOC_QHM1_TFILT_OPCODE_ADDR A:0xfc4691a0
y.create.l HWIO_PNOC_QHM1_TFILT_USERBASE_ADDR A:0xfc4691a4
y.create.l HWIO_PNOC_QHM1_TFILT_USERMASK_ADDR A:0xfc4691a8
y.create.l HWIO_PNOC_QHM2_TFILT_ID_COREID_ADDR A:0xfc469200
y.create.l HWIO_PNOC_QHM2_TFILT_ID_REVISIONID_ADDR A:0xfc469204
y.create.l HWIO_PNOC_QHM2_TFILT_MODE_ADDR A:0xfc469208
y.create.l HWIO_PNOC_QHM2_TFILT_ADDRBASE_LOW_ADDR A:0xfc46920c
y.create.l HWIO_PNOC_QHM2_TFILT_ADDRWINDOWSIZE_ADDR A:0xfc469214
y.create.l HWIO_PNOC_QHM2_TFILT_SRCIDBASE_ADDR A:0xfc469218
y.create.l HWIO_PNOC_QHM2_TFILT_SRCIDMASK_ADDR A:0xfc46921c
y.create.l HWIO_PNOC_QHM2_TFILT_OPCODE_ADDR A:0xfc469220
y.create.l HWIO_PNOC_QHM2_TFILT_USERBASE_ADDR A:0xfc469224
y.create.l HWIO_PNOC_QHM2_TFILT_USERMASK_ADDR A:0xfc469228
y.create.l HWIO_PNOC_QHM3_TFILT_ID_COREID_ADDR A:0xfc469280
y.create.l HWIO_PNOC_QHM3_TFILT_ID_REVISIONID_ADDR A:0xfc469284
y.create.l HWIO_PNOC_QHM3_TFILT_MODE_ADDR A:0xfc469288
y.create.l HWIO_PNOC_QHM3_TFILT_ADDRBASE_LOW_ADDR A:0xfc46928c
y.create.l HWIO_PNOC_QHM3_TFILT_ADDRWINDOWSIZE_ADDR A:0xfc469294
y.create.l HWIO_PNOC_QHM3_TFILT_SRCIDBASE_ADDR A:0xfc469298
y.create.l HWIO_PNOC_QHM3_TFILT_SRCIDMASK_ADDR A:0xfc46929c
y.create.l HWIO_PNOC_QHM3_TFILT_OPCODE_ADDR A:0xfc4692a0
y.create.l HWIO_PNOC_QHM3_TFILT_USERBASE_ADDR A:0xfc4692a4
y.create.l HWIO_PNOC_QHM3_TFILT_USERMASK_ADDR A:0xfc4692a8
y.create.l HWIO_PNOC_TPRB_TPROF_ID_COREID_ADDR A:0xfc469300
y.create.l HWIO_PNOC_TPRB_TPROF_ID_REVISIONID_ADDR A:0xfc469304
y.create.l HWIO_PNOC_TPRB_TPROF_EN_ADDR A:0xfc469308
y.create.l HWIO_PNOC_TPRB_TPROF_MODE_ADDR A:0xfc46930c
y.create.l HWIO_PNOC_TPRB_TPROF_OBSERVEDSEL_0_ADDR A:0xfc469310
y.create.l HWIO_PNOC_TPRB_TPROF_OBSERVEDSEL_1_ADDR A:0xfc469314
y.create.l HWIO_PNOC_TPRB_TPROF_NTENURELINES_0_ADDR A:0xfc469320
y.create.l HWIO_PNOC_TPRB_TPROF_THRESHOLDS_0_0_ADDR A:0xfc46932c
y.create.l HWIO_PNOC_TPRB_TPROF_THRESHOLDS_0_1_ADDR A:0xfc469330
y.create.l HWIO_PNOC_TPRB_TPROF_THRESHOLDS_0_2_ADDR A:0xfc469334
y.create.l HWIO_PNOC_TPRB_TPROF_THRESHOLDS_1_0_ADDR A:0xfc46933c
y.create.l HWIO_PNOC_TPRB_TPROF_THRESHOLDS_1_1_ADDR A:0xfc469340
y.create.l HWIO_PNOC_TPRB_TPROF_THRESHOLDS_1_2_ADDR A:0xfc469344
y.create.l HWIO_PNOC_TPRB_TPROF_OVERFLOWSTATUS_ADDR A:0xfc46936c
y.create.l HWIO_PNOC_TPRB_TPROF_OVERFLOWRESET_ADDR A:0xfc469370
y.create.l HWIO_PNOC_TPRB_TPROF_PENDINGEVENTMODE_ADDR A:0xfc469374
y.create.l HWIO_PNOC_TPRB_TPROF_PRESCALER_ADDR A:0xfc469378
y.create.l HWIO_PNOC_TPRB_SPROF_ID_COREID_ADDR A:0xfc469400
y.create.l HWIO_PNOC_TPRB_SPROF_ID_REVISIONID_ADDR A:0xfc469404
y.create.l HWIO_PNOC_TPRB_SPROF_MAINCTL_ADDR A:0xfc469408
y.create.l HWIO_PNOC_TPRB_SPROF_CFGCTL_ADDR A:0xfc46940c
y.create.l HWIO_PNOC_TPRB_SPROF_STATPERIOD_ADDR A:0xfc469424
y.create.l HWIO_PNOC_TPRB_SPROF_STATGO_ADDR A:0xfc469428
y.create.l HWIO_PNOC_TPRB_SPROF_STATALARMMIN_ADDR A:0xfc46942c
y.create.l HWIO_PNOC_TPRB_SPROF_STATALARMMAX_ADDR A:0xfc469430
y.create.l HWIO_PNOC_TPRB_SPROF_STATALARMSTATUS_ADDR A:0xfc469434
y.create.l HWIO_PNOC_TPRB_SPROF_STATALARMCLR_ADDR A:0xfc469438
y.create.l HWIO_PNOC_TPRB_SPROF_COUNTERS_0_SRC_ADDR A:0xfc469538
y.create.l HWIO_PNOC_TPRB_SPROF_COUNTERS_0_ALARMMODE_ADDR A:0xfc46953c
y.create.l HWIO_PNOC_TPRB_SPROF_COUNTERS_0_VAL_ADDR A:0xfc469540
y.create.l HWIO_PNOC_TPRB_SPROF_COUNTERS_1_SRC_ADDR A:0xfc46954c
y.create.l HWIO_PNOC_TPRB_SPROF_COUNTERS_1_ALARMMODE_ADDR A:0xfc469550
y.create.l HWIO_PNOC_TPRB_SPROF_COUNTERS_1_VAL_ADDR A:0xfc469554
y.create.l HWIO_PNOC_TPRB_SPROF_COUNTERS_2_SRC_ADDR A:0xfc469560
y.create.l HWIO_PNOC_TPRB_SPROF_COUNTERS_2_ALARMMODE_ADDR A:0xfc469564
y.create.l HWIO_PNOC_TPRB_SPROF_COUNTERS_2_VAL_ADDR A:0xfc469568
y.create.l HWIO_PNOC_TPRB_SPROF_COUNTERS_3_SRC_ADDR A:0xfc469574
y.create.l HWIO_PNOC_TPRB_SPROF_COUNTERS_3_ALARMMODE_ADDR A:0xfc469578
y.create.l HWIO_PNOC_TPRB_SPROF_COUNTERS_3_VAL_ADDR A:0xfc46957c
y.create.l HWIO_PNOC_TPRB_SPROF_COUNTERS_4_SRC_ADDR A:0xfc469588
y.create.l HWIO_PNOC_TPRB_SPROF_COUNTERS_4_ALARMMODE_ADDR A:0xfc46958c
y.create.l HWIO_PNOC_TPRB_SPROF_COUNTERS_4_VAL_ADDR A:0xfc469590
y.create.l HWIO_PNOC_TPRB_SPROF_COUNTERS_5_SRC_ADDR A:0xfc46959c
y.create.l HWIO_PNOC_TPRB_SPROF_COUNTERS_5_ALARMMODE_ADDR A:0xfc4695a0
y.create.l HWIO_PNOC_TPRB_SPROF_COUNTERS_5_VAL_ADDR A:0xfc4695a4
y.create.l HWIO_PNOC_TPRB_SPROF_COUNTERS_6_SRC_ADDR A:0xfc4695b0
y.create.l HWIO_PNOC_TPRB_SPROF_COUNTERS_6_ALARMMODE_ADDR A:0xfc4695b4
y.create.l HWIO_PNOC_TPRB_SPROF_COUNTERS_6_VAL_ADDR A:0xfc4695b8
y.create.l HWIO_PNOC_TPRB_SPROF_COUNTERS_7_SRC_ADDR A:0xfc4695c4
y.create.l HWIO_PNOC_TPRB_SPROF_COUNTERS_7_ALARMMODE_ADDR A:0xfc4695c8
y.create.l HWIO_PNOC_TPRB_SPROF_COUNTERS_7_VAL_ADDR A:0xfc4695cc
y.create.l HWIO_PNOC_TPRB_SPROF_COUNTERS_8_SRC_ADDR A:0xfc4695d8
y.create.l HWIO_PNOC_TPRB_SPROF_COUNTERS_8_ALARMMODE_ADDR A:0xfc4695dc
y.create.l HWIO_PNOC_TPRB_SPROF_COUNTERS_8_VAL_ADDR A:0xfc4695e0
y.create.l HWIO_PNOC_TPRB_SPROF_COUNTERS_9_SRC_ADDR A:0xfc4695ec
y.create.l HWIO_PNOC_TPRB_SPROF_COUNTERS_9_ALARMMODE_ADDR A:0xfc4695f0
y.create.l HWIO_PNOC_TPRB_SPROF_COUNTERS_9_VAL_ADDR A:0xfc4695f4
y.create.l HWIO_PNOC_TPRB_SPROF_COUNTERS_10_SRC_ADDR A:0xfc469600
y.create.l HWIO_PNOC_TPRB_SPROF_COUNTERS_10_ALARMMODE_ADDR A:0xfc469604
y.create.l HWIO_PNOC_TPRB_SPROF_COUNTERS_10_VAL_ADDR A:0xfc469608
y.create.l HWIO_PNOC_TPRB_SPROF_COUNTERS_11_SRC_ADDR A:0xfc469614
y.create.l HWIO_PNOC_TPRB_SPROF_COUNTERS_11_ALARMMODE_ADDR A:0xfc469618
y.create.l HWIO_PNOC_TPRB_SPROF_COUNTERS_11_VAL_ADDR A:0xfc46961c
y.create.l HWIO_PNOC_TPRB_SPROF_COUNTERS_12_SRC_ADDR A:0xfc469628
y.create.l HWIO_PNOC_TPRB_SPROF_COUNTERS_12_ALARMMODE_ADDR A:0xfc46962c
y.create.l HWIO_PNOC_TPRB_SPROF_COUNTERS_12_VAL_ADDR A:0xfc469630
y.create.l HWIO_PNOC_TPRB_SPROF_COUNTERS_13_SRC_ADDR A:0xfc46963c
y.create.l HWIO_PNOC_TPRB_SPROF_COUNTERS_13_ALARMMODE_ADDR A:0xfc469640
y.create.l HWIO_PNOC_TPRB_SPROF_COUNTERS_13_VAL_ADDR A:0xfc469644
y.create.l HWIO_PNOC_TPRB_SPROF_COUNTERS_14_SRC_ADDR A:0xfc469650
y.create.l HWIO_PNOC_TPRB_SPROF_COUNTERS_14_ALARMMODE_ADDR A:0xfc469654
y.create.l HWIO_PNOC_TPRB_SPROF_COUNTERS_14_VAL_ADDR A:0xfc469658
y.create.l HWIO_PNOC_TPRB_SPROF_COUNTERS_15_SRC_ADDR A:0xfc469664
y.create.l HWIO_PNOC_TPRB_SPROF_COUNTERS_15_ALARMMODE_ADDR A:0xfc469668
y.create.l HWIO_PNOC_TPRB_SPROF_COUNTERS_15_VAL_ADDR A:0xfc46966c
y.create.l HWIO_PNOC_EPRB_SPROF_ID_COREID_ADDR A:0xfc469800
y.create.l HWIO_PNOC_EPRB_SPROF_ID_REVISIONID_ADDR A:0xfc469804
y.create.l HWIO_PNOC_EPRB_SPROF_MAINCTL_ADDR A:0xfc469808
y.create.l HWIO_PNOC_EPRB_SPROF_CFGCTL_ADDR A:0xfc46980c
y.create.l HWIO_PNOC_EPRB_SPROF_FILTERLUT_ADDR A:0xfc469814
y.create.l HWIO_PNOC_EPRB_SPROF_TRACEALARMEN_ADDR A:0xfc469818
y.create.l HWIO_PNOC_EPRB_SPROF_TRACEALARMSTATUS_ADDR A:0xfc46981c
y.create.l HWIO_PNOC_EPRB_SPROF_TRACEALARMCLR_ADDR A:0xfc469820
y.create.l HWIO_PNOC_EPRB_SPROF_STATPERIOD_ADDR A:0xfc469824
y.create.l HWIO_PNOC_EPRB_SPROF_STATGO_ADDR A:0xfc469828
y.create.l HWIO_PNOC_EPRB_SPROF_STATALARMMIN_ADDR A:0xfc46982c
y.create.l HWIO_PNOC_EPRB_SPROF_STATALARMMAX_ADDR A:0xfc469830
y.create.l HWIO_PNOC_EPRB_SPROF_STATALARMSTATUS_ADDR A:0xfc469834
y.create.l HWIO_PNOC_EPRB_SPROF_STATALARMCLR_ADDR A:0xfc469838
y.create.l HWIO_PNOC_EPRB_SPROF_FILTERS_0_ROUTEIDBASE_ADDR A:0xfc469844
y.create.l HWIO_PNOC_EPRB_SPROF_FILTERS_0_ROUTEIDMASK_ADDR A:0xfc469848
y.create.l HWIO_PNOC_EPRB_SPROF_FILTERS_0_ADDRBASE_LOW_ADDR A:0xfc46984c
y.create.l HWIO_PNOC_EPRB_SPROF_FILTERS_0_ADDRBASE_HIGH_ADDR A:0xfc469850
y.create.l HWIO_PNOC_EPRB_SPROF_FILTERS_0_WINDOWSIZE_ADDR A:0xfc469854
y.create.l HWIO_PNOC_EPRB_SPROF_FILTERS_0_OPCODE_ADDR A:0xfc469860
y.create.l HWIO_PNOC_EPRB_SPROF_FILTERS_0_STATUS_ADDR A:0xfc469864
y.create.l HWIO_PNOC_EPRB_SPROF_FILTERS_0_LENGTH_ADDR A:0xfc469868
y.create.l HWIO_PNOC_EPRB_SPROF_FILTERS_0_URGENCY_ADDR A:0xfc46986c
y.create.l HWIO_PNOC_EPRB_SPROF_FILTERS_1_ROUTEIDBASE_ADDR A:0xfc469880
y.create.l HWIO_PNOC_EPRB_SPROF_FILTERS_1_ROUTEIDMASK_ADDR A:0xfc469884
y.create.l HWIO_PNOC_EPRB_SPROF_FILTERS_1_ADDRBASE_LOW_ADDR A:0xfc469888
y.create.l HWIO_PNOC_EPRB_SPROF_FILTERS_1_ADDRBASE_HIGH_ADDR A:0xfc46988c
y.create.l HWIO_PNOC_EPRB_SPROF_FILTERS_1_WINDOWSIZE_ADDR A:0xfc469890
y.create.l HWIO_PNOC_EPRB_SPROF_FILTERS_1_OPCODE_ADDR A:0xfc46989c
y.create.l HWIO_PNOC_EPRB_SPROF_FILTERS_1_STATUS_ADDR A:0xfc4698a0
y.create.l HWIO_PNOC_EPRB_SPROF_FILTERS_1_LENGTH_ADDR A:0xfc4698a4
y.create.l HWIO_PNOC_EPRB_SPROF_FILTERS_1_URGENCY_ADDR A:0xfc4698a8
y.create.l HWIO_PNOC_EPRB_SPROF_COUNTERS_0_SRC_ADDR A:0xfc469938
y.create.l HWIO_PNOC_EPRB_SPROF_COUNTERS_0_ALARMMODE_ADDR A:0xfc46993c
y.create.l HWIO_PNOC_EPRB_SPROF_COUNTERS_0_VAL_ADDR A:0xfc469940
y.create.l HWIO_PNOC_EPRB_SPROF_COUNTERS_1_SRC_ADDR A:0xfc46994c
y.create.l HWIO_PNOC_EPRB_SPROF_COUNTERS_1_ALARMMODE_ADDR A:0xfc469950
y.create.l HWIO_PNOC_EPRB_SPROF_COUNTERS_1_VAL_ADDR A:0xfc469954
y.create.l HWIO_PNOC_EPRB_SPROF_COUNTERS_2_SRC_ADDR A:0xfc469960
y.create.l HWIO_PNOC_EPRB_SPROF_COUNTERS_2_ALARMMODE_ADDR A:0xfc469964
y.create.l HWIO_PNOC_EPRB_SPROF_COUNTERS_2_VAL_ADDR A:0xfc469968
y.create.l HWIO_PNOC_EPRB_SPROF_COUNTERS_3_SRC_ADDR A:0xfc469974
y.create.l HWIO_PNOC_EPRB_SPROF_COUNTERS_3_ALARMMODE_ADDR A:0xfc469978
y.create.l HWIO_PNOC_EPRB_SPROF_COUNTERS_3_VAL_ADDR A:0xfc46997c
y.create.l HWIO_PNOC_EPRB_SPROF_COUNTERS_4_SRC_ADDR A:0xfc469988
y.create.l HWIO_PNOC_EPRB_SPROF_COUNTERS_4_ALARMMODE_ADDR A:0xfc46998c
y.create.l HWIO_PNOC_EPRB_SPROF_COUNTERS_4_VAL_ADDR A:0xfc469990
y.create.l HWIO_PNOC_EPRB_SPROF_COUNTERS_5_SRC_ADDR A:0xfc46999c
y.create.l HWIO_PNOC_EPRB_SPROF_COUNTERS_5_ALARMMODE_ADDR A:0xfc4699a0
y.create.l HWIO_PNOC_EPRB_SPROF_COUNTERS_5_VAL_ADDR A:0xfc4699a4
y.create.l HWIO_PNOC_EPRB_SPROF_COUNTERS_6_SRC_ADDR A:0xfc4699b0
y.create.l HWIO_PNOC_EPRB_SPROF_COUNTERS_6_ALARMMODE_ADDR A:0xfc4699b4
y.create.l HWIO_PNOC_EPRB_SPROF_COUNTERS_6_VAL_ADDR A:0xfc4699b8
y.create.l HWIO_PNOC_EPRB_SPROF_COUNTERS_7_SRC_ADDR A:0xfc4699c4
y.create.l HWIO_PNOC_EPRB_SPROF_COUNTERS_7_ALARMMODE_ADDR A:0xfc4699c8
y.create.l HWIO_PNOC_EPRB_SPROF_COUNTERS_7_VAL_ADDR A:0xfc4699cc
y.create.l HWIO_PERIPH_SS_SDC2_SDCC_MCI_POWER_ADDR A:0xf98a4000
y.create.l HWIO_PERIPH_SS_SDC2_SDCC_MCI_CLK_ADDR A:0xf98a4004
y.create.l HWIO_PERIPH_SS_SDC2_SDCC_MCI_ARGUMENT_ADDR A:0xf98a4008
y.create.l HWIO_PERIPH_SS_SDC2_SDCC_MCI_CMD_ADDR A:0xf98a400c
y.create.l HWIO_PERIPH_SS_SDC2_SDCC_MCI_RESP_CMD_ADDR A:0xf98a4010
y.create.l HWIO_PERIPH_SS_SDC2_SDCC_MCI_RESP0_ADDR A:0xf98a4014
y.create.l HWIO_PERIPH_SS_SDC2_SDCC_MCI_RESP1_ADDR A:0xf98a4018
y.create.l HWIO_PERIPH_SS_SDC2_SDCC_MCI_RESP2_ADDR A:0xf98a401c
y.create.l HWIO_PERIPH_SS_SDC2_SDCC_MCI_RESP3_ADDR A:0xf98a4020
y.create.l HWIO_PERIPH_SS_SDC2_SDCC_MCI_DATA_TIMER_ADDR A:0xf98a4024
y.create.l HWIO_PERIPH_SS_SDC2_SDCC_MCI_DATA_LENGTH_ADDR A:0xf98a4028
y.create.l HWIO_PERIPH_SS_SDC2_SDCC_MCI_DATA_CTL_ADDR A:0xf98a402c
y.create.l HWIO_PERIPH_SS_SDC2_SDCC_MCI_DATA_COUNT_ADDR A:0xf98a4030
y.create.l HWIO_PERIPH_SS_SDC2_SDCC_MCI_STATUS_ADDR A:0xf98a4034
y.create.l HWIO_PERIPH_SS_SDC2_SDCC_MCI_CLEAR_ADDR A:0xf98a4038
y.create.l HWIO_PERIPH_SS_SDC2_SDCC_MCI_INT_MASK0_ADDR A:0xf98a403c
y.create.l HWIO_PERIPH_SS_SDC2_SDCC_MCI_INT_MASK1_ADDR A:0xf98a4040
y.create.l HWIO_PERIPH_SS_SDC2_SDCC_MCI_FIFO_COUNT_ADDR A:0xf98a4044
y.create.l HWIO_PERIPH_SS_SDC2_SDCC_MCI_BOOT_ADDR A:0xf98a4048
y.create.l HWIO_PERIPH_SS_SDC2_SDCC_MCI_BOOT_ACK_TIMER_ADDR A:0xf98a404c
y.create.l HWIO_PERIPH_SS_SDC2_SDCC_MCI_VERSION_ADDR A:0xf98a4050
y.create.l HWIO_PERIPH_SS_SDC2_SDCC_MCI_EMULATION_DLY_LINE_ADDR A:0xf98a4054
y.create.l HWIO_PERIPH_SS_SDC2_SDCC_MCI_CCS_TIMER_ADDR A:0xf98a4058
y.create.l HWIO_PERIPH_SS_SDC2_SDCC_MCI_RESPONSE_MASK_ADDR A:0xf98a405c
y.create.l HWIO_PERIPH_SS_SDC2_SDCC_MCI_DLL_CONFIG_ADDR A:0xf98a4060
y.create.l HWIO_PERIPH_SS_SDC2_SDCC_MCI_DLL_TEST_CTL_ADDR A:0xf98a4064
y.create.l HWIO_PERIPH_SS_SDC2_SDCC_MCI_DLL_STATUS_ADDR A:0xf98a4068
y.create.l HWIO_PERIPH_SS_SDC2_SDCC_MCI_STATUS2_ADDR A:0xf98a406c
y.create.l HWIO_PERIPH_SS_SDC2_SDCC_MCI_GENERICS_ADDR A:0xf98a4070
y.create.l HWIO_PERIPH_SS_SDC2_SDCC_MCI_FIFO_STATUS_ADDR A:0xf98a4074
y.create.l HWIO_PERIPH_SS_SDC2_SDCC_MCI_HC_MODE_ADDR A:0xf98a4078
y.create.l HWIO_PERIPH_SS_SDC2_SDCC_MCI_FIFO0_ADDR A:0xf98a4080
y.create.l HWIO_PERIPH_SS_SDC2_SDCC_MCI_FIFO1_ADDR A:0xf98a4084
y.create.l HWIO_PERIPH_SS_SDC2_SDCC_MCI_FIFO2_ADDR A:0xf98a4088
y.create.l HWIO_PERIPH_SS_SDC2_SDCC_MCI_FIFO3_ADDR A:0xf98a408c
y.create.l HWIO_PERIPH_SS_SDC2_SDCC_MCI_FIFO4_ADDR A:0xf98a4090
y.create.l HWIO_PERIPH_SS_SDC2_SDCC_MCI_FIFO5_ADDR A:0xf98a4094
y.create.l HWIO_PERIPH_SS_SDC2_SDCC_MCI_FIFO6_ADDR A:0xf98a4098
y.create.l HWIO_PERIPH_SS_SDC2_SDCC_MCI_FIFO7_ADDR A:0xf98a409c
y.create.l HWIO_PERIPH_SS_SDC2_SDCC_MCI_FIFO8_ADDR A:0xf98a40a0
y.create.l HWIO_PERIPH_SS_SDC2_SDCC_MCI_FIFO9_ADDR A:0xf98a40a4
y.create.l HWIO_PERIPH_SS_SDC2_SDCC_MCI_TESTBUS_CONFIG_ADDR A:0xf98a40cc
y.create.l HWIO_PERIPH_SS_SDC2_SDCC_MCI_TEST_CTL_ADDR A:0xf98a40d0
y.create.l HWIO_PERIPH_SS_SDC2_SDCC_MCI_TEST_INPUT_ADDR A:0xf98a40d4
y.create.l HWIO_PERIPH_SS_SDC2_SDCC_MCI_TEST_OUT_ADDR A:0xf98a40d8
y.create.l HWIO_PERIPH_SS_SDC2_SDCC_MCI_PWRCTL_STATUS_REG_ADDR A:0xf98a40dc
y.create.l HWIO_PERIPH_SS_SDC2_SDCC_MCI_PWRCTL_MASK_REG_ADDR A:0xf98a40e0
y.create.l HWIO_PERIPH_SS_SDC2_SDCC_MCI_PWRCTL_CLEAR_REG_ADDR A:0xf98a40e4
y.create.l HWIO_PERIPH_SS_SDC2_SDCC_MCI_PWRCTL_CTL_REG_ADDR A:0xf98a40e8
y.create.l HWIO_PERIPH_SS_SDC2_SDCC_MCI_CLEAR2_ADDR A:0xf98a40ec
y.create.l HWIO_PERIPH_SS_SDC2_SDCC_MCI_INT_MASKINT2_0_ADDR A:0xf98a40f0
y.create.l HWIO_PERIPH_SS_SDC2_SDCC_MCI_INT_MASKINT2_1_ADDR A:0xf98a40f4
y.create.l HWIO_PERIPH_SS_SDC2_SDCC_CHAR_CFG_ADDR A:0xf98a40fc
y.create.l HWIO_PERIPH_SS_SDC2_SDCC_CHAR_CMD_ADDR A:0xf98a4100
y.create.l HWIO_PERIPH_SS_SDC2_SDCC_CHAR_DATA_0_ADDR A:0xf98a4104
y.create.l HWIO_PERIPH_SS_SDC2_SDCC_CHAR_DATA_1_ADDR A:0xf98a4108
y.create.l HWIO_PERIPH_SS_SDC2_SDCC_CHAR_DATA_2_ADDR A:0xf98a410c
y.create.l HWIO_PERIPH_SS_SDC2_SDCC_CHAR_DATA_3_ADDR A:0xf98a4110
y.create.l HWIO_PERIPH_SS_SDC2_SDCC_CHAR_DATA_4_ADDR A:0xf98a4114
y.create.l HWIO_PERIPH_SS_SDC2_SDCC_CHAR_DATA_5_ADDR A:0xf98a4118
y.create.l HWIO_PERIPH_SS_SDC2_SDCC_CHAR_DATA_6_ADDR A:0xf98a411c
y.create.l HWIO_PERIPH_SS_SDC2_SDCC_CHAR_DATA_7_ADDR A:0xf98a4120
y.create.l HWIO_PERIPH_SS_SDC2_SDCC_DEBUG_REG_ADDR A:0xf98a4124
y.create.l HWIO_PERIPH_SS_SDC2_SDCC_IP_CATALOG_ADDR A:0xf98a4128
y.create.l HWIO_PERIPH_SS_SDC2_SDCC_QSB_VALUES_ADDR A:0xf98a412c
y.create.l HWIO_PERIPH_SS_SDC2_SDCC_TIME_COUNT_CTRL_ADDR A:0xf98a4198
y.create.l HWIO_PERIPH_SS_SDC2_SDCC_FLOW_CTRL_TIME_COUNT_ADDR A:0xf98a419c
y.create.l HWIO_PERIPH_SS_SDC2_SDCC_BUSY_TIME_COUNT_ADDR A:0xf98a41a0
y.create.l HWIO_PERIPH_SS_SDC2_SDCC_DATA_TIME_COUNT_ADDR A:0xf98a41a4
y.create.l HWIO_PERIPH_SS_SDC2_SDCC_CMD_TIME_COUNT_ADDR A:0xf98a41a8
y.create.l HWIO_PERIPH_SS_SDC2_SDCC_MCI_FIFO_ALT0_ADDR A:0xf98a4400
y.create.l HWIO_PERIPH_SS_SDC2_SDCC_MCI_FIFO_ALT1_ADDR A:0xf98a4404
y.create.l HWIO_PERIPH_SS_SDC2_SDCC_MCI_FIFO_ALT2_ADDR A:0xf98a4408
y.create.l HWIO_PERIPH_SS_SDC2_SDCC_MCI_FIFO_ALT3_ADDR A:0xf98a440c
y.create.l HWIO_PERIPH_SS_SDC2_SDCC_MCI_FIFO_ALT4_ADDR A:0xf98a4410
y.create.l HWIO_PERIPH_SS_SDC2_SDCC_MCI_FIFO_ALT5_ADDR A:0xf98a4414
y.create.l HWIO_PERIPH_SS_SDC2_SDCC_MCI_FIFO_ALT6_ADDR A:0xf98a4418
y.create.l HWIO_PERIPH_SS_SDC2_SDCC_MCI_FIFO_ALT7_ADDR A:0xf98a441c
y.create.l HWIO_PERIPH_SS_SDC2_SDCC_MCI_FIFO_ALT8_ADDR A:0xf98a4420
y.create.l HWIO_PERIPH_SS_SDC2_SDCC_MCI_FIFO_ALT9_ADDR A:0xf98a4424
y.create.l HWIO_PERIPH_SS_SDC2_SDCC_DML_CONFIG_ADDR A:0xf98a4800
y.create.l HWIO_PERIPH_SS_SDC2_SDCC_DML_STATUS_ADDR A:0xf98a4804
y.create.l HWIO_PERIPH_SS_SDC2_SDCC_DML_SW_RESET_ADDR A:0xf98a4808
y.create.l HWIO_PERIPH_SS_SDC2_SDCC_DML_PRODUCER_START_ADDR A:0xf98a480c
y.create.l HWIO_PERIPH_SS_SDC2_SDCC_DML_CONSUMER_START_ADDR A:0xf98a4810
y.create.l HWIO_PERIPH_SS_SDC2_SDCC_DML_PRODUCER_PIPE_LOGICAL_SIZE_ADDR A:0xf98a4814
y.create.l HWIO_PERIPH_SS_SDC2_SDCC_DML_CONSUMER_PIPE_LOGICAL_SIZE_ADDR A:0xf98a4818
y.create.l HWIO_PERIPH_SS_SDC2_SDCC_DML_PIPE_ID_ADDR A:0xf98a481c
y.create.l HWIO_PERIPH_SS_SDC2_SDCC_DML_PRODUCER_TRACKERS_ADDR A:0xf98a4820
y.create.l HWIO_PERIPH_SS_SDC2_SDCC_DML_PRODUCER_BAM_BLOCK_SIZE_ADDR A:0xf98a4824
y.create.l HWIO_PERIPH_SS_SDC2_SDCC_DML_PRODUCER_BAM_TRANS_SIZE_ADDR A:0xf98a4828
y.create.l HWIO_PERIPH_SS_SDC2_SDCC_DML_DIRECT_MODE_BASE_ADDR_ADDR A:0xf98a482c
y.create.l HWIO_PERIPH_SS_SDC2_SDCC_DML_DEBUG_ADDR A:0xf98a4830
y.create.l HWIO_PERIPH_SS_SDC2_SDCC_DML_BAM_SIDE_STATUS_1_ADDR A:0xf98a4834
y.create.l HWIO_PERIPH_SS_SDC2_SDCC_DML_BAM_SIDE_STATUS_2_ADDR A:0xf98a4838
y.create.l HWIO_PERIPH_SS_SDC2_SDCC_DML_RTL_GENERICS_1_ADDR A:0xf98a483c
y.create.l HWIO_PERIPH_SS_SDC2_SDCC_DML_RTL_GENERICS_2_ADDR A:0xf98a4840
y.create.l HWIO_PERIPH_SS_SDC2_SDCC_DML_RTL_GENERICS_3_ADDR A:0xf98a4844
y.create.l HWIO_PERIPH_SS_SDC2_SDCC_DML_INTERRUPT_ENABLE_ADDR A:0xf98a4848
y.create.l HWIO_PERIPH_SS_SDC2_SDCC_DML_INTERRUPT_CLEAR_ADDR A:0xf98a484c
y.create.l HWIO_PERIPH_SS_SDC2_SDCC_HC_REG_0_2_ADDR A:0xf98a4900
y.create.l HWIO_PERIPH_SS_SDC2_SDCC_HC_REG_4_6_ADDR A:0xf98a4904
y.create.l HWIO_PERIPH_SS_SDC2_SDCC_HC_REG_8_A_ADDR A:0xf98a4908
y.create.l HWIO_PERIPH_SS_SDC2_SDCC_HC_REG_C_E_ADDR A:0xf98a490c
y.create.l HWIO_PERIPH_SS_SDC2_SDCC_HC_REG_10_12_ADDR A:0xf98a4910
y.create.l HWIO_PERIPH_SS_SDC2_SDCC_HC_REG_14_16_ADDR A:0xf98a4914
y.create.l HWIO_PERIPH_SS_SDC2_SDCC_HC_REG_18_1A_ADDR A:0xf98a4918
y.create.l HWIO_PERIPH_SS_SDC2_SDCC_HC_REG_1C_1E_ADDR A:0xf98a491c
y.create.l HWIO_PERIPH_SS_SDC2_SDCC_HC_REG_20_22_ADDR A:0xf98a4920
y.create.l HWIO_PERIPH_SS_SDC2_SDCC_HC_REG_24_26_ADDR A:0xf98a4924
y.create.l HWIO_PERIPH_SS_SDC2_SDCC_HC_REG_28_2A_ADDR A:0xf98a4928
y.create.l HWIO_PERIPH_SS_SDC2_SDCC_HC_REG_2C_2E_ADDR A:0xf98a492c
y.create.l HWIO_PERIPH_SS_SDC2_SDCC_HC_REG_30_32_ADDR A:0xf98a4930
y.create.l HWIO_PERIPH_SS_SDC2_SDCC_HC_REG_34_36_ADDR A:0xf98a4934
y.create.l HWIO_PERIPH_SS_SDC2_SDCC_HC_REG_38_3A_ADDR A:0xf98a4938
y.create.l HWIO_PERIPH_SS_SDC2_SDCC_HC_REG_3C_3E_ADDR A:0xf98a493c
y.create.l HWIO_PERIPH_SS_SDC2_SDCC_HC_REG_40_42_ADDR A:0xf98a4940
y.create.l HWIO_PERIPH_SS_SDC2_SDCC_HC_REG_44_46_ADDR A:0xf98a4944
y.create.l HWIO_PERIPH_SS_SDC2_SDCC_HC_REG_48_4A_ADDR A:0xf98a4948
y.create.l HWIO_PERIPH_SS_SDC2_SDCC_HC_REG_50_52_ADDR A:0xf98a4950
y.create.l HWIO_PERIPH_SS_SDC2_SDCC_HC_REG_54_56_ADDR A:0xf98a4954
y.create.l HWIO_PERIPH_SS_SDC2_SDCC_HC_REG_58_5A_ADDR A:0xf98a4958
y.create.l HWIO_PERIPH_SS_SDC2_SDCC_HC_REG_5C_5E_ADDR A:0xf98a495c
y.create.l HWIO_PERIPH_SS_SDC2_SDCC_HC_REG_60_62_ADDR A:0xf98a4960
y.create.l HWIO_PERIPH_SS_SDC2_SDCC_HC_REG_64_66_ADDR A:0xf98a4964
y.create.l HWIO_PERIPH_SS_SDC2_SDCC_HC_REG_68_6A_ADDR A:0xf98a4968
y.create.l HWIO_PERIPH_SS_SDC2_SDCC_HC_REG_6C_6E_ADDR A:0xf98a496c
y.create.l HWIO_PERIPH_SS_SDC2_SDCC_HC_REG_E0_E2_ADDR A:0xf98a49e0
y.create.l HWIO_PERIPH_SS_SDC2_SDCC_HC_REG_FC_FE_ADDR A:0xf98a49fc
y.create.l HWIO_PERIPH_SS_SDC2_SDCC_HC_REG_DLL_CONFIG_ADDR A:0xf98a4a00
y.create.l HWIO_PERIPH_SS_SDC2_SDCC_HC_REG_DLL_TEST_CTL_ADDR A:0xf98a4a04
y.create.l HWIO_PERIPH_SS_SDC2_SDCC_HC_REG_DLL_STATUS_ADDR A:0xf98a4a08
y.create.l HWIO_PERIPH_SS_SDC2_SDCC_HC_VENDOR_SPECIFIC_FUNC_ADDR A:0xf98a4a0c
y.create.l HWIO_PERIPH_SS_SDC2_SDCC_HC_VENDOR_SPECIFIC_ADMA_ERR_ADDR0_ADDR A:0xf98a4a14
y.create.l HWIO_PERIPH_SS_SDC2_SDCC_HC_VENDOR_SPECIFIC_ADMA_ERR_ADDR1_ADDR A:0xf98a4a18
y.create.l HWIO_PERIPH_SS_SDC2_SDCC_HC_VENDOR_SPECIFIC_CAPABILITIES0_ADDR A:0xf98a4a1c
y.create.l HWIO_PERIPH_SS_SDC2_SDCC_HC_VENDOR_SPECIFIC_CAPABILITIES1_ADDR A:0xf98a4a20
y.create.l HWIO_PERIPH_SS_SDC2_SDCC_HC_VENDOR_SPECIFIC_TIME_COUNT_CTRL_ADDR A:0xf98a4a88
y.create.l HWIO_PERIPH_SS_SDC2_SDCC_HC_VENDOR_SPECIFIC_FLOW_CTRL_TIME_COUNT_ADDR A:0xf98a4a8c
y.create.l HWIO_PERIPH_SS_SDC2_SDCC_HC_VENDOR_SPECIFIC_BUSY_TIME_COUNT_ADDR A:0xf98a4a90
y.create.l HWIO_PERIPH_SS_SDC2_SDCC_HC_VENDOR_SPECIFIC_DATA_TIME_COUNT_ADDR A:0xf98a4a94
y.create.l HWIO_PERIPH_SS_SDC2_SDCC_HC_VENDOR_SPECIFIC_CMD_TIME_COUNT_ADDR A:0xf98a4a98
y.create.l HWIO_PERIPH_SS_SDC2_SDCC_BAM_CTRL_ADDR A:0xf9884000
y.create.l HWIO_PERIPH_SS_SDC2_SDCC_BAM_REVISION_ADDR A:0xf9884004
y.create.l HWIO_PERIPH_SS_SDC2_SDCC_BAM_SW_VERSION_ADDR A:0xf9884080
y.create.l HWIO_PERIPH_SS_SDC2_SDCC_BAM_NUM_PIPES_ADDR A:0xf988403c
y.create.l HWIO_PERIPH_SS_SDC2_SDCC_BAM_TIMER_ADDR A:0xf9884040
y.create.l HWIO_PERIPH_SS_SDC2_SDCC_BAM_TIMER_CTRL_ADDR A:0xf9884044
y.create.l HWIO_PERIPH_SS_SDC2_SDCC_BAM_DESC_CNT_TRSHLD_ADDR A:0xf9884008
y.create.l HWIO_PERIPH_SS_SDC2_SDCC_BAM_IRQ_SRCS_ADDR A:0xf988400c
y.create.l HWIO_PERIPH_SS_SDC2_SDCC_BAM_IRQ_SRCS_MSK_ADDR A:0xf9884010
y.create.l HWIO_PERIPH_SS_SDC2_SDCC_BAM_IRQ_SRCS_UNMASKED_ADDR A:0xf9884030
y.create.l HWIO_PERIPH_SS_SDC2_SDCC_BAM_IRQ_STTS_ADDR A:0xf9884014
y.create.l HWIO_PERIPH_SS_SDC2_SDCC_BAM_IRQ_CLR_ADDR A:0xf9884018
y.create.l HWIO_PERIPH_SS_SDC2_SDCC_BAM_IRQ_EN_ADDR A:0xf988401c
y.create.l HWIO_PERIPH_SS_SDC2_SDCC_BAM_AHB_MASTER_ERR_CTRLS_ADDR A:0xf9884024
y.create.l HWIO_PERIPH_SS_SDC2_SDCC_BAM_AHB_MASTER_ERR_ADDR_ADDR A:0xf9884028
y.create.l HWIO_PERIPH_SS_SDC2_SDCC_BAM_AHB_MASTER_ERR_ADDR_LSB_ADDR A:0xf9884100
y.create.l HWIO_PERIPH_SS_SDC2_SDCC_BAM_AHB_MASTER_ERR_ADDR_MSB_ADDR A:0xf9884104
y.create.l HWIO_PERIPH_SS_SDC2_SDCC_BAM_AHB_MASTER_ERR_DATA_ADDR A:0xf988402c
y.create.l HWIO_PERIPH_SS_SDC2_SDCC_BAM_TRUST_REG_ADDR A:0xf9884070
y.create.l HWIO_PERIPH_SS_SDC2_SDCC_BAM_TEST_BUS_SEL_ADDR A:0xf9884074
y.create.l HWIO_PERIPH_SS_SDC2_SDCC_BAM_TEST_BUS_REG_ADDR A:0xf9884078
y.create.l HWIO_PERIPH_SS_SDC2_SDCC_BAM_CNFG_BITS_ADDR A:0xf988407c
y.create.l HWIO_PERIPH_SS_SDC2_SDCC_BAM_IRQ_SRCS_EE0_ADDR A:0xf9884800
y.create.l HWIO_PERIPH_SS_SDC2_SDCC_BAM_IRQ_SRCS_EE1_ADDR A:0xf9884880
y.create.l HWIO_PERIPH_SS_SDC2_SDCC_BAM_IRQ_SRCS_EE2_ADDR A:0xf9884900
y.create.l HWIO_PERIPH_SS_SDC2_SDCC_BAM_IRQ_SRCS_EE3_ADDR A:0xf9884980
y.create.l HWIO_PERIPH_SS_SDC2_SDCC_BAM_IRQ_SRCS_EE4_ADDR A:0xf9884a00
y.create.l HWIO_PERIPH_SS_SDC2_SDCC_BAM_IRQ_SRCS_EE5_ADDR A:0xf9884a80
y.create.l HWIO_PERIPH_SS_SDC2_SDCC_BAM_IRQ_SRCS_EE6_ADDR A:0xf9884b00
y.create.l HWIO_PERIPH_SS_SDC2_SDCC_BAM_IRQ_SRCS_EE7_ADDR A:0xf9884b80
y.create.l HWIO_PERIPH_SS_SDC2_SDCC_BAM_IRQ_SRCS_MSK_EE0_ADDR A:0xf9884804
y.create.l HWIO_PERIPH_SS_SDC2_SDCC_BAM_IRQ_SRCS_MSK_EE1_ADDR A:0xf9884884
y.create.l HWIO_PERIPH_SS_SDC2_SDCC_BAM_IRQ_SRCS_MSK_EE2_ADDR A:0xf9884904
y.create.l HWIO_PERIPH_SS_SDC2_SDCC_BAM_IRQ_SRCS_MSK_EE3_ADDR A:0xf9884984
y.create.l HWIO_PERIPH_SS_SDC2_SDCC_BAM_IRQ_SRCS_MSK_EE4_ADDR A:0xf9884a04
y.create.l HWIO_PERIPH_SS_SDC2_SDCC_BAM_IRQ_SRCS_MSK_EE5_ADDR A:0xf9884a84
y.create.l HWIO_PERIPH_SS_SDC2_SDCC_BAM_IRQ_SRCS_MSK_EE6_ADDR A:0xf9884b04
y.create.l HWIO_PERIPH_SS_SDC2_SDCC_BAM_IRQ_SRCS_MSK_EE7_ADDR A:0xf9884b84
y.create.l HWIO_PERIPH_SS_SDC2_SDCC_BAM_IRQ_SRCS_UNMASKED_EE0_ADDR A:0xf9884808
y.create.l HWIO_PERIPH_SS_SDC2_SDCC_BAM_IRQ_SRCS_UNMASKED_EE1_ADDR A:0xf9884888
y.create.l HWIO_PERIPH_SS_SDC2_SDCC_BAM_IRQ_SRCS_UNMASKED_EE2_ADDR A:0xf9884908
y.create.l HWIO_PERIPH_SS_SDC2_SDCC_BAM_IRQ_SRCS_UNMASKED_EE3_ADDR A:0xf9884988
y.create.l HWIO_PERIPH_SS_SDC2_SDCC_BAM_IRQ_SRCS_UNMASKED_EE4_ADDR A:0xf9884a08
y.create.l HWIO_PERIPH_SS_SDC2_SDCC_BAM_IRQ_SRCS_UNMASKED_EE5_ADDR A:0xf9884a88
y.create.l HWIO_PERIPH_SS_SDC2_SDCC_BAM_IRQ_SRCS_UNMASKED_EE6_ADDR A:0xf9884b08
y.create.l HWIO_PERIPH_SS_SDC2_SDCC_BAM_IRQ_SRCS_UNMASKED_EE7_ADDR A:0xf9884b88
y.create.l HWIO_PERIPH_SS_SDC2_SDCC_BAM_PIPE_ATTR_EE0_ADDR A:0xf988480c
y.create.l HWIO_PERIPH_SS_SDC2_SDCC_BAM_PIPE_ATTR_EE1_ADDR A:0xf988488c
y.create.l HWIO_PERIPH_SS_SDC2_SDCC_BAM_PIPE_ATTR_EE2_ADDR A:0xf988490c
y.create.l HWIO_PERIPH_SS_SDC2_SDCC_BAM_PIPE_ATTR_EE3_ADDR A:0xf988498c
y.create.l HWIO_PERIPH_SS_SDC2_SDCC_BAM_PIPE_ATTR_EE4_ADDR A:0xf9884a0c
y.create.l HWIO_PERIPH_SS_SDC2_SDCC_BAM_PIPE_ATTR_EE5_ADDR A:0xf9884a8c
y.create.l HWIO_PERIPH_SS_SDC2_SDCC_BAM_PIPE_ATTR_EE6_ADDR A:0xf9884b0c
y.create.l HWIO_PERIPH_SS_SDC2_SDCC_BAM_PIPE_ATTR_EE7_ADDR A:0xf9884b8c
y.create.l HWIO_PERIPH_SS_SDC2_SDCC_BAM_P_CTRL0_ADDR A:0xf9885000
y.create.l HWIO_PERIPH_SS_SDC2_SDCC_BAM_P_CTRL1_ADDR A:0xf9886000
y.create.l HWIO_PERIPH_SS_SDC2_SDCC_BAM_P_CTRL2_ADDR A:0xf9887000
y.create.l HWIO_PERIPH_SS_SDC2_SDCC_BAM_P_CTRL3_ADDR A:0xf9888000
y.create.l HWIO_PERIPH_SS_SDC2_SDCC_BAM_P_CTRL4_ADDR A:0xf9889000
y.create.l HWIO_PERIPH_SS_SDC2_SDCC_BAM_P_CTRL5_ADDR A:0xf988a000
y.create.l HWIO_PERIPH_SS_SDC2_SDCC_BAM_P_RST0_ADDR A:0xf9885004
y.create.l HWIO_PERIPH_SS_SDC2_SDCC_BAM_P_RST1_ADDR A:0xf9886004
y.create.l HWIO_PERIPH_SS_SDC2_SDCC_BAM_P_RST2_ADDR A:0xf9887004
y.create.l HWIO_PERIPH_SS_SDC2_SDCC_BAM_P_RST3_ADDR A:0xf9888004
y.create.l HWIO_PERIPH_SS_SDC2_SDCC_BAM_P_RST4_ADDR A:0xf9889004
y.create.l HWIO_PERIPH_SS_SDC2_SDCC_BAM_P_RST5_ADDR A:0xf988a004
y.create.l HWIO_PERIPH_SS_SDC2_SDCC_BAM_P_HALT0_ADDR A:0xf9885008
y.create.l HWIO_PERIPH_SS_SDC2_SDCC_BAM_P_HALT1_ADDR A:0xf9886008
y.create.l HWIO_PERIPH_SS_SDC2_SDCC_BAM_P_HALT2_ADDR A:0xf9887008
y.create.l HWIO_PERIPH_SS_SDC2_SDCC_BAM_P_HALT3_ADDR A:0xf9888008
y.create.l HWIO_PERIPH_SS_SDC2_SDCC_BAM_P_HALT4_ADDR A:0xf9889008
y.create.l HWIO_PERIPH_SS_SDC2_SDCC_BAM_P_HALT5_ADDR A:0xf988a008
y.create.l HWIO_PERIPH_SS_SDC2_SDCC_BAM_P_TRUST_REG0_ADDR A:0xf9885030
y.create.l HWIO_PERIPH_SS_SDC2_SDCC_BAM_P_TRUST_REG1_ADDR A:0xf9886030
y.create.l HWIO_PERIPH_SS_SDC2_SDCC_BAM_P_TRUST_REG2_ADDR A:0xf9887030
y.create.l HWIO_PERIPH_SS_SDC2_SDCC_BAM_P_TRUST_REG3_ADDR A:0xf9888030
y.create.l HWIO_PERIPH_SS_SDC2_SDCC_BAM_P_TRUST_REG4_ADDR A:0xf9889030
y.create.l HWIO_PERIPH_SS_SDC2_SDCC_BAM_P_TRUST_REG5_ADDR A:0xf988a030
y.create.l HWIO_PERIPH_SS_SDC2_SDCC_BAM_P_IRQ_STTS0_ADDR A:0xf9885010
y.create.l HWIO_PERIPH_SS_SDC2_SDCC_BAM_P_IRQ_STTS1_ADDR A:0xf9886010
y.create.l HWIO_PERIPH_SS_SDC2_SDCC_BAM_P_IRQ_STTS2_ADDR A:0xf9887010
y.create.l HWIO_PERIPH_SS_SDC2_SDCC_BAM_P_IRQ_STTS3_ADDR A:0xf9888010
y.create.l HWIO_PERIPH_SS_SDC2_SDCC_BAM_P_IRQ_STTS4_ADDR A:0xf9889010
y.create.l HWIO_PERIPH_SS_SDC2_SDCC_BAM_P_IRQ_STTS5_ADDR A:0xf988a010
y.create.l HWIO_PERIPH_SS_SDC2_SDCC_BAM_P_IRQ_CLR0_ADDR A:0xf9885014
y.create.l HWIO_PERIPH_SS_SDC2_SDCC_BAM_P_IRQ_CLR1_ADDR A:0xf9886014
y.create.l HWIO_PERIPH_SS_SDC2_SDCC_BAM_P_IRQ_CLR2_ADDR A:0xf9887014
y.create.l HWIO_PERIPH_SS_SDC2_SDCC_BAM_P_IRQ_CLR3_ADDR A:0xf9888014
y.create.l HWIO_PERIPH_SS_SDC2_SDCC_BAM_P_IRQ_CLR4_ADDR A:0xf9889014
y.create.l HWIO_PERIPH_SS_SDC2_SDCC_BAM_P_IRQ_CLR5_ADDR A:0xf988a014
y.create.l HWIO_PERIPH_SS_SDC2_SDCC_BAM_P_IRQ_EN0_ADDR A:0xf9885018
y.create.l HWIO_PERIPH_SS_SDC2_SDCC_BAM_P_IRQ_EN1_ADDR A:0xf9886018
y.create.l HWIO_PERIPH_SS_SDC2_SDCC_BAM_P_IRQ_EN2_ADDR A:0xf9887018
y.create.l HWIO_PERIPH_SS_SDC2_SDCC_BAM_P_IRQ_EN3_ADDR A:0xf9888018
y.create.l HWIO_PERIPH_SS_SDC2_SDCC_BAM_P_IRQ_EN4_ADDR A:0xf9889018
y.create.l HWIO_PERIPH_SS_SDC2_SDCC_BAM_P_IRQ_EN5_ADDR A:0xf988a018
y.create.l HWIO_PERIPH_SS_SDC2_SDCC_BAM_P_TIMER0_ADDR A:0xf988501c
y.create.l HWIO_PERIPH_SS_SDC2_SDCC_BAM_P_TIMER1_ADDR A:0xf988601c
y.create.l HWIO_PERIPH_SS_SDC2_SDCC_BAM_P_TIMER2_ADDR A:0xf988701c
y.create.l HWIO_PERIPH_SS_SDC2_SDCC_BAM_P_TIMER3_ADDR A:0xf988801c
y.create.l HWIO_PERIPH_SS_SDC2_SDCC_BAM_P_TIMER4_ADDR A:0xf988901c
y.create.l HWIO_PERIPH_SS_SDC2_SDCC_BAM_P_TIMER5_ADDR A:0xf988a01c
y.create.l HWIO_PERIPH_SS_SDC2_SDCC_BAM_P_TIMER_CTRL0_ADDR A:0xf9885020
y.create.l HWIO_PERIPH_SS_SDC2_SDCC_BAM_P_TIMER_CTRL1_ADDR A:0xf9886020
y.create.l HWIO_PERIPH_SS_SDC2_SDCC_BAM_P_TIMER_CTRL2_ADDR A:0xf9887020
y.create.l HWIO_PERIPH_SS_SDC2_SDCC_BAM_P_TIMER_CTRL3_ADDR A:0xf9888020
y.create.l HWIO_PERIPH_SS_SDC2_SDCC_BAM_P_TIMER_CTRL4_ADDR A:0xf9889020
y.create.l HWIO_PERIPH_SS_SDC2_SDCC_BAM_P_TIMER_CTRL5_ADDR A:0xf988a020
y.create.l HWIO_PERIPH_SS_SDC2_SDCC_BAM_P_PRDCR_SDBND0_ADDR A:0xf9885024
y.create.l HWIO_PERIPH_SS_SDC2_SDCC_BAM_P_PRDCR_SDBND1_ADDR A:0xf9886024
y.create.l HWIO_PERIPH_SS_SDC2_SDCC_BAM_P_PRDCR_SDBND2_ADDR A:0xf9887024
y.create.l HWIO_PERIPH_SS_SDC2_SDCC_BAM_P_PRDCR_SDBND3_ADDR A:0xf9888024
y.create.l HWIO_PERIPH_SS_SDC2_SDCC_BAM_P_PRDCR_SDBND4_ADDR A:0xf9889024
y.create.l HWIO_PERIPH_SS_SDC2_SDCC_BAM_P_PRDCR_SDBND5_ADDR A:0xf988a024
y.create.l HWIO_PERIPH_SS_SDC2_SDCC_BAM_P_CNSMR_SDBND0_ADDR A:0xf9885028
y.create.l HWIO_PERIPH_SS_SDC2_SDCC_BAM_P_CNSMR_SDBND1_ADDR A:0xf9886028
y.create.l HWIO_PERIPH_SS_SDC2_SDCC_BAM_P_CNSMR_SDBND2_ADDR A:0xf9887028
y.create.l HWIO_PERIPH_SS_SDC2_SDCC_BAM_P_CNSMR_SDBND3_ADDR A:0xf9888028
y.create.l HWIO_PERIPH_SS_SDC2_SDCC_BAM_P_CNSMR_SDBND4_ADDR A:0xf9889028
y.create.l HWIO_PERIPH_SS_SDC2_SDCC_BAM_P_CNSMR_SDBND5_ADDR A:0xf988a028
y.create.l HWIO_PERIPH_SS_SDC2_SDCC_BAM_P_EVNT_DEST_ADDR0_ADDR A:0xf988582c
y.create.l HWIO_PERIPH_SS_SDC2_SDCC_BAM_P_EVNT_DEST_ADDR1_ADDR A:0xf988682c
y.create.l HWIO_PERIPH_SS_SDC2_SDCC_BAM_P_EVNT_DEST_ADDR2_ADDR A:0xf988782c
y.create.l HWIO_PERIPH_SS_SDC2_SDCC_BAM_P_EVNT_DEST_ADDR3_ADDR A:0xf988882c
y.create.l HWIO_PERIPH_SS_SDC2_SDCC_BAM_P_EVNT_DEST_ADDR4_ADDR A:0xf988982c
y.create.l HWIO_PERIPH_SS_SDC2_SDCC_BAM_P_EVNT_DEST_ADDR5_ADDR A:0xf988a82c
y.create.l HWIO_PERIPH_SS_SDC2_SDCC_BAM_P_EVNT_DEST_ADDR_LSB0_ADDR A:0xf9885930
y.create.l HWIO_PERIPH_SS_SDC2_SDCC_BAM_P_EVNT_DEST_ADDR_LSB1_ADDR A:0xf9886930
y.create.l HWIO_PERIPH_SS_SDC2_SDCC_BAM_P_EVNT_DEST_ADDR_LSB2_ADDR A:0xf9887930
y.create.l HWIO_PERIPH_SS_SDC2_SDCC_BAM_P_EVNT_DEST_ADDR_LSB3_ADDR A:0xf9888930
y.create.l HWIO_PERIPH_SS_SDC2_SDCC_BAM_P_EVNT_DEST_ADDR_LSB4_ADDR A:0xf9889930
y.create.l HWIO_PERIPH_SS_SDC2_SDCC_BAM_P_EVNT_DEST_ADDR_LSB5_ADDR A:0xf988a930
y.create.l HWIO_PERIPH_SS_SDC2_SDCC_BAM_P_EVNT_DEST_ADDR_MSB0_ADDR A:0xf9885934
y.create.l HWIO_PERIPH_SS_SDC2_SDCC_BAM_P_EVNT_DEST_ADDR_MSB1_ADDR A:0xf9886934
y.create.l HWIO_PERIPH_SS_SDC2_SDCC_BAM_P_EVNT_DEST_ADDR_MSB2_ADDR A:0xf9887934
y.create.l HWIO_PERIPH_SS_SDC2_SDCC_BAM_P_EVNT_DEST_ADDR_MSB3_ADDR A:0xf9888934
y.create.l HWIO_PERIPH_SS_SDC2_SDCC_BAM_P_EVNT_DEST_ADDR_MSB4_ADDR A:0xf9889934
y.create.l HWIO_PERIPH_SS_SDC2_SDCC_BAM_P_EVNT_DEST_ADDR_MSB5_ADDR A:0xf988a934
y.create.l HWIO_PERIPH_SS_SDC2_SDCC_BAM_P_EVNT_REG0_ADDR A:0xf9885818
y.create.l HWIO_PERIPH_SS_SDC2_SDCC_BAM_P_EVNT_REG1_ADDR A:0xf9886818
y.create.l HWIO_PERIPH_SS_SDC2_SDCC_BAM_P_EVNT_REG2_ADDR A:0xf9887818
y.create.l HWIO_PERIPH_SS_SDC2_SDCC_BAM_P_EVNT_REG3_ADDR A:0xf9888818
y.create.l HWIO_PERIPH_SS_SDC2_SDCC_BAM_P_EVNT_REG4_ADDR A:0xf9889818
y.create.l HWIO_PERIPH_SS_SDC2_SDCC_BAM_P_EVNT_REG5_ADDR A:0xf988a818
y.create.l HWIO_PERIPH_SS_SDC2_SDCC_BAM_P_SW_OFSTS0_ADDR A:0xf9885800
y.create.l HWIO_PERIPH_SS_SDC2_SDCC_BAM_P_SW_OFSTS1_ADDR A:0xf9886800
y.create.l HWIO_PERIPH_SS_SDC2_SDCC_BAM_P_SW_OFSTS2_ADDR A:0xf9887800
y.create.l HWIO_PERIPH_SS_SDC2_SDCC_BAM_P_SW_OFSTS3_ADDR A:0xf9888800
y.create.l HWIO_PERIPH_SS_SDC2_SDCC_BAM_P_SW_OFSTS4_ADDR A:0xf9889800
y.create.l HWIO_PERIPH_SS_SDC2_SDCC_BAM_P_SW_OFSTS5_ADDR A:0xf988a800
y.create.l HWIO_PERIPH_SS_SDC2_SDCC_BAM_P_DATA_FIFO_ADDR0_ADDR A:0xf9885824
y.create.l HWIO_PERIPH_SS_SDC2_SDCC_BAM_P_DATA_FIFO_ADDR1_ADDR A:0xf9886824
y.create.l HWIO_PERIPH_SS_SDC2_SDCC_BAM_P_DATA_FIFO_ADDR2_ADDR A:0xf9887824
y.create.l HWIO_PERIPH_SS_SDC2_SDCC_BAM_P_DATA_FIFO_ADDR3_ADDR A:0xf9888824
y.create.l HWIO_PERIPH_SS_SDC2_SDCC_BAM_P_DATA_FIFO_ADDR4_ADDR A:0xf9889824
y.create.l HWIO_PERIPH_SS_SDC2_SDCC_BAM_P_DATA_FIFO_ADDR5_ADDR A:0xf988a824
y.create.l HWIO_PERIPH_SS_SDC2_SDCC_BAM_P_DATA_FIFO_ADDR_LSB0_ADDR A:0xf9885920
y.create.l HWIO_PERIPH_SS_SDC2_SDCC_BAM_P_DATA_FIFO_ADDR_LSB1_ADDR A:0xf9886920
y.create.l HWIO_PERIPH_SS_SDC2_SDCC_BAM_P_DATA_FIFO_ADDR_LSB2_ADDR A:0xf9887920
y.create.l HWIO_PERIPH_SS_SDC2_SDCC_BAM_P_DATA_FIFO_ADDR_LSB3_ADDR A:0xf9888920
y.create.l HWIO_PERIPH_SS_SDC2_SDCC_BAM_P_DATA_FIFO_ADDR_LSB4_ADDR A:0xf9889920
y.create.l HWIO_PERIPH_SS_SDC2_SDCC_BAM_P_DATA_FIFO_ADDR_LSB5_ADDR A:0xf988a920
y.create.l HWIO_PERIPH_SS_SDC2_SDCC_BAM_P_DATA_FIFO_ADDR_MSB0_ADDR A:0xf9885924
y.create.l HWIO_PERIPH_SS_SDC2_SDCC_BAM_P_DATA_FIFO_ADDR_MSB1_ADDR A:0xf9886924
y.create.l HWIO_PERIPH_SS_SDC2_SDCC_BAM_P_DATA_FIFO_ADDR_MSB2_ADDR A:0xf9887924
y.create.l HWIO_PERIPH_SS_SDC2_SDCC_BAM_P_DATA_FIFO_ADDR_MSB3_ADDR A:0xf9888924
y.create.l HWIO_PERIPH_SS_SDC2_SDCC_BAM_P_DATA_FIFO_ADDR_MSB4_ADDR A:0xf9889924
y.create.l HWIO_PERIPH_SS_SDC2_SDCC_BAM_P_DATA_FIFO_ADDR_MSB5_ADDR A:0xf988a924
y.create.l HWIO_PERIPH_SS_SDC2_SDCC_BAM_P_DESC_FIFO_ADDR0_ADDR A:0xf988581c
y.create.l HWIO_PERIPH_SS_SDC2_SDCC_BAM_P_DESC_FIFO_ADDR1_ADDR A:0xf988681c
y.create.l HWIO_PERIPH_SS_SDC2_SDCC_BAM_P_DESC_FIFO_ADDR2_ADDR A:0xf988781c
y.create.l HWIO_PERIPH_SS_SDC2_SDCC_BAM_P_DESC_FIFO_ADDR3_ADDR A:0xf988881c
y.create.l HWIO_PERIPH_SS_SDC2_SDCC_BAM_P_DESC_FIFO_ADDR4_ADDR A:0xf988981c
y.create.l HWIO_PERIPH_SS_SDC2_SDCC_BAM_P_DESC_FIFO_ADDR5_ADDR A:0xf988a81c
y.create.l HWIO_PERIPH_SS_SDC2_SDCC_BAM_P_DESC_FIFO_ADDR_LSB0_ADDR A:0xf9885910
y.create.l HWIO_PERIPH_SS_SDC2_SDCC_BAM_P_DESC_FIFO_ADDR_LSB1_ADDR A:0xf9886910
y.create.l HWIO_PERIPH_SS_SDC2_SDCC_BAM_P_DESC_FIFO_ADDR_LSB2_ADDR A:0xf9887910
y.create.l HWIO_PERIPH_SS_SDC2_SDCC_BAM_P_DESC_FIFO_ADDR_LSB3_ADDR A:0xf9888910
y.create.l HWIO_PERIPH_SS_SDC2_SDCC_BAM_P_DESC_FIFO_ADDR_LSB4_ADDR A:0xf9889910
y.create.l HWIO_PERIPH_SS_SDC2_SDCC_BAM_P_DESC_FIFO_ADDR_LSB5_ADDR A:0xf988a910
y.create.l HWIO_PERIPH_SS_SDC2_SDCC_BAM_P_DESC_FIFO_ADDR_MSB0_ADDR A:0xf9885914
y.create.l HWIO_PERIPH_SS_SDC2_SDCC_BAM_P_DESC_FIFO_ADDR_MSB1_ADDR A:0xf9886914
y.create.l HWIO_PERIPH_SS_SDC2_SDCC_BAM_P_DESC_FIFO_ADDR_MSB2_ADDR A:0xf9887914
y.create.l HWIO_PERIPH_SS_SDC2_SDCC_BAM_P_DESC_FIFO_ADDR_MSB3_ADDR A:0xf9888914
y.create.l HWIO_PERIPH_SS_SDC2_SDCC_BAM_P_DESC_FIFO_ADDR_MSB4_ADDR A:0xf9889914
y.create.l HWIO_PERIPH_SS_SDC2_SDCC_BAM_P_DESC_FIFO_ADDR_MSB5_ADDR A:0xf988a914
y.create.l HWIO_PERIPH_SS_SDC2_SDCC_BAM_P_EVNT_GEN_TRSHLD0_ADDR A:0xf9885828
y.create.l HWIO_PERIPH_SS_SDC2_SDCC_BAM_P_EVNT_GEN_TRSHLD1_ADDR A:0xf9886828
y.create.l HWIO_PERIPH_SS_SDC2_SDCC_BAM_P_EVNT_GEN_TRSHLD2_ADDR A:0xf9887828
y.create.l HWIO_PERIPH_SS_SDC2_SDCC_BAM_P_EVNT_GEN_TRSHLD3_ADDR A:0xf9888828
y.create.l HWIO_PERIPH_SS_SDC2_SDCC_BAM_P_EVNT_GEN_TRSHLD4_ADDR A:0xf9889828
y.create.l HWIO_PERIPH_SS_SDC2_SDCC_BAM_P_EVNT_GEN_TRSHLD5_ADDR A:0xf988a828
y.create.l HWIO_PERIPH_SS_SDC2_SDCC_BAM_P_FIFO_SIZES0_ADDR A:0xf9885820
y.create.l HWIO_PERIPH_SS_SDC2_SDCC_BAM_P_FIFO_SIZES1_ADDR A:0xf9886820
y.create.l HWIO_PERIPH_SS_SDC2_SDCC_BAM_P_FIFO_SIZES2_ADDR A:0xf9887820
y.create.l HWIO_PERIPH_SS_SDC2_SDCC_BAM_P_FIFO_SIZES3_ADDR A:0xf9888820
y.create.l HWIO_PERIPH_SS_SDC2_SDCC_BAM_P_FIFO_SIZES4_ADDR A:0xf9889820
y.create.l HWIO_PERIPH_SS_SDC2_SDCC_BAM_P_FIFO_SIZES5_ADDR A:0xf988a820
y.create.l HWIO_PERIPH_SS_SDC2_SDCC_BAM_P_RETR_CNTXT_0_ADDR A:0xf9885834
y.create.l HWIO_PERIPH_SS_SDC2_SDCC_BAM_P_RETR_CNTXT_1_ADDR A:0xf9886834
y.create.l HWIO_PERIPH_SS_SDC2_SDCC_BAM_P_RETR_CNTXT_2_ADDR A:0xf9887834
y.create.l HWIO_PERIPH_SS_SDC2_SDCC_BAM_P_RETR_CNTXT_3_ADDR A:0xf9888834
y.create.l HWIO_PERIPH_SS_SDC2_SDCC_BAM_P_RETR_CNTXT_4_ADDR A:0xf9889834
y.create.l HWIO_PERIPH_SS_SDC2_SDCC_BAM_P_RETR_CNTXT_5_ADDR A:0xf988a834
y.create.l HWIO_PERIPH_SS_SDC2_SDCC_BAM_P_SI_CNTXT_0_ADDR A:0xf9885838
y.create.l HWIO_PERIPH_SS_SDC2_SDCC_BAM_P_SI_CNTXT_1_ADDR A:0xf9886838
y.create.l HWIO_PERIPH_SS_SDC2_SDCC_BAM_P_SI_CNTXT_2_ADDR A:0xf9887838
y.create.l HWIO_PERIPH_SS_SDC2_SDCC_BAM_P_SI_CNTXT_3_ADDR A:0xf9888838
y.create.l HWIO_PERIPH_SS_SDC2_SDCC_BAM_P_SI_CNTXT_4_ADDR A:0xf9889838
y.create.l HWIO_PERIPH_SS_SDC2_SDCC_BAM_P_SI_CNTXT_5_ADDR A:0xf988a838
y.create.l HWIO_PERIPH_SS_SDC2_SDCC_BAM_P_DF_CNTXT_0_ADDR A:0xf9885830
y.create.l HWIO_PERIPH_SS_SDC2_SDCC_BAM_P_DF_CNTXT_1_ADDR A:0xf9886830
y.create.l HWIO_PERIPH_SS_SDC2_SDCC_BAM_P_DF_CNTXT_2_ADDR A:0xf9887830
y.create.l HWIO_PERIPH_SS_SDC2_SDCC_BAM_P_DF_CNTXT_3_ADDR A:0xf9888830
y.create.l HWIO_PERIPH_SS_SDC2_SDCC_BAM_P_DF_CNTXT_4_ADDR A:0xf9889830
y.create.l HWIO_PERIPH_SS_SDC2_SDCC_BAM_P_DF_CNTXT_5_ADDR A:0xf988a830
y.create.l HWIO_PERIPH_SS_SDC2_SDCC_BAM_P_AU_PSM_CNTXT_1_0_ADDR A:0xf9885804
y.create.l HWIO_PERIPH_SS_SDC2_SDCC_BAM_P_AU_PSM_CNTXT_1_1_ADDR A:0xf9886804
y.create.l HWIO_PERIPH_SS_SDC2_SDCC_BAM_P_AU_PSM_CNTXT_1_2_ADDR A:0xf9887804
y.create.l HWIO_PERIPH_SS_SDC2_SDCC_BAM_P_AU_PSM_CNTXT_1_3_ADDR A:0xf9888804
y.create.l HWIO_PERIPH_SS_SDC2_SDCC_BAM_P_AU_PSM_CNTXT_1_4_ADDR A:0xf9889804
y.create.l HWIO_PERIPH_SS_SDC2_SDCC_BAM_P_AU_PSM_CNTXT_1_5_ADDR A:0xf988a804
y.create.l HWIO_PERIPH_SS_SDC2_SDCC_BAM_P_PSM_CNTXT_2_0_ADDR A:0xf9885808
y.create.l HWIO_PERIPH_SS_SDC2_SDCC_BAM_P_PSM_CNTXT_2_1_ADDR A:0xf9886808
y.create.l HWIO_PERIPH_SS_SDC2_SDCC_BAM_P_PSM_CNTXT_2_2_ADDR A:0xf9887808
y.create.l HWIO_PERIPH_SS_SDC2_SDCC_BAM_P_PSM_CNTXT_2_3_ADDR A:0xf9888808
y.create.l HWIO_PERIPH_SS_SDC2_SDCC_BAM_P_PSM_CNTXT_2_4_ADDR A:0xf9889808
y.create.l HWIO_PERIPH_SS_SDC2_SDCC_BAM_P_PSM_CNTXT_2_5_ADDR A:0xf988a808
y.create.l HWIO_PERIPH_SS_SDC2_SDCC_BAM_P_PSM_CNTXT_3_0_ADDR A:0xf988580c
y.create.l HWIO_PERIPH_SS_SDC2_SDCC_BAM_P_PSM_CNTXT_3_1_ADDR A:0xf988680c
y.create.l HWIO_PERIPH_SS_SDC2_SDCC_BAM_P_PSM_CNTXT_3_2_ADDR A:0xf988780c
y.create.l HWIO_PERIPH_SS_SDC2_SDCC_BAM_P_PSM_CNTXT_3_3_ADDR A:0xf988880c
y.create.l HWIO_PERIPH_SS_SDC2_SDCC_BAM_P_PSM_CNTXT_3_4_ADDR A:0xf988980c
y.create.l HWIO_PERIPH_SS_SDC2_SDCC_BAM_P_PSM_CNTXT_3_5_ADDR A:0xf988a80c
y.create.l HWIO_PERIPH_SS_SDC2_SDCC_BAM_P_PSM_CNTXT_3_LSB0_ADDR A:0xf9885900
y.create.l HWIO_PERIPH_SS_SDC2_SDCC_BAM_P_PSM_CNTXT_3_LSB1_ADDR A:0xf9886900
y.create.l HWIO_PERIPH_SS_SDC2_SDCC_BAM_P_PSM_CNTXT_3_LSB2_ADDR A:0xf9887900
y.create.l HWIO_PERIPH_SS_SDC2_SDCC_BAM_P_PSM_CNTXT_3_LSB3_ADDR A:0xf9888900
y.create.l HWIO_PERIPH_SS_SDC2_SDCC_BAM_P_PSM_CNTXT_3_LSB4_ADDR A:0xf9889900
y.create.l HWIO_PERIPH_SS_SDC2_SDCC_BAM_P_PSM_CNTXT_3_LSB5_ADDR A:0xf988a900
y.create.l HWIO_PERIPH_SS_SDC2_SDCC_BAM_P_PSM_CNTXT_3_MSB0_ADDR A:0xf9885904
y.create.l HWIO_PERIPH_SS_SDC2_SDCC_BAM_P_PSM_CNTXT_3_MSB1_ADDR A:0xf9886904
y.create.l HWIO_PERIPH_SS_SDC2_SDCC_BAM_P_PSM_CNTXT_3_MSB2_ADDR A:0xf9887904
y.create.l HWIO_PERIPH_SS_SDC2_SDCC_BAM_P_PSM_CNTXT_3_MSB3_ADDR A:0xf9888904
y.create.l HWIO_PERIPH_SS_SDC2_SDCC_BAM_P_PSM_CNTXT_3_MSB4_ADDR A:0xf9889904
y.create.l HWIO_PERIPH_SS_SDC2_SDCC_BAM_P_PSM_CNTXT_3_MSB5_ADDR A:0xf988a904
y.create.l HWIO_PERIPH_SS_SDC2_SDCC_BAM_P_PSM_CNTXT_4_0_ADDR A:0xf9885810
y.create.l HWIO_PERIPH_SS_SDC2_SDCC_BAM_P_PSM_CNTXT_4_1_ADDR A:0xf9886810
y.create.l HWIO_PERIPH_SS_SDC2_SDCC_BAM_P_PSM_CNTXT_4_2_ADDR A:0xf9887810
y.create.l HWIO_PERIPH_SS_SDC2_SDCC_BAM_P_PSM_CNTXT_4_3_ADDR A:0xf9888810
y.create.l HWIO_PERIPH_SS_SDC2_SDCC_BAM_P_PSM_CNTXT_4_4_ADDR A:0xf9889810
y.create.l HWIO_PERIPH_SS_SDC2_SDCC_BAM_P_PSM_CNTXT_4_5_ADDR A:0xf988a810
y.create.l HWIO_PERIPH_SS_SDC2_SDCC_BAM_P_PSM_CNTXT_5_0_ADDR A:0xf9885814
y.create.l HWIO_PERIPH_SS_SDC2_SDCC_BAM_P_PSM_CNTXT_5_1_ADDR A:0xf9886814
y.create.l HWIO_PERIPH_SS_SDC2_SDCC_BAM_P_PSM_CNTXT_5_2_ADDR A:0xf9887814
y.create.l HWIO_PERIPH_SS_SDC2_SDCC_BAM_P_PSM_CNTXT_5_3_ADDR A:0xf9888814
y.create.l HWIO_PERIPH_SS_SDC2_SDCC_BAM_P_PSM_CNTXT_5_4_ADDR A:0xf9889814
y.create.l HWIO_PERIPH_SS_SDC2_SDCC_BAM_P_PSM_CNTXT_5_5_ADDR A:0xf988a814
y.create.l HWIO_PERIPH_SS_SDC2_SDCC_XPU_SCR_ADDR A:0xf9882000
y.create.l HWIO_PERIPH_SS_SDC2_SDCC_XPU_SWDR_ADDR A:0xf9882004
y.create.l HWIO_PERIPH_SS_SDC2_SDCC_XPU_SEAR0_ADDR A:0xf9882040
y.create.l HWIO_PERIPH_SS_SDC2_SDCC_XPU_SESR_ADDR A:0xf9882048
y.create.l HWIO_PERIPH_SS_SDC2_SDCC_XPU_SESRRESTORE_ADDR A:0xf988204c
y.create.l HWIO_PERIPH_SS_SDC2_SDCC_XPU_SESYNR0_ADDR A:0xf9882050
y.create.l HWIO_PERIPH_SS_SDC2_SDCC_XPU_SESYNR1_ADDR A:0xf9882054
y.create.l HWIO_PERIPH_SS_SDC2_SDCC_XPU_SESYNR2_ADDR A:0xf9882058
y.create.l HWIO_PERIPH_SS_SDC2_SDCC_XPU_MCR_ADDR A:0xf9882100
y.create.l HWIO_PERIPH_SS_SDC2_SDCC_XPU_MEAR0_ADDR A:0xf9882140
y.create.l HWIO_PERIPH_SS_SDC2_SDCC_XPU_MESR_ADDR A:0xf9882148
y.create.l HWIO_PERIPH_SS_SDC2_SDCC_XPU_MESRRESTORE_ADDR A:0xf988214c
y.create.l HWIO_PERIPH_SS_SDC2_SDCC_XPU_MESYNR0_ADDR A:0xf9882150
y.create.l HWIO_PERIPH_SS_SDC2_SDCC_XPU_MESYNR1_ADDR A:0xf9882154
y.create.l HWIO_PERIPH_SS_SDC2_SDCC_XPU_MESYNR2_ADDR A:0xf9882158
y.create.l HWIO_PERIPH_SS_SDC2_SDCC_XPU_CR_ADDR A:0xf9882080
y.create.l HWIO_PERIPH_SS_SDC2_SDCC_XPU_RPU_ACR0_ADDR A:0xf98820a0
y.create.l HWIO_PERIPH_SS_SDC2_SDCC_XPU_EAR0_ADDR A:0xf98820c0
y.create.l HWIO_PERIPH_SS_SDC2_SDCC_XPU_ESR_ADDR A:0xf98820c8
y.create.l HWIO_PERIPH_SS_SDC2_SDCC_XPU_ESRRESTORE_ADDR A:0xf98820cc
y.create.l HWIO_PERIPH_SS_SDC2_SDCC_XPU_ESYNR0_ADDR A:0xf98820d0
y.create.l HWIO_PERIPH_SS_SDC2_SDCC_XPU_ESYNR1_ADDR A:0xf98820d4
y.create.l HWIO_PERIPH_SS_SDC2_SDCC_XPU_ESYNR2_ADDR A:0xf98820d8
y.create.l HWIO_PERIPH_SS_SDC2_SDCC_XPU_IDR0_ADDR A:0xf9882074
y.create.l HWIO_PERIPH_SS_SDC2_SDCC_XPU_IDR1_ADDR A:0xf9882078
y.create.l HWIO_PERIPH_SS_SDC2_SDCC_XPU_REV_ADDR A:0xf988207c
y.create.l HWIO_PERIPH_SS_SDC2_SDCC_XPU_RG0_RACR0_ADDR A:0xf9882200
y.create.l HWIO_PERIPH_SS_SDC2_SDCC_XPU_RG1_RACR0_ADDR A:0xf9882280
y.create.l HWIO_PERIPH_SS_SDC2_SDCC_XPU_RG2_RACR0_ADDR A:0xf9882300
y.create.l HWIO_PERIPH_SS_SDC2_SDCC_XPU_RG3_RACR0_ADDR A:0xf9882380
y.create.l HWIO_PERIPH_SS_SDC2_SDCC_XPU_RG4_RACR0_ADDR A:0xf9882400
y.create.l HWIO_PERIPH_SS_SDC2_SDCC_XPU_RG5_RACR0_ADDR A:0xf9882480
y.create.l HWIO_PERIPH_SS_SDC2_SDCC_XPU_RG6_RACR0_ADDR A:0xf9882500
y.create.l HWIO_PERIPH_SS_SDC2_SDCC_XPU_RG7_RACR0_ADDR A:0xf9882580
y.create.l HWIO_PERIPH_SS_SDC2_SDCC_XPU_RG8_RACR0_ADDR A:0xf9882600
y.create.l HWIO_PERIPH_SS_SDC2_SDCC_XPU_RG9_RACR0_ADDR A:0xf9882680
y.create.l HWIO_PERIPH_SS_SDC2_SDCC_XPU_RG0_SCR_ADDR A:0xf9882250
y.create.l HWIO_PERIPH_SS_SDC2_SDCC_XPU_RG1_SCR_ADDR A:0xf98822d0
y.create.l HWIO_PERIPH_SS_SDC2_SDCC_XPU_RG2_SCR_ADDR A:0xf9882350
y.create.l HWIO_PERIPH_SS_SDC2_SDCC_XPU_RG3_SCR_ADDR A:0xf98823d0
y.create.l HWIO_PERIPH_SS_SDC2_SDCC_XPU_RG4_SCR_ADDR A:0xf9882450
y.create.l HWIO_PERIPH_SS_SDC2_SDCC_XPU_RG5_SCR_ADDR A:0xf98824d0
y.create.l HWIO_PERIPH_SS_SDC2_SDCC_XPU_RG6_SCR_ADDR A:0xf9882550
y.create.l HWIO_PERIPH_SS_SDC2_SDCC_XPU_RG7_SCR_ADDR A:0xf98825d0
y.create.l HWIO_PERIPH_SS_SDC2_SDCC_XPU_RG8_SCR_ADDR A:0xf9882650
y.create.l HWIO_PERIPH_SS_SDC2_SDCC_XPU_RG9_SCR_ADDR A:0xf98826d0
y.create.l HWIO_PERIPH_SS_SDC2_SDCC_XPU_RG0_MCR_ADDR A:0xf9882254
y.create.l HWIO_PERIPH_SS_SDC2_SDCC_XPU_RG1_MCR_ADDR A:0xf98822d4
y.create.l HWIO_PERIPH_SS_SDC2_SDCC_XPU_RG2_MCR_ADDR A:0xf9882354
y.create.l HWIO_PERIPH_SS_SDC2_SDCC_XPU_RG3_MCR_ADDR A:0xf98823d4
y.create.l HWIO_PERIPH_SS_SDC2_SDCC_XPU_RG4_MCR_ADDR A:0xf9882454
y.create.l HWIO_PERIPH_SS_SDC2_SDCC_XPU_RG5_MCR_ADDR A:0xf98824d4
y.create.l HWIO_PERIPH_SS_SDC2_SDCC_XPU_RG6_MCR_ADDR A:0xf9882554
y.create.l HWIO_PERIPH_SS_SDC2_SDCC_XPU_RG7_MCR_ADDR A:0xf98825d4
y.create.l HWIO_PERIPH_SS_SDC2_SDCC_XPU_RG8_MCR_ADDR A:0xf9882654
y.create.l HWIO_PERIPH_SS_SDC2_SDCC_XPU_RG9_MCR_ADDR A:0xf98826d4
y.create.l HWIO_PERIPH_SS_SDC2_SDCC_VMIDMT_SCR0_ADDR A:0xf9880000
y.create.l HWIO_PERIPH_SS_SDC2_SDCC_VMIDMT_SCR1_ADDR A:0xf9880004
y.create.l HWIO_PERIPH_SS_SDC2_SDCC_VMIDMT_SCR2_ADDR A:0xf9880008
y.create.l HWIO_PERIPH_SS_SDC2_SDCC_VMIDMT_SACR_ADDR A:0xf9880010
y.create.l HWIO_PERIPH_SS_SDC2_SDCC_VMIDMT_SIDR0_ADDR A:0xf9880020
y.create.l HWIO_PERIPH_SS_SDC2_SDCC_VMIDMT_SIDR1_ADDR A:0xf9880024
y.create.l HWIO_PERIPH_SS_SDC2_SDCC_VMIDMT_SIDR2_ADDR A:0xf9880028
y.create.l HWIO_PERIPH_SS_SDC2_SDCC_VMIDMT_SIDR4_ADDR A:0xf9880030
y.create.l HWIO_PERIPH_SS_SDC2_SDCC_VMIDMT_SIDR5_ADDR A:0xf9880034
y.create.l HWIO_PERIPH_SS_SDC2_SDCC_VMIDMT_SIDR7_ADDR A:0xf988003c
y.create.l HWIO_PERIPH_SS_SDC2_SDCC_VMIDMT_SGFAR0_ADDR A:0xf9880040
y.create.l HWIO_PERIPH_SS_SDC2_SDCC_VMIDMT_SGFSR_ADDR A:0xf9880048
y.create.l HWIO_PERIPH_SS_SDC2_SDCC_VMIDMT_SGFSRRESTORE_ADDR A:0xf988004c
y.create.l HWIO_PERIPH_SS_SDC2_SDCC_VMIDMT_SGFSYNDR0_ADDR A:0xf9880050
y.create.l HWIO_PERIPH_SS_SDC2_SDCC_VMIDMT_SGFSYNDR1_ADDR A:0xf9880054
y.create.l HWIO_PERIPH_SS_SDC2_SDCC_VMIDMT_SGFSYNDR2_ADDR A:0xf9880058
y.create.l HWIO_PERIPH_SS_SDC2_SDCC_VMIDMT_VMIDMTSCR0_ADDR A:0xf9880090
y.create.l HWIO_PERIPH_SS_SDC2_SDCC_VMIDMT_CR0_ADDR A:0xf9880000
y.create.l HWIO_PERIPH_SS_SDC2_SDCC_VMIDMT_CR2_ADDR A:0xf9880008
y.create.l HWIO_PERIPH_SS_SDC2_SDCC_VMIDMT_ACR_ADDR A:0xf9880010
y.create.l HWIO_PERIPH_SS_SDC2_SDCC_VMIDMT_IDR0_ADDR A:0xf9880020
y.create.l HWIO_PERIPH_SS_SDC2_SDCC_VMIDMT_IDR1_ADDR A:0xf9880024
y.create.l HWIO_PERIPH_SS_SDC2_SDCC_VMIDMT_IDR2_ADDR A:0xf9880028
y.create.l HWIO_PERIPH_SS_SDC2_SDCC_VMIDMT_IDR4_ADDR A:0xf9880030
y.create.l HWIO_PERIPH_SS_SDC2_SDCC_VMIDMT_IDR5_ADDR A:0xf9880034
y.create.l HWIO_PERIPH_SS_SDC2_SDCC_VMIDMT_IDR7_ADDR A:0xf988003c
y.create.l HWIO_PERIPH_SS_SDC2_SDCC_VMIDMT_GFAR0_ADDR A:0xf9880040
y.create.l HWIO_PERIPH_SS_SDC2_SDCC_VMIDMT_GFSR_ADDR A:0xf9880048
y.create.l HWIO_PERIPH_SS_SDC2_SDCC_VMIDMT_GFSRRESTORE_ADDR A:0xf988004c
y.create.l HWIO_PERIPH_SS_SDC2_SDCC_VMIDMT_GFSYNDR0_ADDR A:0xf9880050
y.create.l HWIO_PERIPH_SS_SDC2_SDCC_VMIDMT_GFSYNDR1_ADDR A:0xf9880054
y.create.l HWIO_PERIPH_SS_SDC2_SDCC_VMIDMT_GFSYNDR2_ADDR A:0xf9880058
y.create.l HWIO_PERIPH_SS_SDC2_SDCC_VMIDMT_VMIDMTCR0_ADDR A:0xf9880090
y.create.l HWIO_PERIPH_SS_SDC2_SDCC_VMIDMT_VMIDMTACR_ADDR A:0xf988009c
y.create.l HWIO_PERIPH_SS_SDC2_SDCC_VMIDMT_NSCR0_ADDR A:0xf9880400
y.create.l HWIO_PERIPH_SS_SDC2_SDCC_VMIDMT_NSCR2_ADDR A:0xf9880408
y.create.l HWIO_PERIPH_SS_SDC2_SDCC_VMIDMT_NSACR_ADDR A:0xf9880410
y.create.l HWIO_PERIPH_SS_SDC2_SDCC_VMIDMT_NSGFAR0_ADDR A:0xf9880440
y.create.l HWIO_PERIPH_SS_SDC2_SDCC_VMIDMT_NSGFSR_ADDR A:0xf9880448
y.create.l HWIO_PERIPH_SS_SDC2_SDCC_VMIDMT_NSGFSRRESTORE_ADDR A:0xf988044c
y.create.l HWIO_PERIPH_SS_SDC2_SDCC_VMIDMT_NSGFSYNDR0_ADDR A:0xf9880450
y.create.l HWIO_PERIPH_SS_SDC2_SDCC_VMIDMT_NSGFSYNDR1_ADDR A:0xf9880454
y.create.l HWIO_PERIPH_SS_SDC2_SDCC_VMIDMT_NSGFSYNDR2_ADDR A:0xf9880458
y.create.l HWIO_PERIPH_SS_SDC2_SDCC_VMIDMT_NSVMIDMTCR0_ADDR A:0xf9880490
y.create.l HWIO_PERIPH_SS_SDC2_SDCC_VMIDMT_SSDR0_ADDR A:0xf9880080
y.create.l HWIO_PERIPH_SS_SDC2_SDCC_VMIDMT_MSDR0_ADDR A:0xf9880480
y.create.l HWIO_PERIPH_SS_SDC2_SDCC_VMIDMT_MCR_ADDR A:0xf9880494
y.create.l HWIO_PERIPH_SS_SDC2_SDCC_VMIDMT_S2VR0_ADDR A:0xf9880c00
y.create.l HWIO_PERIPH_SS_SDC2_SDCC_VMIDMT_S2VR1_ADDR A:0xf9880c04
y.create.l HWIO_PERIPH_SS_SDC2_SDCC_VMIDMT_S2VR2_ADDR A:0xf9880c08
y.create.l HWIO_PERIPH_SS_SDC2_SDCC_VMIDMT_S2VR3_ADDR A:0xf9880c0c
y.create.l HWIO_PERIPH_SS_SDC2_SDCC_VMIDMT_S2VR4_ADDR A:0xf9880c10
y.create.l HWIO_PERIPH_SS_SDC2_SDCC_VMIDMT_S2VR5_ADDR A:0xf9880c14
y.create.l HWIO_PERIPH_SS_SDC2_SDCC_VMIDMT_S2VR6_ADDR A:0xf9880c18
y.create.l HWIO_PERIPH_SS_SDC2_SDCC_VMIDMT_AS2VR0_ADDR A:0xf9880e00
y.create.l HWIO_PERIPH_SS_SDC2_SDCC_VMIDMT_AS2VR1_ADDR A:0xf9880e04
y.create.l HWIO_PERIPH_SS_SDC2_SDCC_VMIDMT_AS2VR2_ADDR A:0xf9880e08
y.create.l HWIO_PERIPH_SS_SDC2_SDCC_VMIDMT_AS2VR3_ADDR A:0xf9880e0c
y.create.l HWIO_PERIPH_SS_SDC2_SDCC_VMIDMT_AS2VR4_ADDR A:0xf9880e10
y.create.l HWIO_PERIPH_SS_SDC2_SDCC_VMIDMT_AS2VR5_ADDR A:0xf9880e14
y.create.l HWIO_PERIPH_SS_SDC2_SDCC_VMIDMT_AS2VR6_ADDR A:0xf9880e18
y.create.l HWIO_PERIPH_SS_SDC2_SDCC_VMIDMT_SMR0_ADDR A:0xf9880800
y.create.l HWIO_PERIPH_SS_SDC2_SDCC_VMIDMT_SMR1_ADDR A:0xf9880804
y.create.l HWIO_PERIPH_SS_SDC2_SDCC_VMIDMT_SMR2_ADDR A:0xf9880808
y.create.l HWIO_PERIPH_SS_SDC2_SDCC_VMIDMT_SMR3_ADDR A:0xf988080c
y.create.l HWIO_PERIPH_SS_SDC2_SDCC_VMIDMT_SMR4_ADDR A:0xf9880810
y.create.l HWIO_PERIPH_SS_SDC2_SDCC_VMIDMT_SMR5_ADDR A:0xf9880814
y.create.l HWIO_PERIPH_SS_SDC2_SDCC_VMIDMT_SMR6_ADDR A:0xf9880818
y.create.l HWIO_PERIPH_SS_BLSP1_BLSP_BAM_BAM_CTRL_ADDR A:0xf9904000
y.create.l HWIO_PERIPH_SS_BLSP1_BLSP_BAM_BAM_REVISION_ADDR A:0xf9904004
y.create.l HWIO_PERIPH_SS_BLSP1_BLSP_BAM_BAM_SW_VERSION_ADDR A:0xf9904080
y.create.l HWIO_PERIPH_SS_BLSP1_BLSP_BAM_BAM_NUM_PIPES_ADDR A:0xf990403c
y.create.l HWIO_PERIPH_SS_BLSP1_BLSP_BAM_BAM_TIMER_ADDR A:0xf9904040
y.create.l HWIO_PERIPH_SS_BLSP1_BLSP_BAM_BAM_TIMER_CTRL_ADDR A:0xf9904044
y.create.l HWIO_PERIPH_SS_BLSP1_BLSP_BAM_BAM_DESC_CNT_TRSHLD_ADDR A:0xf9904008
y.create.l HWIO_PERIPH_SS_BLSP1_BLSP_BAM_BAM_IRQ_SRCS_ADDR A:0xf990400c
y.create.l HWIO_PERIPH_SS_BLSP1_BLSP_BAM_BAM_IRQ_SRCS_MSK_ADDR A:0xf9904010
y.create.l HWIO_PERIPH_SS_BLSP1_BLSP_BAM_BAM_IRQ_SRCS_UNMASKED_ADDR A:0xf9904030
y.create.l HWIO_PERIPH_SS_BLSP1_BLSP_BAM_BAM_IRQ_STTS_ADDR A:0xf9904014
y.create.l HWIO_PERIPH_SS_BLSP1_BLSP_BAM_BAM_IRQ_CLR_ADDR A:0xf9904018
y.create.l HWIO_PERIPH_SS_BLSP1_BLSP_BAM_BAM_IRQ_EN_ADDR A:0xf990401c
y.create.l HWIO_PERIPH_SS_BLSP1_BLSP_BAM_BAM_AHB_MASTER_ERR_CTRLS_ADDR A:0xf9904024
y.create.l HWIO_PERIPH_SS_BLSP1_BLSP_BAM_BAM_AHB_MASTER_ERR_ADDR_ADDR A:0xf9904028
y.create.l HWIO_PERIPH_SS_BLSP1_BLSP_BAM_BAM_AHB_MASTER_ERR_ADDR_LSB_ADDR A:0xf9904100
y.create.l HWIO_PERIPH_SS_BLSP1_BLSP_BAM_BAM_AHB_MASTER_ERR_ADDR_MSB_ADDR A:0xf9904104
y.create.l HWIO_PERIPH_SS_BLSP1_BLSP_BAM_BAM_AHB_MASTER_ERR_DATA_ADDR A:0xf990402c
y.create.l HWIO_PERIPH_SS_BLSP1_BLSP_BAM_BAM_TRUST_REG_ADDR A:0xf9904070
y.create.l HWIO_PERIPH_SS_BLSP1_BLSP_BAM_BAM_TEST_BUS_SEL_ADDR A:0xf9904074
y.create.l HWIO_PERIPH_SS_BLSP1_BLSP_BAM_BAM_TEST_BUS_REG_ADDR A:0xf9904078
y.create.l HWIO_PERIPH_SS_BLSP1_BLSP_BAM_BAM_CNFG_BITS_ADDR A:0xf990407c
y.create.l HWIO_PERIPH_SS_BLSP1_BLSP_BAM_BAM_IRQ_SRCS_EE0_ADDR A:0xf9904800
y.create.l HWIO_PERIPH_SS_BLSP1_BLSP_BAM_BAM_IRQ_SRCS_EE1_ADDR A:0xf9904880
y.create.l HWIO_PERIPH_SS_BLSP1_BLSP_BAM_BAM_IRQ_SRCS_EE2_ADDR A:0xf9904900
y.create.l HWIO_PERIPH_SS_BLSP1_BLSP_BAM_BAM_IRQ_SRCS_EE3_ADDR A:0xf9904980
y.create.l HWIO_PERIPH_SS_BLSP1_BLSP_BAM_BAM_IRQ_SRCS_EE4_ADDR A:0xf9904a00
y.create.l HWIO_PERIPH_SS_BLSP1_BLSP_BAM_BAM_IRQ_SRCS_EE5_ADDR A:0xf9904a80
y.create.l HWIO_PERIPH_SS_BLSP1_BLSP_BAM_BAM_IRQ_SRCS_EE6_ADDR A:0xf9904b00
y.create.l HWIO_PERIPH_SS_BLSP1_BLSP_BAM_BAM_IRQ_SRCS_EE7_ADDR A:0xf9904b80
y.create.l HWIO_PERIPH_SS_BLSP1_BLSP_BAM_BAM_IRQ_SRCS_MSK_EE0_ADDR A:0xf9904804
y.create.l HWIO_PERIPH_SS_BLSP1_BLSP_BAM_BAM_IRQ_SRCS_MSK_EE1_ADDR A:0xf9904884
y.create.l HWIO_PERIPH_SS_BLSP1_BLSP_BAM_BAM_IRQ_SRCS_MSK_EE2_ADDR A:0xf9904904
y.create.l HWIO_PERIPH_SS_BLSP1_BLSP_BAM_BAM_IRQ_SRCS_MSK_EE3_ADDR A:0xf9904984
y.create.l HWIO_PERIPH_SS_BLSP1_BLSP_BAM_BAM_IRQ_SRCS_MSK_EE4_ADDR A:0xf9904a04
y.create.l HWIO_PERIPH_SS_BLSP1_BLSP_BAM_BAM_IRQ_SRCS_MSK_EE5_ADDR A:0xf9904a84
y.create.l HWIO_PERIPH_SS_BLSP1_BLSP_BAM_BAM_IRQ_SRCS_MSK_EE6_ADDR A:0xf9904b04
y.create.l HWIO_PERIPH_SS_BLSP1_BLSP_BAM_BAM_IRQ_SRCS_MSK_EE7_ADDR A:0xf9904b84
y.create.l HWIO_PERIPH_SS_BLSP1_BLSP_BAM_BAM_IRQ_SRCS_UNMASKED_EE0_ADDR A:0xf9904808
y.create.l HWIO_PERIPH_SS_BLSP1_BLSP_BAM_BAM_IRQ_SRCS_UNMASKED_EE1_ADDR A:0xf9904888
y.create.l HWIO_PERIPH_SS_BLSP1_BLSP_BAM_BAM_IRQ_SRCS_UNMASKED_EE2_ADDR A:0xf9904908
y.create.l HWIO_PERIPH_SS_BLSP1_BLSP_BAM_BAM_IRQ_SRCS_UNMASKED_EE3_ADDR A:0xf9904988
y.create.l HWIO_PERIPH_SS_BLSP1_BLSP_BAM_BAM_IRQ_SRCS_UNMASKED_EE4_ADDR A:0xf9904a08
y.create.l HWIO_PERIPH_SS_BLSP1_BLSP_BAM_BAM_IRQ_SRCS_UNMASKED_EE5_ADDR A:0xf9904a88
y.create.l HWIO_PERIPH_SS_BLSP1_BLSP_BAM_BAM_IRQ_SRCS_UNMASKED_EE6_ADDR A:0xf9904b08
y.create.l HWIO_PERIPH_SS_BLSP1_BLSP_BAM_BAM_IRQ_SRCS_UNMASKED_EE7_ADDR A:0xf9904b88
y.create.l HWIO_PERIPH_SS_BLSP1_BLSP_BAM_BAM_PIPE_ATTR_EE0_ADDR A:0xf990480c
y.create.l HWIO_PERIPH_SS_BLSP1_BLSP_BAM_BAM_PIPE_ATTR_EE1_ADDR A:0xf990488c
y.create.l HWIO_PERIPH_SS_BLSP1_BLSP_BAM_BAM_PIPE_ATTR_EE2_ADDR A:0xf990490c
y.create.l HWIO_PERIPH_SS_BLSP1_BLSP_BAM_BAM_PIPE_ATTR_EE3_ADDR A:0xf990498c
y.create.l HWIO_PERIPH_SS_BLSP1_BLSP_BAM_BAM_PIPE_ATTR_EE4_ADDR A:0xf9904a0c
y.create.l HWIO_PERIPH_SS_BLSP1_BLSP_BAM_BAM_PIPE_ATTR_EE5_ADDR A:0xf9904a8c
y.create.l HWIO_PERIPH_SS_BLSP1_BLSP_BAM_BAM_PIPE_ATTR_EE6_ADDR A:0xf9904b0c
y.create.l HWIO_PERIPH_SS_BLSP1_BLSP_BAM_BAM_PIPE_ATTR_EE7_ADDR A:0xf9904b8c
y.create.l HWIO_PERIPH_SS_BLSP1_BLSP_BAM_BAM_P_CTRL0_ADDR A:0xf9905000
y.create.l HWIO_PERIPH_SS_BLSP1_BLSP_BAM_BAM_P_CTRL1_ADDR A:0xf9906000
y.create.l HWIO_PERIPH_SS_BLSP1_BLSP_BAM_BAM_P_CTRL2_ADDR A:0xf9907000
y.create.l HWIO_PERIPH_SS_BLSP1_BLSP_BAM_BAM_P_CTRL3_ADDR A:0xf9908000
y.create.l HWIO_PERIPH_SS_BLSP1_BLSP_BAM_BAM_P_CTRL4_ADDR A:0xf9909000
y.create.l HWIO_PERIPH_SS_BLSP1_BLSP_BAM_BAM_P_CTRL5_ADDR A:0xf990a000
y.create.l HWIO_PERIPH_SS_BLSP1_BLSP_BAM_BAM_P_CTRL6_ADDR A:0xf990b000
y.create.l HWIO_PERIPH_SS_BLSP1_BLSP_BAM_BAM_P_CTRL7_ADDR A:0xf990c000
y.create.l HWIO_PERIPH_SS_BLSP1_BLSP_BAM_BAM_P_CTRL8_ADDR A:0xf990d000
y.create.l HWIO_PERIPH_SS_BLSP1_BLSP_BAM_BAM_P_CTRL9_ADDR A:0xf990e000
y.create.l HWIO_PERIPH_SS_BLSP1_BLSP_BAM_BAM_P_RST0_ADDR A:0xf9905004
y.create.l HWIO_PERIPH_SS_BLSP1_BLSP_BAM_BAM_P_RST1_ADDR A:0xf9906004
y.create.l HWIO_PERIPH_SS_BLSP1_BLSP_BAM_BAM_P_RST2_ADDR A:0xf9907004
y.create.l HWIO_PERIPH_SS_BLSP1_BLSP_BAM_BAM_P_RST3_ADDR A:0xf9908004
y.create.l HWIO_PERIPH_SS_BLSP1_BLSP_BAM_BAM_P_RST4_ADDR A:0xf9909004
y.create.l HWIO_PERIPH_SS_BLSP1_BLSP_BAM_BAM_P_RST5_ADDR A:0xf990a004
y.create.l HWIO_PERIPH_SS_BLSP1_BLSP_BAM_BAM_P_RST6_ADDR A:0xf990b004
y.create.l HWIO_PERIPH_SS_BLSP1_BLSP_BAM_BAM_P_RST7_ADDR A:0xf990c004
y.create.l HWIO_PERIPH_SS_BLSP1_BLSP_BAM_BAM_P_RST8_ADDR A:0xf990d004
y.create.l HWIO_PERIPH_SS_BLSP1_BLSP_BAM_BAM_P_RST9_ADDR A:0xf990e004
y.create.l HWIO_PERIPH_SS_BLSP1_BLSP_BAM_BAM_P_HALT0_ADDR A:0xf9905008
y.create.l HWIO_PERIPH_SS_BLSP1_BLSP_BAM_BAM_P_HALT1_ADDR A:0xf9906008
y.create.l HWIO_PERIPH_SS_BLSP1_BLSP_BAM_BAM_P_HALT2_ADDR A:0xf9907008
y.create.l HWIO_PERIPH_SS_BLSP1_BLSP_BAM_BAM_P_HALT3_ADDR A:0xf9908008
y.create.l HWIO_PERIPH_SS_BLSP1_BLSP_BAM_BAM_P_HALT4_ADDR A:0xf9909008
y.create.l HWIO_PERIPH_SS_BLSP1_BLSP_BAM_BAM_P_HALT5_ADDR A:0xf990a008
y.create.l HWIO_PERIPH_SS_BLSP1_BLSP_BAM_BAM_P_HALT6_ADDR A:0xf990b008
y.create.l HWIO_PERIPH_SS_BLSP1_BLSP_BAM_BAM_P_HALT7_ADDR A:0xf990c008
y.create.l HWIO_PERIPH_SS_BLSP1_BLSP_BAM_BAM_P_HALT8_ADDR A:0xf990d008
y.create.l HWIO_PERIPH_SS_BLSP1_BLSP_BAM_BAM_P_HALT9_ADDR A:0xf990e008
y.create.l HWIO_PERIPH_SS_BLSP1_BLSP_BAM_BAM_P_TRUST_REG0_ADDR A:0xf9905030
y.create.l HWIO_PERIPH_SS_BLSP1_BLSP_BAM_BAM_P_TRUST_REG1_ADDR A:0xf9906030
y.create.l HWIO_PERIPH_SS_BLSP1_BLSP_BAM_BAM_P_TRUST_REG2_ADDR A:0xf9907030
y.create.l HWIO_PERIPH_SS_BLSP1_BLSP_BAM_BAM_P_TRUST_REG3_ADDR A:0xf9908030
y.create.l HWIO_PERIPH_SS_BLSP1_BLSP_BAM_BAM_P_TRUST_REG4_ADDR A:0xf9909030
y.create.l HWIO_PERIPH_SS_BLSP1_BLSP_BAM_BAM_P_TRUST_REG5_ADDR A:0xf990a030
y.create.l HWIO_PERIPH_SS_BLSP1_BLSP_BAM_BAM_P_TRUST_REG6_ADDR A:0xf990b030
y.create.l HWIO_PERIPH_SS_BLSP1_BLSP_BAM_BAM_P_TRUST_REG7_ADDR A:0xf990c030
y.create.l HWIO_PERIPH_SS_BLSP1_BLSP_BAM_BAM_P_TRUST_REG8_ADDR A:0xf990d030
y.create.l HWIO_PERIPH_SS_BLSP1_BLSP_BAM_BAM_P_TRUST_REG9_ADDR A:0xf990e030
y.create.l HWIO_PERIPH_SS_BLSP1_BLSP_BAM_BAM_P_IRQ_STTS0_ADDR A:0xf9905010
y.create.l HWIO_PERIPH_SS_BLSP1_BLSP_BAM_BAM_P_IRQ_STTS1_ADDR A:0xf9906010
y.create.l HWIO_PERIPH_SS_BLSP1_BLSP_BAM_BAM_P_IRQ_STTS2_ADDR A:0xf9907010
y.create.l HWIO_PERIPH_SS_BLSP1_BLSP_BAM_BAM_P_IRQ_STTS3_ADDR A:0xf9908010
y.create.l HWIO_PERIPH_SS_BLSP1_BLSP_BAM_BAM_P_IRQ_STTS4_ADDR A:0xf9909010
y.create.l HWIO_PERIPH_SS_BLSP1_BLSP_BAM_BAM_P_IRQ_STTS5_ADDR A:0xf990a010
y.create.l HWIO_PERIPH_SS_BLSP1_BLSP_BAM_BAM_P_IRQ_STTS6_ADDR A:0xf990b010
y.create.l HWIO_PERIPH_SS_BLSP1_BLSP_BAM_BAM_P_IRQ_STTS7_ADDR A:0xf990c010
y.create.l HWIO_PERIPH_SS_BLSP1_BLSP_BAM_BAM_P_IRQ_STTS8_ADDR A:0xf990d010
y.create.l HWIO_PERIPH_SS_BLSP1_BLSP_BAM_BAM_P_IRQ_STTS9_ADDR A:0xf990e010
y.create.l HWIO_PERIPH_SS_BLSP1_BLSP_BAM_BAM_P_IRQ_CLR0_ADDR A:0xf9905014
y.create.l HWIO_PERIPH_SS_BLSP1_BLSP_BAM_BAM_P_IRQ_CLR1_ADDR A:0xf9906014
y.create.l HWIO_PERIPH_SS_BLSP1_BLSP_BAM_BAM_P_IRQ_CLR2_ADDR A:0xf9907014
y.create.l HWIO_PERIPH_SS_BLSP1_BLSP_BAM_BAM_P_IRQ_CLR3_ADDR A:0xf9908014
y.create.l HWIO_PERIPH_SS_BLSP1_BLSP_BAM_BAM_P_IRQ_CLR4_ADDR A:0xf9909014
y.create.l HWIO_PERIPH_SS_BLSP1_BLSP_BAM_BAM_P_IRQ_CLR5_ADDR A:0xf990a014
y.create.l HWIO_PERIPH_SS_BLSP1_BLSP_BAM_BAM_P_IRQ_CLR6_ADDR A:0xf990b014
y.create.l HWIO_PERIPH_SS_BLSP1_BLSP_BAM_BAM_P_IRQ_CLR7_ADDR A:0xf990c014
y.create.l HWIO_PERIPH_SS_BLSP1_BLSP_BAM_BAM_P_IRQ_CLR8_ADDR A:0xf990d014
y.create.l HWIO_PERIPH_SS_BLSP1_BLSP_BAM_BAM_P_IRQ_CLR9_ADDR A:0xf990e014
y.create.l HWIO_PERIPH_SS_BLSP1_BLSP_BAM_BAM_P_IRQ_EN0_ADDR A:0xf9905018
y.create.l HWIO_PERIPH_SS_BLSP1_BLSP_BAM_BAM_P_IRQ_EN1_ADDR A:0xf9906018
y.create.l HWIO_PERIPH_SS_BLSP1_BLSP_BAM_BAM_P_IRQ_EN2_ADDR A:0xf9907018
y.create.l HWIO_PERIPH_SS_BLSP1_BLSP_BAM_BAM_P_IRQ_EN3_ADDR A:0xf9908018
y.create.l HWIO_PERIPH_SS_BLSP1_BLSP_BAM_BAM_P_IRQ_EN4_ADDR A:0xf9909018
y.create.l HWIO_PERIPH_SS_BLSP1_BLSP_BAM_BAM_P_IRQ_EN5_ADDR A:0xf990a018
y.create.l HWIO_PERIPH_SS_BLSP1_BLSP_BAM_BAM_P_IRQ_EN6_ADDR A:0xf990b018
y.create.l HWIO_PERIPH_SS_BLSP1_BLSP_BAM_BAM_P_IRQ_EN7_ADDR A:0xf990c018
y.create.l HWIO_PERIPH_SS_BLSP1_BLSP_BAM_BAM_P_IRQ_EN8_ADDR A:0xf990d018
y.create.l HWIO_PERIPH_SS_BLSP1_BLSP_BAM_BAM_P_IRQ_EN9_ADDR A:0xf990e018
y.create.l HWIO_PERIPH_SS_BLSP1_BLSP_BAM_BAM_P_TIMER0_ADDR A:0xf990501c
y.create.l HWIO_PERIPH_SS_BLSP1_BLSP_BAM_BAM_P_TIMER1_ADDR A:0xf990601c
y.create.l HWIO_PERIPH_SS_BLSP1_BLSP_BAM_BAM_P_TIMER2_ADDR A:0xf990701c
y.create.l HWIO_PERIPH_SS_BLSP1_BLSP_BAM_BAM_P_TIMER3_ADDR A:0xf990801c
y.create.l HWIO_PERIPH_SS_BLSP1_BLSP_BAM_BAM_P_TIMER4_ADDR A:0xf990901c
y.create.l HWIO_PERIPH_SS_BLSP1_BLSP_BAM_BAM_P_TIMER5_ADDR A:0xf990a01c
y.create.l HWIO_PERIPH_SS_BLSP1_BLSP_BAM_BAM_P_TIMER6_ADDR A:0xf990b01c
y.create.l HWIO_PERIPH_SS_BLSP1_BLSP_BAM_BAM_P_TIMER7_ADDR A:0xf990c01c
y.create.l HWIO_PERIPH_SS_BLSP1_BLSP_BAM_BAM_P_TIMER8_ADDR A:0xf990d01c
y.create.l HWIO_PERIPH_SS_BLSP1_BLSP_BAM_BAM_P_TIMER9_ADDR A:0xf990e01c
y.create.l HWIO_PERIPH_SS_BLSP1_BLSP_BAM_BAM_P_TIMER_CTRL0_ADDR A:0xf9905020
y.create.l HWIO_PERIPH_SS_BLSP1_BLSP_BAM_BAM_P_TIMER_CTRL1_ADDR A:0xf9906020
y.create.l HWIO_PERIPH_SS_BLSP1_BLSP_BAM_BAM_P_TIMER_CTRL2_ADDR A:0xf9907020
y.create.l HWIO_PERIPH_SS_BLSP1_BLSP_BAM_BAM_P_TIMER_CTRL3_ADDR A:0xf9908020
y.create.l HWIO_PERIPH_SS_BLSP1_BLSP_BAM_BAM_P_TIMER_CTRL4_ADDR A:0xf9909020
y.create.l HWIO_PERIPH_SS_BLSP1_BLSP_BAM_BAM_P_TIMER_CTRL5_ADDR A:0xf990a020
y.create.l HWIO_PERIPH_SS_BLSP1_BLSP_BAM_BAM_P_TIMER_CTRL6_ADDR A:0xf990b020
y.create.l HWIO_PERIPH_SS_BLSP1_BLSP_BAM_BAM_P_TIMER_CTRL7_ADDR A:0xf990c020
y.create.l HWIO_PERIPH_SS_BLSP1_BLSP_BAM_BAM_P_TIMER_CTRL8_ADDR A:0xf990d020
y.create.l HWIO_PERIPH_SS_BLSP1_BLSP_BAM_BAM_P_TIMER_CTRL9_ADDR A:0xf990e020
y.create.l HWIO_PERIPH_SS_BLSP1_BLSP_BAM_BAM_P_PRDCR_SDBND0_ADDR A:0xf9905024
y.create.l HWIO_PERIPH_SS_BLSP1_BLSP_BAM_BAM_P_PRDCR_SDBND1_ADDR A:0xf9906024
y.create.l HWIO_PERIPH_SS_BLSP1_BLSP_BAM_BAM_P_PRDCR_SDBND2_ADDR A:0xf9907024
y.create.l HWIO_PERIPH_SS_BLSP1_BLSP_BAM_BAM_P_PRDCR_SDBND3_ADDR A:0xf9908024
y.create.l HWIO_PERIPH_SS_BLSP1_BLSP_BAM_BAM_P_PRDCR_SDBND4_ADDR A:0xf9909024
y.create.l HWIO_PERIPH_SS_BLSP1_BLSP_BAM_BAM_P_PRDCR_SDBND5_ADDR A:0xf990a024
y.create.l HWIO_PERIPH_SS_BLSP1_BLSP_BAM_BAM_P_PRDCR_SDBND6_ADDR A:0xf990b024
y.create.l HWIO_PERIPH_SS_BLSP1_BLSP_BAM_BAM_P_PRDCR_SDBND7_ADDR A:0xf990c024
y.create.l HWIO_PERIPH_SS_BLSP1_BLSP_BAM_BAM_P_PRDCR_SDBND8_ADDR A:0xf990d024
y.create.l HWIO_PERIPH_SS_BLSP1_BLSP_BAM_BAM_P_PRDCR_SDBND9_ADDR A:0xf990e024
y.create.l HWIO_PERIPH_SS_BLSP1_BLSP_BAM_BAM_P_CNSMR_SDBND0_ADDR A:0xf9905028
y.create.l HWIO_PERIPH_SS_BLSP1_BLSP_BAM_BAM_P_CNSMR_SDBND1_ADDR A:0xf9906028
y.create.l HWIO_PERIPH_SS_BLSP1_BLSP_BAM_BAM_P_CNSMR_SDBND2_ADDR A:0xf9907028
y.create.l HWIO_PERIPH_SS_BLSP1_BLSP_BAM_BAM_P_CNSMR_SDBND3_ADDR A:0xf9908028
y.create.l HWIO_PERIPH_SS_BLSP1_BLSP_BAM_BAM_P_CNSMR_SDBND4_ADDR A:0xf9909028
y.create.l HWIO_PERIPH_SS_BLSP1_BLSP_BAM_BAM_P_CNSMR_SDBND5_ADDR A:0xf990a028
y.create.l HWIO_PERIPH_SS_BLSP1_BLSP_BAM_BAM_P_CNSMR_SDBND6_ADDR A:0xf990b028
y.create.l HWIO_PERIPH_SS_BLSP1_BLSP_BAM_BAM_P_CNSMR_SDBND7_ADDR A:0xf990c028
y.create.l HWIO_PERIPH_SS_BLSP1_BLSP_BAM_BAM_P_CNSMR_SDBND8_ADDR A:0xf990d028
y.create.l HWIO_PERIPH_SS_BLSP1_BLSP_BAM_BAM_P_CNSMR_SDBND9_ADDR A:0xf990e028
y.create.l HWIO_PERIPH_SS_BLSP1_BLSP_BAM_BAM_P_EVNT_DEST_ADDR0_ADDR A:0xf990582c
y.create.l HWIO_PERIPH_SS_BLSP1_BLSP_BAM_BAM_P_EVNT_DEST_ADDR1_ADDR A:0xf990682c
y.create.l HWIO_PERIPH_SS_BLSP1_BLSP_BAM_BAM_P_EVNT_DEST_ADDR2_ADDR A:0xf990782c
y.create.l HWIO_PERIPH_SS_BLSP1_BLSP_BAM_BAM_P_EVNT_DEST_ADDR3_ADDR A:0xf990882c
y.create.l HWIO_PERIPH_SS_BLSP1_BLSP_BAM_BAM_P_EVNT_DEST_ADDR4_ADDR A:0xf990982c
y.create.l HWIO_PERIPH_SS_BLSP1_BLSP_BAM_BAM_P_EVNT_DEST_ADDR5_ADDR A:0xf990a82c
y.create.l HWIO_PERIPH_SS_BLSP1_BLSP_BAM_BAM_P_EVNT_DEST_ADDR6_ADDR A:0xf990b82c
y.create.l HWIO_PERIPH_SS_BLSP1_BLSP_BAM_BAM_P_EVNT_DEST_ADDR7_ADDR A:0xf990c82c
y.create.l HWIO_PERIPH_SS_BLSP1_BLSP_BAM_BAM_P_EVNT_DEST_ADDR8_ADDR A:0xf990d82c
y.create.l HWIO_PERIPH_SS_BLSP1_BLSP_BAM_BAM_P_EVNT_DEST_ADDR9_ADDR A:0xf990e82c
y.create.l HWIO_PERIPH_SS_BLSP1_BLSP_BAM_BAM_P_EVNT_DEST_ADDR_LSB0_ADDR A:0xf9905930
y.create.l HWIO_PERIPH_SS_BLSP1_BLSP_BAM_BAM_P_EVNT_DEST_ADDR_LSB1_ADDR A:0xf9906930
y.create.l HWIO_PERIPH_SS_BLSP1_BLSP_BAM_BAM_P_EVNT_DEST_ADDR_LSB2_ADDR A:0xf9907930
y.create.l HWIO_PERIPH_SS_BLSP1_BLSP_BAM_BAM_P_EVNT_DEST_ADDR_LSB3_ADDR A:0xf9908930
y.create.l HWIO_PERIPH_SS_BLSP1_BLSP_BAM_BAM_P_EVNT_DEST_ADDR_LSB4_ADDR A:0xf9909930
y.create.l HWIO_PERIPH_SS_BLSP1_BLSP_BAM_BAM_P_EVNT_DEST_ADDR_LSB5_ADDR A:0xf990a930
y.create.l HWIO_PERIPH_SS_BLSP1_BLSP_BAM_BAM_P_EVNT_DEST_ADDR_LSB6_ADDR A:0xf990b930
y.create.l HWIO_PERIPH_SS_BLSP1_BLSP_BAM_BAM_P_EVNT_DEST_ADDR_LSB7_ADDR A:0xf990c930
y.create.l HWIO_PERIPH_SS_BLSP1_BLSP_BAM_BAM_P_EVNT_DEST_ADDR_LSB8_ADDR A:0xf990d930
y.create.l HWIO_PERIPH_SS_BLSP1_BLSP_BAM_BAM_P_EVNT_DEST_ADDR_LSB9_ADDR A:0xf990e930
y.create.l HWIO_PERIPH_SS_BLSP1_BLSP_BAM_BAM_P_EVNT_DEST_ADDR_MSB0_ADDR A:0xf9905934
y.create.l HWIO_PERIPH_SS_BLSP1_BLSP_BAM_BAM_P_EVNT_DEST_ADDR_MSB1_ADDR A:0xf9906934
y.create.l HWIO_PERIPH_SS_BLSP1_BLSP_BAM_BAM_P_EVNT_DEST_ADDR_MSB2_ADDR A:0xf9907934
y.create.l HWIO_PERIPH_SS_BLSP1_BLSP_BAM_BAM_P_EVNT_DEST_ADDR_MSB3_ADDR A:0xf9908934
y.create.l HWIO_PERIPH_SS_BLSP1_BLSP_BAM_BAM_P_EVNT_DEST_ADDR_MSB4_ADDR A:0xf9909934
y.create.l HWIO_PERIPH_SS_BLSP1_BLSP_BAM_BAM_P_EVNT_DEST_ADDR_MSB5_ADDR A:0xf990a934
y.create.l HWIO_PERIPH_SS_BLSP1_BLSP_BAM_BAM_P_EVNT_DEST_ADDR_MSB6_ADDR A:0xf990b934
y.create.l HWIO_PERIPH_SS_BLSP1_BLSP_BAM_BAM_P_EVNT_DEST_ADDR_MSB7_ADDR A:0xf990c934
y.create.l HWIO_PERIPH_SS_BLSP1_BLSP_BAM_BAM_P_EVNT_DEST_ADDR_MSB8_ADDR A:0xf990d934
y.create.l HWIO_PERIPH_SS_BLSP1_BLSP_BAM_BAM_P_EVNT_DEST_ADDR_MSB9_ADDR A:0xf990e934
y.create.l HWIO_PERIPH_SS_BLSP1_BLSP_BAM_BAM_P_EVNT_REG0_ADDR A:0xf9905818
y.create.l HWIO_PERIPH_SS_BLSP1_BLSP_BAM_BAM_P_EVNT_REG1_ADDR A:0xf9906818
y.create.l HWIO_PERIPH_SS_BLSP1_BLSP_BAM_BAM_P_EVNT_REG2_ADDR A:0xf9907818
y.create.l HWIO_PERIPH_SS_BLSP1_BLSP_BAM_BAM_P_EVNT_REG3_ADDR A:0xf9908818
y.create.l HWIO_PERIPH_SS_BLSP1_BLSP_BAM_BAM_P_EVNT_REG4_ADDR A:0xf9909818
y.create.l HWIO_PERIPH_SS_BLSP1_BLSP_BAM_BAM_P_EVNT_REG5_ADDR A:0xf990a818
y.create.l HWIO_PERIPH_SS_BLSP1_BLSP_BAM_BAM_P_EVNT_REG6_ADDR A:0xf990b818
y.create.l HWIO_PERIPH_SS_BLSP1_BLSP_BAM_BAM_P_EVNT_REG7_ADDR A:0xf990c818
y.create.l HWIO_PERIPH_SS_BLSP1_BLSP_BAM_BAM_P_EVNT_REG8_ADDR A:0xf990d818
y.create.l HWIO_PERIPH_SS_BLSP1_BLSP_BAM_BAM_P_EVNT_REG9_ADDR A:0xf990e818
y.create.l HWIO_PERIPH_SS_BLSP1_BLSP_BAM_BAM_P_SW_OFSTS0_ADDR A:0xf9905800
y.create.l HWIO_PERIPH_SS_BLSP1_BLSP_BAM_BAM_P_SW_OFSTS1_ADDR A:0xf9906800
y.create.l HWIO_PERIPH_SS_BLSP1_BLSP_BAM_BAM_P_SW_OFSTS2_ADDR A:0xf9907800
y.create.l HWIO_PERIPH_SS_BLSP1_BLSP_BAM_BAM_P_SW_OFSTS3_ADDR A:0xf9908800
y.create.l HWIO_PERIPH_SS_BLSP1_BLSP_BAM_BAM_P_SW_OFSTS4_ADDR A:0xf9909800
y.create.l HWIO_PERIPH_SS_BLSP1_BLSP_BAM_BAM_P_SW_OFSTS5_ADDR A:0xf990a800
y.create.l HWIO_PERIPH_SS_BLSP1_BLSP_BAM_BAM_P_SW_OFSTS6_ADDR A:0xf990b800
y.create.l HWIO_PERIPH_SS_BLSP1_BLSP_BAM_BAM_P_SW_OFSTS7_ADDR A:0xf990c800
y.create.l HWIO_PERIPH_SS_BLSP1_BLSP_BAM_BAM_P_SW_OFSTS8_ADDR A:0xf990d800
y.create.l HWIO_PERIPH_SS_BLSP1_BLSP_BAM_BAM_P_SW_OFSTS9_ADDR A:0xf990e800
y.create.l HWIO_PERIPH_SS_BLSP1_BLSP_BAM_BAM_P_DATA_FIFO_ADDR0_ADDR A:0xf9905824
y.create.l HWIO_PERIPH_SS_BLSP1_BLSP_BAM_BAM_P_DATA_FIFO_ADDR1_ADDR A:0xf9906824
y.create.l HWIO_PERIPH_SS_BLSP1_BLSP_BAM_BAM_P_DATA_FIFO_ADDR2_ADDR A:0xf9907824
y.create.l HWIO_PERIPH_SS_BLSP1_BLSP_BAM_BAM_P_DATA_FIFO_ADDR3_ADDR A:0xf9908824
y.create.l HWIO_PERIPH_SS_BLSP1_BLSP_BAM_BAM_P_DATA_FIFO_ADDR4_ADDR A:0xf9909824
y.create.l HWIO_PERIPH_SS_BLSP1_BLSP_BAM_BAM_P_DATA_FIFO_ADDR5_ADDR A:0xf990a824
y.create.l HWIO_PERIPH_SS_BLSP1_BLSP_BAM_BAM_P_DATA_FIFO_ADDR6_ADDR A:0xf990b824
y.create.l HWIO_PERIPH_SS_BLSP1_BLSP_BAM_BAM_P_DATA_FIFO_ADDR7_ADDR A:0xf990c824
y.create.l HWIO_PERIPH_SS_BLSP1_BLSP_BAM_BAM_P_DATA_FIFO_ADDR8_ADDR A:0xf990d824
y.create.l HWIO_PERIPH_SS_BLSP1_BLSP_BAM_BAM_P_DATA_FIFO_ADDR9_ADDR A:0xf990e824
y.create.l HWIO_PERIPH_SS_BLSP1_BLSP_BAM_BAM_P_DATA_FIFO_ADDR_LSB0_ADDR A:0xf9905920
y.create.l HWIO_PERIPH_SS_BLSP1_BLSP_BAM_BAM_P_DATA_FIFO_ADDR_LSB1_ADDR A:0xf9906920
y.create.l HWIO_PERIPH_SS_BLSP1_BLSP_BAM_BAM_P_DATA_FIFO_ADDR_LSB2_ADDR A:0xf9907920
y.create.l HWIO_PERIPH_SS_BLSP1_BLSP_BAM_BAM_P_DATA_FIFO_ADDR_LSB3_ADDR A:0xf9908920
y.create.l HWIO_PERIPH_SS_BLSP1_BLSP_BAM_BAM_P_DATA_FIFO_ADDR_LSB4_ADDR A:0xf9909920
y.create.l HWIO_PERIPH_SS_BLSP1_BLSP_BAM_BAM_P_DATA_FIFO_ADDR_LSB5_ADDR A:0xf990a920
y.create.l HWIO_PERIPH_SS_BLSP1_BLSP_BAM_BAM_P_DATA_FIFO_ADDR_LSB6_ADDR A:0xf990b920
y.create.l HWIO_PERIPH_SS_BLSP1_BLSP_BAM_BAM_P_DATA_FIFO_ADDR_LSB7_ADDR A:0xf990c920
y.create.l HWIO_PERIPH_SS_BLSP1_BLSP_BAM_BAM_P_DATA_FIFO_ADDR_LSB8_ADDR A:0xf990d920
y.create.l HWIO_PERIPH_SS_BLSP1_BLSP_BAM_BAM_P_DATA_FIFO_ADDR_LSB9_ADDR A:0xf990e920
y.create.l HWIO_PERIPH_SS_BLSP1_BLSP_BAM_BAM_P_DATA_FIFO_ADDR_MSB0_ADDR A:0xf9905924
y.create.l HWIO_PERIPH_SS_BLSP1_BLSP_BAM_BAM_P_DATA_FIFO_ADDR_MSB1_ADDR A:0xf9906924
y.create.l HWIO_PERIPH_SS_BLSP1_BLSP_BAM_BAM_P_DATA_FIFO_ADDR_MSB2_ADDR A:0xf9907924
y.create.l HWIO_PERIPH_SS_BLSP1_BLSP_BAM_BAM_P_DATA_FIFO_ADDR_MSB3_ADDR A:0xf9908924
y.create.l HWIO_PERIPH_SS_BLSP1_BLSP_BAM_BAM_P_DATA_FIFO_ADDR_MSB4_ADDR A:0xf9909924
y.create.l HWIO_PERIPH_SS_BLSP1_BLSP_BAM_BAM_P_DATA_FIFO_ADDR_MSB5_ADDR A:0xf990a924
y.create.l HWIO_PERIPH_SS_BLSP1_BLSP_BAM_BAM_P_DATA_FIFO_ADDR_MSB6_ADDR A:0xf990b924
y.create.l HWIO_PERIPH_SS_BLSP1_BLSP_BAM_BAM_P_DATA_FIFO_ADDR_MSB7_ADDR A:0xf990c924
y.create.l HWIO_PERIPH_SS_BLSP1_BLSP_BAM_BAM_P_DATA_FIFO_ADDR_MSB8_ADDR A:0xf990d924
y.create.l HWIO_PERIPH_SS_BLSP1_BLSP_BAM_BAM_P_DATA_FIFO_ADDR_MSB9_ADDR A:0xf990e924
y.create.l HWIO_PERIPH_SS_BLSP1_BLSP_BAM_BAM_P_DESC_FIFO_ADDR0_ADDR A:0xf990581c
y.create.l HWIO_PERIPH_SS_BLSP1_BLSP_BAM_BAM_P_DESC_FIFO_ADDR1_ADDR A:0xf990681c
y.create.l HWIO_PERIPH_SS_BLSP1_BLSP_BAM_BAM_P_DESC_FIFO_ADDR2_ADDR A:0xf990781c
y.create.l HWIO_PERIPH_SS_BLSP1_BLSP_BAM_BAM_P_DESC_FIFO_ADDR3_ADDR A:0xf990881c
y.create.l HWIO_PERIPH_SS_BLSP1_BLSP_BAM_BAM_P_DESC_FIFO_ADDR4_ADDR A:0xf990981c
y.create.l HWIO_PERIPH_SS_BLSP1_BLSP_BAM_BAM_P_DESC_FIFO_ADDR5_ADDR A:0xf990a81c
y.create.l HWIO_PERIPH_SS_BLSP1_BLSP_BAM_BAM_P_DESC_FIFO_ADDR6_ADDR A:0xf990b81c
y.create.l HWIO_PERIPH_SS_BLSP1_BLSP_BAM_BAM_P_DESC_FIFO_ADDR7_ADDR A:0xf990c81c
y.create.l HWIO_PERIPH_SS_BLSP1_BLSP_BAM_BAM_P_DESC_FIFO_ADDR8_ADDR A:0xf990d81c
y.create.l HWIO_PERIPH_SS_BLSP1_BLSP_BAM_BAM_P_DESC_FIFO_ADDR9_ADDR A:0xf990e81c
y.create.l HWIO_PERIPH_SS_BLSP1_BLSP_BAM_BAM_P_DESC_FIFO_ADDR_LSB0_ADDR A:0xf9905910
y.create.l HWIO_PERIPH_SS_BLSP1_BLSP_BAM_BAM_P_DESC_FIFO_ADDR_LSB1_ADDR A:0xf9906910
y.create.l HWIO_PERIPH_SS_BLSP1_BLSP_BAM_BAM_P_DESC_FIFO_ADDR_LSB2_ADDR A:0xf9907910
y.create.l HWIO_PERIPH_SS_BLSP1_BLSP_BAM_BAM_P_DESC_FIFO_ADDR_LSB3_ADDR A:0xf9908910
y.create.l HWIO_PERIPH_SS_BLSP1_BLSP_BAM_BAM_P_DESC_FIFO_ADDR_LSB4_ADDR A:0xf9909910
y.create.l HWIO_PERIPH_SS_BLSP1_BLSP_BAM_BAM_P_DESC_FIFO_ADDR_LSB5_ADDR A:0xf990a910
y.create.l HWIO_PERIPH_SS_BLSP1_BLSP_BAM_BAM_P_DESC_FIFO_ADDR_LSB6_ADDR A:0xf990b910
y.create.l HWIO_PERIPH_SS_BLSP1_BLSP_BAM_BAM_P_DESC_FIFO_ADDR_LSB7_ADDR A:0xf990c910
y.create.l HWIO_PERIPH_SS_BLSP1_BLSP_BAM_BAM_P_DESC_FIFO_ADDR_LSB8_ADDR A:0xf990d910
y.create.l HWIO_PERIPH_SS_BLSP1_BLSP_BAM_BAM_P_DESC_FIFO_ADDR_LSB9_ADDR A:0xf990e910
y.create.l HWIO_PERIPH_SS_BLSP1_BLSP_BAM_BAM_P_DESC_FIFO_ADDR_MSB0_ADDR A:0xf9905914
y.create.l HWIO_PERIPH_SS_BLSP1_BLSP_BAM_BAM_P_DESC_FIFO_ADDR_MSB1_ADDR A:0xf9906914
y.create.l HWIO_PERIPH_SS_BLSP1_BLSP_BAM_BAM_P_DESC_FIFO_ADDR_MSB2_ADDR A:0xf9907914
y.create.l HWIO_PERIPH_SS_BLSP1_BLSP_BAM_BAM_P_DESC_FIFO_ADDR_MSB3_ADDR A:0xf9908914
y.create.l HWIO_PERIPH_SS_BLSP1_BLSP_BAM_BAM_P_DESC_FIFO_ADDR_MSB4_ADDR A:0xf9909914
y.create.l HWIO_PERIPH_SS_BLSP1_BLSP_BAM_BAM_P_DESC_FIFO_ADDR_MSB5_ADDR A:0xf990a914
y.create.l HWIO_PERIPH_SS_BLSP1_BLSP_BAM_BAM_P_DESC_FIFO_ADDR_MSB6_ADDR A:0xf990b914
y.create.l HWIO_PERIPH_SS_BLSP1_BLSP_BAM_BAM_P_DESC_FIFO_ADDR_MSB7_ADDR A:0xf990c914
y.create.l HWIO_PERIPH_SS_BLSP1_BLSP_BAM_BAM_P_DESC_FIFO_ADDR_MSB8_ADDR A:0xf990d914
y.create.l HWIO_PERIPH_SS_BLSP1_BLSP_BAM_BAM_P_DESC_FIFO_ADDR_MSB9_ADDR A:0xf990e914
y.create.l HWIO_PERIPH_SS_BLSP1_BLSP_BAM_BAM_P_EVNT_GEN_TRSHLD0_ADDR A:0xf9905828
y.create.l HWIO_PERIPH_SS_BLSP1_BLSP_BAM_BAM_P_EVNT_GEN_TRSHLD1_ADDR A:0xf9906828
y.create.l HWIO_PERIPH_SS_BLSP1_BLSP_BAM_BAM_P_EVNT_GEN_TRSHLD2_ADDR A:0xf9907828
y.create.l HWIO_PERIPH_SS_BLSP1_BLSP_BAM_BAM_P_EVNT_GEN_TRSHLD3_ADDR A:0xf9908828
y.create.l HWIO_PERIPH_SS_BLSP1_BLSP_BAM_BAM_P_EVNT_GEN_TRSHLD4_ADDR A:0xf9909828
y.create.l HWIO_PERIPH_SS_BLSP1_BLSP_BAM_BAM_P_EVNT_GEN_TRSHLD5_ADDR A:0xf990a828
y.create.l HWIO_PERIPH_SS_BLSP1_BLSP_BAM_BAM_P_EVNT_GEN_TRSHLD6_ADDR A:0xf990b828
y.create.l HWIO_PERIPH_SS_BLSP1_BLSP_BAM_BAM_P_EVNT_GEN_TRSHLD7_ADDR A:0xf990c828
y.create.l HWIO_PERIPH_SS_BLSP1_BLSP_BAM_BAM_P_EVNT_GEN_TRSHLD8_ADDR A:0xf990d828
y.create.l HWIO_PERIPH_SS_BLSP1_BLSP_BAM_BAM_P_EVNT_GEN_TRSHLD9_ADDR A:0xf990e828
y.create.l HWIO_PERIPH_SS_BLSP1_BLSP_BAM_BAM_P_FIFO_SIZES0_ADDR A:0xf9905820
y.create.l HWIO_PERIPH_SS_BLSP1_BLSP_BAM_BAM_P_FIFO_SIZES1_ADDR A:0xf9906820
y.create.l HWIO_PERIPH_SS_BLSP1_BLSP_BAM_BAM_P_FIFO_SIZES2_ADDR A:0xf9907820
y.create.l HWIO_PERIPH_SS_BLSP1_BLSP_BAM_BAM_P_FIFO_SIZES3_ADDR A:0xf9908820
y.create.l HWIO_PERIPH_SS_BLSP1_BLSP_BAM_BAM_P_FIFO_SIZES4_ADDR A:0xf9909820
y.create.l HWIO_PERIPH_SS_BLSP1_BLSP_BAM_BAM_P_FIFO_SIZES5_ADDR A:0xf990a820
y.create.l HWIO_PERIPH_SS_BLSP1_BLSP_BAM_BAM_P_FIFO_SIZES6_ADDR A:0xf990b820
y.create.l HWIO_PERIPH_SS_BLSP1_BLSP_BAM_BAM_P_FIFO_SIZES7_ADDR A:0xf990c820
y.create.l HWIO_PERIPH_SS_BLSP1_BLSP_BAM_BAM_P_FIFO_SIZES8_ADDR A:0xf990d820
y.create.l HWIO_PERIPH_SS_BLSP1_BLSP_BAM_BAM_P_FIFO_SIZES9_ADDR A:0xf990e820
y.create.l HWIO_PERIPH_SS_BLSP1_BLSP_BAM_BAM_P_RETR_CNTXT_0_ADDR A:0xf9905834
y.create.l HWIO_PERIPH_SS_BLSP1_BLSP_BAM_BAM_P_RETR_CNTXT_1_ADDR A:0xf9906834
y.create.l HWIO_PERIPH_SS_BLSP1_BLSP_BAM_BAM_P_RETR_CNTXT_2_ADDR A:0xf9907834
y.create.l HWIO_PERIPH_SS_BLSP1_BLSP_BAM_BAM_P_RETR_CNTXT_3_ADDR A:0xf9908834
y.create.l HWIO_PERIPH_SS_BLSP1_BLSP_BAM_BAM_P_RETR_CNTXT_4_ADDR A:0xf9909834
y.create.l HWIO_PERIPH_SS_BLSP1_BLSP_BAM_BAM_P_RETR_CNTXT_5_ADDR A:0xf990a834
y.create.l HWIO_PERIPH_SS_BLSP1_BLSP_BAM_BAM_P_RETR_CNTXT_6_ADDR A:0xf990b834
y.create.l HWIO_PERIPH_SS_BLSP1_BLSP_BAM_BAM_P_RETR_CNTXT_7_ADDR A:0xf990c834
y.create.l HWIO_PERIPH_SS_BLSP1_BLSP_BAM_BAM_P_RETR_CNTXT_8_ADDR A:0xf990d834
y.create.l HWIO_PERIPH_SS_BLSP1_BLSP_BAM_BAM_P_RETR_CNTXT_9_ADDR A:0xf990e834
y.create.l HWIO_PERIPH_SS_BLSP1_BLSP_BAM_BAM_P_SI_CNTXT_0_ADDR A:0xf9905838
y.create.l HWIO_PERIPH_SS_BLSP1_BLSP_BAM_BAM_P_SI_CNTXT_1_ADDR A:0xf9906838
y.create.l HWIO_PERIPH_SS_BLSP1_BLSP_BAM_BAM_P_SI_CNTXT_2_ADDR A:0xf9907838
y.create.l HWIO_PERIPH_SS_BLSP1_BLSP_BAM_BAM_P_SI_CNTXT_3_ADDR A:0xf9908838
y.create.l HWIO_PERIPH_SS_BLSP1_BLSP_BAM_BAM_P_SI_CNTXT_4_ADDR A:0xf9909838
y.create.l HWIO_PERIPH_SS_BLSP1_BLSP_BAM_BAM_P_SI_CNTXT_5_ADDR A:0xf990a838
y.create.l HWIO_PERIPH_SS_BLSP1_BLSP_BAM_BAM_P_SI_CNTXT_6_ADDR A:0xf990b838
y.create.l HWIO_PERIPH_SS_BLSP1_BLSP_BAM_BAM_P_SI_CNTXT_7_ADDR A:0xf990c838
y.create.l HWIO_PERIPH_SS_BLSP1_BLSP_BAM_BAM_P_SI_CNTXT_8_ADDR A:0xf990d838
y.create.l HWIO_PERIPH_SS_BLSP1_BLSP_BAM_BAM_P_SI_CNTXT_9_ADDR A:0xf990e838
y.create.l HWIO_PERIPH_SS_BLSP1_BLSP_BAM_BAM_P_DF_CNTXT_0_ADDR A:0xf9905830
y.create.l HWIO_PERIPH_SS_BLSP1_BLSP_BAM_BAM_P_DF_CNTXT_1_ADDR A:0xf9906830
y.create.l HWIO_PERIPH_SS_BLSP1_BLSP_BAM_BAM_P_DF_CNTXT_2_ADDR A:0xf9907830
y.create.l HWIO_PERIPH_SS_BLSP1_BLSP_BAM_BAM_P_DF_CNTXT_3_ADDR A:0xf9908830
y.create.l HWIO_PERIPH_SS_BLSP1_BLSP_BAM_BAM_P_DF_CNTXT_4_ADDR A:0xf9909830
y.create.l HWIO_PERIPH_SS_BLSP1_BLSP_BAM_BAM_P_DF_CNTXT_5_ADDR A:0xf990a830
y.create.l HWIO_PERIPH_SS_BLSP1_BLSP_BAM_BAM_P_DF_CNTXT_6_ADDR A:0xf990b830
y.create.l HWIO_PERIPH_SS_BLSP1_BLSP_BAM_BAM_P_DF_CNTXT_7_ADDR A:0xf990c830
y.create.l HWIO_PERIPH_SS_BLSP1_BLSP_BAM_BAM_P_DF_CNTXT_8_ADDR A:0xf990d830
y.create.l HWIO_PERIPH_SS_BLSP1_BLSP_BAM_BAM_P_DF_CNTXT_9_ADDR A:0xf990e830
y.create.l HWIO_PERIPH_SS_BLSP1_BLSP_BAM_BAM_P_AU_PSM_CNTXT_1_0_ADDR A:0xf9905804
y.create.l HWIO_PERIPH_SS_BLSP1_BLSP_BAM_BAM_P_AU_PSM_CNTXT_1_1_ADDR A:0xf9906804
y.create.l HWIO_PERIPH_SS_BLSP1_BLSP_BAM_BAM_P_AU_PSM_CNTXT_1_2_ADDR A:0xf9907804
y.create.l HWIO_PERIPH_SS_BLSP1_BLSP_BAM_BAM_P_AU_PSM_CNTXT_1_3_ADDR A:0xf9908804
y.create.l HWIO_PERIPH_SS_BLSP1_BLSP_BAM_BAM_P_AU_PSM_CNTXT_1_4_ADDR A:0xf9909804
y.create.l HWIO_PERIPH_SS_BLSP1_BLSP_BAM_BAM_P_AU_PSM_CNTXT_1_5_ADDR A:0xf990a804
y.create.l HWIO_PERIPH_SS_BLSP1_BLSP_BAM_BAM_P_AU_PSM_CNTXT_1_6_ADDR A:0xf990b804
y.create.l HWIO_PERIPH_SS_BLSP1_BLSP_BAM_BAM_P_AU_PSM_CNTXT_1_7_ADDR A:0xf990c804
y.create.l HWIO_PERIPH_SS_BLSP1_BLSP_BAM_BAM_P_AU_PSM_CNTXT_1_8_ADDR A:0xf990d804
y.create.l HWIO_PERIPH_SS_BLSP1_BLSP_BAM_BAM_P_AU_PSM_CNTXT_1_9_ADDR A:0xf990e804
y.create.l HWIO_PERIPH_SS_BLSP1_BLSP_BAM_BAM_P_PSM_CNTXT_2_0_ADDR A:0xf9905808
y.create.l HWIO_PERIPH_SS_BLSP1_BLSP_BAM_BAM_P_PSM_CNTXT_2_1_ADDR A:0xf9906808
y.create.l HWIO_PERIPH_SS_BLSP1_BLSP_BAM_BAM_P_PSM_CNTXT_2_2_ADDR A:0xf9907808
y.create.l HWIO_PERIPH_SS_BLSP1_BLSP_BAM_BAM_P_PSM_CNTXT_2_3_ADDR A:0xf9908808
y.create.l HWIO_PERIPH_SS_BLSP1_BLSP_BAM_BAM_P_PSM_CNTXT_2_4_ADDR A:0xf9909808
y.create.l HWIO_PERIPH_SS_BLSP1_BLSP_BAM_BAM_P_PSM_CNTXT_2_5_ADDR A:0xf990a808
y.create.l HWIO_PERIPH_SS_BLSP1_BLSP_BAM_BAM_P_PSM_CNTXT_2_6_ADDR A:0xf990b808
y.create.l HWIO_PERIPH_SS_BLSP1_BLSP_BAM_BAM_P_PSM_CNTXT_2_7_ADDR A:0xf990c808
y.create.l HWIO_PERIPH_SS_BLSP1_BLSP_BAM_BAM_P_PSM_CNTXT_2_8_ADDR A:0xf990d808
y.create.l HWIO_PERIPH_SS_BLSP1_BLSP_BAM_BAM_P_PSM_CNTXT_2_9_ADDR A:0xf990e808
y.create.l HWIO_PERIPH_SS_BLSP1_BLSP_BAM_BAM_P_PSM_CNTXT_3_0_ADDR A:0xf990580c
y.create.l HWIO_PERIPH_SS_BLSP1_BLSP_BAM_BAM_P_PSM_CNTXT_3_1_ADDR A:0xf990680c
y.create.l HWIO_PERIPH_SS_BLSP1_BLSP_BAM_BAM_P_PSM_CNTXT_3_2_ADDR A:0xf990780c
y.create.l HWIO_PERIPH_SS_BLSP1_BLSP_BAM_BAM_P_PSM_CNTXT_3_3_ADDR A:0xf990880c
y.create.l HWIO_PERIPH_SS_BLSP1_BLSP_BAM_BAM_P_PSM_CNTXT_3_4_ADDR A:0xf990980c
y.create.l HWIO_PERIPH_SS_BLSP1_BLSP_BAM_BAM_P_PSM_CNTXT_3_5_ADDR A:0xf990a80c
y.create.l HWIO_PERIPH_SS_BLSP1_BLSP_BAM_BAM_P_PSM_CNTXT_3_6_ADDR A:0xf990b80c
y.create.l HWIO_PERIPH_SS_BLSP1_BLSP_BAM_BAM_P_PSM_CNTXT_3_7_ADDR A:0xf990c80c
y.create.l HWIO_PERIPH_SS_BLSP1_BLSP_BAM_BAM_P_PSM_CNTXT_3_8_ADDR A:0xf990d80c
y.create.l HWIO_PERIPH_SS_BLSP1_BLSP_BAM_BAM_P_PSM_CNTXT_3_9_ADDR A:0xf990e80c
y.create.l HWIO_PERIPH_SS_BLSP1_BLSP_BAM_BAM_P_PSM_CNTXT_3_LSB0_ADDR A:0xf9905900
y.create.l HWIO_PERIPH_SS_BLSP1_BLSP_BAM_BAM_P_PSM_CNTXT_3_LSB1_ADDR A:0xf9906900
y.create.l HWIO_PERIPH_SS_BLSP1_BLSP_BAM_BAM_P_PSM_CNTXT_3_LSB2_ADDR A:0xf9907900
y.create.l HWIO_PERIPH_SS_BLSP1_BLSP_BAM_BAM_P_PSM_CNTXT_3_LSB3_ADDR A:0xf9908900
y.create.l HWIO_PERIPH_SS_BLSP1_BLSP_BAM_BAM_P_PSM_CNTXT_3_LSB4_ADDR A:0xf9909900
y.create.l HWIO_PERIPH_SS_BLSP1_BLSP_BAM_BAM_P_PSM_CNTXT_3_LSB5_ADDR A:0xf990a900
y.create.l HWIO_PERIPH_SS_BLSP1_BLSP_BAM_BAM_P_PSM_CNTXT_3_LSB6_ADDR A:0xf990b900
y.create.l HWIO_PERIPH_SS_BLSP1_BLSP_BAM_BAM_P_PSM_CNTXT_3_LSB7_ADDR A:0xf990c900
y.create.l HWIO_PERIPH_SS_BLSP1_BLSP_BAM_BAM_P_PSM_CNTXT_3_LSB8_ADDR A:0xf990d900
y.create.l HWIO_PERIPH_SS_BLSP1_BLSP_BAM_BAM_P_PSM_CNTXT_3_LSB9_ADDR A:0xf990e900
y.create.l HWIO_PERIPH_SS_BLSP1_BLSP_BAM_BAM_P_PSM_CNTXT_3_MSB0_ADDR A:0xf9905904
y.create.l HWIO_PERIPH_SS_BLSP1_BLSP_BAM_BAM_P_PSM_CNTXT_3_MSB1_ADDR A:0xf9906904
y.create.l HWIO_PERIPH_SS_BLSP1_BLSP_BAM_BAM_P_PSM_CNTXT_3_MSB2_ADDR A:0xf9907904
y.create.l HWIO_PERIPH_SS_BLSP1_BLSP_BAM_BAM_P_PSM_CNTXT_3_MSB3_ADDR A:0xf9908904
y.create.l HWIO_PERIPH_SS_BLSP1_BLSP_BAM_BAM_P_PSM_CNTXT_3_MSB4_ADDR A:0xf9909904
y.create.l HWIO_PERIPH_SS_BLSP1_BLSP_BAM_BAM_P_PSM_CNTXT_3_MSB5_ADDR A:0xf990a904
y.create.l HWIO_PERIPH_SS_BLSP1_BLSP_BAM_BAM_P_PSM_CNTXT_3_MSB6_ADDR A:0xf990b904
y.create.l HWIO_PERIPH_SS_BLSP1_BLSP_BAM_BAM_P_PSM_CNTXT_3_MSB7_ADDR A:0xf990c904
y.create.l HWIO_PERIPH_SS_BLSP1_BLSP_BAM_BAM_P_PSM_CNTXT_3_MSB8_ADDR A:0xf990d904
y.create.l HWIO_PERIPH_SS_BLSP1_BLSP_BAM_BAM_P_PSM_CNTXT_3_MSB9_ADDR A:0xf990e904
y.create.l HWIO_PERIPH_SS_BLSP1_BLSP_BAM_BAM_P_PSM_CNTXT_4_0_ADDR A:0xf9905810
y.create.l HWIO_PERIPH_SS_BLSP1_BLSP_BAM_BAM_P_PSM_CNTXT_4_1_ADDR A:0xf9906810
y.create.l HWIO_PERIPH_SS_BLSP1_BLSP_BAM_BAM_P_PSM_CNTXT_4_2_ADDR A:0xf9907810
y.create.l HWIO_PERIPH_SS_BLSP1_BLSP_BAM_BAM_P_PSM_CNTXT_4_3_ADDR A:0xf9908810
y.create.l HWIO_PERIPH_SS_BLSP1_BLSP_BAM_BAM_P_PSM_CNTXT_4_4_ADDR A:0xf9909810
y.create.l HWIO_PERIPH_SS_BLSP1_BLSP_BAM_BAM_P_PSM_CNTXT_4_5_ADDR A:0xf990a810
y.create.l HWIO_PERIPH_SS_BLSP1_BLSP_BAM_BAM_P_PSM_CNTXT_4_6_ADDR A:0xf990b810
y.create.l HWIO_PERIPH_SS_BLSP1_BLSP_BAM_BAM_P_PSM_CNTXT_4_7_ADDR A:0xf990c810
y.create.l HWIO_PERIPH_SS_BLSP1_BLSP_BAM_BAM_P_PSM_CNTXT_4_8_ADDR A:0xf990d810
y.create.l HWIO_PERIPH_SS_BLSP1_BLSP_BAM_BAM_P_PSM_CNTXT_4_9_ADDR A:0xf990e810
y.create.l HWIO_PERIPH_SS_BLSP1_BLSP_BAM_BAM_P_PSM_CNTXT_5_0_ADDR A:0xf9905814
y.create.l HWIO_PERIPH_SS_BLSP1_BLSP_BAM_BAM_P_PSM_CNTXT_5_1_ADDR A:0xf9906814
y.create.l HWIO_PERIPH_SS_BLSP1_BLSP_BAM_BAM_P_PSM_CNTXT_5_2_ADDR A:0xf9907814
y.create.l HWIO_PERIPH_SS_BLSP1_BLSP_BAM_BAM_P_PSM_CNTXT_5_3_ADDR A:0xf9908814
y.create.l HWIO_PERIPH_SS_BLSP1_BLSP_BAM_BAM_P_PSM_CNTXT_5_4_ADDR A:0xf9909814
y.create.l HWIO_PERIPH_SS_BLSP1_BLSP_BAM_BAM_P_PSM_CNTXT_5_5_ADDR A:0xf990a814
y.create.l HWIO_PERIPH_SS_BLSP1_BLSP_BAM_BAM_P_PSM_CNTXT_5_6_ADDR A:0xf990b814
y.create.l HWIO_PERIPH_SS_BLSP1_BLSP_BAM_BAM_P_PSM_CNTXT_5_7_ADDR A:0xf990c814
y.create.l HWIO_PERIPH_SS_BLSP1_BLSP_BAM_BAM_P_PSM_CNTXT_5_8_ADDR A:0xf990d814
y.create.l HWIO_PERIPH_SS_BLSP1_BLSP_BAM_BAM_P_PSM_CNTXT_5_9_ADDR A:0xf990e814
y.create.l HWIO_PERIPH_SS_BLSP1_BLSP_BAM_XPU_SCR_ADDR A:0xf9902000
y.create.l HWIO_PERIPH_SS_BLSP1_BLSP_BAM_XPU_SWDR_ADDR A:0xf9902004
y.create.l HWIO_PERIPH_SS_BLSP1_BLSP_BAM_XPU_SEAR0_ADDR A:0xf9902040
y.create.l HWIO_PERIPH_SS_BLSP1_BLSP_BAM_XPU_SESR_ADDR A:0xf9902048
y.create.l HWIO_PERIPH_SS_BLSP1_BLSP_BAM_XPU_SESRRESTORE_ADDR A:0xf990204c
y.create.l HWIO_PERIPH_SS_BLSP1_BLSP_BAM_XPU_SESYNR0_ADDR A:0xf9902050
y.create.l HWIO_PERIPH_SS_BLSP1_BLSP_BAM_XPU_SESYNR1_ADDR A:0xf9902054
y.create.l HWIO_PERIPH_SS_BLSP1_BLSP_BAM_XPU_SESYNR2_ADDR A:0xf9902058
y.create.l HWIO_PERIPH_SS_BLSP1_BLSP_BAM_XPU_MCR_ADDR A:0xf9902100
y.create.l HWIO_PERIPH_SS_BLSP1_BLSP_BAM_XPU_MEAR0_ADDR A:0xf9902140
y.create.l HWIO_PERIPH_SS_BLSP1_BLSP_BAM_XPU_MESR_ADDR A:0xf9902148
y.create.l HWIO_PERIPH_SS_BLSP1_BLSP_BAM_XPU_MESRRESTORE_ADDR A:0xf990214c
y.create.l HWIO_PERIPH_SS_BLSP1_BLSP_BAM_XPU_MESYNR0_ADDR A:0xf9902150
y.create.l HWIO_PERIPH_SS_BLSP1_BLSP_BAM_XPU_MESYNR1_ADDR A:0xf9902154
y.create.l HWIO_PERIPH_SS_BLSP1_BLSP_BAM_XPU_MESYNR2_ADDR A:0xf9902158
y.create.l HWIO_PERIPH_SS_BLSP1_BLSP_BAM_XPU_CR_ADDR A:0xf9902080
y.create.l HWIO_PERIPH_SS_BLSP1_BLSP_BAM_XPU_RPU_ACR0_ADDR A:0xf99020a0
y.create.l HWIO_PERIPH_SS_BLSP1_BLSP_BAM_XPU_EAR0_ADDR A:0xf99020c0
y.create.l HWIO_PERIPH_SS_BLSP1_BLSP_BAM_XPU_ESR_ADDR A:0xf99020c8
y.create.l HWIO_PERIPH_SS_BLSP1_BLSP_BAM_XPU_ESRRESTORE_ADDR A:0xf99020cc
y.create.l HWIO_PERIPH_SS_BLSP1_BLSP_BAM_XPU_ESYNR0_ADDR A:0xf99020d0
y.create.l HWIO_PERIPH_SS_BLSP1_BLSP_BAM_XPU_ESYNR1_ADDR A:0xf99020d4
y.create.l HWIO_PERIPH_SS_BLSP1_BLSP_BAM_XPU_ESYNR2_ADDR A:0xf99020d8
y.create.l HWIO_PERIPH_SS_BLSP1_BLSP_BAM_XPU_IDR0_ADDR A:0xf9902074
y.create.l HWIO_PERIPH_SS_BLSP1_BLSP_BAM_XPU_IDR1_ADDR A:0xf9902078
y.create.l HWIO_PERIPH_SS_BLSP1_BLSP_BAM_XPU_REV_ADDR A:0xf990207c
y.create.l HWIO_PERIPH_SS_BLSP1_BLSP_BAM_XPU_RG0_RACR0_ADDR A:0xf9902200
y.create.l HWIO_PERIPH_SS_BLSP1_BLSP_BAM_XPU_RG1_RACR0_ADDR A:0xf9902280
y.create.l HWIO_PERIPH_SS_BLSP1_BLSP_BAM_XPU_RG2_RACR0_ADDR A:0xf9902300
y.create.l HWIO_PERIPH_SS_BLSP1_BLSP_BAM_XPU_RG3_RACR0_ADDR A:0xf9902380
y.create.l HWIO_PERIPH_SS_BLSP1_BLSP_BAM_XPU_RG4_RACR0_ADDR A:0xf9902400
y.create.l HWIO_PERIPH_SS_BLSP1_BLSP_BAM_XPU_RG5_RACR0_ADDR A:0xf9902480
y.create.l HWIO_PERIPH_SS_BLSP1_BLSP_BAM_XPU_RG6_RACR0_ADDR A:0xf9902500
y.create.l HWIO_PERIPH_SS_BLSP1_BLSP_BAM_XPU_RG7_RACR0_ADDR A:0xf9902580
y.create.l HWIO_PERIPH_SS_BLSP1_BLSP_BAM_XPU_RG8_RACR0_ADDR A:0xf9902600
y.create.l HWIO_PERIPH_SS_BLSP1_BLSP_BAM_XPU_RG9_RACR0_ADDR A:0xf9902680
y.create.l HWIO_PERIPH_SS_BLSP1_BLSP_BAM_XPU_RG0_SCR_ADDR A:0xf9902250
y.create.l HWIO_PERIPH_SS_BLSP1_BLSP_BAM_XPU_RG1_SCR_ADDR A:0xf99022d0
y.create.l HWIO_PERIPH_SS_BLSP1_BLSP_BAM_XPU_RG2_SCR_ADDR A:0xf9902350
y.create.l HWIO_PERIPH_SS_BLSP1_BLSP_BAM_XPU_RG3_SCR_ADDR A:0xf99023d0
y.create.l HWIO_PERIPH_SS_BLSP1_BLSP_BAM_XPU_RG4_SCR_ADDR A:0xf9902450
y.create.l HWIO_PERIPH_SS_BLSP1_BLSP_BAM_XPU_RG5_SCR_ADDR A:0xf99024d0
y.create.l HWIO_PERIPH_SS_BLSP1_BLSP_BAM_XPU_RG6_SCR_ADDR A:0xf9902550
y.create.l HWIO_PERIPH_SS_BLSP1_BLSP_BAM_XPU_RG7_SCR_ADDR A:0xf99025d0
y.create.l HWIO_PERIPH_SS_BLSP1_BLSP_BAM_XPU_RG8_SCR_ADDR A:0xf9902650
y.create.l HWIO_PERIPH_SS_BLSP1_BLSP_BAM_XPU_RG9_SCR_ADDR A:0xf99026d0
y.create.l HWIO_PERIPH_SS_BLSP1_BLSP_BAM_XPU_RG0_MCR_ADDR A:0xf9902254
y.create.l HWIO_PERIPH_SS_BLSP1_BLSP_BAM_XPU_RG1_MCR_ADDR A:0xf99022d4
y.create.l HWIO_PERIPH_SS_BLSP1_BLSP_BAM_XPU_RG2_MCR_ADDR A:0xf9902354
y.create.l HWIO_PERIPH_SS_BLSP1_BLSP_BAM_XPU_RG3_MCR_ADDR A:0xf99023d4
y.create.l HWIO_PERIPH_SS_BLSP1_BLSP_BAM_XPU_RG4_MCR_ADDR A:0xf9902454
y.create.l HWIO_PERIPH_SS_BLSP1_BLSP_BAM_XPU_RG5_MCR_ADDR A:0xf99024d4
y.create.l HWIO_PERIPH_SS_BLSP1_BLSP_BAM_XPU_RG6_MCR_ADDR A:0xf9902554
y.create.l HWIO_PERIPH_SS_BLSP1_BLSP_BAM_XPU_RG7_MCR_ADDR A:0xf99025d4
y.create.l HWIO_PERIPH_SS_BLSP1_BLSP_BAM_XPU_RG8_MCR_ADDR A:0xf9902654
y.create.l HWIO_PERIPH_SS_BLSP1_BLSP_BAM_XPU_RG9_MCR_ADDR A:0xf99026d4
y.create.l HWIO_PERIPH_SS_BLSP1_BLSP_BAM_VMIDMT_SCR0_ADDR A:0xf9900000
y.create.l HWIO_PERIPH_SS_BLSP1_BLSP_BAM_VMIDMT_SCR1_ADDR A:0xf9900004
y.create.l HWIO_PERIPH_SS_BLSP1_BLSP_BAM_VMIDMT_SCR2_ADDR A:0xf9900008
y.create.l HWIO_PERIPH_SS_BLSP1_BLSP_BAM_VMIDMT_SACR_ADDR A:0xf9900010
y.create.l HWIO_PERIPH_SS_BLSP1_BLSP_BAM_VMIDMT_SIDR0_ADDR A:0xf9900020
y.create.l HWIO_PERIPH_SS_BLSP1_BLSP_BAM_VMIDMT_SIDR1_ADDR A:0xf9900024
y.create.l HWIO_PERIPH_SS_BLSP1_BLSP_BAM_VMIDMT_SIDR2_ADDR A:0xf9900028
y.create.l HWIO_PERIPH_SS_BLSP1_BLSP_BAM_VMIDMT_SIDR4_ADDR A:0xf9900030
y.create.l HWIO_PERIPH_SS_BLSP1_BLSP_BAM_VMIDMT_SIDR5_ADDR A:0xf9900034
y.create.l HWIO_PERIPH_SS_BLSP1_BLSP_BAM_VMIDMT_SIDR7_ADDR A:0xf990003c
y.create.l HWIO_PERIPH_SS_BLSP1_BLSP_BAM_VMIDMT_SGFAR0_ADDR A:0xf9900040
y.create.l HWIO_PERIPH_SS_BLSP1_BLSP_BAM_VMIDMT_SGFSR_ADDR A:0xf9900048
y.create.l HWIO_PERIPH_SS_BLSP1_BLSP_BAM_VMIDMT_SGFSRRESTORE_ADDR A:0xf990004c
y.create.l HWIO_PERIPH_SS_BLSP1_BLSP_BAM_VMIDMT_SGFSYNDR0_ADDR A:0xf9900050
y.create.l HWIO_PERIPH_SS_BLSP1_BLSP_BAM_VMIDMT_SGFSYNDR1_ADDR A:0xf9900054
y.create.l HWIO_PERIPH_SS_BLSP1_BLSP_BAM_VMIDMT_SGFSYNDR2_ADDR A:0xf9900058
y.create.l HWIO_PERIPH_SS_BLSP1_BLSP_BAM_VMIDMT_VMIDMTSCR0_ADDR A:0xf9900090
y.create.l HWIO_PERIPH_SS_BLSP1_BLSP_BAM_VMIDMT_CR0_ADDR A:0xf9900000
y.create.l HWIO_PERIPH_SS_BLSP1_BLSP_BAM_VMIDMT_CR2_ADDR A:0xf9900008
y.create.l HWIO_PERIPH_SS_BLSP1_BLSP_BAM_VMIDMT_ACR_ADDR A:0xf9900010
y.create.l HWIO_PERIPH_SS_BLSP1_BLSP_BAM_VMIDMT_IDR0_ADDR A:0xf9900020
y.create.l HWIO_PERIPH_SS_BLSP1_BLSP_BAM_VMIDMT_IDR1_ADDR A:0xf9900024
y.create.l HWIO_PERIPH_SS_BLSP1_BLSP_BAM_VMIDMT_IDR2_ADDR A:0xf9900028
y.create.l HWIO_PERIPH_SS_BLSP1_BLSP_BAM_VMIDMT_IDR4_ADDR A:0xf9900030
y.create.l HWIO_PERIPH_SS_BLSP1_BLSP_BAM_VMIDMT_IDR5_ADDR A:0xf9900034
y.create.l HWIO_PERIPH_SS_BLSP1_BLSP_BAM_VMIDMT_IDR7_ADDR A:0xf990003c
y.create.l HWIO_PERIPH_SS_BLSP1_BLSP_BAM_VMIDMT_GFAR0_ADDR A:0xf9900040
y.create.l HWIO_PERIPH_SS_BLSP1_BLSP_BAM_VMIDMT_GFSR_ADDR A:0xf9900048
y.create.l HWIO_PERIPH_SS_BLSP1_BLSP_BAM_VMIDMT_GFSRRESTORE_ADDR A:0xf990004c
y.create.l HWIO_PERIPH_SS_BLSP1_BLSP_BAM_VMIDMT_GFSYNDR0_ADDR A:0xf9900050
y.create.l HWIO_PERIPH_SS_BLSP1_BLSP_BAM_VMIDMT_GFSYNDR1_ADDR A:0xf9900054
y.create.l HWIO_PERIPH_SS_BLSP1_BLSP_BAM_VMIDMT_GFSYNDR2_ADDR A:0xf9900058
y.create.l HWIO_PERIPH_SS_BLSP1_BLSP_BAM_VMIDMT_VMIDMTCR0_ADDR A:0xf9900090
y.create.l HWIO_PERIPH_SS_BLSP1_BLSP_BAM_VMIDMT_VMIDMTACR_ADDR A:0xf990009c
y.create.l HWIO_PERIPH_SS_BLSP1_BLSP_BAM_VMIDMT_NSCR0_ADDR A:0xf9900400
y.create.l HWIO_PERIPH_SS_BLSP1_BLSP_BAM_VMIDMT_NSCR2_ADDR A:0xf9900408
y.create.l HWIO_PERIPH_SS_BLSP1_BLSP_BAM_VMIDMT_NSACR_ADDR A:0xf9900410
y.create.l HWIO_PERIPH_SS_BLSP1_BLSP_BAM_VMIDMT_NSGFAR0_ADDR A:0xf9900440
y.create.l HWIO_PERIPH_SS_BLSP1_BLSP_BAM_VMIDMT_NSGFSR_ADDR A:0xf9900448
y.create.l HWIO_PERIPH_SS_BLSP1_BLSP_BAM_VMIDMT_NSGFSRRESTORE_ADDR A:0xf990044c
y.create.l HWIO_PERIPH_SS_BLSP1_BLSP_BAM_VMIDMT_NSGFSYNDR0_ADDR A:0xf9900450
y.create.l HWIO_PERIPH_SS_BLSP1_BLSP_BAM_VMIDMT_NSGFSYNDR1_ADDR A:0xf9900454
y.create.l HWIO_PERIPH_SS_BLSP1_BLSP_BAM_VMIDMT_NSGFSYNDR2_ADDR A:0xf9900458
y.create.l HWIO_PERIPH_SS_BLSP1_BLSP_BAM_VMIDMT_NSVMIDMTCR0_ADDR A:0xf9900490
y.create.l HWIO_PERIPH_SS_BLSP1_BLSP_BAM_VMIDMT_SSDR0_ADDR A:0xf9900080
y.create.l HWIO_PERIPH_SS_BLSP1_BLSP_BAM_VMIDMT_MSDR0_ADDR A:0xf9900480
y.create.l HWIO_PERIPH_SS_BLSP1_BLSP_BAM_VMIDMT_MCR_ADDR A:0xf9900494
y.create.l HWIO_PERIPH_SS_BLSP1_BLSP_BAM_VMIDMT_S2VR0_ADDR A:0xf9900c00
y.create.l HWIO_PERIPH_SS_BLSP1_BLSP_BAM_VMIDMT_S2VR1_ADDR A:0xf9900c04
y.create.l HWIO_PERIPH_SS_BLSP1_BLSP_BAM_VMIDMT_S2VR2_ADDR A:0xf9900c08
y.create.l HWIO_PERIPH_SS_BLSP1_BLSP_BAM_VMIDMT_S2VR3_ADDR A:0xf9900c0c
y.create.l HWIO_PERIPH_SS_BLSP1_BLSP_BAM_VMIDMT_S2VR4_ADDR A:0xf9900c10
y.create.l HWIO_PERIPH_SS_BLSP1_BLSP_BAM_VMIDMT_S2VR5_ADDR A:0xf9900c14
y.create.l HWIO_PERIPH_SS_BLSP1_BLSP_BAM_VMIDMT_S2VR6_ADDR A:0xf9900c18
y.create.l HWIO_PERIPH_SS_BLSP1_BLSP_BAM_VMIDMT_S2VR7_ADDR A:0xf9900c1c
y.create.l HWIO_PERIPH_SS_BLSP1_BLSP_BAM_VMIDMT_S2VR8_ADDR A:0xf9900c20
y.create.l HWIO_PERIPH_SS_BLSP1_BLSP_BAM_VMIDMT_S2VR9_ADDR A:0xf9900c24
y.create.l HWIO_PERIPH_SS_BLSP1_BLSP_BAM_VMIDMT_AS2VR0_ADDR A:0xf9900e00
y.create.l HWIO_PERIPH_SS_BLSP1_BLSP_BAM_VMIDMT_AS2VR1_ADDR A:0xf9900e04
y.create.l HWIO_PERIPH_SS_BLSP1_BLSP_BAM_VMIDMT_AS2VR2_ADDR A:0xf9900e08
y.create.l HWIO_PERIPH_SS_BLSP1_BLSP_BAM_VMIDMT_AS2VR3_ADDR A:0xf9900e0c
y.create.l HWIO_PERIPH_SS_BLSP1_BLSP_BAM_VMIDMT_AS2VR4_ADDR A:0xf9900e10
y.create.l HWIO_PERIPH_SS_BLSP1_BLSP_BAM_VMIDMT_AS2VR5_ADDR A:0xf9900e14
y.create.l HWIO_PERIPH_SS_BLSP1_BLSP_BAM_VMIDMT_AS2VR6_ADDR A:0xf9900e18
y.create.l HWIO_PERIPH_SS_BLSP1_BLSP_BAM_VMIDMT_AS2VR7_ADDR A:0xf9900e1c
y.create.l HWIO_PERIPH_SS_BLSP1_BLSP_BAM_VMIDMT_AS2VR8_ADDR A:0xf9900e20
y.create.l HWIO_PERIPH_SS_BLSP1_BLSP_BAM_VMIDMT_AS2VR9_ADDR A:0xf9900e24
y.create.l HWIO_PERIPH_SS_BLSP1_BLSP_BAM_VMIDMT_SMR0_ADDR A:0xf9900800
y.create.l HWIO_PERIPH_SS_BLSP1_BLSP_BAM_VMIDMT_SMR1_ADDR A:0xf9900804
y.create.l HWIO_PERIPH_SS_BLSP1_BLSP_BAM_VMIDMT_SMR2_ADDR A:0xf9900808
y.create.l HWIO_PERIPH_SS_BLSP1_BLSP_BAM_VMIDMT_SMR3_ADDR A:0xf990080c
y.create.l HWIO_PERIPH_SS_BLSP1_BLSP_BAM_VMIDMT_SMR4_ADDR A:0xf9900810
y.create.l HWIO_PERIPH_SS_BLSP1_BLSP_BAM_VMIDMT_SMR5_ADDR A:0xf9900814
y.create.l HWIO_PERIPH_SS_BLSP1_BLSP_BAM_VMIDMT_SMR6_ADDR A:0xf9900818
y.create.l HWIO_PERIPH_SS_BLSP1_BLSP_BAM_VMIDMT_SMR7_ADDR A:0xf990081c
y.create.l HWIO_PERIPH_SS_BLSP1_BLSP_BAM_VMIDMT_SMR8_ADDR A:0xf9900820
y.create.l HWIO_PERIPH_SS_BLSP1_BLSP_BAM_VMIDMT_SMR9_ADDR A:0xf9900824
y.create.l HWIO_PERIPH_SS_BLSP1_BLSP_UART0_UART_DM_MR1_ADDR A:0xf991d000
y.create.l HWIO_PERIPH_SS_BLSP1_BLSP_UART0_UART_DM_MR2_ADDR A:0xf991d004
y.create.l HWIO_PERIPH_SS_BLSP1_BLSP_UART0_UART_DM_CSR_SR_DEPRECATED_ADDR A:0xf991d008
y.create.l HWIO_PERIPH_SS_BLSP1_BLSP_UART0_UART_DM_CR_MISR_DEPRECATED_ADDR A:0xf991d010
y.create.l HWIO_PERIPH_SS_BLSP1_BLSP_UART0_UART_DM_IMR_ISR_DEPRECATED_ADDR A:0xf991d014
y.create.l HWIO_PERIPH_SS_BLSP1_BLSP_UART0_UART_DM_IPR_ADDR A:0xf991d018
y.create.l HWIO_PERIPH_SS_BLSP1_BLSP_UART0_UART_DM_TFWR_ADDR A:0xf991d01c
y.create.l HWIO_PERIPH_SS_BLSP1_BLSP_UART0_UART_DM_RFWR_ADDR A:0xf991d020
y.create.l HWIO_PERIPH_SS_BLSP1_BLSP_UART0_UART_DM_HCR_ADDR A:0xf991d024
y.create.l HWIO_PERIPH_SS_BLSP1_BLSP_UART0_UART_DM_DMRX_ADDR A:0xf991d034
y.create.l HWIO_PERIPH_SS_BLSP1_BLSP_UART0_UART_DM_IRDA_RX_TOTAL_SNAP_DEPRECATED_ADDR A:0xf991d038
y.create.l HWIO_PERIPH_SS_BLSP1_BLSP_UART0_UART_DM_DMEN_ADDR A:0xf991d03c
y.create.l HWIO_PERIPH_SS_BLSP1_BLSP_UART0_UART_DM_NO_CHARS_FOR_TX_ADDR A:0xf991d040
y.create.l HWIO_PERIPH_SS_BLSP1_BLSP_UART0_UART_DM_BADR_ADDR A:0xf991d044
y.create.l HWIO_PERIPH_SS_BLSP1_BLSP_UART0_UART_DM_TESTSL_ADDR A:0xf991d048
y.create.l HWIO_PERIPH_SS_BLSP1_BLSP_UART0_UART_DM_TXFS_ADDR A:0xf991d04c
y.create.l HWIO_PERIPH_SS_BLSP1_BLSP_UART0_UART_DM_RXFS_ADDR A:0xf991d050
y.create.l HWIO_PERIPH_SS_BLSP1_BLSP_UART0_UART_DM_MISR_MODE_ADDR A:0xf991d060
y.create.l HWIO_PERIPH_SS_BLSP1_BLSP_UART0_UART_DM_MISR_RESET_ADDR A:0xf991d064
y.create.l HWIO_PERIPH_SS_BLSP1_BLSP_UART0_UART_DM_MISR_EXPORT_ADDR A:0xf991d068
y.create.l HWIO_PERIPH_SS_BLSP1_BLSP_UART0_UART_DM_MISR_VAL_ADDR A:0xf991d06c
y.create.l HWIO_PERIPH_SS_BLSP1_BLSP_UART0_UART_DM_TF_RF_DEPRECATED_ADDR A:0xf991d070
y.create.l HWIO_PERIPH_SS_BLSP1_BLSP_UART0_UART_DM_TF_RF_2_DEPRECATED_ADDR A:0xf991d074
y.create.l HWIO_PERIPH_SS_BLSP1_BLSP_UART0_UART_DM_TF_RF_3_DEPRECATED_ADDR A:0xf991d078
y.create.l HWIO_PERIPH_SS_BLSP1_BLSP_UART0_UART_DM_TF_RF_4_DEPRECATED_ADDR A:0xf991d07c
y.create.l HWIO_PERIPH_SS_BLSP1_BLSP_UART0_UART_DM_SIM_CFG_ADDR A:0xf991d080
y.create.l HWIO_PERIPH_SS_BLSP1_BLSP_UART0_UART_DM_TEST_WR_ADDR_ADDR A:0xf991d084
y.create.l HWIO_PERIPH_SS_BLSP1_BLSP_UART0_UART_DM_TEST_WR_DATA_ADDR A:0xf991d088
y.create.l HWIO_PERIPH_SS_BLSP1_BLSP_UART0_UART_DM_TEST_RD_ADDR_ADDR A:0xf991d08c
y.create.l HWIO_PERIPH_SS_BLSP1_BLSP_UART0_UART_DM_TEST_RD_DATA_ADDR A:0xf991d090
y.create.l HWIO_PERIPH_SS_BLSP1_BLSP_UART0_UART_DM_CSR_ADDR A:0xf991d0a0
y.create.l HWIO_PERIPH_SS_BLSP1_BLSP_UART0_UART_DM_SR_ADDR A:0xf991d0a4
y.create.l HWIO_PERIPH_SS_BLSP1_BLSP_UART0_UART_DM_CR_ADDR A:0xf991d0a8
y.create.l HWIO_PERIPH_SS_BLSP1_BLSP_UART0_UART_DM_MISR_ADDR A:0xf991d0ac
y.create.l HWIO_PERIPH_SS_BLSP1_BLSP_UART0_UART_DM_IMR_ADDR A:0xf991d0b0
y.create.l HWIO_PERIPH_SS_BLSP1_BLSP_UART0_UART_DM_ISR_ADDR A:0xf991d0b4
y.create.l HWIO_PERIPH_SS_BLSP1_BLSP_UART0_UART_DM_IRDA_ADDR A:0xf991d0b8
y.create.l HWIO_PERIPH_SS_BLSP1_BLSP_UART0_UART_DM_RX_TOTAL_SNAP_ADDR A:0xf991d0bc
y.create.l HWIO_PERIPH_SS_BLSP1_BLSP_UART0_UART_DM_WWT_TIMEOUT_ADDR A:0xf991d0c0
y.create.l HWIO_PERIPH_SS_BLSP1_BLSP_UART0_UART_DM_CLK_CTRL_ADDR A:0xf991d0c4
y.create.l HWIO_PERIPH_SS_BLSP1_BLSP_UART0_UART_DM_BCR_ADDR A:0xf991d0c8
y.create.l HWIO_PERIPH_SS_BLSP1_BLSP_UART0_UART_DM_RX_TRANS_CTRL_ADDR A:0xf991d0cc
y.create.l HWIO_PERIPH_SS_BLSP1_BLSP_UART0_UART_DM_DMRX_DBG_ADDR A:0xf991d0d0
y.create.l HWIO_PERIPH_SS_BLSP1_BLSP_UART0_UART_DM_FSM_STATUS_ADDR A:0xf991d0d4
y.create.l HWIO_PERIPH_SS_BLSP1_BLSP_UART0_UART_DM_HW_VERSION_ADDR A:0xf991d0d8
y.create.l HWIO_PERIPH_SS_BLSP1_BLSP_UART0_UART_DM_GENERICS_ADDR A:0xf991d0dc
y.create.l HWIO_PERIPH_SS_BLSP1_BLSP_UART0_UART_DM_TF_ADDR A:0xf991d100
y.create.l HWIO_PERIPH_SS_BLSP1_BLSP_UART0_UART_DM_TF_2_ADDR A:0xf991d104
y.create.l HWIO_PERIPH_SS_BLSP1_BLSP_UART0_UART_DM_TF_3_ADDR A:0xf991d108
y.create.l HWIO_PERIPH_SS_BLSP1_BLSP_UART0_UART_DM_TF_4_ADDR A:0xf991d10c
y.create.l HWIO_PERIPH_SS_BLSP1_BLSP_UART0_UART_DM_TF_5_ADDR A:0xf991d110
y.create.l HWIO_PERIPH_SS_BLSP1_BLSP_UART0_UART_DM_TF_6_ADDR A:0xf991d114
y.create.l HWIO_PERIPH_SS_BLSP1_BLSP_UART0_UART_DM_TF_7_ADDR A:0xf991d118
y.create.l HWIO_PERIPH_SS_BLSP1_BLSP_UART0_UART_DM_TF_8_ADDR A:0xf991d11c
y.create.l HWIO_PERIPH_SS_BLSP1_BLSP_UART0_UART_DM_TF_9_ADDR A:0xf991d120
y.create.l HWIO_PERIPH_SS_BLSP1_BLSP_UART0_UART_DM_TF_10_ADDR A:0xf991d124
y.create.l HWIO_PERIPH_SS_BLSP1_BLSP_UART0_UART_DM_TF_11_ADDR A:0xf991d128
y.create.l HWIO_PERIPH_SS_BLSP1_BLSP_UART0_UART_DM_TF_12_ADDR A:0xf991d12c
y.create.l HWIO_PERIPH_SS_BLSP1_BLSP_UART0_UART_DM_TF_13_ADDR A:0xf991d130
y.create.l HWIO_PERIPH_SS_BLSP1_BLSP_UART0_UART_DM_TF_14_ADDR A:0xf991d134
y.create.l HWIO_PERIPH_SS_BLSP1_BLSP_UART0_UART_DM_TF_15_ADDR A:0xf991d138
y.create.l HWIO_PERIPH_SS_BLSP1_BLSP_UART0_UART_DM_TF_16_ADDR A:0xf991d13c
y.create.l HWIO_PERIPH_SS_BLSP1_BLSP_UART0_UART_DM_RF_ADDR A:0xf991d140
y.create.l HWIO_PERIPH_SS_BLSP1_BLSP_UART0_UART_DM_RF_2_ADDR A:0xf991d144
y.create.l HWIO_PERIPH_SS_BLSP1_BLSP_UART0_UART_DM_RF_3_ADDR A:0xf991d148
y.create.l HWIO_PERIPH_SS_BLSP1_BLSP_UART0_UART_DM_RF_4_ADDR A:0xf991d14c
y.create.l HWIO_PERIPH_SS_BLSP1_BLSP_UART0_UART_DM_RF_5_ADDR A:0xf991d150
y.create.l HWIO_PERIPH_SS_BLSP1_BLSP_UART0_UART_DM_RF_6_ADDR A:0xf991d154
y.create.l HWIO_PERIPH_SS_BLSP1_BLSP_UART0_UART_DM_RF_7_ADDR A:0xf991d158
y.create.l HWIO_PERIPH_SS_BLSP1_BLSP_UART0_UART_DM_RF_8_ADDR A:0xf991d15c
y.create.l HWIO_PERIPH_SS_BLSP1_BLSP_UART0_UART_DM_RF_9_ADDR A:0xf991d160
y.create.l HWIO_PERIPH_SS_BLSP1_BLSP_UART0_UART_DM_RF_10_ADDR A:0xf991d164
y.create.l HWIO_PERIPH_SS_BLSP1_BLSP_UART0_UART_DM_RF_11_ADDR A:0xf991d168
y.create.l HWIO_PERIPH_SS_BLSP1_BLSP_UART0_UART_DM_RF_12_ADDR A:0xf991d16c
y.create.l HWIO_PERIPH_SS_BLSP1_BLSP_UART0_UART_DM_RF_13_ADDR A:0xf991d170
y.create.l HWIO_PERIPH_SS_BLSP1_BLSP_UART0_UART_DM_RF_14_ADDR A:0xf991d174
y.create.l HWIO_PERIPH_SS_BLSP1_BLSP_UART0_UART_DM_RF_15_ADDR A:0xf991d178
y.create.l HWIO_PERIPH_SS_BLSP1_BLSP_UART0_UART_DM_RF_16_ADDR A:0xf991d17c
y.create.l HWIO_PERIPH_SS_BLSP1_BLSP_UART0_UART_DM_UIM_CFG_ADDR A:0xf991d180
y.create.l HWIO_PERIPH_SS_BLSP1_BLSP_UART0_UART_DM_UIM_CMD_ADDR A:0xf991d184
y.create.l HWIO_PERIPH_SS_BLSP1_BLSP_UART0_UART_DM_UIM_IO_STATUS_ADDR A:0xf991d188
y.create.l HWIO_PERIPH_SS_BLSP1_BLSP_UART0_UART_DM_UIM_IRQ_ISR_ADDR A:0xf991d18c
y.create.l HWIO_PERIPH_SS_BLSP1_BLSP_UART0_UART_DM_UIM_IRQ_MISR_ADDR A:0xf991d190
y.create.l HWIO_PERIPH_SS_BLSP1_BLSP_UART0_UART_DM_UIM_IRQ_CLR_ADDR A:0xf991d194
y.create.l HWIO_PERIPH_SS_BLSP1_BLSP_UART0_UART_DM_UIM_IRQ_IMR_ADDR A:0xf991d198
y.create.l HWIO_PERIPH_SS_BLSP1_BLSP_UART0_UART_DM_UIM_IRQ_IMR_SET_ADDR A:0xf991d19c
y.create.l HWIO_PERIPH_SS_BLSP1_BLSP_UART0_UART_DM_UIM_IRQ_IMR_CLR_ADDR A:0xf991d1a0
y.create.l HWIO_PERIPH_SS_BLSP1_BLSP_UART1_UART_DM_MR1_ADDR A:0xf991e000
y.create.l HWIO_PERIPH_SS_BLSP1_BLSP_UART1_UART_DM_MR2_ADDR A:0xf991e004
y.create.l HWIO_PERIPH_SS_BLSP1_BLSP_UART1_UART_DM_CSR_SR_DEPRECATED_ADDR A:0xf991e008
y.create.l HWIO_PERIPH_SS_BLSP1_BLSP_UART1_UART_DM_CR_MISR_DEPRECATED_ADDR A:0xf991e010
y.create.l HWIO_PERIPH_SS_BLSP1_BLSP_UART1_UART_DM_IMR_ISR_DEPRECATED_ADDR A:0xf991e014
y.create.l HWIO_PERIPH_SS_BLSP1_BLSP_UART1_UART_DM_IPR_ADDR A:0xf991e018
y.create.l HWIO_PERIPH_SS_BLSP1_BLSP_UART1_UART_DM_TFWR_ADDR A:0xf991e01c
y.create.l HWIO_PERIPH_SS_BLSP1_BLSP_UART1_UART_DM_RFWR_ADDR A:0xf991e020
y.create.l HWIO_PERIPH_SS_BLSP1_BLSP_UART1_UART_DM_HCR_ADDR A:0xf991e024
y.create.l HWIO_PERIPH_SS_BLSP1_BLSP_UART1_UART_DM_DMRX_ADDR A:0xf991e034
y.create.l HWIO_PERIPH_SS_BLSP1_BLSP_UART1_UART_DM_IRDA_RX_TOTAL_SNAP_DEPRECATED_ADDR A:0xf991e038
y.create.l HWIO_PERIPH_SS_BLSP1_BLSP_UART1_UART_DM_DMEN_ADDR A:0xf991e03c
y.create.l HWIO_PERIPH_SS_BLSP1_BLSP_UART1_UART_DM_NO_CHARS_FOR_TX_ADDR A:0xf991e040
y.create.l HWIO_PERIPH_SS_BLSP1_BLSP_UART1_UART_DM_BADR_ADDR A:0xf991e044
y.create.l HWIO_PERIPH_SS_BLSP1_BLSP_UART1_UART_DM_TESTSL_ADDR A:0xf991e048
y.create.l HWIO_PERIPH_SS_BLSP1_BLSP_UART1_UART_DM_TXFS_ADDR A:0xf991e04c
y.create.l HWIO_PERIPH_SS_BLSP1_BLSP_UART1_UART_DM_RXFS_ADDR A:0xf991e050
y.create.l HWIO_PERIPH_SS_BLSP1_BLSP_UART1_UART_DM_MISR_MODE_ADDR A:0xf991e060
y.create.l HWIO_PERIPH_SS_BLSP1_BLSP_UART1_UART_DM_MISR_RESET_ADDR A:0xf991e064
y.create.l HWIO_PERIPH_SS_BLSP1_BLSP_UART1_UART_DM_MISR_EXPORT_ADDR A:0xf991e068
y.create.l HWIO_PERIPH_SS_BLSP1_BLSP_UART1_UART_DM_MISR_VAL_ADDR A:0xf991e06c
y.create.l HWIO_PERIPH_SS_BLSP1_BLSP_UART1_UART_DM_TF_RF_DEPRECATED_ADDR A:0xf991e070
y.create.l HWIO_PERIPH_SS_BLSP1_BLSP_UART1_UART_DM_TF_RF_2_DEPRECATED_ADDR A:0xf991e074
y.create.l HWIO_PERIPH_SS_BLSP1_BLSP_UART1_UART_DM_TF_RF_3_DEPRECATED_ADDR A:0xf991e078
y.create.l HWIO_PERIPH_SS_BLSP1_BLSP_UART1_UART_DM_TF_RF_4_DEPRECATED_ADDR A:0xf991e07c
y.create.l HWIO_PERIPH_SS_BLSP1_BLSP_UART1_UART_DM_SIM_CFG_ADDR A:0xf991e080
y.create.l HWIO_PERIPH_SS_BLSP1_BLSP_UART1_UART_DM_TEST_WR_ADDR_ADDR A:0xf991e084
y.create.l HWIO_PERIPH_SS_BLSP1_BLSP_UART1_UART_DM_TEST_WR_DATA_ADDR A:0xf991e088
y.create.l HWIO_PERIPH_SS_BLSP1_BLSP_UART1_UART_DM_TEST_RD_ADDR_ADDR A:0xf991e08c
y.create.l HWIO_PERIPH_SS_BLSP1_BLSP_UART1_UART_DM_TEST_RD_DATA_ADDR A:0xf991e090
y.create.l HWIO_PERIPH_SS_BLSP1_BLSP_UART1_UART_DM_CSR_ADDR A:0xf991e0a0
y.create.l HWIO_PERIPH_SS_BLSP1_BLSP_UART1_UART_DM_SR_ADDR A:0xf991e0a4
y.create.l HWIO_PERIPH_SS_BLSP1_BLSP_UART1_UART_DM_CR_ADDR A:0xf991e0a8
y.create.l HWIO_PERIPH_SS_BLSP1_BLSP_UART1_UART_DM_MISR_ADDR A:0xf991e0ac
y.create.l HWIO_PERIPH_SS_BLSP1_BLSP_UART1_UART_DM_IMR_ADDR A:0xf991e0b0
y.create.l HWIO_PERIPH_SS_BLSP1_BLSP_UART1_UART_DM_ISR_ADDR A:0xf991e0b4
y.create.l HWIO_PERIPH_SS_BLSP1_BLSP_UART1_UART_DM_IRDA_ADDR A:0xf991e0b8
y.create.l HWIO_PERIPH_SS_BLSP1_BLSP_UART1_UART_DM_RX_TOTAL_SNAP_ADDR A:0xf991e0bc
y.create.l HWIO_PERIPH_SS_BLSP1_BLSP_UART1_UART_DM_WWT_TIMEOUT_ADDR A:0xf991e0c0
y.create.l HWIO_PERIPH_SS_BLSP1_BLSP_UART1_UART_DM_CLK_CTRL_ADDR A:0xf991e0c4
y.create.l HWIO_PERIPH_SS_BLSP1_BLSP_UART1_UART_DM_BCR_ADDR A:0xf991e0c8
y.create.l HWIO_PERIPH_SS_BLSP1_BLSP_UART1_UART_DM_RX_TRANS_CTRL_ADDR A:0xf991e0cc
y.create.l HWIO_PERIPH_SS_BLSP1_BLSP_UART1_UART_DM_DMRX_DBG_ADDR A:0xf991e0d0
y.create.l HWIO_PERIPH_SS_BLSP1_BLSP_UART1_UART_DM_FSM_STATUS_ADDR A:0xf991e0d4
y.create.l HWIO_PERIPH_SS_BLSP1_BLSP_UART1_UART_DM_HW_VERSION_ADDR A:0xf991e0d8
y.create.l HWIO_PERIPH_SS_BLSP1_BLSP_UART1_UART_DM_GENERICS_ADDR A:0xf991e0dc
y.create.l HWIO_PERIPH_SS_BLSP1_BLSP_UART1_UART_DM_TF_ADDR A:0xf991e100
y.create.l HWIO_PERIPH_SS_BLSP1_BLSP_UART1_UART_DM_TF_2_ADDR A:0xf991e104
y.create.l HWIO_PERIPH_SS_BLSP1_BLSP_UART1_UART_DM_TF_3_ADDR A:0xf991e108
y.create.l HWIO_PERIPH_SS_BLSP1_BLSP_UART1_UART_DM_TF_4_ADDR A:0xf991e10c
y.create.l HWIO_PERIPH_SS_BLSP1_BLSP_UART1_UART_DM_TF_5_ADDR A:0xf991e110
y.create.l HWIO_PERIPH_SS_BLSP1_BLSP_UART1_UART_DM_TF_6_ADDR A:0xf991e114
y.create.l HWIO_PERIPH_SS_BLSP1_BLSP_UART1_UART_DM_TF_7_ADDR A:0xf991e118
y.create.l HWIO_PERIPH_SS_BLSP1_BLSP_UART1_UART_DM_TF_8_ADDR A:0xf991e11c
y.create.l HWIO_PERIPH_SS_BLSP1_BLSP_UART1_UART_DM_TF_9_ADDR A:0xf991e120
y.create.l HWIO_PERIPH_SS_BLSP1_BLSP_UART1_UART_DM_TF_10_ADDR A:0xf991e124
y.create.l HWIO_PERIPH_SS_BLSP1_BLSP_UART1_UART_DM_TF_11_ADDR A:0xf991e128
y.create.l HWIO_PERIPH_SS_BLSP1_BLSP_UART1_UART_DM_TF_12_ADDR A:0xf991e12c
y.create.l HWIO_PERIPH_SS_BLSP1_BLSP_UART1_UART_DM_TF_13_ADDR A:0xf991e130
y.create.l HWIO_PERIPH_SS_BLSP1_BLSP_UART1_UART_DM_TF_14_ADDR A:0xf991e134
y.create.l HWIO_PERIPH_SS_BLSP1_BLSP_UART1_UART_DM_TF_15_ADDR A:0xf991e138
y.create.l HWIO_PERIPH_SS_BLSP1_BLSP_UART1_UART_DM_TF_16_ADDR A:0xf991e13c
y.create.l HWIO_PERIPH_SS_BLSP1_BLSP_UART1_UART_DM_RF_ADDR A:0xf991e140
y.create.l HWIO_PERIPH_SS_BLSP1_BLSP_UART1_UART_DM_RF_2_ADDR A:0xf991e144
y.create.l HWIO_PERIPH_SS_BLSP1_BLSP_UART1_UART_DM_RF_3_ADDR A:0xf991e148
y.create.l HWIO_PERIPH_SS_BLSP1_BLSP_UART1_UART_DM_RF_4_ADDR A:0xf991e14c
y.create.l HWIO_PERIPH_SS_BLSP1_BLSP_UART1_UART_DM_RF_5_ADDR A:0xf991e150
y.create.l HWIO_PERIPH_SS_BLSP1_BLSP_UART1_UART_DM_RF_6_ADDR A:0xf991e154
y.create.l HWIO_PERIPH_SS_BLSP1_BLSP_UART1_UART_DM_RF_7_ADDR A:0xf991e158
y.create.l HWIO_PERIPH_SS_BLSP1_BLSP_UART1_UART_DM_RF_8_ADDR A:0xf991e15c
y.create.l HWIO_PERIPH_SS_BLSP1_BLSP_UART1_UART_DM_RF_9_ADDR A:0xf991e160
y.create.l HWIO_PERIPH_SS_BLSP1_BLSP_UART1_UART_DM_RF_10_ADDR A:0xf991e164
y.create.l HWIO_PERIPH_SS_BLSP1_BLSP_UART1_UART_DM_RF_11_ADDR A:0xf991e168
y.create.l HWIO_PERIPH_SS_BLSP1_BLSP_UART1_UART_DM_RF_12_ADDR A:0xf991e16c
y.create.l HWIO_PERIPH_SS_BLSP1_BLSP_UART1_UART_DM_RF_13_ADDR A:0xf991e170
y.create.l HWIO_PERIPH_SS_BLSP1_BLSP_UART1_UART_DM_RF_14_ADDR A:0xf991e174
y.create.l HWIO_PERIPH_SS_BLSP1_BLSP_UART1_UART_DM_RF_15_ADDR A:0xf991e178
y.create.l HWIO_PERIPH_SS_BLSP1_BLSP_UART1_UART_DM_RF_16_ADDR A:0xf991e17c
y.create.l HWIO_PERIPH_SS_BLSP1_BLSP_UART1_UART_DM_UIM_CFG_ADDR A:0xf991e180
y.create.l HWIO_PERIPH_SS_BLSP1_BLSP_UART1_UART_DM_UIM_CMD_ADDR A:0xf991e184
y.create.l HWIO_PERIPH_SS_BLSP1_BLSP_UART1_UART_DM_UIM_IO_STATUS_ADDR A:0xf991e188
y.create.l HWIO_PERIPH_SS_BLSP1_BLSP_UART1_UART_DM_UIM_IRQ_ISR_ADDR A:0xf991e18c
y.create.l HWIO_PERIPH_SS_BLSP1_BLSP_UART1_UART_DM_UIM_IRQ_MISR_ADDR A:0xf991e190
y.create.l HWIO_PERIPH_SS_BLSP1_BLSP_UART1_UART_DM_UIM_IRQ_CLR_ADDR A:0xf991e194
y.create.l HWIO_PERIPH_SS_BLSP1_BLSP_UART1_UART_DM_UIM_IRQ_IMR_ADDR A:0xf991e198
y.create.l HWIO_PERIPH_SS_BLSP1_BLSP_UART1_UART_DM_UIM_IRQ_IMR_SET_ADDR A:0xf991e19c
y.create.l HWIO_PERIPH_SS_BLSP1_BLSP_UART1_UART_DM_UIM_IRQ_IMR_CLR_ADDR A:0xf991e1a0
y.create.l HWIO_PERIPH_SS_BLSP1_BLSP_UART2_UART_DM_MR1_ADDR A:0xf991f000
y.create.l HWIO_PERIPH_SS_BLSP1_BLSP_UART2_UART_DM_MR2_ADDR A:0xf991f004
y.create.l HWIO_PERIPH_SS_BLSP1_BLSP_UART2_UART_DM_CSR_SR_DEPRECATED_ADDR A:0xf991f008
y.create.l HWIO_PERIPH_SS_BLSP1_BLSP_UART2_UART_DM_CR_MISR_DEPRECATED_ADDR A:0xf991f010
y.create.l HWIO_PERIPH_SS_BLSP1_BLSP_UART2_UART_DM_IMR_ISR_DEPRECATED_ADDR A:0xf991f014
y.create.l HWIO_PERIPH_SS_BLSP1_BLSP_UART2_UART_DM_IPR_ADDR A:0xf991f018
y.create.l HWIO_PERIPH_SS_BLSP1_BLSP_UART2_UART_DM_TFWR_ADDR A:0xf991f01c
y.create.l HWIO_PERIPH_SS_BLSP1_BLSP_UART2_UART_DM_RFWR_ADDR A:0xf991f020
y.create.l HWIO_PERIPH_SS_BLSP1_BLSP_UART2_UART_DM_HCR_ADDR A:0xf991f024
y.create.l HWIO_PERIPH_SS_BLSP1_BLSP_UART2_UART_DM_DMRX_ADDR A:0xf991f034
y.create.l HWIO_PERIPH_SS_BLSP1_BLSP_UART2_UART_DM_IRDA_RX_TOTAL_SNAP_DEPRECATED_ADDR A:0xf991f038
y.create.l HWIO_PERIPH_SS_BLSP1_BLSP_UART2_UART_DM_DMEN_ADDR A:0xf991f03c
y.create.l HWIO_PERIPH_SS_BLSP1_BLSP_UART2_UART_DM_NO_CHARS_FOR_TX_ADDR A:0xf991f040
y.create.l HWIO_PERIPH_SS_BLSP1_BLSP_UART2_UART_DM_BADR_ADDR A:0xf991f044
y.create.l HWIO_PERIPH_SS_BLSP1_BLSP_UART2_UART_DM_TESTSL_ADDR A:0xf991f048
y.create.l HWIO_PERIPH_SS_BLSP1_BLSP_UART2_UART_DM_TXFS_ADDR A:0xf991f04c
y.create.l HWIO_PERIPH_SS_BLSP1_BLSP_UART2_UART_DM_RXFS_ADDR A:0xf991f050
y.create.l HWIO_PERIPH_SS_BLSP1_BLSP_UART2_UART_DM_MISR_MODE_ADDR A:0xf991f060
y.create.l HWIO_PERIPH_SS_BLSP1_BLSP_UART2_UART_DM_MISR_RESET_ADDR A:0xf991f064
y.create.l HWIO_PERIPH_SS_BLSP1_BLSP_UART2_UART_DM_MISR_EXPORT_ADDR A:0xf991f068
y.create.l HWIO_PERIPH_SS_BLSP1_BLSP_UART2_UART_DM_MISR_VAL_ADDR A:0xf991f06c
y.create.l HWIO_PERIPH_SS_BLSP1_BLSP_UART2_UART_DM_TF_RF_DEPRECATED_ADDR A:0xf991f070
y.create.l HWIO_PERIPH_SS_BLSP1_BLSP_UART2_UART_DM_TF_RF_2_DEPRECATED_ADDR A:0xf991f074
y.create.l HWIO_PERIPH_SS_BLSP1_BLSP_UART2_UART_DM_TF_RF_3_DEPRECATED_ADDR A:0xf991f078
y.create.l HWIO_PERIPH_SS_BLSP1_BLSP_UART2_UART_DM_TF_RF_4_DEPRECATED_ADDR A:0xf991f07c
y.create.l HWIO_PERIPH_SS_BLSP1_BLSP_UART2_UART_DM_SIM_CFG_ADDR A:0xf991f080
y.create.l HWIO_PERIPH_SS_BLSP1_BLSP_UART2_UART_DM_TEST_WR_ADDR_ADDR A:0xf991f084
y.create.l HWIO_PERIPH_SS_BLSP1_BLSP_UART2_UART_DM_TEST_WR_DATA_ADDR A:0xf991f088
y.create.l HWIO_PERIPH_SS_BLSP1_BLSP_UART2_UART_DM_TEST_RD_ADDR_ADDR A:0xf991f08c
y.create.l HWIO_PERIPH_SS_BLSP1_BLSP_UART2_UART_DM_TEST_RD_DATA_ADDR A:0xf991f090
y.create.l HWIO_PERIPH_SS_BLSP1_BLSP_UART2_UART_DM_CSR_ADDR A:0xf991f0a0
y.create.l HWIO_PERIPH_SS_BLSP1_BLSP_UART2_UART_DM_SR_ADDR A:0xf991f0a4
y.create.l HWIO_PERIPH_SS_BLSP1_BLSP_UART2_UART_DM_CR_ADDR A:0xf991f0a8
y.create.l HWIO_PERIPH_SS_BLSP1_BLSP_UART2_UART_DM_MISR_ADDR A:0xf991f0ac
y.create.l HWIO_PERIPH_SS_BLSP1_BLSP_UART2_UART_DM_IMR_ADDR A:0xf991f0b0
y.create.l HWIO_PERIPH_SS_BLSP1_BLSP_UART2_UART_DM_ISR_ADDR A:0xf991f0b4
y.create.l HWIO_PERIPH_SS_BLSP1_BLSP_UART2_UART_DM_IRDA_ADDR A:0xf991f0b8
y.create.l HWIO_PERIPH_SS_BLSP1_BLSP_UART2_UART_DM_RX_TOTAL_SNAP_ADDR A:0xf991f0bc
y.create.l HWIO_PERIPH_SS_BLSP1_BLSP_UART2_UART_DM_WWT_TIMEOUT_ADDR A:0xf991f0c0
y.create.l HWIO_PERIPH_SS_BLSP1_BLSP_UART2_UART_DM_CLK_CTRL_ADDR A:0xf991f0c4
y.create.l HWIO_PERIPH_SS_BLSP1_BLSP_UART2_UART_DM_BCR_ADDR A:0xf991f0c8
y.create.l HWIO_PERIPH_SS_BLSP1_BLSP_UART2_UART_DM_RX_TRANS_CTRL_ADDR A:0xf991f0cc
y.create.l HWIO_PERIPH_SS_BLSP1_BLSP_UART2_UART_DM_DMRX_DBG_ADDR A:0xf991f0d0
y.create.l HWIO_PERIPH_SS_BLSP1_BLSP_UART2_UART_DM_FSM_STATUS_ADDR A:0xf991f0d4
y.create.l HWIO_PERIPH_SS_BLSP1_BLSP_UART2_UART_DM_HW_VERSION_ADDR A:0xf991f0d8
y.create.l HWIO_PERIPH_SS_BLSP1_BLSP_UART2_UART_DM_GENERICS_ADDR A:0xf991f0dc
y.create.l HWIO_PERIPH_SS_BLSP1_BLSP_UART2_UART_DM_TF_ADDR A:0xf991f100
y.create.l HWIO_PERIPH_SS_BLSP1_BLSP_UART2_UART_DM_TF_2_ADDR A:0xf991f104
y.create.l HWIO_PERIPH_SS_BLSP1_BLSP_UART2_UART_DM_TF_3_ADDR A:0xf991f108
y.create.l HWIO_PERIPH_SS_BLSP1_BLSP_UART2_UART_DM_TF_4_ADDR A:0xf991f10c
y.create.l HWIO_PERIPH_SS_BLSP1_BLSP_UART2_UART_DM_TF_5_ADDR A:0xf991f110
y.create.l HWIO_PERIPH_SS_BLSP1_BLSP_UART2_UART_DM_TF_6_ADDR A:0xf991f114
y.create.l HWIO_PERIPH_SS_BLSP1_BLSP_UART2_UART_DM_TF_7_ADDR A:0xf991f118
y.create.l HWIO_PERIPH_SS_BLSP1_BLSP_UART2_UART_DM_TF_8_ADDR A:0xf991f11c
y.create.l HWIO_PERIPH_SS_BLSP1_BLSP_UART2_UART_DM_TF_9_ADDR A:0xf991f120
y.create.l HWIO_PERIPH_SS_BLSP1_BLSP_UART2_UART_DM_TF_10_ADDR A:0xf991f124
y.create.l HWIO_PERIPH_SS_BLSP1_BLSP_UART2_UART_DM_TF_11_ADDR A:0xf991f128
y.create.l HWIO_PERIPH_SS_BLSP1_BLSP_UART2_UART_DM_TF_12_ADDR A:0xf991f12c
y.create.l HWIO_PERIPH_SS_BLSP1_BLSP_UART2_UART_DM_TF_13_ADDR A:0xf991f130
y.create.l HWIO_PERIPH_SS_BLSP1_BLSP_UART2_UART_DM_TF_14_ADDR A:0xf991f134
y.create.l HWIO_PERIPH_SS_BLSP1_BLSP_UART2_UART_DM_TF_15_ADDR A:0xf991f138
y.create.l HWIO_PERIPH_SS_BLSP1_BLSP_UART2_UART_DM_TF_16_ADDR A:0xf991f13c
y.create.l HWIO_PERIPH_SS_BLSP1_BLSP_UART2_UART_DM_RF_ADDR A:0xf991f140
y.create.l HWIO_PERIPH_SS_BLSP1_BLSP_UART2_UART_DM_RF_2_ADDR A:0xf991f144
y.create.l HWIO_PERIPH_SS_BLSP1_BLSP_UART2_UART_DM_RF_3_ADDR A:0xf991f148
y.create.l HWIO_PERIPH_SS_BLSP1_BLSP_UART2_UART_DM_RF_4_ADDR A:0xf991f14c
y.create.l HWIO_PERIPH_SS_BLSP1_BLSP_UART2_UART_DM_RF_5_ADDR A:0xf991f150
y.create.l HWIO_PERIPH_SS_BLSP1_BLSP_UART2_UART_DM_RF_6_ADDR A:0xf991f154
y.create.l HWIO_PERIPH_SS_BLSP1_BLSP_UART2_UART_DM_RF_7_ADDR A:0xf991f158
y.create.l HWIO_PERIPH_SS_BLSP1_BLSP_UART2_UART_DM_RF_8_ADDR A:0xf991f15c
y.create.l HWIO_PERIPH_SS_BLSP1_BLSP_UART2_UART_DM_RF_9_ADDR A:0xf991f160
y.create.l HWIO_PERIPH_SS_BLSP1_BLSP_UART2_UART_DM_RF_10_ADDR A:0xf991f164
y.create.l HWIO_PERIPH_SS_BLSP1_BLSP_UART2_UART_DM_RF_11_ADDR A:0xf991f168
y.create.l HWIO_PERIPH_SS_BLSP1_BLSP_UART2_UART_DM_RF_12_ADDR A:0xf991f16c
y.create.l HWIO_PERIPH_SS_BLSP1_BLSP_UART2_UART_DM_RF_13_ADDR A:0xf991f170
y.create.l HWIO_PERIPH_SS_BLSP1_BLSP_UART2_UART_DM_RF_14_ADDR A:0xf991f174
y.create.l HWIO_PERIPH_SS_BLSP1_BLSP_UART2_UART_DM_RF_15_ADDR A:0xf991f178
y.create.l HWIO_PERIPH_SS_BLSP1_BLSP_UART2_UART_DM_RF_16_ADDR A:0xf991f17c
y.create.l HWIO_PERIPH_SS_BLSP1_BLSP_UART2_UART_DM_UIM_CFG_ADDR A:0xf991f180
y.create.l HWIO_PERIPH_SS_BLSP1_BLSP_UART2_UART_DM_UIM_CMD_ADDR A:0xf991f184
y.create.l HWIO_PERIPH_SS_BLSP1_BLSP_UART2_UART_DM_UIM_IO_STATUS_ADDR A:0xf991f188
y.create.l HWIO_PERIPH_SS_BLSP1_BLSP_UART2_UART_DM_UIM_IRQ_ISR_ADDR A:0xf991f18c
y.create.l HWIO_PERIPH_SS_BLSP1_BLSP_UART2_UART_DM_UIM_IRQ_MISR_ADDR A:0xf991f190
y.create.l HWIO_PERIPH_SS_BLSP1_BLSP_UART2_UART_DM_UIM_IRQ_CLR_ADDR A:0xf991f194
y.create.l HWIO_PERIPH_SS_BLSP1_BLSP_UART2_UART_DM_UIM_IRQ_IMR_ADDR A:0xf991f198
y.create.l HWIO_PERIPH_SS_BLSP1_BLSP_UART2_UART_DM_UIM_IRQ_IMR_SET_ADDR A:0xf991f19c
y.create.l HWIO_PERIPH_SS_BLSP1_BLSP_UART2_UART_DM_UIM_IRQ_IMR_CLR_ADDR A:0xf991f1a0
y.create.l HWIO_PERIPH_SS_BLSP1_BLSP_UART3_UART_DM_MR1_ADDR A:0xf9920000
y.create.l HWIO_PERIPH_SS_BLSP1_BLSP_UART3_UART_DM_MR2_ADDR A:0xf9920004
y.create.l HWIO_PERIPH_SS_BLSP1_BLSP_UART3_UART_DM_CSR_SR_DEPRECATED_ADDR A:0xf9920008
y.create.l HWIO_PERIPH_SS_BLSP1_BLSP_UART3_UART_DM_CR_MISR_DEPRECATED_ADDR A:0xf9920010
y.create.l HWIO_PERIPH_SS_BLSP1_BLSP_UART3_UART_DM_IMR_ISR_DEPRECATED_ADDR A:0xf9920014
y.create.l HWIO_PERIPH_SS_BLSP1_BLSP_UART3_UART_DM_IPR_ADDR A:0xf9920018
y.create.l HWIO_PERIPH_SS_BLSP1_BLSP_UART3_UART_DM_TFWR_ADDR A:0xf992001c
y.create.l HWIO_PERIPH_SS_BLSP1_BLSP_UART3_UART_DM_RFWR_ADDR A:0xf9920020
y.create.l HWIO_PERIPH_SS_BLSP1_BLSP_UART3_UART_DM_HCR_ADDR A:0xf9920024
y.create.l HWIO_PERIPH_SS_BLSP1_BLSP_UART3_UART_DM_DMRX_ADDR A:0xf9920034
y.create.l HWIO_PERIPH_SS_BLSP1_BLSP_UART3_UART_DM_IRDA_RX_TOTAL_SNAP_DEPRECATED_ADDR A:0xf9920038
y.create.l HWIO_PERIPH_SS_BLSP1_BLSP_UART3_UART_DM_DMEN_ADDR A:0xf992003c
y.create.l HWIO_PERIPH_SS_BLSP1_BLSP_UART3_UART_DM_NO_CHARS_FOR_TX_ADDR A:0xf9920040
y.create.l HWIO_PERIPH_SS_BLSP1_BLSP_UART3_UART_DM_BADR_ADDR A:0xf9920044
y.create.l HWIO_PERIPH_SS_BLSP1_BLSP_UART3_UART_DM_TESTSL_ADDR A:0xf9920048
y.create.l HWIO_PERIPH_SS_BLSP1_BLSP_UART3_UART_DM_TXFS_ADDR A:0xf992004c
y.create.l HWIO_PERIPH_SS_BLSP1_BLSP_UART3_UART_DM_RXFS_ADDR A:0xf9920050
y.create.l HWIO_PERIPH_SS_BLSP1_BLSP_UART3_UART_DM_MISR_MODE_ADDR A:0xf9920060
y.create.l HWIO_PERIPH_SS_BLSP1_BLSP_UART3_UART_DM_MISR_RESET_ADDR A:0xf9920064
y.create.l HWIO_PERIPH_SS_BLSP1_BLSP_UART3_UART_DM_MISR_EXPORT_ADDR A:0xf9920068
y.create.l HWIO_PERIPH_SS_BLSP1_BLSP_UART3_UART_DM_MISR_VAL_ADDR A:0xf992006c
y.create.l HWIO_PERIPH_SS_BLSP1_BLSP_UART3_UART_DM_TF_RF_DEPRECATED_ADDR A:0xf9920070
y.create.l HWIO_PERIPH_SS_BLSP1_BLSP_UART3_UART_DM_TF_RF_2_DEPRECATED_ADDR A:0xf9920074
y.create.l HWIO_PERIPH_SS_BLSP1_BLSP_UART3_UART_DM_TF_RF_3_DEPRECATED_ADDR A:0xf9920078
y.create.l HWIO_PERIPH_SS_BLSP1_BLSP_UART3_UART_DM_TF_RF_4_DEPRECATED_ADDR A:0xf992007c
y.create.l HWIO_PERIPH_SS_BLSP1_BLSP_UART3_UART_DM_SIM_CFG_ADDR A:0xf9920080
y.create.l HWIO_PERIPH_SS_BLSP1_BLSP_UART3_UART_DM_TEST_WR_ADDR_ADDR A:0xf9920084
y.create.l HWIO_PERIPH_SS_BLSP1_BLSP_UART3_UART_DM_TEST_WR_DATA_ADDR A:0xf9920088
y.create.l HWIO_PERIPH_SS_BLSP1_BLSP_UART3_UART_DM_TEST_RD_ADDR_ADDR A:0xf992008c
y.create.l HWIO_PERIPH_SS_BLSP1_BLSP_UART3_UART_DM_TEST_RD_DATA_ADDR A:0xf9920090
y.create.l HWIO_PERIPH_SS_BLSP1_BLSP_UART3_UART_DM_CSR_ADDR A:0xf99200a0
y.create.l HWIO_PERIPH_SS_BLSP1_BLSP_UART3_UART_DM_SR_ADDR A:0xf99200a4
y.create.l HWIO_PERIPH_SS_BLSP1_BLSP_UART3_UART_DM_CR_ADDR A:0xf99200a8
y.create.l HWIO_PERIPH_SS_BLSP1_BLSP_UART3_UART_DM_MISR_ADDR A:0xf99200ac
y.create.l HWIO_PERIPH_SS_BLSP1_BLSP_UART3_UART_DM_IMR_ADDR A:0xf99200b0
y.create.l HWIO_PERIPH_SS_BLSP1_BLSP_UART3_UART_DM_ISR_ADDR A:0xf99200b4
y.create.l HWIO_PERIPH_SS_BLSP1_BLSP_UART3_UART_DM_IRDA_ADDR A:0xf99200b8
y.create.l HWIO_PERIPH_SS_BLSP1_BLSP_UART3_UART_DM_RX_TOTAL_SNAP_ADDR A:0xf99200bc
y.create.l HWIO_PERIPH_SS_BLSP1_BLSP_UART3_UART_DM_WWT_TIMEOUT_ADDR A:0xf99200c0
y.create.l HWIO_PERIPH_SS_BLSP1_BLSP_UART3_UART_DM_CLK_CTRL_ADDR A:0xf99200c4
y.create.l HWIO_PERIPH_SS_BLSP1_BLSP_UART3_UART_DM_BCR_ADDR A:0xf99200c8
y.create.l HWIO_PERIPH_SS_BLSP1_BLSP_UART3_UART_DM_RX_TRANS_CTRL_ADDR A:0xf99200cc
y.create.l HWIO_PERIPH_SS_BLSP1_BLSP_UART3_UART_DM_DMRX_DBG_ADDR A:0xf99200d0
y.create.l HWIO_PERIPH_SS_BLSP1_BLSP_UART3_UART_DM_FSM_STATUS_ADDR A:0xf99200d4
y.create.l HWIO_PERIPH_SS_BLSP1_BLSP_UART3_UART_DM_HW_VERSION_ADDR A:0xf99200d8
y.create.l HWIO_PERIPH_SS_BLSP1_BLSP_UART3_UART_DM_GENERICS_ADDR A:0xf99200dc
y.create.l HWIO_PERIPH_SS_BLSP1_BLSP_UART3_UART_DM_TF_ADDR A:0xf9920100
y.create.l HWIO_PERIPH_SS_BLSP1_BLSP_UART3_UART_DM_TF_2_ADDR A:0xf9920104
y.create.l HWIO_PERIPH_SS_BLSP1_BLSP_UART3_UART_DM_TF_3_ADDR A:0xf9920108
y.create.l HWIO_PERIPH_SS_BLSP1_BLSP_UART3_UART_DM_TF_4_ADDR A:0xf992010c
y.create.l HWIO_PERIPH_SS_BLSP1_BLSP_UART3_UART_DM_TF_5_ADDR A:0xf9920110
y.create.l HWIO_PERIPH_SS_BLSP1_BLSP_UART3_UART_DM_TF_6_ADDR A:0xf9920114
y.create.l HWIO_PERIPH_SS_BLSP1_BLSP_UART3_UART_DM_TF_7_ADDR A:0xf9920118
y.create.l HWIO_PERIPH_SS_BLSP1_BLSP_UART3_UART_DM_TF_8_ADDR A:0xf992011c
y.create.l HWIO_PERIPH_SS_BLSP1_BLSP_UART3_UART_DM_TF_9_ADDR A:0xf9920120
y.create.l HWIO_PERIPH_SS_BLSP1_BLSP_UART3_UART_DM_TF_10_ADDR A:0xf9920124
y.create.l HWIO_PERIPH_SS_BLSP1_BLSP_UART3_UART_DM_TF_11_ADDR A:0xf9920128
y.create.l HWIO_PERIPH_SS_BLSP1_BLSP_UART3_UART_DM_TF_12_ADDR A:0xf992012c
y.create.l HWIO_PERIPH_SS_BLSP1_BLSP_UART3_UART_DM_TF_13_ADDR A:0xf9920130
y.create.l HWIO_PERIPH_SS_BLSP1_BLSP_UART3_UART_DM_TF_14_ADDR A:0xf9920134
y.create.l HWIO_PERIPH_SS_BLSP1_BLSP_UART3_UART_DM_TF_15_ADDR A:0xf9920138
y.create.l HWIO_PERIPH_SS_BLSP1_BLSP_UART3_UART_DM_TF_16_ADDR A:0xf992013c
y.create.l HWIO_PERIPH_SS_BLSP1_BLSP_UART3_UART_DM_RF_ADDR A:0xf9920140
y.create.l HWIO_PERIPH_SS_BLSP1_BLSP_UART3_UART_DM_RF_2_ADDR A:0xf9920144
y.create.l HWIO_PERIPH_SS_BLSP1_BLSP_UART3_UART_DM_RF_3_ADDR A:0xf9920148
y.create.l HWIO_PERIPH_SS_BLSP1_BLSP_UART3_UART_DM_RF_4_ADDR A:0xf992014c
y.create.l HWIO_PERIPH_SS_BLSP1_BLSP_UART3_UART_DM_RF_5_ADDR A:0xf9920150
y.create.l HWIO_PERIPH_SS_BLSP1_BLSP_UART3_UART_DM_RF_6_ADDR A:0xf9920154
y.create.l HWIO_PERIPH_SS_BLSP1_BLSP_UART3_UART_DM_RF_7_ADDR A:0xf9920158
y.create.l HWIO_PERIPH_SS_BLSP1_BLSP_UART3_UART_DM_RF_8_ADDR A:0xf992015c
y.create.l HWIO_PERIPH_SS_BLSP1_BLSP_UART3_UART_DM_RF_9_ADDR A:0xf9920160
y.create.l HWIO_PERIPH_SS_BLSP1_BLSP_UART3_UART_DM_RF_10_ADDR A:0xf9920164
y.create.l HWIO_PERIPH_SS_BLSP1_BLSP_UART3_UART_DM_RF_11_ADDR A:0xf9920168
y.create.l HWIO_PERIPH_SS_BLSP1_BLSP_UART3_UART_DM_RF_12_ADDR A:0xf992016c
y.create.l HWIO_PERIPH_SS_BLSP1_BLSP_UART3_UART_DM_RF_13_ADDR A:0xf9920170
y.create.l HWIO_PERIPH_SS_BLSP1_BLSP_UART3_UART_DM_RF_14_ADDR A:0xf9920174
y.create.l HWIO_PERIPH_SS_BLSP1_BLSP_UART3_UART_DM_RF_15_ADDR A:0xf9920178
y.create.l HWIO_PERIPH_SS_BLSP1_BLSP_UART3_UART_DM_RF_16_ADDR A:0xf992017c
y.create.l HWIO_PERIPH_SS_BLSP1_BLSP_UART3_UART_DM_UIM_CFG_ADDR A:0xf9920180
y.create.l HWIO_PERIPH_SS_BLSP1_BLSP_UART3_UART_DM_UIM_CMD_ADDR A:0xf9920184
y.create.l HWIO_PERIPH_SS_BLSP1_BLSP_UART3_UART_DM_UIM_IO_STATUS_ADDR A:0xf9920188
y.create.l HWIO_PERIPH_SS_BLSP1_BLSP_UART3_UART_DM_UIM_IRQ_ISR_ADDR A:0xf992018c
y.create.l HWIO_PERIPH_SS_BLSP1_BLSP_UART3_UART_DM_UIM_IRQ_MISR_ADDR A:0xf9920190
y.create.l HWIO_PERIPH_SS_BLSP1_BLSP_UART3_UART_DM_UIM_IRQ_CLR_ADDR A:0xf9920194
y.create.l HWIO_PERIPH_SS_BLSP1_BLSP_UART3_UART_DM_UIM_IRQ_IMR_ADDR A:0xf9920198
y.create.l HWIO_PERIPH_SS_BLSP1_BLSP_UART3_UART_DM_UIM_IRQ_IMR_SET_ADDR A:0xf992019c
y.create.l HWIO_PERIPH_SS_BLSP1_BLSP_UART3_UART_DM_UIM_IRQ_IMR_CLR_ADDR A:0xf99201a0
y.create.l HWIO_PERIPH_SS_BLSP1_BLSP_UART4_UART_DM_MR1_ADDR A:0xf9921000
y.create.l HWIO_PERIPH_SS_BLSP1_BLSP_UART4_UART_DM_MR2_ADDR A:0xf9921004
y.create.l HWIO_PERIPH_SS_BLSP1_BLSP_UART4_UART_DM_CSR_SR_DEPRECATED_ADDR A:0xf9921008
y.create.l HWIO_PERIPH_SS_BLSP1_BLSP_UART4_UART_DM_CR_MISR_DEPRECATED_ADDR A:0xf9921010
y.create.l HWIO_PERIPH_SS_BLSP1_BLSP_UART4_UART_DM_IMR_ISR_DEPRECATED_ADDR A:0xf9921014
y.create.l HWIO_PERIPH_SS_BLSP1_BLSP_UART4_UART_DM_IPR_ADDR A:0xf9921018
y.create.l HWIO_PERIPH_SS_BLSP1_BLSP_UART4_UART_DM_TFWR_ADDR A:0xf992101c
y.create.l HWIO_PERIPH_SS_BLSP1_BLSP_UART4_UART_DM_RFWR_ADDR A:0xf9921020
y.create.l HWIO_PERIPH_SS_BLSP1_BLSP_UART4_UART_DM_HCR_ADDR A:0xf9921024
y.create.l HWIO_PERIPH_SS_BLSP1_BLSP_UART4_UART_DM_DMRX_ADDR A:0xf9921034
y.create.l HWIO_PERIPH_SS_BLSP1_BLSP_UART4_UART_DM_IRDA_RX_TOTAL_SNAP_DEPRECATED_ADDR A:0xf9921038
y.create.l HWIO_PERIPH_SS_BLSP1_BLSP_UART4_UART_DM_DMEN_ADDR A:0xf992103c
y.create.l HWIO_PERIPH_SS_BLSP1_BLSP_UART4_UART_DM_NO_CHARS_FOR_TX_ADDR A:0xf9921040
y.create.l HWIO_PERIPH_SS_BLSP1_BLSP_UART4_UART_DM_BADR_ADDR A:0xf9921044
y.create.l HWIO_PERIPH_SS_BLSP1_BLSP_UART4_UART_DM_TESTSL_ADDR A:0xf9921048
y.create.l HWIO_PERIPH_SS_BLSP1_BLSP_UART4_UART_DM_TXFS_ADDR A:0xf992104c
y.create.l HWIO_PERIPH_SS_BLSP1_BLSP_UART4_UART_DM_RXFS_ADDR A:0xf9921050
y.create.l HWIO_PERIPH_SS_BLSP1_BLSP_UART4_UART_DM_MISR_MODE_ADDR A:0xf9921060
y.create.l HWIO_PERIPH_SS_BLSP1_BLSP_UART4_UART_DM_MISR_RESET_ADDR A:0xf9921064
y.create.l HWIO_PERIPH_SS_BLSP1_BLSP_UART4_UART_DM_MISR_EXPORT_ADDR A:0xf9921068
y.create.l HWIO_PERIPH_SS_BLSP1_BLSP_UART4_UART_DM_MISR_VAL_ADDR A:0xf992106c
y.create.l HWIO_PERIPH_SS_BLSP1_BLSP_UART4_UART_DM_TF_RF_DEPRECATED_ADDR A:0xf9921070
y.create.l HWIO_PERIPH_SS_BLSP1_BLSP_UART4_UART_DM_TF_RF_2_DEPRECATED_ADDR A:0xf9921074
y.create.l HWIO_PERIPH_SS_BLSP1_BLSP_UART4_UART_DM_TF_RF_3_DEPRECATED_ADDR A:0xf9921078
y.create.l HWIO_PERIPH_SS_BLSP1_BLSP_UART4_UART_DM_TF_RF_4_DEPRECATED_ADDR A:0xf992107c
y.create.l HWIO_PERIPH_SS_BLSP1_BLSP_UART4_UART_DM_SIM_CFG_ADDR A:0xf9921080
y.create.l HWIO_PERIPH_SS_BLSP1_BLSP_UART4_UART_DM_TEST_WR_ADDR_ADDR A:0xf9921084
y.create.l HWIO_PERIPH_SS_BLSP1_BLSP_UART4_UART_DM_TEST_WR_DATA_ADDR A:0xf9921088
y.create.l HWIO_PERIPH_SS_BLSP1_BLSP_UART4_UART_DM_TEST_RD_ADDR_ADDR A:0xf992108c
y.create.l HWIO_PERIPH_SS_BLSP1_BLSP_UART4_UART_DM_TEST_RD_DATA_ADDR A:0xf9921090
y.create.l HWIO_PERIPH_SS_BLSP1_BLSP_UART4_UART_DM_CSR_ADDR A:0xf99210a0
y.create.l HWIO_PERIPH_SS_BLSP1_BLSP_UART4_UART_DM_SR_ADDR A:0xf99210a4
y.create.l HWIO_PERIPH_SS_BLSP1_BLSP_UART4_UART_DM_CR_ADDR A:0xf99210a8
y.create.l HWIO_PERIPH_SS_BLSP1_BLSP_UART4_UART_DM_MISR_ADDR A:0xf99210ac
y.create.l HWIO_PERIPH_SS_BLSP1_BLSP_UART4_UART_DM_IMR_ADDR A:0xf99210b0
y.create.l HWIO_PERIPH_SS_BLSP1_BLSP_UART4_UART_DM_ISR_ADDR A:0xf99210b4
y.create.l HWIO_PERIPH_SS_BLSP1_BLSP_UART4_UART_DM_IRDA_ADDR A:0xf99210b8
y.create.l HWIO_PERIPH_SS_BLSP1_BLSP_UART4_UART_DM_RX_TOTAL_SNAP_ADDR A:0xf99210bc
y.create.l HWIO_PERIPH_SS_BLSP1_BLSP_UART4_UART_DM_WWT_TIMEOUT_ADDR A:0xf99210c0
y.create.l HWIO_PERIPH_SS_BLSP1_BLSP_UART4_UART_DM_CLK_CTRL_ADDR A:0xf99210c4
y.create.l HWIO_PERIPH_SS_BLSP1_BLSP_UART4_UART_DM_BCR_ADDR A:0xf99210c8
y.create.l HWIO_PERIPH_SS_BLSP1_BLSP_UART4_UART_DM_RX_TRANS_CTRL_ADDR A:0xf99210cc
y.create.l HWIO_PERIPH_SS_BLSP1_BLSP_UART4_UART_DM_DMRX_DBG_ADDR A:0xf99210d0
y.create.l HWIO_PERIPH_SS_BLSP1_BLSP_UART4_UART_DM_FSM_STATUS_ADDR A:0xf99210d4
y.create.l HWIO_PERIPH_SS_BLSP1_BLSP_UART4_UART_DM_HW_VERSION_ADDR A:0xf99210d8
y.create.l HWIO_PERIPH_SS_BLSP1_BLSP_UART4_UART_DM_GENERICS_ADDR A:0xf99210dc
y.create.l HWIO_PERIPH_SS_BLSP1_BLSP_UART4_UART_DM_TF_ADDR A:0xf9921100
y.create.l HWIO_PERIPH_SS_BLSP1_BLSP_UART4_UART_DM_TF_2_ADDR A:0xf9921104
y.create.l HWIO_PERIPH_SS_BLSP1_BLSP_UART4_UART_DM_TF_3_ADDR A:0xf9921108
y.create.l HWIO_PERIPH_SS_BLSP1_BLSP_UART4_UART_DM_TF_4_ADDR A:0xf992110c
y.create.l HWIO_PERIPH_SS_BLSP1_BLSP_UART4_UART_DM_TF_5_ADDR A:0xf9921110
y.create.l HWIO_PERIPH_SS_BLSP1_BLSP_UART4_UART_DM_TF_6_ADDR A:0xf9921114
y.create.l HWIO_PERIPH_SS_BLSP1_BLSP_UART4_UART_DM_TF_7_ADDR A:0xf9921118
y.create.l HWIO_PERIPH_SS_BLSP1_BLSP_UART4_UART_DM_TF_8_ADDR A:0xf992111c
y.create.l HWIO_PERIPH_SS_BLSP1_BLSP_UART4_UART_DM_TF_9_ADDR A:0xf9921120
y.create.l HWIO_PERIPH_SS_BLSP1_BLSP_UART4_UART_DM_TF_10_ADDR A:0xf9921124
y.create.l HWIO_PERIPH_SS_BLSP1_BLSP_UART4_UART_DM_TF_11_ADDR A:0xf9921128
y.create.l HWIO_PERIPH_SS_BLSP1_BLSP_UART4_UART_DM_TF_12_ADDR A:0xf992112c
y.create.l HWIO_PERIPH_SS_BLSP1_BLSP_UART4_UART_DM_TF_13_ADDR A:0xf9921130
y.create.l HWIO_PERIPH_SS_BLSP1_BLSP_UART4_UART_DM_TF_14_ADDR A:0xf9921134
y.create.l HWIO_PERIPH_SS_BLSP1_BLSP_UART4_UART_DM_TF_15_ADDR A:0xf9921138
y.create.l HWIO_PERIPH_SS_BLSP1_BLSP_UART4_UART_DM_TF_16_ADDR A:0xf992113c
y.create.l HWIO_PERIPH_SS_BLSP1_BLSP_UART4_UART_DM_RF_ADDR A:0xf9921140
y.create.l HWIO_PERIPH_SS_BLSP1_BLSP_UART4_UART_DM_RF_2_ADDR A:0xf9921144
y.create.l HWIO_PERIPH_SS_BLSP1_BLSP_UART4_UART_DM_RF_3_ADDR A:0xf9921148
y.create.l HWIO_PERIPH_SS_BLSP1_BLSP_UART4_UART_DM_RF_4_ADDR A:0xf992114c
y.create.l HWIO_PERIPH_SS_BLSP1_BLSP_UART4_UART_DM_RF_5_ADDR A:0xf9921150
y.create.l HWIO_PERIPH_SS_BLSP1_BLSP_UART4_UART_DM_RF_6_ADDR A:0xf9921154
y.create.l HWIO_PERIPH_SS_BLSP1_BLSP_UART4_UART_DM_RF_7_ADDR A:0xf9921158
y.create.l HWIO_PERIPH_SS_BLSP1_BLSP_UART4_UART_DM_RF_8_ADDR A:0xf992115c
y.create.l HWIO_PERIPH_SS_BLSP1_BLSP_UART4_UART_DM_RF_9_ADDR A:0xf9921160
y.create.l HWIO_PERIPH_SS_BLSP1_BLSP_UART4_UART_DM_RF_10_ADDR A:0xf9921164
y.create.l HWIO_PERIPH_SS_BLSP1_BLSP_UART4_UART_DM_RF_11_ADDR A:0xf9921168
y.create.l HWIO_PERIPH_SS_BLSP1_BLSP_UART4_UART_DM_RF_12_ADDR A:0xf992116c
y.create.l HWIO_PERIPH_SS_BLSP1_BLSP_UART4_UART_DM_RF_13_ADDR A:0xf9921170
y.create.l HWIO_PERIPH_SS_BLSP1_BLSP_UART4_UART_DM_RF_14_ADDR A:0xf9921174
y.create.l HWIO_PERIPH_SS_BLSP1_BLSP_UART4_UART_DM_RF_15_ADDR A:0xf9921178
y.create.l HWIO_PERIPH_SS_BLSP1_BLSP_UART4_UART_DM_RF_16_ADDR A:0xf992117c
y.create.l HWIO_PERIPH_SS_BLSP1_BLSP_UART4_UART_DM_UIM_CFG_ADDR A:0xf9921180
y.create.l HWIO_PERIPH_SS_BLSP1_BLSP_UART4_UART_DM_UIM_CMD_ADDR A:0xf9921184
y.create.l HWIO_PERIPH_SS_BLSP1_BLSP_UART4_UART_DM_UIM_IO_STATUS_ADDR A:0xf9921188
y.create.l HWIO_PERIPH_SS_BLSP1_BLSP_UART4_UART_DM_UIM_IRQ_ISR_ADDR A:0xf992118c
y.create.l HWIO_PERIPH_SS_BLSP1_BLSP_UART4_UART_DM_UIM_IRQ_MISR_ADDR A:0xf9921190
y.create.l HWIO_PERIPH_SS_BLSP1_BLSP_UART4_UART_DM_UIM_IRQ_CLR_ADDR A:0xf9921194
y.create.l HWIO_PERIPH_SS_BLSP1_BLSP_UART4_UART_DM_UIM_IRQ_IMR_ADDR A:0xf9921198
y.create.l HWIO_PERIPH_SS_BLSP1_BLSP_UART4_UART_DM_UIM_IRQ_IMR_SET_ADDR A:0xf992119c
y.create.l HWIO_PERIPH_SS_BLSP1_BLSP_UART4_UART_DM_UIM_IRQ_IMR_CLR_ADDR A:0xf99211a0
y.create.l HWIO_PERIPH_SS_BLSP1_BLSP_UART5_UART_DM_MR1_ADDR A:0xf9922000
y.create.l HWIO_PERIPH_SS_BLSP1_BLSP_UART5_UART_DM_MR2_ADDR A:0xf9922004
y.create.l HWIO_PERIPH_SS_BLSP1_BLSP_UART5_UART_DM_CSR_SR_DEPRECATED_ADDR A:0xf9922008
y.create.l HWIO_PERIPH_SS_BLSP1_BLSP_UART5_UART_DM_CR_MISR_DEPRECATED_ADDR A:0xf9922010
y.create.l HWIO_PERIPH_SS_BLSP1_BLSP_UART5_UART_DM_IMR_ISR_DEPRECATED_ADDR A:0xf9922014
y.create.l HWIO_PERIPH_SS_BLSP1_BLSP_UART5_UART_DM_IPR_ADDR A:0xf9922018
y.create.l HWIO_PERIPH_SS_BLSP1_BLSP_UART5_UART_DM_TFWR_ADDR A:0xf992201c
y.create.l HWIO_PERIPH_SS_BLSP1_BLSP_UART5_UART_DM_RFWR_ADDR A:0xf9922020
y.create.l HWIO_PERIPH_SS_BLSP1_BLSP_UART5_UART_DM_HCR_ADDR A:0xf9922024
y.create.l HWIO_PERIPH_SS_BLSP1_BLSP_UART5_UART_DM_DMRX_ADDR A:0xf9922034
y.create.l HWIO_PERIPH_SS_BLSP1_BLSP_UART5_UART_DM_IRDA_RX_TOTAL_SNAP_DEPRECATED_ADDR A:0xf9922038
y.create.l HWIO_PERIPH_SS_BLSP1_BLSP_UART5_UART_DM_DMEN_ADDR A:0xf992203c
y.create.l HWIO_PERIPH_SS_BLSP1_BLSP_UART5_UART_DM_NO_CHARS_FOR_TX_ADDR A:0xf9922040
y.create.l HWIO_PERIPH_SS_BLSP1_BLSP_UART5_UART_DM_BADR_ADDR A:0xf9922044
y.create.l HWIO_PERIPH_SS_BLSP1_BLSP_UART5_UART_DM_TESTSL_ADDR A:0xf9922048
y.create.l HWIO_PERIPH_SS_BLSP1_BLSP_UART5_UART_DM_TXFS_ADDR A:0xf992204c
y.create.l HWIO_PERIPH_SS_BLSP1_BLSP_UART5_UART_DM_RXFS_ADDR A:0xf9922050
y.create.l HWIO_PERIPH_SS_BLSP1_BLSP_UART5_UART_DM_MISR_MODE_ADDR A:0xf9922060
y.create.l HWIO_PERIPH_SS_BLSP1_BLSP_UART5_UART_DM_MISR_RESET_ADDR A:0xf9922064
y.create.l HWIO_PERIPH_SS_BLSP1_BLSP_UART5_UART_DM_MISR_EXPORT_ADDR A:0xf9922068
y.create.l HWIO_PERIPH_SS_BLSP1_BLSP_UART5_UART_DM_MISR_VAL_ADDR A:0xf992206c
y.create.l HWIO_PERIPH_SS_BLSP1_BLSP_UART5_UART_DM_TF_RF_DEPRECATED_ADDR A:0xf9922070
y.create.l HWIO_PERIPH_SS_BLSP1_BLSP_UART5_UART_DM_TF_RF_2_DEPRECATED_ADDR A:0xf9922074
y.create.l HWIO_PERIPH_SS_BLSP1_BLSP_UART5_UART_DM_TF_RF_3_DEPRECATED_ADDR A:0xf9922078
y.create.l HWIO_PERIPH_SS_BLSP1_BLSP_UART5_UART_DM_TF_RF_4_DEPRECATED_ADDR A:0xf992207c
y.create.l HWIO_PERIPH_SS_BLSP1_BLSP_UART5_UART_DM_SIM_CFG_ADDR A:0xf9922080
y.create.l HWIO_PERIPH_SS_BLSP1_BLSP_UART5_UART_DM_TEST_WR_ADDR_ADDR A:0xf9922084
y.create.l HWIO_PERIPH_SS_BLSP1_BLSP_UART5_UART_DM_TEST_WR_DATA_ADDR A:0xf9922088
y.create.l HWIO_PERIPH_SS_BLSP1_BLSP_UART5_UART_DM_TEST_RD_ADDR_ADDR A:0xf992208c
y.create.l HWIO_PERIPH_SS_BLSP1_BLSP_UART5_UART_DM_TEST_RD_DATA_ADDR A:0xf9922090
y.create.l HWIO_PERIPH_SS_BLSP1_BLSP_UART5_UART_DM_CSR_ADDR A:0xf99220a0
y.create.l HWIO_PERIPH_SS_BLSP1_BLSP_UART5_UART_DM_SR_ADDR A:0xf99220a4
y.create.l HWIO_PERIPH_SS_BLSP1_BLSP_UART5_UART_DM_CR_ADDR A:0xf99220a8
y.create.l HWIO_PERIPH_SS_BLSP1_BLSP_UART5_UART_DM_MISR_ADDR A:0xf99220ac
y.create.l HWIO_PERIPH_SS_BLSP1_BLSP_UART5_UART_DM_IMR_ADDR A:0xf99220b0
y.create.l HWIO_PERIPH_SS_BLSP1_BLSP_UART5_UART_DM_ISR_ADDR A:0xf99220b4
y.create.l HWIO_PERIPH_SS_BLSP1_BLSP_UART5_UART_DM_IRDA_ADDR A:0xf99220b8
y.create.l HWIO_PERIPH_SS_BLSP1_BLSP_UART5_UART_DM_RX_TOTAL_SNAP_ADDR A:0xf99220bc
y.create.l HWIO_PERIPH_SS_BLSP1_BLSP_UART5_UART_DM_WWT_TIMEOUT_ADDR A:0xf99220c0
y.create.l HWIO_PERIPH_SS_BLSP1_BLSP_UART5_UART_DM_CLK_CTRL_ADDR A:0xf99220c4
y.create.l HWIO_PERIPH_SS_BLSP1_BLSP_UART5_UART_DM_BCR_ADDR A:0xf99220c8
y.create.l HWIO_PERIPH_SS_BLSP1_BLSP_UART5_UART_DM_RX_TRANS_CTRL_ADDR A:0xf99220cc
y.create.l HWIO_PERIPH_SS_BLSP1_BLSP_UART5_UART_DM_DMRX_DBG_ADDR A:0xf99220d0
y.create.l HWIO_PERIPH_SS_BLSP1_BLSP_UART5_UART_DM_FSM_STATUS_ADDR A:0xf99220d4
y.create.l HWIO_PERIPH_SS_BLSP1_BLSP_UART5_UART_DM_HW_VERSION_ADDR A:0xf99220d8
y.create.l HWIO_PERIPH_SS_BLSP1_BLSP_UART5_UART_DM_GENERICS_ADDR A:0xf99220dc
y.create.l HWIO_PERIPH_SS_BLSP1_BLSP_UART5_UART_DM_TF_ADDR A:0xf9922100
y.create.l HWIO_PERIPH_SS_BLSP1_BLSP_UART5_UART_DM_TF_2_ADDR A:0xf9922104
y.create.l HWIO_PERIPH_SS_BLSP1_BLSP_UART5_UART_DM_TF_3_ADDR A:0xf9922108
y.create.l HWIO_PERIPH_SS_BLSP1_BLSP_UART5_UART_DM_TF_4_ADDR A:0xf992210c
y.create.l HWIO_PERIPH_SS_BLSP1_BLSP_UART5_UART_DM_TF_5_ADDR A:0xf9922110
y.create.l HWIO_PERIPH_SS_BLSP1_BLSP_UART5_UART_DM_TF_6_ADDR A:0xf9922114
y.create.l HWIO_PERIPH_SS_BLSP1_BLSP_UART5_UART_DM_TF_7_ADDR A:0xf9922118
y.create.l HWIO_PERIPH_SS_BLSP1_BLSP_UART5_UART_DM_TF_8_ADDR A:0xf992211c
y.create.l HWIO_PERIPH_SS_BLSP1_BLSP_UART5_UART_DM_TF_9_ADDR A:0xf9922120
y.create.l HWIO_PERIPH_SS_BLSP1_BLSP_UART5_UART_DM_TF_10_ADDR A:0xf9922124
y.create.l HWIO_PERIPH_SS_BLSP1_BLSP_UART5_UART_DM_TF_11_ADDR A:0xf9922128
y.create.l HWIO_PERIPH_SS_BLSP1_BLSP_UART5_UART_DM_TF_12_ADDR A:0xf992212c
y.create.l HWIO_PERIPH_SS_BLSP1_BLSP_UART5_UART_DM_TF_13_ADDR A:0xf9922130
y.create.l HWIO_PERIPH_SS_BLSP1_BLSP_UART5_UART_DM_TF_14_ADDR A:0xf9922134
y.create.l HWIO_PERIPH_SS_BLSP1_BLSP_UART5_UART_DM_TF_15_ADDR A:0xf9922138
y.create.l HWIO_PERIPH_SS_BLSP1_BLSP_UART5_UART_DM_TF_16_ADDR A:0xf992213c
y.create.l HWIO_PERIPH_SS_BLSP1_BLSP_UART5_UART_DM_RF_ADDR A:0xf9922140
y.create.l HWIO_PERIPH_SS_BLSP1_BLSP_UART5_UART_DM_RF_2_ADDR A:0xf9922144
y.create.l HWIO_PERIPH_SS_BLSP1_BLSP_UART5_UART_DM_RF_3_ADDR A:0xf9922148
y.create.l HWIO_PERIPH_SS_BLSP1_BLSP_UART5_UART_DM_RF_4_ADDR A:0xf992214c
y.create.l HWIO_PERIPH_SS_BLSP1_BLSP_UART5_UART_DM_RF_5_ADDR A:0xf9922150
y.create.l HWIO_PERIPH_SS_BLSP1_BLSP_UART5_UART_DM_RF_6_ADDR A:0xf9922154
y.create.l HWIO_PERIPH_SS_BLSP1_BLSP_UART5_UART_DM_RF_7_ADDR A:0xf9922158
y.create.l HWIO_PERIPH_SS_BLSP1_BLSP_UART5_UART_DM_RF_8_ADDR A:0xf992215c
y.create.l HWIO_PERIPH_SS_BLSP1_BLSP_UART5_UART_DM_RF_9_ADDR A:0xf9922160
y.create.l HWIO_PERIPH_SS_BLSP1_BLSP_UART5_UART_DM_RF_10_ADDR A:0xf9922164
y.create.l HWIO_PERIPH_SS_BLSP1_BLSP_UART5_UART_DM_RF_11_ADDR A:0xf9922168
y.create.l HWIO_PERIPH_SS_BLSP1_BLSP_UART5_UART_DM_RF_12_ADDR A:0xf992216c
y.create.l HWIO_PERIPH_SS_BLSP1_BLSP_UART5_UART_DM_RF_13_ADDR A:0xf9922170
y.create.l HWIO_PERIPH_SS_BLSP1_BLSP_UART5_UART_DM_RF_14_ADDR A:0xf9922174
y.create.l HWIO_PERIPH_SS_BLSP1_BLSP_UART5_UART_DM_RF_15_ADDR A:0xf9922178
y.create.l HWIO_PERIPH_SS_BLSP1_BLSP_UART5_UART_DM_RF_16_ADDR A:0xf992217c
y.create.l HWIO_PERIPH_SS_BLSP1_BLSP_UART5_UART_DM_UIM_CFG_ADDR A:0xf9922180
y.create.l HWIO_PERIPH_SS_BLSP1_BLSP_UART5_UART_DM_UIM_CMD_ADDR A:0xf9922184
y.create.l HWIO_PERIPH_SS_BLSP1_BLSP_UART5_UART_DM_UIM_IO_STATUS_ADDR A:0xf9922188
y.create.l HWIO_PERIPH_SS_BLSP1_BLSP_UART5_UART_DM_UIM_IRQ_ISR_ADDR A:0xf992218c
y.create.l HWIO_PERIPH_SS_BLSP1_BLSP_UART5_UART_DM_UIM_IRQ_MISR_ADDR A:0xf9922190
y.create.l HWIO_PERIPH_SS_BLSP1_BLSP_UART5_UART_DM_UIM_IRQ_CLR_ADDR A:0xf9922194
y.create.l HWIO_PERIPH_SS_BLSP1_BLSP_UART5_UART_DM_UIM_IRQ_IMR_ADDR A:0xf9922198
y.create.l HWIO_PERIPH_SS_BLSP1_BLSP_UART5_UART_DM_UIM_IRQ_IMR_SET_ADDR A:0xf992219c
y.create.l HWIO_PERIPH_SS_BLSP1_BLSP_UART5_UART_DM_UIM_IRQ_IMR_CLR_ADDR A:0xf99221a0
y.create.l HWIO_PERIPH_SS_BLSP1_BLSP_QUP0_QUP_CONFIG_ADDR A:0xf9923000
y.create.l HWIO_PERIPH_SS_BLSP1_BLSP_QUP0_QUP_STATE_ADDR A:0xf9923004
y.create.l HWIO_PERIPH_SS_BLSP1_BLSP_QUP0_QUP_IO_MODES_ADDR A:0xf9923008
y.create.l HWIO_PERIPH_SS_BLSP1_BLSP_QUP0_QUP_SW_RESET_ADDR A:0xf992300c
y.create.l HWIO_PERIPH_SS_BLSP1_BLSP_QUP0_QUP_TRANSFER_CANCEL_ADDR A:0xf9923014
y.create.l HWIO_PERIPH_SS_BLSP1_BLSP_QUP0_QUP_OPERATIONAL_ADDR A:0xf9923018
y.create.l HWIO_PERIPH_SS_BLSP1_BLSP_QUP0_QUP_ERROR_FLAGS_ADDR A:0xf992301c
y.create.l HWIO_PERIPH_SS_BLSP1_BLSP_QUP0_QUP_ERROR_FLAGS_EN_ADDR A:0xf9923020
y.create.l HWIO_PERIPH_SS_BLSP1_BLSP_QUP0_QUP_TEST_CTRL_ADDR A:0xf9923024
y.create.l HWIO_PERIPH_SS_BLSP1_BLSP_QUP0_QUP_OPERATIONAL_MASK_ADDR A:0xf9923028
y.create.l HWIO_PERIPH_SS_BLSP1_BLSP_QUP0_QUP_HW_VERSION_ADDR A:0xf9923030
y.create.l HWIO_PERIPH_SS_BLSP1_BLSP_QUP0_QUP_MX_OUTPUT_COUNT_ADDR A:0xf9923100
y.create.l HWIO_PERIPH_SS_BLSP1_BLSP_QUP0_QUP_MX_OUTPUT_CNT_CURRENT_ADDR A:0xf9923104
y.create.l HWIO_PERIPH_SS_BLSP1_BLSP_QUP0_QUP_OUTPUT_DEBUG_ADDR A:0xf9923108
y.create.l HWIO_PERIPH_SS_BLSP1_BLSP_QUP0_QUP_OUTPUT_FIFO_WORD_CNT_ADDR A:0xf992310c
y.create.l HWIO_PERIPH_SS_BLSP1_BLSP_QUP0_QUP_OUTPUT_FIFO0_ADDR A:0xf9923110
y.create.l HWIO_PERIPH_SS_BLSP1_BLSP_QUP0_QUP_OUTPUT_FIFO1_ADDR A:0xf9923114
y.create.l HWIO_PERIPH_SS_BLSP1_BLSP_QUP0_QUP_OUTPUT_FIFO2_ADDR A:0xf9923118
y.create.l HWIO_PERIPH_SS_BLSP1_BLSP_QUP0_QUP_OUTPUT_FIFO3_ADDR A:0xf992311c
y.create.l HWIO_PERIPH_SS_BLSP1_BLSP_QUP0_QUP_OUTPUT_FIFO4_ADDR A:0xf9923120
y.create.l HWIO_PERIPH_SS_BLSP1_BLSP_QUP0_QUP_OUTPUT_FIFO5_ADDR A:0xf9923124
y.create.l HWIO_PERIPH_SS_BLSP1_BLSP_QUP0_QUP_OUTPUT_FIFO6_ADDR A:0xf9923128
y.create.l HWIO_PERIPH_SS_BLSP1_BLSP_QUP0_QUP_OUTPUT_FIFO7_ADDR A:0xf992312c
y.create.l HWIO_PERIPH_SS_BLSP1_BLSP_QUP0_QUP_OUTPUT_FIFO8_ADDR A:0xf9923130
y.create.l HWIO_PERIPH_SS_BLSP1_BLSP_QUP0_QUP_OUTPUT_FIFO9_ADDR A:0xf9923134
y.create.l HWIO_PERIPH_SS_BLSP1_BLSP_QUP0_QUP_MX_WRITE_COUNT_ADDR A:0xf9923150
y.create.l HWIO_PERIPH_SS_BLSP1_BLSP_QUP0_QUP_MX_WRITE_CNT_CURRENT_ADDR A:0xf9923154
y.create.l HWIO_PERIPH_SS_BLSP1_BLSP_QUP0_QUP_MX_INPUT_COUNT_ADDR A:0xf9923200
y.create.l HWIO_PERIPH_SS_BLSP1_BLSP_QUP0_QUP_MX_INPUT_CNT_CURRENT_ADDR A:0xf9923204
y.create.l HWIO_PERIPH_SS_BLSP1_BLSP_QUP0_QUP_MX_READ_COUNT_ADDR A:0xf9923208
y.create.l HWIO_PERIPH_SS_BLSP1_BLSP_QUP0_QUP_MX_READ_CNT_CURRENT_ADDR A:0xf992320c
y.create.l HWIO_PERIPH_SS_BLSP1_BLSP_QUP0_QUP_INPUT_DEBUG_ADDR A:0xf9923210
y.create.l HWIO_PERIPH_SS_BLSP1_BLSP_QUP0_QUP_INPUT_FIFO_WORD_CNT_ADDR A:0xf9923214
y.create.l HWIO_PERIPH_SS_BLSP1_BLSP_QUP0_QUP_INPUT_FIFO0_ADDR A:0xf9923218
y.create.l HWIO_PERIPH_SS_BLSP1_BLSP_QUP0_QUP_INPUT_FIFO1_ADDR A:0xf992321c
y.create.l HWIO_PERIPH_SS_BLSP1_BLSP_QUP0_QUP_INPUT_FIFO2_ADDR A:0xf9923220
y.create.l HWIO_PERIPH_SS_BLSP1_BLSP_QUP0_QUP_INPUT_FIFO3_ADDR A:0xf9923224
y.create.l HWIO_PERIPH_SS_BLSP1_BLSP_QUP0_QUP_INPUT_FIFO4_ADDR A:0xf9923228
y.create.l HWIO_PERIPH_SS_BLSP1_BLSP_QUP0_QUP_INPUT_FIFO5_ADDR A:0xf992322c
y.create.l HWIO_PERIPH_SS_BLSP1_BLSP_QUP0_QUP_INPUT_FIFO6_ADDR A:0xf9923230
y.create.l HWIO_PERIPH_SS_BLSP1_BLSP_QUP0_QUP_INPUT_FIFO7_ADDR A:0xf9923234
y.create.l HWIO_PERIPH_SS_BLSP1_BLSP_QUP0_QUP_INPUT_FIFO8_ADDR A:0xf9923238
y.create.l HWIO_PERIPH_SS_BLSP1_BLSP_QUP0_QUP_INPUT_FIFO9_ADDR A:0xf992323c
y.create.l HWIO_PERIPH_SS_BLSP1_BLSP_QUP0_SPI_CONFIG_ADDR A:0xf9923300
y.create.l HWIO_PERIPH_SS_BLSP1_BLSP_QUP0_SPI_IO_CONTROL_ADDR A:0xf9923304
y.create.l HWIO_PERIPH_SS_BLSP1_BLSP_QUP0_SPI_ERROR_FLAGS_ADDR A:0xf9923308
y.create.l HWIO_PERIPH_SS_BLSP1_BLSP_QUP0_SPI_ERROR_FLAGS_EN_ADDR A:0xf992330c
y.create.l HWIO_PERIPH_SS_BLSP1_BLSP_QUP0_SPI_DEASSERT_WAIT_ADDR A:0xf9923310
y.create.l HWIO_PERIPH_SS_BLSP1_BLSP_QUP0_SPI_MASTER_LOCAL_ID_ADDR A:0xf9923314
y.create.l HWIO_PERIPH_SS_BLSP1_BLSP_QUP0_SPI_MASTER_COMMAND_ADDR A:0xf9923318
y.create.l HWIO_PERIPH_SS_BLSP1_BLSP_QUP0_SPI_MASTER_STATUS_ADDR A:0xf992331c
y.create.l HWIO_PERIPH_SS_BLSP1_BLSP_QUP0_SPI_CHAR_CFG_ADDR A:0xf9923320
y.create.l HWIO_PERIPH_SS_BLSP1_BLSP_QUP0_SPI_CHAR_DATA_SPI_CS_ADDR A:0xf9923324
y.create.l HWIO_PERIPH_SS_BLSP1_BLSP_QUP0_SPI_CHAR_DATA_SPI_MOSI_ADDR A:0xf9923328
y.create.l HWIO_PERIPH_SS_BLSP1_BLSP_QUP0_SPI_CHAR_DATA_SPI_MISO_ADDR A:0xf992332c
y.create.l HWIO_PERIPH_SS_BLSP1_BLSP_QUP0_I2C_MASTER_CLK_CTL_ADDR A:0xf9923400
y.create.l HWIO_PERIPH_SS_BLSP1_BLSP_QUP0_I2C_MASTER_STATUS_ADDR A:0xf9923404
y.create.l HWIO_PERIPH_SS_BLSP1_BLSP_QUP0_I2C_MASTER_CONFIG_ADDR A:0xf9923408
y.create.l HWIO_PERIPH_SS_BLSP1_BLSP_QUP0_I2C_MASTER_BUS_CLEAR_ADDR A:0xf992340c
y.create.l HWIO_PERIPH_SS_BLSP1_BLSP_QUP0_I2C_MASTER_LOCAL_ID_ADDR A:0xf9923410
y.create.l HWIO_PERIPH_SS_BLSP1_BLSP_QUP0_I2C_MASTER_COMMAND_ADDR A:0xf9923414
y.create.l HWIO_PERIPH_SS_BLSP1_BLSP_QUP1_QUP_CONFIG_ADDR A:0xf9924000
y.create.l HWIO_PERIPH_SS_BLSP1_BLSP_QUP1_QUP_STATE_ADDR A:0xf9924004
y.create.l HWIO_PERIPH_SS_BLSP1_BLSP_QUP1_QUP_IO_MODES_ADDR A:0xf9924008
y.create.l HWIO_PERIPH_SS_BLSP1_BLSP_QUP1_QUP_SW_RESET_ADDR A:0xf992400c
y.create.l HWIO_PERIPH_SS_BLSP1_BLSP_QUP1_QUP_TRANSFER_CANCEL_ADDR A:0xf9924014
y.create.l HWIO_PERIPH_SS_BLSP1_BLSP_QUP1_QUP_OPERATIONAL_ADDR A:0xf9924018
y.create.l HWIO_PERIPH_SS_BLSP1_BLSP_QUP1_QUP_ERROR_FLAGS_ADDR A:0xf992401c
y.create.l HWIO_PERIPH_SS_BLSP1_BLSP_QUP1_QUP_ERROR_FLAGS_EN_ADDR A:0xf9924020
y.create.l HWIO_PERIPH_SS_BLSP1_BLSP_QUP1_QUP_TEST_CTRL_ADDR A:0xf9924024
y.create.l HWIO_PERIPH_SS_BLSP1_BLSP_QUP1_QUP_OPERATIONAL_MASK_ADDR A:0xf9924028
y.create.l HWIO_PERIPH_SS_BLSP1_BLSP_QUP1_QUP_HW_VERSION_ADDR A:0xf9924030
y.create.l HWIO_PERIPH_SS_BLSP1_BLSP_QUP1_QUP_MX_OUTPUT_COUNT_ADDR A:0xf9924100
y.create.l HWIO_PERIPH_SS_BLSP1_BLSP_QUP1_QUP_MX_OUTPUT_CNT_CURRENT_ADDR A:0xf9924104
y.create.l HWIO_PERIPH_SS_BLSP1_BLSP_QUP1_QUP_OUTPUT_DEBUG_ADDR A:0xf9924108
y.create.l HWIO_PERIPH_SS_BLSP1_BLSP_QUP1_QUP_OUTPUT_FIFO_WORD_CNT_ADDR A:0xf992410c
y.create.l HWIO_PERIPH_SS_BLSP1_BLSP_QUP1_QUP_OUTPUT_FIFO0_ADDR A:0xf9924110
y.create.l HWIO_PERIPH_SS_BLSP1_BLSP_QUP1_QUP_OUTPUT_FIFO1_ADDR A:0xf9924114
y.create.l HWIO_PERIPH_SS_BLSP1_BLSP_QUP1_QUP_OUTPUT_FIFO2_ADDR A:0xf9924118
y.create.l HWIO_PERIPH_SS_BLSP1_BLSP_QUP1_QUP_OUTPUT_FIFO3_ADDR A:0xf992411c
y.create.l HWIO_PERIPH_SS_BLSP1_BLSP_QUP1_QUP_OUTPUT_FIFO4_ADDR A:0xf9924120
y.create.l HWIO_PERIPH_SS_BLSP1_BLSP_QUP1_QUP_OUTPUT_FIFO5_ADDR A:0xf9924124
y.create.l HWIO_PERIPH_SS_BLSP1_BLSP_QUP1_QUP_OUTPUT_FIFO6_ADDR A:0xf9924128
y.create.l HWIO_PERIPH_SS_BLSP1_BLSP_QUP1_QUP_OUTPUT_FIFO7_ADDR A:0xf992412c
y.create.l HWIO_PERIPH_SS_BLSP1_BLSP_QUP1_QUP_OUTPUT_FIFO8_ADDR A:0xf9924130
y.create.l HWIO_PERIPH_SS_BLSP1_BLSP_QUP1_QUP_OUTPUT_FIFO9_ADDR A:0xf9924134
y.create.l HWIO_PERIPH_SS_BLSP1_BLSP_QUP1_QUP_MX_WRITE_COUNT_ADDR A:0xf9924150
y.create.l HWIO_PERIPH_SS_BLSP1_BLSP_QUP1_QUP_MX_WRITE_CNT_CURRENT_ADDR A:0xf9924154
y.create.l HWIO_PERIPH_SS_BLSP1_BLSP_QUP1_QUP_MX_INPUT_COUNT_ADDR A:0xf9924200
y.create.l HWIO_PERIPH_SS_BLSP1_BLSP_QUP1_QUP_MX_INPUT_CNT_CURRENT_ADDR A:0xf9924204
y.create.l HWIO_PERIPH_SS_BLSP1_BLSP_QUP1_QUP_MX_READ_COUNT_ADDR A:0xf9924208
y.create.l HWIO_PERIPH_SS_BLSP1_BLSP_QUP1_QUP_MX_READ_CNT_CURRENT_ADDR A:0xf992420c
y.create.l HWIO_PERIPH_SS_BLSP1_BLSP_QUP1_QUP_INPUT_DEBUG_ADDR A:0xf9924210
y.create.l HWIO_PERIPH_SS_BLSP1_BLSP_QUP1_QUP_INPUT_FIFO_WORD_CNT_ADDR A:0xf9924214
y.create.l HWIO_PERIPH_SS_BLSP1_BLSP_QUP1_QUP_INPUT_FIFO0_ADDR A:0xf9924218
y.create.l HWIO_PERIPH_SS_BLSP1_BLSP_QUP1_QUP_INPUT_FIFO1_ADDR A:0xf992421c
y.create.l HWIO_PERIPH_SS_BLSP1_BLSP_QUP1_QUP_INPUT_FIFO2_ADDR A:0xf9924220
y.create.l HWIO_PERIPH_SS_BLSP1_BLSP_QUP1_QUP_INPUT_FIFO3_ADDR A:0xf9924224
y.create.l HWIO_PERIPH_SS_BLSP1_BLSP_QUP1_QUP_INPUT_FIFO4_ADDR A:0xf9924228
y.create.l HWIO_PERIPH_SS_BLSP1_BLSP_QUP1_QUP_INPUT_FIFO5_ADDR A:0xf992422c
y.create.l HWIO_PERIPH_SS_BLSP1_BLSP_QUP1_QUP_INPUT_FIFO6_ADDR A:0xf9924230
y.create.l HWIO_PERIPH_SS_BLSP1_BLSP_QUP1_QUP_INPUT_FIFO7_ADDR A:0xf9924234
y.create.l HWIO_PERIPH_SS_BLSP1_BLSP_QUP1_QUP_INPUT_FIFO8_ADDR A:0xf9924238
y.create.l HWIO_PERIPH_SS_BLSP1_BLSP_QUP1_QUP_INPUT_FIFO9_ADDR A:0xf992423c
y.create.l HWIO_PERIPH_SS_BLSP1_BLSP_QUP1_SPI_CONFIG_ADDR A:0xf9924300
y.create.l HWIO_PERIPH_SS_BLSP1_BLSP_QUP1_SPI_IO_CONTROL_ADDR A:0xf9924304
y.create.l HWIO_PERIPH_SS_BLSP1_BLSP_QUP1_SPI_ERROR_FLAGS_ADDR A:0xf9924308
y.create.l HWIO_PERIPH_SS_BLSP1_BLSP_QUP1_SPI_ERROR_FLAGS_EN_ADDR A:0xf992430c
y.create.l HWIO_PERIPH_SS_BLSP1_BLSP_QUP1_SPI_DEASSERT_WAIT_ADDR A:0xf9924310
y.create.l HWIO_PERIPH_SS_BLSP1_BLSP_QUP1_SPI_MASTER_LOCAL_ID_ADDR A:0xf9924314
y.create.l HWIO_PERIPH_SS_BLSP1_BLSP_QUP1_SPI_MASTER_COMMAND_ADDR A:0xf9924318
y.create.l HWIO_PERIPH_SS_BLSP1_BLSP_QUP1_SPI_MASTER_STATUS_ADDR A:0xf992431c
y.create.l HWIO_PERIPH_SS_BLSP1_BLSP_QUP1_SPI_CHAR_CFG_ADDR A:0xf9924320
y.create.l HWIO_PERIPH_SS_BLSP1_BLSP_QUP1_SPI_CHAR_DATA_SPI_CS_ADDR A:0xf9924324
y.create.l HWIO_PERIPH_SS_BLSP1_BLSP_QUP1_SPI_CHAR_DATA_SPI_MOSI_ADDR A:0xf9924328
y.create.l HWIO_PERIPH_SS_BLSP1_BLSP_QUP1_SPI_CHAR_DATA_SPI_MISO_ADDR A:0xf992432c
y.create.l HWIO_PERIPH_SS_BLSP1_BLSP_QUP1_I2C_MASTER_CLK_CTL_ADDR A:0xf9924400
y.create.l HWIO_PERIPH_SS_BLSP1_BLSP_QUP1_I2C_MASTER_STATUS_ADDR A:0xf9924404
y.create.l HWIO_PERIPH_SS_BLSP1_BLSP_QUP1_I2C_MASTER_CONFIG_ADDR A:0xf9924408
y.create.l HWIO_PERIPH_SS_BLSP1_BLSP_QUP1_I2C_MASTER_BUS_CLEAR_ADDR A:0xf992440c
y.create.l HWIO_PERIPH_SS_BLSP1_BLSP_QUP1_I2C_MASTER_LOCAL_ID_ADDR A:0xf9924410
y.create.l HWIO_PERIPH_SS_BLSP1_BLSP_QUP1_I2C_MASTER_COMMAND_ADDR A:0xf9924414
y.create.l HWIO_PERIPH_SS_BLSP1_BLSP_QUP2_QUP_CONFIG_ADDR A:0xf9925000
y.create.l HWIO_PERIPH_SS_BLSP1_BLSP_QUP2_QUP_STATE_ADDR A:0xf9925004
y.create.l HWIO_PERIPH_SS_BLSP1_BLSP_QUP2_QUP_IO_MODES_ADDR A:0xf9925008
y.create.l HWIO_PERIPH_SS_BLSP1_BLSP_QUP2_QUP_SW_RESET_ADDR A:0xf992500c
y.create.l HWIO_PERIPH_SS_BLSP1_BLSP_QUP2_QUP_TRANSFER_CANCEL_ADDR A:0xf9925014
y.create.l HWIO_PERIPH_SS_BLSP1_BLSP_QUP2_QUP_OPERATIONAL_ADDR A:0xf9925018
y.create.l HWIO_PERIPH_SS_BLSP1_BLSP_QUP2_QUP_ERROR_FLAGS_ADDR A:0xf992501c
y.create.l HWIO_PERIPH_SS_BLSP1_BLSP_QUP2_QUP_ERROR_FLAGS_EN_ADDR A:0xf9925020
y.create.l HWIO_PERIPH_SS_BLSP1_BLSP_QUP2_QUP_TEST_CTRL_ADDR A:0xf9925024
y.create.l HWIO_PERIPH_SS_BLSP1_BLSP_QUP2_QUP_OPERATIONAL_MASK_ADDR A:0xf9925028
y.create.l HWIO_PERIPH_SS_BLSP1_BLSP_QUP2_QUP_HW_VERSION_ADDR A:0xf9925030
y.create.l HWIO_PERIPH_SS_BLSP1_BLSP_QUP2_QUP_MX_OUTPUT_COUNT_ADDR A:0xf9925100
y.create.l HWIO_PERIPH_SS_BLSP1_BLSP_QUP2_QUP_MX_OUTPUT_CNT_CURRENT_ADDR A:0xf9925104
y.create.l HWIO_PERIPH_SS_BLSP1_BLSP_QUP2_QUP_OUTPUT_DEBUG_ADDR A:0xf9925108
y.create.l HWIO_PERIPH_SS_BLSP1_BLSP_QUP2_QUP_OUTPUT_FIFO_WORD_CNT_ADDR A:0xf992510c
y.create.l HWIO_PERIPH_SS_BLSP1_BLSP_QUP2_QUP_OUTPUT_FIFO0_ADDR A:0xf9925110
y.create.l HWIO_PERIPH_SS_BLSP1_BLSP_QUP2_QUP_OUTPUT_FIFO1_ADDR A:0xf9925114
y.create.l HWIO_PERIPH_SS_BLSP1_BLSP_QUP2_QUP_OUTPUT_FIFO2_ADDR A:0xf9925118
y.create.l HWIO_PERIPH_SS_BLSP1_BLSP_QUP2_QUP_OUTPUT_FIFO3_ADDR A:0xf992511c
y.create.l HWIO_PERIPH_SS_BLSP1_BLSP_QUP2_QUP_OUTPUT_FIFO4_ADDR A:0xf9925120
y.create.l HWIO_PERIPH_SS_BLSP1_BLSP_QUP2_QUP_OUTPUT_FIFO5_ADDR A:0xf9925124
y.create.l HWIO_PERIPH_SS_BLSP1_BLSP_QUP2_QUP_OUTPUT_FIFO6_ADDR A:0xf9925128
y.create.l HWIO_PERIPH_SS_BLSP1_BLSP_QUP2_QUP_OUTPUT_FIFO7_ADDR A:0xf992512c
y.create.l HWIO_PERIPH_SS_BLSP1_BLSP_QUP2_QUP_OUTPUT_FIFO8_ADDR A:0xf9925130
y.create.l HWIO_PERIPH_SS_BLSP1_BLSP_QUP2_QUP_OUTPUT_FIFO9_ADDR A:0xf9925134
y.create.l HWIO_PERIPH_SS_BLSP1_BLSP_QUP2_QUP_MX_WRITE_COUNT_ADDR A:0xf9925150
y.create.l HWIO_PERIPH_SS_BLSP1_BLSP_QUP2_QUP_MX_WRITE_CNT_CURRENT_ADDR A:0xf9925154
y.create.l HWIO_PERIPH_SS_BLSP1_BLSP_QUP2_QUP_MX_INPUT_COUNT_ADDR A:0xf9925200
y.create.l HWIO_PERIPH_SS_BLSP1_BLSP_QUP2_QUP_MX_INPUT_CNT_CURRENT_ADDR A:0xf9925204
y.create.l HWIO_PERIPH_SS_BLSP1_BLSP_QUP2_QUP_MX_READ_COUNT_ADDR A:0xf9925208
y.create.l HWIO_PERIPH_SS_BLSP1_BLSP_QUP2_QUP_MX_READ_CNT_CURRENT_ADDR A:0xf992520c
y.create.l HWIO_PERIPH_SS_BLSP1_BLSP_QUP2_QUP_INPUT_DEBUG_ADDR A:0xf9925210
y.create.l HWIO_PERIPH_SS_BLSP1_BLSP_QUP2_QUP_INPUT_FIFO_WORD_CNT_ADDR A:0xf9925214
y.create.l HWIO_PERIPH_SS_BLSP1_BLSP_QUP2_QUP_INPUT_FIFO0_ADDR A:0xf9925218
y.create.l HWIO_PERIPH_SS_BLSP1_BLSP_QUP2_QUP_INPUT_FIFO1_ADDR A:0xf992521c
y.create.l HWIO_PERIPH_SS_BLSP1_BLSP_QUP2_QUP_INPUT_FIFO2_ADDR A:0xf9925220
y.create.l HWIO_PERIPH_SS_BLSP1_BLSP_QUP2_QUP_INPUT_FIFO3_ADDR A:0xf9925224
y.create.l HWIO_PERIPH_SS_BLSP1_BLSP_QUP2_QUP_INPUT_FIFO4_ADDR A:0xf9925228
y.create.l HWIO_PERIPH_SS_BLSP1_BLSP_QUP2_QUP_INPUT_FIFO5_ADDR A:0xf992522c
y.create.l HWIO_PERIPH_SS_BLSP1_BLSP_QUP2_QUP_INPUT_FIFO6_ADDR A:0xf9925230
y.create.l HWIO_PERIPH_SS_BLSP1_BLSP_QUP2_QUP_INPUT_FIFO7_ADDR A:0xf9925234
y.create.l HWIO_PERIPH_SS_BLSP1_BLSP_QUP2_QUP_INPUT_FIFO8_ADDR A:0xf9925238
y.create.l HWIO_PERIPH_SS_BLSP1_BLSP_QUP2_QUP_INPUT_FIFO9_ADDR A:0xf992523c
y.create.l HWIO_PERIPH_SS_BLSP1_BLSP_QUP2_SPI_CONFIG_ADDR A:0xf9925300
y.create.l HWIO_PERIPH_SS_BLSP1_BLSP_QUP2_SPI_IO_CONTROL_ADDR A:0xf9925304
y.create.l HWIO_PERIPH_SS_BLSP1_BLSP_QUP2_SPI_ERROR_FLAGS_ADDR A:0xf9925308
y.create.l HWIO_PERIPH_SS_BLSP1_BLSP_QUP2_SPI_ERROR_FLAGS_EN_ADDR A:0xf992530c
y.create.l HWIO_PERIPH_SS_BLSP1_BLSP_QUP2_SPI_DEASSERT_WAIT_ADDR A:0xf9925310
y.create.l HWIO_PERIPH_SS_BLSP1_BLSP_QUP2_SPI_MASTER_LOCAL_ID_ADDR A:0xf9925314
y.create.l HWIO_PERIPH_SS_BLSP1_BLSP_QUP2_SPI_MASTER_COMMAND_ADDR A:0xf9925318
y.create.l HWIO_PERIPH_SS_BLSP1_BLSP_QUP2_SPI_MASTER_STATUS_ADDR A:0xf992531c
y.create.l HWIO_PERIPH_SS_BLSP1_BLSP_QUP2_SPI_CHAR_CFG_ADDR A:0xf9925320
y.create.l HWIO_PERIPH_SS_BLSP1_BLSP_QUP2_SPI_CHAR_DATA_SPI_CS_ADDR A:0xf9925324
y.create.l HWIO_PERIPH_SS_BLSP1_BLSP_QUP2_SPI_CHAR_DATA_SPI_MOSI_ADDR A:0xf9925328
y.create.l HWIO_PERIPH_SS_BLSP1_BLSP_QUP2_SPI_CHAR_DATA_SPI_MISO_ADDR A:0xf992532c
y.create.l HWIO_PERIPH_SS_BLSP1_BLSP_QUP2_I2C_MASTER_CLK_CTL_ADDR A:0xf9925400
y.create.l HWIO_PERIPH_SS_BLSP1_BLSP_QUP2_I2C_MASTER_STATUS_ADDR A:0xf9925404
y.create.l HWIO_PERIPH_SS_BLSP1_BLSP_QUP2_I2C_MASTER_CONFIG_ADDR A:0xf9925408
y.create.l HWIO_PERIPH_SS_BLSP1_BLSP_QUP2_I2C_MASTER_BUS_CLEAR_ADDR A:0xf992540c
y.create.l HWIO_PERIPH_SS_BLSP1_BLSP_QUP2_I2C_MASTER_LOCAL_ID_ADDR A:0xf9925410
y.create.l HWIO_PERIPH_SS_BLSP1_BLSP_QUP2_I2C_MASTER_COMMAND_ADDR A:0xf9925414
y.create.l HWIO_PERIPH_SS_BLSP1_BLSP_QUP3_QUP_CONFIG_ADDR A:0xf9926000
y.create.l HWIO_PERIPH_SS_BLSP1_BLSP_QUP3_QUP_STATE_ADDR A:0xf9926004
y.create.l HWIO_PERIPH_SS_BLSP1_BLSP_QUP3_QUP_IO_MODES_ADDR A:0xf9926008
y.create.l HWIO_PERIPH_SS_BLSP1_BLSP_QUP3_QUP_SW_RESET_ADDR A:0xf992600c
y.create.l HWIO_PERIPH_SS_BLSP1_BLSP_QUP3_QUP_TRANSFER_CANCEL_ADDR A:0xf9926014
y.create.l HWIO_PERIPH_SS_BLSP1_BLSP_QUP3_QUP_OPERATIONAL_ADDR A:0xf9926018
y.create.l HWIO_PERIPH_SS_BLSP1_BLSP_QUP3_QUP_ERROR_FLAGS_ADDR A:0xf992601c
y.create.l HWIO_PERIPH_SS_BLSP1_BLSP_QUP3_QUP_ERROR_FLAGS_EN_ADDR A:0xf9926020
y.create.l HWIO_PERIPH_SS_BLSP1_BLSP_QUP3_QUP_TEST_CTRL_ADDR A:0xf9926024
y.create.l HWIO_PERIPH_SS_BLSP1_BLSP_QUP3_QUP_OPERATIONAL_MASK_ADDR A:0xf9926028
y.create.l HWIO_PERIPH_SS_BLSP1_BLSP_QUP3_QUP_HW_VERSION_ADDR A:0xf9926030
y.create.l HWIO_PERIPH_SS_BLSP1_BLSP_QUP3_QUP_MX_OUTPUT_COUNT_ADDR A:0xf9926100
y.create.l HWIO_PERIPH_SS_BLSP1_BLSP_QUP3_QUP_MX_OUTPUT_CNT_CURRENT_ADDR A:0xf9926104
y.create.l HWIO_PERIPH_SS_BLSP1_BLSP_QUP3_QUP_OUTPUT_DEBUG_ADDR A:0xf9926108
y.create.l HWIO_PERIPH_SS_BLSP1_BLSP_QUP3_QUP_OUTPUT_FIFO_WORD_CNT_ADDR A:0xf992610c
y.create.l HWIO_PERIPH_SS_BLSP1_BLSP_QUP3_QUP_OUTPUT_FIFO0_ADDR A:0xf9926110
y.create.l HWIO_PERIPH_SS_BLSP1_BLSP_QUP3_QUP_OUTPUT_FIFO1_ADDR A:0xf9926114
y.create.l HWIO_PERIPH_SS_BLSP1_BLSP_QUP3_QUP_OUTPUT_FIFO2_ADDR A:0xf9926118
y.create.l HWIO_PERIPH_SS_BLSP1_BLSP_QUP3_QUP_OUTPUT_FIFO3_ADDR A:0xf992611c
y.create.l HWIO_PERIPH_SS_BLSP1_BLSP_QUP3_QUP_OUTPUT_FIFO4_ADDR A:0xf9926120
y.create.l HWIO_PERIPH_SS_BLSP1_BLSP_QUP3_QUP_OUTPUT_FIFO5_ADDR A:0xf9926124
y.create.l HWIO_PERIPH_SS_BLSP1_BLSP_QUP3_QUP_OUTPUT_FIFO6_ADDR A:0xf9926128
y.create.l HWIO_PERIPH_SS_BLSP1_BLSP_QUP3_QUP_OUTPUT_FIFO7_ADDR A:0xf992612c
y.create.l HWIO_PERIPH_SS_BLSP1_BLSP_QUP3_QUP_OUTPUT_FIFO8_ADDR A:0xf9926130
y.create.l HWIO_PERIPH_SS_BLSP1_BLSP_QUP3_QUP_OUTPUT_FIFO9_ADDR A:0xf9926134
y.create.l HWIO_PERIPH_SS_BLSP1_BLSP_QUP3_QUP_MX_WRITE_COUNT_ADDR A:0xf9926150
y.create.l HWIO_PERIPH_SS_BLSP1_BLSP_QUP3_QUP_MX_WRITE_CNT_CURRENT_ADDR A:0xf9926154
y.create.l HWIO_PERIPH_SS_BLSP1_BLSP_QUP3_QUP_MX_INPUT_COUNT_ADDR A:0xf9926200
y.create.l HWIO_PERIPH_SS_BLSP1_BLSP_QUP3_QUP_MX_INPUT_CNT_CURRENT_ADDR A:0xf9926204
y.create.l HWIO_PERIPH_SS_BLSP1_BLSP_QUP3_QUP_MX_READ_COUNT_ADDR A:0xf9926208
y.create.l HWIO_PERIPH_SS_BLSP1_BLSP_QUP3_QUP_MX_READ_CNT_CURRENT_ADDR A:0xf992620c
y.create.l HWIO_PERIPH_SS_BLSP1_BLSP_QUP3_QUP_INPUT_DEBUG_ADDR A:0xf9926210
y.create.l HWIO_PERIPH_SS_BLSP1_BLSP_QUP3_QUP_INPUT_FIFO_WORD_CNT_ADDR A:0xf9926214
y.create.l HWIO_PERIPH_SS_BLSP1_BLSP_QUP3_QUP_INPUT_FIFO0_ADDR A:0xf9926218
y.create.l HWIO_PERIPH_SS_BLSP1_BLSP_QUP3_QUP_INPUT_FIFO1_ADDR A:0xf992621c
y.create.l HWIO_PERIPH_SS_BLSP1_BLSP_QUP3_QUP_INPUT_FIFO2_ADDR A:0xf9926220
y.create.l HWIO_PERIPH_SS_BLSP1_BLSP_QUP3_QUP_INPUT_FIFO3_ADDR A:0xf9926224
y.create.l HWIO_PERIPH_SS_BLSP1_BLSP_QUP3_QUP_INPUT_FIFO4_ADDR A:0xf9926228
y.create.l HWIO_PERIPH_SS_BLSP1_BLSP_QUP3_QUP_INPUT_FIFO5_ADDR A:0xf992622c
y.create.l HWIO_PERIPH_SS_BLSP1_BLSP_QUP3_QUP_INPUT_FIFO6_ADDR A:0xf9926230
y.create.l HWIO_PERIPH_SS_BLSP1_BLSP_QUP3_QUP_INPUT_FIFO7_ADDR A:0xf9926234
y.create.l HWIO_PERIPH_SS_BLSP1_BLSP_QUP3_QUP_INPUT_FIFO8_ADDR A:0xf9926238
y.create.l HWIO_PERIPH_SS_BLSP1_BLSP_QUP3_QUP_INPUT_FIFO9_ADDR A:0xf992623c
y.create.l HWIO_PERIPH_SS_BLSP1_BLSP_QUP3_SPI_CONFIG_ADDR A:0xf9926300
y.create.l HWIO_PERIPH_SS_BLSP1_BLSP_QUP3_SPI_IO_CONTROL_ADDR A:0xf9926304
y.create.l HWIO_PERIPH_SS_BLSP1_BLSP_QUP3_SPI_ERROR_FLAGS_ADDR A:0xf9926308
y.create.l HWIO_PERIPH_SS_BLSP1_BLSP_QUP3_SPI_ERROR_FLAGS_EN_ADDR A:0xf992630c
y.create.l HWIO_PERIPH_SS_BLSP1_BLSP_QUP3_SPI_DEASSERT_WAIT_ADDR A:0xf9926310
y.create.l HWIO_PERIPH_SS_BLSP1_BLSP_QUP3_SPI_MASTER_LOCAL_ID_ADDR A:0xf9926314
y.create.l HWIO_PERIPH_SS_BLSP1_BLSP_QUP3_SPI_MASTER_COMMAND_ADDR A:0xf9926318
y.create.l HWIO_PERIPH_SS_BLSP1_BLSP_QUP3_SPI_MASTER_STATUS_ADDR A:0xf992631c
y.create.l HWIO_PERIPH_SS_BLSP1_BLSP_QUP3_SPI_CHAR_CFG_ADDR A:0xf9926320
y.create.l HWIO_PERIPH_SS_BLSP1_BLSP_QUP3_SPI_CHAR_DATA_SPI_CS_ADDR A:0xf9926324
y.create.l HWIO_PERIPH_SS_BLSP1_BLSP_QUP3_SPI_CHAR_DATA_SPI_MOSI_ADDR A:0xf9926328
y.create.l HWIO_PERIPH_SS_BLSP1_BLSP_QUP3_SPI_CHAR_DATA_SPI_MISO_ADDR A:0xf992632c
y.create.l HWIO_PERIPH_SS_BLSP1_BLSP_QUP3_I2C_MASTER_CLK_CTL_ADDR A:0xf9926400
y.create.l HWIO_PERIPH_SS_BLSP1_BLSP_QUP3_I2C_MASTER_STATUS_ADDR A:0xf9926404
y.create.l HWIO_PERIPH_SS_BLSP1_BLSP_QUP3_I2C_MASTER_CONFIG_ADDR A:0xf9926408
y.create.l HWIO_PERIPH_SS_BLSP1_BLSP_QUP3_I2C_MASTER_BUS_CLEAR_ADDR A:0xf992640c
y.create.l HWIO_PERIPH_SS_BLSP1_BLSP_QUP3_I2C_MASTER_LOCAL_ID_ADDR A:0xf9926410
y.create.l HWIO_PERIPH_SS_BLSP1_BLSP_QUP3_I2C_MASTER_COMMAND_ADDR A:0xf9926414
y.create.l HWIO_PERIPH_SS_BLSP1_BLSP_QUP4_QUP_CONFIG_ADDR A:0xf9927000
y.create.l HWIO_PERIPH_SS_BLSP1_BLSP_QUP4_QUP_STATE_ADDR A:0xf9927004
y.create.l HWIO_PERIPH_SS_BLSP1_BLSP_QUP4_QUP_IO_MODES_ADDR A:0xf9927008
y.create.l HWIO_PERIPH_SS_BLSP1_BLSP_QUP4_QUP_SW_RESET_ADDR A:0xf992700c
y.create.l HWIO_PERIPH_SS_BLSP1_BLSP_QUP4_QUP_TRANSFER_CANCEL_ADDR A:0xf9927014
y.create.l HWIO_PERIPH_SS_BLSP1_BLSP_QUP4_QUP_OPERATIONAL_ADDR A:0xf9927018
y.create.l HWIO_PERIPH_SS_BLSP1_BLSP_QUP4_QUP_ERROR_FLAGS_ADDR A:0xf992701c
y.create.l HWIO_PERIPH_SS_BLSP1_BLSP_QUP4_QUP_ERROR_FLAGS_EN_ADDR A:0xf9927020
y.create.l HWIO_PERIPH_SS_BLSP1_BLSP_QUP4_QUP_TEST_CTRL_ADDR A:0xf9927024
y.create.l HWIO_PERIPH_SS_BLSP1_BLSP_QUP4_QUP_OPERATIONAL_MASK_ADDR A:0xf9927028
y.create.l HWIO_PERIPH_SS_BLSP1_BLSP_QUP4_QUP_HW_VERSION_ADDR A:0xf9927030
y.create.l HWIO_PERIPH_SS_BLSP1_BLSP_QUP4_QUP_MX_OUTPUT_COUNT_ADDR A:0xf9927100
y.create.l HWIO_PERIPH_SS_BLSP1_BLSP_QUP4_QUP_MX_OUTPUT_CNT_CURRENT_ADDR A:0xf9927104
y.create.l HWIO_PERIPH_SS_BLSP1_BLSP_QUP4_QUP_OUTPUT_DEBUG_ADDR A:0xf9927108
y.create.l HWIO_PERIPH_SS_BLSP1_BLSP_QUP4_QUP_OUTPUT_FIFO_WORD_CNT_ADDR A:0xf992710c
y.create.l HWIO_PERIPH_SS_BLSP1_BLSP_QUP4_QUP_OUTPUT_FIFO0_ADDR A:0xf9927110
y.create.l HWIO_PERIPH_SS_BLSP1_BLSP_QUP4_QUP_OUTPUT_FIFO1_ADDR A:0xf9927114
y.create.l HWIO_PERIPH_SS_BLSP1_BLSP_QUP4_QUP_OUTPUT_FIFO2_ADDR A:0xf9927118
y.create.l HWIO_PERIPH_SS_BLSP1_BLSP_QUP4_QUP_OUTPUT_FIFO3_ADDR A:0xf992711c
y.create.l HWIO_PERIPH_SS_BLSP1_BLSP_QUP4_QUP_OUTPUT_FIFO4_ADDR A:0xf9927120
y.create.l HWIO_PERIPH_SS_BLSP1_BLSP_QUP4_QUP_OUTPUT_FIFO5_ADDR A:0xf9927124
y.create.l HWIO_PERIPH_SS_BLSP1_BLSP_QUP4_QUP_OUTPUT_FIFO6_ADDR A:0xf9927128
y.create.l HWIO_PERIPH_SS_BLSP1_BLSP_QUP4_QUP_OUTPUT_FIFO7_ADDR A:0xf992712c
y.create.l HWIO_PERIPH_SS_BLSP1_BLSP_QUP4_QUP_OUTPUT_FIFO8_ADDR A:0xf9927130
y.create.l HWIO_PERIPH_SS_BLSP1_BLSP_QUP4_QUP_OUTPUT_FIFO9_ADDR A:0xf9927134
y.create.l HWIO_PERIPH_SS_BLSP1_BLSP_QUP4_QUP_MX_WRITE_COUNT_ADDR A:0xf9927150
y.create.l HWIO_PERIPH_SS_BLSP1_BLSP_QUP4_QUP_MX_WRITE_CNT_CURRENT_ADDR A:0xf9927154
y.create.l HWIO_PERIPH_SS_BLSP1_BLSP_QUP4_QUP_MX_INPUT_COUNT_ADDR A:0xf9927200
y.create.l HWIO_PERIPH_SS_BLSP1_BLSP_QUP4_QUP_MX_INPUT_CNT_CURRENT_ADDR A:0xf9927204
y.create.l HWIO_PERIPH_SS_BLSP1_BLSP_QUP4_QUP_MX_READ_COUNT_ADDR A:0xf9927208
y.create.l HWIO_PERIPH_SS_BLSP1_BLSP_QUP4_QUP_MX_READ_CNT_CURRENT_ADDR A:0xf992720c
y.create.l HWIO_PERIPH_SS_BLSP1_BLSP_QUP4_QUP_INPUT_DEBUG_ADDR A:0xf9927210
y.create.l HWIO_PERIPH_SS_BLSP1_BLSP_QUP4_QUP_INPUT_FIFO_WORD_CNT_ADDR A:0xf9927214
y.create.l HWIO_PERIPH_SS_BLSP1_BLSP_QUP4_QUP_INPUT_FIFO0_ADDR A:0xf9927218
y.create.l HWIO_PERIPH_SS_BLSP1_BLSP_QUP4_QUP_INPUT_FIFO1_ADDR A:0xf992721c
y.create.l HWIO_PERIPH_SS_BLSP1_BLSP_QUP4_QUP_INPUT_FIFO2_ADDR A:0xf9927220
y.create.l HWIO_PERIPH_SS_BLSP1_BLSP_QUP4_QUP_INPUT_FIFO3_ADDR A:0xf9927224
y.create.l HWIO_PERIPH_SS_BLSP1_BLSP_QUP4_QUP_INPUT_FIFO4_ADDR A:0xf9927228
y.create.l HWIO_PERIPH_SS_BLSP1_BLSP_QUP4_QUP_INPUT_FIFO5_ADDR A:0xf992722c
y.create.l HWIO_PERIPH_SS_BLSP1_BLSP_QUP4_QUP_INPUT_FIFO6_ADDR A:0xf9927230
y.create.l HWIO_PERIPH_SS_BLSP1_BLSP_QUP4_QUP_INPUT_FIFO7_ADDR A:0xf9927234
y.create.l HWIO_PERIPH_SS_BLSP1_BLSP_QUP4_QUP_INPUT_FIFO8_ADDR A:0xf9927238
y.create.l HWIO_PERIPH_SS_BLSP1_BLSP_QUP4_QUP_INPUT_FIFO9_ADDR A:0xf992723c
y.create.l HWIO_PERIPH_SS_BLSP1_BLSP_QUP4_SPI_CONFIG_ADDR A:0xf9927300
y.create.l HWIO_PERIPH_SS_BLSP1_BLSP_QUP4_SPI_IO_CONTROL_ADDR A:0xf9927304
y.create.l HWIO_PERIPH_SS_BLSP1_BLSP_QUP4_SPI_ERROR_FLAGS_ADDR A:0xf9927308
y.create.l HWIO_PERIPH_SS_BLSP1_BLSP_QUP4_SPI_ERROR_FLAGS_EN_ADDR A:0xf992730c
y.create.l HWIO_PERIPH_SS_BLSP1_BLSP_QUP4_SPI_DEASSERT_WAIT_ADDR A:0xf9927310
y.create.l HWIO_PERIPH_SS_BLSP1_BLSP_QUP4_SPI_MASTER_LOCAL_ID_ADDR A:0xf9927314
y.create.l HWIO_PERIPH_SS_BLSP1_BLSP_QUP4_SPI_MASTER_COMMAND_ADDR A:0xf9927318
y.create.l HWIO_PERIPH_SS_BLSP1_BLSP_QUP4_SPI_MASTER_STATUS_ADDR A:0xf992731c
y.create.l HWIO_PERIPH_SS_BLSP1_BLSP_QUP4_SPI_CHAR_CFG_ADDR A:0xf9927320
y.create.l HWIO_PERIPH_SS_BLSP1_BLSP_QUP4_SPI_CHAR_DATA_SPI_CS_ADDR A:0xf9927324
y.create.l HWIO_PERIPH_SS_BLSP1_BLSP_QUP4_SPI_CHAR_DATA_SPI_MOSI_ADDR A:0xf9927328
y.create.l HWIO_PERIPH_SS_BLSP1_BLSP_QUP4_SPI_CHAR_DATA_SPI_MISO_ADDR A:0xf992732c
y.create.l HWIO_PERIPH_SS_BLSP1_BLSP_QUP4_I2C_MASTER_CLK_CTL_ADDR A:0xf9927400
y.create.l HWIO_PERIPH_SS_BLSP1_BLSP_QUP4_I2C_MASTER_STATUS_ADDR A:0xf9927404
y.create.l HWIO_PERIPH_SS_BLSP1_BLSP_QUP4_I2C_MASTER_CONFIG_ADDR A:0xf9927408
y.create.l HWIO_PERIPH_SS_BLSP1_BLSP_QUP4_I2C_MASTER_BUS_CLEAR_ADDR A:0xf992740c
y.create.l HWIO_PERIPH_SS_BLSP1_BLSP_QUP4_I2C_MASTER_LOCAL_ID_ADDR A:0xf9927410
y.create.l HWIO_PERIPH_SS_BLSP1_BLSP_QUP4_I2C_MASTER_COMMAND_ADDR A:0xf9927414
y.create.l HWIO_PERIPH_SS_BLSP1_BLSP_QUP5_QUP_CONFIG_ADDR A:0xf9928000
y.create.l HWIO_PERIPH_SS_BLSP1_BLSP_QUP5_QUP_STATE_ADDR A:0xf9928004
y.create.l HWIO_PERIPH_SS_BLSP1_BLSP_QUP5_QUP_IO_MODES_ADDR A:0xf9928008
y.create.l HWIO_PERIPH_SS_BLSP1_BLSP_QUP5_QUP_SW_RESET_ADDR A:0xf992800c
y.create.l HWIO_PERIPH_SS_BLSP1_BLSP_QUP5_QUP_TRANSFER_CANCEL_ADDR A:0xf9928014
y.create.l HWIO_PERIPH_SS_BLSP1_BLSP_QUP5_QUP_OPERATIONAL_ADDR A:0xf9928018
y.create.l HWIO_PERIPH_SS_BLSP1_BLSP_QUP5_QUP_ERROR_FLAGS_ADDR A:0xf992801c
y.create.l HWIO_PERIPH_SS_BLSP1_BLSP_QUP5_QUP_ERROR_FLAGS_EN_ADDR A:0xf9928020
y.create.l HWIO_PERIPH_SS_BLSP1_BLSP_QUP5_QUP_TEST_CTRL_ADDR A:0xf9928024
y.create.l HWIO_PERIPH_SS_BLSP1_BLSP_QUP5_QUP_OPERATIONAL_MASK_ADDR A:0xf9928028
y.create.l HWIO_PERIPH_SS_BLSP1_BLSP_QUP5_QUP_HW_VERSION_ADDR A:0xf9928030
y.create.l HWIO_PERIPH_SS_BLSP1_BLSP_QUP5_QUP_MX_OUTPUT_COUNT_ADDR A:0xf9928100
y.create.l HWIO_PERIPH_SS_BLSP1_BLSP_QUP5_QUP_MX_OUTPUT_CNT_CURRENT_ADDR A:0xf9928104
y.create.l HWIO_PERIPH_SS_BLSP1_BLSP_QUP5_QUP_OUTPUT_DEBUG_ADDR A:0xf9928108
y.create.l HWIO_PERIPH_SS_BLSP1_BLSP_QUP5_QUP_OUTPUT_FIFO_WORD_CNT_ADDR A:0xf992810c
y.create.l HWIO_PERIPH_SS_BLSP1_BLSP_QUP5_QUP_OUTPUT_FIFO0_ADDR A:0xf9928110
y.create.l HWIO_PERIPH_SS_BLSP1_BLSP_QUP5_QUP_OUTPUT_FIFO1_ADDR A:0xf9928114
y.create.l HWIO_PERIPH_SS_BLSP1_BLSP_QUP5_QUP_OUTPUT_FIFO2_ADDR A:0xf9928118
y.create.l HWIO_PERIPH_SS_BLSP1_BLSP_QUP5_QUP_OUTPUT_FIFO3_ADDR A:0xf992811c
y.create.l HWIO_PERIPH_SS_BLSP1_BLSP_QUP5_QUP_OUTPUT_FIFO4_ADDR A:0xf9928120
y.create.l HWIO_PERIPH_SS_BLSP1_BLSP_QUP5_QUP_OUTPUT_FIFO5_ADDR A:0xf9928124
y.create.l HWIO_PERIPH_SS_BLSP1_BLSP_QUP5_QUP_OUTPUT_FIFO6_ADDR A:0xf9928128
y.create.l HWIO_PERIPH_SS_BLSP1_BLSP_QUP5_QUP_OUTPUT_FIFO7_ADDR A:0xf992812c
y.create.l HWIO_PERIPH_SS_BLSP1_BLSP_QUP5_QUP_OUTPUT_FIFO8_ADDR A:0xf9928130
y.create.l HWIO_PERIPH_SS_BLSP1_BLSP_QUP5_QUP_OUTPUT_FIFO9_ADDR A:0xf9928134
y.create.l HWIO_PERIPH_SS_BLSP1_BLSP_QUP5_QUP_MX_WRITE_COUNT_ADDR A:0xf9928150
y.create.l HWIO_PERIPH_SS_BLSP1_BLSP_QUP5_QUP_MX_WRITE_CNT_CURRENT_ADDR A:0xf9928154
y.create.l HWIO_PERIPH_SS_BLSP1_BLSP_QUP5_QUP_MX_INPUT_COUNT_ADDR A:0xf9928200
y.create.l HWIO_PERIPH_SS_BLSP1_BLSP_QUP5_QUP_MX_INPUT_CNT_CURRENT_ADDR A:0xf9928204
y.create.l HWIO_PERIPH_SS_BLSP1_BLSP_QUP5_QUP_MX_READ_COUNT_ADDR A:0xf9928208
y.create.l HWIO_PERIPH_SS_BLSP1_BLSP_QUP5_QUP_MX_READ_CNT_CURRENT_ADDR A:0xf992820c
y.create.l HWIO_PERIPH_SS_BLSP1_BLSP_QUP5_QUP_INPUT_DEBUG_ADDR A:0xf9928210
y.create.l HWIO_PERIPH_SS_BLSP1_BLSP_QUP5_QUP_INPUT_FIFO_WORD_CNT_ADDR A:0xf9928214
y.create.l HWIO_PERIPH_SS_BLSP1_BLSP_QUP5_QUP_INPUT_FIFO0_ADDR A:0xf9928218
y.create.l HWIO_PERIPH_SS_BLSP1_BLSP_QUP5_QUP_INPUT_FIFO1_ADDR A:0xf992821c
y.create.l HWIO_PERIPH_SS_BLSP1_BLSP_QUP5_QUP_INPUT_FIFO2_ADDR A:0xf9928220
y.create.l HWIO_PERIPH_SS_BLSP1_BLSP_QUP5_QUP_INPUT_FIFO3_ADDR A:0xf9928224
y.create.l HWIO_PERIPH_SS_BLSP1_BLSP_QUP5_QUP_INPUT_FIFO4_ADDR A:0xf9928228
y.create.l HWIO_PERIPH_SS_BLSP1_BLSP_QUP5_QUP_INPUT_FIFO5_ADDR A:0xf992822c
y.create.l HWIO_PERIPH_SS_BLSP1_BLSP_QUP5_QUP_INPUT_FIFO6_ADDR A:0xf9928230
y.create.l HWIO_PERIPH_SS_BLSP1_BLSP_QUP5_QUP_INPUT_FIFO7_ADDR A:0xf9928234
y.create.l HWIO_PERIPH_SS_BLSP1_BLSP_QUP5_QUP_INPUT_FIFO8_ADDR A:0xf9928238
y.create.l HWIO_PERIPH_SS_BLSP1_BLSP_QUP5_QUP_INPUT_FIFO9_ADDR A:0xf992823c
y.create.l HWIO_PERIPH_SS_BLSP1_BLSP_QUP5_SPI_CONFIG_ADDR A:0xf9928300
y.create.l HWIO_PERIPH_SS_BLSP1_BLSP_QUP5_SPI_IO_CONTROL_ADDR A:0xf9928304
y.create.l HWIO_PERIPH_SS_BLSP1_BLSP_QUP5_SPI_ERROR_FLAGS_ADDR A:0xf9928308
y.create.l HWIO_PERIPH_SS_BLSP1_BLSP_QUP5_SPI_ERROR_FLAGS_EN_ADDR A:0xf992830c
y.create.l HWIO_PERIPH_SS_BLSP1_BLSP_QUP5_SPI_DEASSERT_WAIT_ADDR A:0xf9928310
y.create.l HWIO_PERIPH_SS_BLSP1_BLSP_QUP5_SPI_MASTER_LOCAL_ID_ADDR A:0xf9928314
y.create.l HWIO_PERIPH_SS_BLSP1_BLSP_QUP5_SPI_MASTER_COMMAND_ADDR A:0xf9928318
y.create.l HWIO_PERIPH_SS_BLSP1_BLSP_QUP5_SPI_MASTER_STATUS_ADDR A:0xf992831c
y.create.l HWIO_PERIPH_SS_BLSP1_BLSP_QUP5_SPI_CHAR_CFG_ADDR A:0xf9928320
y.create.l HWIO_PERIPH_SS_BLSP1_BLSP_QUP5_SPI_CHAR_DATA_SPI_CS_ADDR A:0xf9928324
y.create.l HWIO_PERIPH_SS_BLSP1_BLSP_QUP5_SPI_CHAR_DATA_SPI_MOSI_ADDR A:0xf9928328
y.create.l HWIO_PERIPH_SS_BLSP1_BLSP_QUP5_SPI_CHAR_DATA_SPI_MISO_ADDR A:0xf992832c
y.create.l HWIO_PERIPH_SS_BLSP1_BLSP_QUP5_I2C_MASTER_CLK_CTL_ADDR A:0xf9928400
y.create.l HWIO_PERIPH_SS_BLSP1_BLSP_QUP5_I2C_MASTER_STATUS_ADDR A:0xf9928404
y.create.l HWIO_PERIPH_SS_BLSP1_BLSP_QUP5_I2C_MASTER_CONFIG_ADDR A:0xf9928408
y.create.l HWIO_PERIPH_SS_BLSP1_BLSP_QUP5_I2C_MASTER_BUS_CLEAR_ADDR A:0xf992840c
y.create.l HWIO_PERIPH_SS_BLSP1_BLSP_QUP5_I2C_MASTER_LOCAL_ID_ADDR A:0xf9928410
y.create.l HWIO_PERIPH_SS_BLSP1_BLSP_QUP5_I2C_MASTER_COMMAND_ADDR A:0xf9928414
y.create.l HWIO_PERIPH_SS_BAM_DMA_BAM_CTRL_ADDR A:0xf9984000
y.create.l HWIO_PERIPH_SS_BAM_DMA_BAM_REVISION_ADDR A:0xf9984004
y.create.l HWIO_PERIPH_SS_BAM_DMA_BAM_SW_VERSION_ADDR A:0xf9984080
y.create.l HWIO_PERIPH_SS_BAM_DMA_BAM_NUM_PIPES_ADDR A:0xf998403c
y.create.l HWIO_PERIPH_SS_BAM_DMA_BAM_TIMER_ADDR A:0xf9984040
y.create.l HWIO_PERIPH_SS_BAM_DMA_BAM_TIMER_CTRL_ADDR A:0xf9984044
y.create.l HWIO_PERIPH_SS_BAM_DMA_BAM_DESC_CNT_TRSHLD_ADDR A:0xf9984008
y.create.l HWIO_PERIPH_SS_BAM_DMA_BAM_IRQ_SRCS_ADDR A:0xf998400c
y.create.l HWIO_PERIPH_SS_BAM_DMA_BAM_IRQ_SRCS_MSK_ADDR A:0xf9984010
y.create.l HWIO_PERIPH_SS_BAM_DMA_BAM_IRQ_SRCS_UNMASKED_ADDR A:0xf9984030
y.create.l HWIO_PERIPH_SS_BAM_DMA_BAM_IRQ_STTS_ADDR A:0xf9984014
y.create.l HWIO_PERIPH_SS_BAM_DMA_BAM_IRQ_CLR_ADDR A:0xf9984018
y.create.l HWIO_PERIPH_SS_BAM_DMA_BAM_IRQ_EN_ADDR A:0xf998401c
y.create.l HWIO_PERIPH_SS_BAM_DMA_BAM_AHB_MASTER_ERR_CTRLS_ADDR A:0xf9984024
y.create.l HWIO_PERIPH_SS_BAM_DMA_BAM_AHB_MASTER_ERR_ADDR_ADDR A:0xf9984028
y.create.l HWIO_PERIPH_SS_BAM_DMA_BAM_AHB_MASTER_ERR_ADDR_LSB_ADDR A:0xf9984100
y.create.l HWIO_PERIPH_SS_BAM_DMA_BAM_AHB_MASTER_ERR_ADDR_MSB_ADDR A:0xf9984104
y.create.l HWIO_PERIPH_SS_BAM_DMA_BAM_AHB_MASTER_ERR_DATA_ADDR A:0xf998402c
y.create.l HWIO_PERIPH_SS_BAM_DMA_BAM_TRUST_REG_ADDR A:0xf9984070
y.create.l HWIO_PERIPH_SS_BAM_DMA_BAM_TEST_BUS_SEL_ADDR A:0xf9984074
y.create.l HWIO_PERIPH_SS_BAM_DMA_BAM_TEST_BUS_REG_ADDR A:0xf9984078
y.create.l HWIO_PERIPH_SS_BAM_DMA_BAM_CNFG_BITS_ADDR A:0xf998407c
y.create.l HWIO_PERIPH_SS_BAM_DMA_BAM_IRQ_SRCS_EE0_ADDR A:0xf9984800
y.create.l HWIO_PERIPH_SS_BAM_DMA_BAM_IRQ_SRCS_EE1_ADDR A:0xf9984880
y.create.l HWIO_PERIPH_SS_BAM_DMA_BAM_IRQ_SRCS_EE2_ADDR A:0xf9984900
y.create.l HWIO_PERIPH_SS_BAM_DMA_BAM_IRQ_SRCS_EE3_ADDR A:0xf9984980
y.create.l HWIO_PERIPH_SS_BAM_DMA_BAM_IRQ_SRCS_EE4_ADDR A:0xf9984a00
y.create.l HWIO_PERIPH_SS_BAM_DMA_BAM_IRQ_SRCS_EE5_ADDR A:0xf9984a80
y.create.l HWIO_PERIPH_SS_BAM_DMA_BAM_IRQ_SRCS_EE6_ADDR A:0xf9984b00
y.create.l HWIO_PERIPH_SS_BAM_DMA_BAM_IRQ_SRCS_EE7_ADDR A:0xf9984b80
y.create.l HWIO_PERIPH_SS_BAM_DMA_BAM_IRQ_SRCS_MSK_EE0_ADDR A:0xf9984804
y.create.l HWIO_PERIPH_SS_BAM_DMA_BAM_IRQ_SRCS_MSK_EE1_ADDR A:0xf9984884
y.create.l HWIO_PERIPH_SS_BAM_DMA_BAM_IRQ_SRCS_MSK_EE2_ADDR A:0xf9984904
y.create.l HWIO_PERIPH_SS_BAM_DMA_BAM_IRQ_SRCS_MSK_EE3_ADDR A:0xf9984984
y.create.l HWIO_PERIPH_SS_BAM_DMA_BAM_IRQ_SRCS_MSK_EE4_ADDR A:0xf9984a04
y.create.l HWIO_PERIPH_SS_BAM_DMA_BAM_IRQ_SRCS_MSK_EE5_ADDR A:0xf9984a84
y.create.l HWIO_PERIPH_SS_BAM_DMA_BAM_IRQ_SRCS_MSK_EE6_ADDR A:0xf9984b04
y.create.l HWIO_PERIPH_SS_BAM_DMA_BAM_IRQ_SRCS_MSK_EE7_ADDR A:0xf9984b84
y.create.l HWIO_PERIPH_SS_BAM_DMA_BAM_IRQ_SRCS_UNMASKED_EE0_ADDR A:0xf9984808
y.create.l HWIO_PERIPH_SS_BAM_DMA_BAM_IRQ_SRCS_UNMASKED_EE1_ADDR A:0xf9984888
y.create.l HWIO_PERIPH_SS_BAM_DMA_BAM_IRQ_SRCS_UNMASKED_EE2_ADDR A:0xf9984908
y.create.l HWIO_PERIPH_SS_BAM_DMA_BAM_IRQ_SRCS_UNMASKED_EE3_ADDR A:0xf9984988
y.create.l HWIO_PERIPH_SS_BAM_DMA_BAM_IRQ_SRCS_UNMASKED_EE4_ADDR A:0xf9984a08
y.create.l HWIO_PERIPH_SS_BAM_DMA_BAM_IRQ_SRCS_UNMASKED_EE5_ADDR A:0xf9984a88
y.create.l HWIO_PERIPH_SS_BAM_DMA_BAM_IRQ_SRCS_UNMASKED_EE6_ADDR A:0xf9984b08
y.create.l HWIO_PERIPH_SS_BAM_DMA_BAM_IRQ_SRCS_UNMASKED_EE7_ADDR A:0xf9984b88
y.create.l HWIO_PERIPH_SS_BAM_DMA_BAM_PIPE_ATTR_EE0_ADDR A:0xf998480c
y.create.l HWIO_PERIPH_SS_BAM_DMA_BAM_PIPE_ATTR_EE1_ADDR A:0xf998488c
y.create.l HWIO_PERIPH_SS_BAM_DMA_BAM_PIPE_ATTR_EE2_ADDR A:0xf998490c
y.create.l HWIO_PERIPH_SS_BAM_DMA_BAM_PIPE_ATTR_EE3_ADDR A:0xf998498c
y.create.l HWIO_PERIPH_SS_BAM_DMA_BAM_PIPE_ATTR_EE4_ADDR A:0xf9984a0c
y.create.l HWIO_PERIPH_SS_BAM_DMA_BAM_PIPE_ATTR_EE5_ADDR A:0xf9984a8c
y.create.l HWIO_PERIPH_SS_BAM_DMA_BAM_PIPE_ATTR_EE6_ADDR A:0xf9984b0c
y.create.l HWIO_PERIPH_SS_BAM_DMA_BAM_PIPE_ATTR_EE7_ADDR A:0xf9984b8c
y.create.l HWIO_PERIPH_SS_BAM_DMA_BAM_P_CTRL0_ADDR A:0xf9985000
y.create.l HWIO_PERIPH_SS_BAM_DMA_BAM_P_CTRL1_ADDR A:0xf9986000
y.create.l HWIO_PERIPH_SS_BAM_DMA_BAM_P_CTRL2_ADDR A:0xf9987000
y.create.l HWIO_PERIPH_SS_BAM_DMA_BAM_P_CTRL3_ADDR A:0xf9988000
y.create.l HWIO_PERIPH_SS_BAM_DMA_BAM_P_CTRL4_ADDR A:0xf9989000
y.create.l HWIO_PERIPH_SS_BAM_DMA_BAM_P_CTRL5_ADDR A:0xf998a000
y.create.l HWIO_PERIPH_SS_BAM_DMA_BAM_P_CTRL6_ADDR A:0xf998b000
y.create.l HWIO_PERIPH_SS_BAM_DMA_BAM_P_CTRL7_ADDR A:0xf998c000
y.create.l HWIO_PERIPH_SS_BAM_DMA_BAM_P_CTRL8_ADDR A:0xf998d000
y.create.l HWIO_PERIPH_SS_BAM_DMA_BAM_P_CTRL9_ADDR A:0xf998e000
y.create.l HWIO_PERIPH_SS_BAM_DMA_BAM_P_RST0_ADDR A:0xf9985004
y.create.l HWIO_PERIPH_SS_BAM_DMA_BAM_P_RST1_ADDR A:0xf9986004
y.create.l HWIO_PERIPH_SS_BAM_DMA_BAM_P_RST2_ADDR A:0xf9987004
y.create.l HWIO_PERIPH_SS_BAM_DMA_BAM_P_RST3_ADDR A:0xf9988004
y.create.l HWIO_PERIPH_SS_BAM_DMA_BAM_P_RST4_ADDR A:0xf9989004
y.create.l HWIO_PERIPH_SS_BAM_DMA_BAM_P_RST5_ADDR A:0xf998a004
y.create.l HWIO_PERIPH_SS_BAM_DMA_BAM_P_RST6_ADDR A:0xf998b004
y.create.l HWIO_PERIPH_SS_BAM_DMA_BAM_P_RST7_ADDR A:0xf998c004
y.create.l HWIO_PERIPH_SS_BAM_DMA_BAM_P_RST8_ADDR A:0xf998d004
y.create.l HWIO_PERIPH_SS_BAM_DMA_BAM_P_RST9_ADDR A:0xf998e004
y.create.l HWIO_PERIPH_SS_BAM_DMA_BAM_P_HALT0_ADDR A:0xf9985008
y.create.l HWIO_PERIPH_SS_BAM_DMA_BAM_P_HALT1_ADDR A:0xf9986008
y.create.l HWIO_PERIPH_SS_BAM_DMA_BAM_P_HALT2_ADDR A:0xf9987008
y.create.l HWIO_PERIPH_SS_BAM_DMA_BAM_P_HALT3_ADDR A:0xf9988008
y.create.l HWIO_PERIPH_SS_BAM_DMA_BAM_P_HALT4_ADDR A:0xf9989008
y.create.l HWIO_PERIPH_SS_BAM_DMA_BAM_P_HALT5_ADDR A:0xf998a008
y.create.l HWIO_PERIPH_SS_BAM_DMA_BAM_P_HALT6_ADDR A:0xf998b008
y.create.l HWIO_PERIPH_SS_BAM_DMA_BAM_P_HALT7_ADDR A:0xf998c008
y.create.l HWIO_PERIPH_SS_BAM_DMA_BAM_P_HALT8_ADDR A:0xf998d008
y.create.l HWIO_PERIPH_SS_BAM_DMA_BAM_P_HALT9_ADDR A:0xf998e008
y.create.l HWIO_PERIPH_SS_BAM_DMA_BAM_P_TRUST_REG0_ADDR A:0xf9985030
y.create.l HWIO_PERIPH_SS_BAM_DMA_BAM_P_TRUST_REG1_ADDR A:0xf9986030
y.create.l HWIO_PERIPH_SS_BAM_DMA_BAM_P_TRUST_REG2_ADDR A:0xf9987030
y.create.l HWIO_PERIPH_SS_BAM_DMA_BAM_P_TRUST_REG3_ADDR A:0xf9988030
y.create.l HWIO_PERIPH_SS_BAM_DMA_BAM_P_TRUST_REG4_ADDR A:0xf9989030
y.create.l HWIO_PERIPH_SS_BAM_DMA_BAM_P_TRUST_REG5_ADDR A:0xf998a030
y.create.l HWIO_PERIPH_SS_BAM_DMA_BAM_P_TRUST_REG6_ADDR A:0xf998b030
y.create.l HWIO_PERIPH_SS_BAM_DMA_BAM_P_TRUST_REG7_ADDR A:0xf998c030
y.create.l HWIO_PERIPH_SS_BAM_DMA_BAM_P_TRUST_REG8_ADDR A:0xf998d030
y.create.l HWIO_PERIPH_SS_BAM_DMA_BAM_P_TRUST_REG9_ADDR A:0xf998e030
y.create.l HWIO_PERIPH_SS_BAM_DMA_BAM_P_IRQ_STTS0_ADDR A:0xf9985010
y.create.l HWIO_PERIPH_SS_BAM_DMA_BAM_P_IRQ_STTS1_ADDR A:0xf9986010
y.create.l HWIO_PERIPH_SS_BAM_DMA_BAM_P_IRQ_STTS2_ADDR A:0xf9987010
y.create.l HWIO_PERIPH_SS_BAM_DMA_BAM_P_IRQ_STTS3_ADDR A:0xf9988010
y.create.l HWIO_PERIPH_SS_BAM_DMA_BAM_P_IRQ_STTS4_ADDR A:0xf9989010
y.create.l HWIO_PERIPH_SS_BAM_DMA_BAM_P_IRQ_STTS5_ADDR A:0xf998a010
y.create.l HWIO_PERIPH_SS_BAM_DMA_BAM_P_IRQ_STTS6_ADDR A:0xf998b010
y.create.l HWIO_PERIPH_SS_BAM_DMA_BAM_P_IRQ_STTS7_ADDR A:0xf998c010
y.create.l HWIO_PERIPH_SS_BAM_DMA_BAM_P_IRQ_STTS8_ADDR A:0xf998d010
y.create.l HWIO_PERIPH_SS_BAM_DMA_BAM_P_IRQ_STTS9_ADDR A:0xf998e010
y.create.l HWIO_PERIPH_SS_BAM_DMA_BAM_P_IRQ_CLR0_ADDR A:0xf9985014
y.create.l HWIO_PERIPH_SS_BAM_DMA_BAM_P_IRQ_CLR1_ADDR A:0xf9986014
y.create.l HWIO_PERIPH_SS_BAM_DMA_BAM_P_IRQ_CLR2_ADDR A:0xf9987014
y.create.l HWIO_PERIPH_SS_BAM_DMA_BAM_P_IRQ_CLR3_ADDR A:0xf9988014
y.create.l HWIO_PERIPH_SS_BAM_DMA_BAM_P_IRQ_CLR4_ADDR A:0xf9989014
y.create.l HWIO_PERIPH_SS_BAM_DMA_BAM_P_IRQ_CLR5_ADDR A:0xf998a014
y.create.l HWIO_PERIPH_SS_BAM_DMA_BAM_P_IRQ_CLR6_ADDR A:0xf998b014
y.create.l HWIO_PERIPH_SS_BAM_DMA_BAM_P_IRQ_CLR7_ADDR A:0xf998c014
y.create.l HWIO_PERIPH_SS_BAM_DMA_BAM_P_IRQ_CLR8_ADDR A:0xf998d014
y.create.l HWIO_PERIPH_SS_BAM_DMA_BAM_P_IRQ_CLR9_ADDR A:0xf998e014
y.create.l HWIO_PERIPH_SS_BAM_DMA_BAM_P_IRQ_EN0_ADDR A:0xf9985018
y.create.l HWIO_PERIPH_SS_BAM_DMA_BAM_P_IRQ_EN1_ADDR A:0xf9986018
y.create.l HWIO_PERIPH_SS_BAM_DMA_BAM_P_IRQ_EN2_ADDR A:0xf9987018
y.create.l HWIO_PERIPH_SS_BAM_DMA_BAM_P_IRQ_EN3_ADDR A:0xf9988018
y.create.l HWIO_PERIPH_SS_BAM_DMA_BAM_P_IRQ_EN4_ADDR A:0xf9989018
y.create.l HWIO_PERIPH_SS_BAM_DMA_BAM_P_IRQ_EN5_ADDR A:0xf998a018
y.create.l HWIO_PERIPH_SS_BAM_DMA_BAM_P_IRQ_EN6_ADDR A:0xf998b018
y.create.l HWIO_PERIPH_SS_BAM_DMA_BAM_P_IRQ_EN7_ADDR A:0xf998c018
y.create.l HWIO_PERIPH_SS_BAM_DMA_BAM_P_IRQ_EN8_ADDR A:0xf998d018
y.create.l HWIO_PERIPH_SS_BAM_DMA_BAM_P_IRQ_EN9_ADDR A:0xf998e018
y.create.l HWIO_PERIPH_SS_BAM_DMA_BAM_P_TIMER0_ADDR A:0xf998501c
y.create.l HWIO_PERIPH_SS_BAM_DMA_BAM_P_TIMER1_ADDR A:0xf998601c
y.create.l HWIO_PERIPH_SS_BAM_DMA_BAM_P_TIMER2_ADDR A:0xf998701c
y.create.l HWIO_PERIPH_SS_BAM_DMA_BAM_P_TIMER3_ADDR A:0xf998801c
y.create.l HWIO_PERIPH_SS_BAM_DMA_BAM_P_TIMER4_ADDR A:0xf998901c
y.create.l HWIO_PERIPH_SS_BAM_DMA_BAM_P_TIMER5_ADDR A:0xf998a01c
y.create.l HWIO_PERIPH_SS_BAM_DMA_BAM_P_TIMER6_ADDR A:0xf998b01c
y.create.l HWIO_PERIPH_SS_BAM_DMA_BAM_P_TIMER7_ADDR A:0xf998c01c
y.create.l HWIO_PERIPH_SS_BAM_DMA_BAM_P_TIMER8_ADDR A:0xf998d01c
y.create.l HWIO_PERIPH_SS_BAM_DMA_BAM_P_TIMER9_ADDR A:0xf998e01c
y.create.l HWIO_PERIPH_SS_BAM_DMA_BAM_P_TIMER_CTRL0_ADDR A:0xf9985020
y.create.l HWIO_PERIPH_SS_BAM_DMA_BAM_P_TIMER_CTRL1_ADDR A:0xf9986020
y.create.l HWIO_PERIPH_SS_BAM_DMA_BAM_P_TIMER_CTRL2_ADDR A:0xf9987020
y.create.l HWIO_PERIPH_SS_BAM_DMA_BAM_P_TIMER_CTRL3_ADDR A:0xf9988020
y.create.l HWIO_PERIPH_SS_BAM_DMA_BAM_P_TIMER_CTRL4_ADDR A:0xf9989020
y.create.l HWIO_PERIPH_SS_BAM_DMA_BAM_P_TIMER_CTRL5_ADDR A:0xf998a020
y.create.l HWIO_PERIPH_SS_BAM_DMA_BAM_P_TIMER_CTRL6_ADDR A:0xf998b020
y.create.l HWIO_PERIPH_SS_BAM_DMA_BAM_P_TIMER_CTRL7_ADDR A:0xf998c020
y.create.l HWIO_PERIPH_SS_BAM_DMA_BAM_P_TIMER_CTRL8_ADDR A:0xf998d020
y.create.l HWIO_PERIPH_SS_BAM_DMA_BAM_P_TIMER_CTRL9_ADDR A:0xf998e020
y.create.l HWIO_PERIPH_SS_BAM_DMA_BAM_P_PRDCR_SDBND0_ADDR A:0xf9985024
y.create.l HWIO_PERIPH_SS_BAM_DMA_BAM_P_PRDCR_SDBND1_ADDR A:0xf9986024
y.create.l HWIO_PERIPH_SS_BAM_DMA_BAM_P_PRDCR_SDBND2_ADDR A:0xf9987024
y.create.l HWIO_PERIPH_SS_BAM_DMA_BAM_P_PRDCR_SDBND3_ADDR A:0xf9988024
y.create.l HWIO_PERIPH_SS_BAM_DMA_BAM_P_PRDCR_SDBND4_ADDR A:0xf9989024
y.create.l HWIO_PERIPH_SS_BAM_DMA_BAM_P_PRDCR_SDBND5_ADDR A:0xf998a024
y.create.l HWIO_PERIPH_SS_BAM_DMA_BAM_P_PRDCR_SDBND6_ADDR A:0xf998b024
y.create.l HWIO_PERIPH_SS_BAM_DMA_BAM_P_PRDCR_SDBND7_ADDR A:0xf998c024
y.create.l HWIO_PERIPH_SS_BAM_DMA_BAM_P_PRDCR_SDBND8_ADDR A:0xf998d024
y.create.l HWIO_PERIPH_SS_BAM_DMA_BAM_P_PRDCR_SDBND9_ADDR A:0xf998e024
y.create.l HWIO_PERIPH_SS_BAM_DMA_BAM_P_CNSMR_SDBND0_ADDR A:0xf9985028
y.create.l HWIO_PERIPH_SS_BAM_DMA_BAM_P_CNSMR_SDBND1_ADDR A:0xf9986028
y.create.l HWIO_PERIPH_SS_BAM_DMA_BAM_P_CNSMR_SDBND2_ADDR A:0xf9987028
y.create.l HWIO_PERIPH_SS_BAM_DMA_BAM_P_CNSMR_SDBND3_ADDR A:0xf9988028
y.create.l HWIO_PERIPH_SS_BAM_DMA_BAM_P_CNSMR_SDBND4_ADDR A:0xf9989028
y.create.l HWIO_PERIPH_SS_BAM_DMA_BAM_P_CNSMR_SDBND5_ADDR A:0xf998a028
y.create.l HWIO_PERIPH_SS_BAM_DMA_BAM_P_CNSMR_SDBND6_ADDR A:0xf998b028
y.create.l HWIO_PERIPH_SS_BAM_DMA_BAM_P_CNSMR_SDBND7_ADDR A:0xf998c028
y.create.l HWIO_PERIPH_SS_BAM_DMA_BAM_P_CNSMR_SDBND8_ADDR A:0xf998d028
y.create.l HWIO_PERIPH_SS_BAM_DMA_BAM_P_CNSMR_SDBND9_ADDR A:0xf998e028
y.create.l HWIO_PERIPH_SS_BAM_DMA_BAM_P_EVNT_DEST_ADDR0_ADDR A:0xf998582c
y.create.l HWIO_PERIPH_SS_BAM_DMA_BAM_P_EVNT_DEST_ADDR1_ADDR A:0xf998682c
y.create.l HWIO_PERIPH_SS_BAM_DMA_BAM_P_EVNT_DEST_ADDR2_ADDR A:0xf998782c
y.create.l HWIO_PERIPH_SS_BAM_DMA_BAM_P_EVNT_DEST_ADDR3_ADDR A:0xf998882c
y.create.l HWIO_PERIPH_SS_BAM_DMA_BAM_P_EVNT_DEST_ADDR4_ADDR A:0xf998982c
y.create.l HWIO_PERIPH_SS_BAM_DMA_BAM_P_EVNT_DEST_ADDR5_ADDR A:0xf998a82c
y.create.l HWIO_PERIPH_SS_BAM_DMA_BAM_P_EVNT_DEST_ADDR6_ADDR A:0xf998b82c
y.create.l HWIO_PERIPH_SS_BAM_DMA_BAM_P_EVNT_DEST_ADDR7_ADDR A:0xf998c82c
y.create.l HWIO_PERIPH_SS_BAM_DMA_BAM_P_EVNT_DEST_ADDR8_ADDR A:0xf998d82c
y.create.l HWIO_PERIPH_SS_BAM_DMA_BAM_P_EVNT_DEST_ADDR9_ADDR A:0xf998e82c
y.create.l HWIO_PERIPH_SS_BAM_DMA_BAM_P_EVNT_DEST_ADDR_LSB0_ADDR A:0xf9985930
y.create.l HWIO_PERIPH_SS_BAM_DMA_BAM_P_EVNT_DEST_ADDR_LSB1_ADDR A:0xf9986930
y.create.l HWIO_PERIPH_SS_BAM_DMA_BAM_P_EVNT_DEST_ADDR_LSB2_ADDR A:0xf9987930
y.create.l HWIO_PERIPH_SS_BAM_DMA_BAM_P_EVNT_DEST_ADDR_LSB3_ADDR A:0xf9988930
y.create.l HWIO_PERIPH_SS_BAM_DMA_BAM_P_EVNT_DEST_ADDR_LSB4_ADDR A:0xf9989930
y.create.l HWIO_PERIPH_SS_BAM_DMA_BAM_P_EVNT_DEST_ADDR_LSB5_ADDR A:0xf998a930
y.create.l HWIO_PERIPH_SS_BAM_DMA_BAM_P_EVNT_DEST_ADDR_LSB6_ADDR A:0xf998b930
y.create.l HWIO_PERIPH_SS_BAM_DMA_BAM_P_EVNT_DEST_ADDR_LSB7_ADDR A:0xf998c930
y.create.l HWIO_PERIPH_SS_BAM_DMA_BAM_P_EVNT_DEST_ADDR_LSB8_ADDR A:0xf998d930
y.create.l HWIO_PERIPH_SS_BAM_DMA_BAM_P_EVNT_DEST_ADDR_LSB9_ADDR A:0xf998e930
y.create.l HWIO_PERIPH_SS_BAM_DMA_BAM_P_EVNT_DEST_ADDR_MSB0_ADDR A:0xf9985934
y.create.l HWIO_PERIPH_SS_BAM_DMA_BAM_P_EVNT_DEST_ADDR_MSB1_ADDR A:0xf9986934
y.create.l HWIO_PERIPH_SS_BAM_DMA_BAM_P_EVNT_DEST_ADDR_MSB2_ADDR A:0xf9987934
y.create.l HWIO_PERIPH_SS_BAM_DMA_BAM_P_EVNT_DEST_ADDR_MSB3_ADDR A:0xf9988934
y.create.l HWIO_PERIPH_SS_BAM_DMA_BAM_P_EVNT_DEST_ADDR_MSB4_ADDR A:0xf9989934
y.create.l HWIO_PERIPH_SS_BAM_DMA_BAM_P_EVNT_DEST_ADDR_MSB5_ADDR A:0xf998a934
y.create.l HWIO_PERIPH_SS_BAM_DMA_BAM_P_EVNT_DEST_ADDR_MSB6_ADDR A:0xf998b934
y.create.l HWIO_PERIPH_SS_BAM_DMA_BAM_P_EVNT_DEST_ADDR_MSB7_ADDR A:0xf998c934
y.create.l HWIO_PERIPH_SS_BAM_DMA_BAM_P_EVNT_DEST_ADDR_MSB8_ADDR A:0xf998d934
y.create.l HWIO_PERIPH_SS_BAM_DMA_BAM_P_EVNT_DEST_ADDR_MSB9_ADDR A:0xf998e934
y.create.l HWIO_PERIPH_SS_BAM_DMA_BAM_P_EVNT_REG0_ADDR A:0xf9985818
y.create.l HWIO_PERIPH_SS_BAM_DMA_BAM_P_EVNT_REG1_ADDR A:0xf9986818
y.create.l HWIO_PERIPH_SS_BAM_DMA_BAM_P_EVNT_REG2_ADDR A:0xf9987818
y.create.l HWIO_PERIPH_SS_BAM_DMA_BAM_P_EVNT_REG3_ADDR A:0xf9988818
y.create.l HWIO_PERIPH_SS_BAM_DMA_BAM_P_EVNT_REG4_ADDR A:0xf9989818
y.create.l HWIO_PERIPH_SS_BAM_DMA_BAM_P_EVNT_REG5_ADDR A:0xf998a818
y.create.l HWIO_PERIPH_SS_BAM_DMA_BAM_P_EVNT_REG6_ADDR A:0xf998b818
y.create.l HWIO_PERIPH_SS_BAM_DMA_BAM_P_EVNT_REG7_ADDR A:0xf998c818
y.create.l HWIO_PERIPH_SS_BAM_DMA_BAM_P_EVNT_REG8_ADDR A:0xf998d818
y.create.l HWIO_PERIPH_SS_BAM_DMA_BAM_P_EVNT_REG9_ADDR A:0xf998e818
y.create.l HWIO_PERIPH_SS_BAM_DMA_BAM_P_SW_OFSTS0_ADDR A:0xf9985800
y.create.l HWIO_PERIPH_SS_BAM_DMA_BAM_P_SW_OFSTS1_ADDR A:0xf9986800
y.create.l HWIO_PERIPH_SS_BAM_DMA_BAM_P_SW_OFSTS2_ADDR A:0xf9987800
y.create.l HWIO_PERIPH_SS_BAM_DMA_BAM_P_SW_OFSTS3_ADDR A:0xf9988800
y.create.l HWIO_PERIPH_SS_BAM_DMA_BAM_P_SW_OFSTS4_ADDR A:0xf9989800
y.create.l HWIO_PERIPH_SS_BAM_DMA_BAM_P_SW_OFSTS5_ADDR A:0xf998a800
y.create.l HWIO_PERIPH_SS_BAM_DMA_BAM_P_SW_OFSTS6_ADDR A:0xf998b800
y.create.l HWIO_PERIPH_SS_BAM_DMA_BAM_P_SW_OFSTS7_ADDR A:0xf998c800
y.create.l HWIO_PERIPH_SS_BAM_DMA_BAM_P_SW_OFSTS8_ADDR A:0xf998d800
y.create.l HWIO_PERIPH_SS_BAM_DMA_BAM_P_SW_OFSTS9_ADDR A:0xf998e800
y.create.l HWIO_PERIPH_SS_BAM_DMA_BAM_P_DATA_FIFO_ADDR0_ADDR A:0xf9985824
y.create.l HWIO_PERIPH_SS_BAM_DMA_BAM_P_DATA_FIFO_ADDR1_ADDR A:0xf9986824
y.create.l HWIO_PERIPH_SS_BAM_DMA_BAM_P_DATA_FIFO_ADDR2_ADDR A:0xf9987824
y.create.l HWIO_PERIPH_SS_BAM_DMA_BAM_P_DATA_FIFO_ADDR3_ADDR A:0xf9988824
y.create.l HWIO_PERIPH_SS_BAM_DMA_BAM_P_DATA_FIFO_ADDR4_ADDR A:0xf9989824
y.create.l HWIO_PERIPH_SS_BAM_DMA_BAM_P_DATA_FIFO_ADDR5_ADDR A:0xf998a824
y.create.l HWIO_PERIPH_SS_BAM_DMA_BAM_P_DATA_FIFO_ADDR6_ADDR A:0xf998b824
y.create.l HWIO_PERIPH_SS_BAM_DMA_BAM_P_DATA_FIFO_ADDR7_ADDR A:0xf998c824
y.create.l HWIO_PERIPH_SS_BAM_DMA_BAM_P_DATA_FIFO_ADDR8_ADDR A:0xf998d824
y.create.l HWIO_PERIPH_SS_BAM_DMA_BAM_P_DATA_FIFO_ADDR9_ADDR A:0xf998e824
y.create.l HWIO_PERIPH_SS_BAM_DMA_BAM_P_DATA_FIFO_ADDR_LSB0_ADDR A:0xf9985920
y.create.l HWIO_PERIPH_SS_BAM_DMA_BAM_P_DATA_FIFO_ADDR_LSB1_ADDR A:0xf9986920
y.create.l HWIO_PERIPH_SS_BAM_DMA_BAM_P_DATA_FIFO_ADDR_LSB2_ADDR A:0xf9987920
y.create.l HWIO_PERIPH_SS_BAM_DMA_BAM_P_DATA_FIFO_ADDR_LSB3_ADDR A:0xf9988920
y.create.l HWIO_PERIPH_SS_BAM_DMA_BAM_P_DATA_FIFO_ADDR_LSB4_ADDR A:0xf9989920
y.create.l HWIO_PERIPH_SS_BAM_DMA_BAM_P_DATA_FIFO_ADDR_LSB5_ADDR A:0xf998a920
y.create.l HWIO_PERIPH_SS_BAM_DMA_BAM_P_DATA_FIFO_ADDR_LSB6_ADDR A:0xf998b920
y.create.l HWIO_PERIPH_SS_BAM_DMA_BAM_P_DATA_FIFO_ADDR_LSB7_ADDR A:0xf998c920
y.create.l HWIO_PERIPH_SS_BAM_DMA_BAM_P_DATA_FIFO_ADDR_LSB8_ADDR A:0xf998d920
y.create.l HWIO_PERIPH_SS_BAM_DMA_BAM_P_DATA_FIFO_ADDR_LSB9_ADDR A:0xf998e920
y.create.l HWIO_PERIPH_SS_BAM_DMA_BAM_P_DATA_FIFO_ADDR_MSB0_ADDR A:0xf9985924
y.create.l HWIO_PERIPH_SS_BAM_DMA_BAM_P_DATA_FIFO_ADDR_MSB1_ADDR A:0xf9986924
y.create.l HWIO_PERIPH_SS_BAM_DMA_BAM_P_DATA_FIFO_ADDR_MSB2_ADDR A:0xf9987924
y.create.l HWIO_PERIPH_SS_BAM_DMA_BAM_P_DATA_FIFO_ADDR_MSB3_ADDR A:0xf9988924
y.create.l HWIO_PERIPH_SS_BAM_DMA_BAM_P_DATA_FIFO_ADDR_MSB4_ADDR A:0xf9989924
y.create.l HWIO_PERIPH_SS_BAM_DMA_BAM_P_DATA_FIFO_ADDR_MSB5_ADDR A:0xf998a924
y.create.l HWIO_PERIPH_SS_BAM_DMA_BAM_P_DATA_FIFO_ADDR_MSB6_ADDR A:0xf998b924
y.create.l HWIO_PERIPH_SS_BAM_DMA_BAM_P_DATA_FIFO_ADDR_MSB7_ADDR A:0xf998c924
y.create.l HWIO_PERIPH_SS_BAM_DMA_BAM_P_DATA_FIFO_ADDR_MSB8_ADDR A:0xf998d924
y.create.l HWIO_PERIPH_SS_BAM_DMA_BAM_P_DATA_FIFO_ADDR_MSB9_ADDR A:0xf998e924
y.create.l HWIO_PERIPH_SS_BAM_DMA_BAM_P_DESC_FIFO_ADDR0_ADDR A:0xf998581c
y.create.l HWIO_PERIPH_SS_BAM_DMA_BAM_P_DESC_FIFO_ADDR1_ADDR A:0xf998681c
y.create.l HWIO_PERIPH_SS_BAM_DMA_BAM_P_DESC_FIFO_ADDR2_ADDR A:0xf998781c
y.create.l HWIO_PERIPH_SS_BAM_DMA_BAM_P_DESC_FIFO_ADDR3_ADDR A:0xf998881c
y.create.l HWIO_PERIPH_SS_BAM_DMA_BAM_P_DESC_FIFO_ADDR4_ADDR A:0xf998981c
y.create.l HWIO_PERIPH_SS_BAM_DMA_BAM_P_DESC_FIFO_ADDR5_ADDR A:0xf998a81c
y.create.l HWIO_PERIPH_SS_BAM_DMA_BAM_P_DESC_FIFO_ADDR6_ADDR A:0xf998b81c
y.create.l HWIO_PERIPH_SS_BAM_DMA_BAM_P_DESC_FIFO_ADDR7_ADDR A:0xf998c81c
y.create.l HWIO_PERIPH_SS_BAM_DMA_BAM_P_DESC_FIFO_ADDR8_ADDR A:0xf998d81c
y.create.l HWIO_PERIPH_SS_BAM_DMA_BAM_P_DESC_FIFO_ADDR9_ADDR A:0xf998e81c
y.create.l HWIO_PERIPH_SS_BAM_DMA_BAM_P_DESC_FIFO_ADDR_LSB0_ADDR A:0xf9985910
y.create.l HWIO_PERIPH_SS_BAM_DMA_BAM_P_DESC_FIFO_ADDR_LSB1_ADDR A:0xf9986910
y.create.l HWIO_PERIPH_SS_BAM_DMA_BAM_P_DESC_FIFO_ADDR_LSB2_ADDR A:0xf9987910
y.create.l HWIO_PERIPH_SS_BAM_DMA_BAM_P_DESC_FIFO_ADDR_LSB3_ADDR A:0xf9988910
y.create.l HWIO_PERIPH_SS_BAM_DMA_BAM_P_DESC_FIFO_ADDR_LSB4_ADDR A:0xf9989910
y.create.l HWIO_PERIPH_SS_BAM_DMA_BAM_P_DESC_FIFO_ADDR_LSB5_ADDR A:0xf998a910
y.create.l HWIO_PERIPH_SS_BAM_DMA_BAM_P_DESC_FIFO_ADDR_LSB6_ADDR A:0xf998b910
y.create.l HWIO_PERIPH_SS_BAM_DMA_BAM_P_DESC_FIFO_ADDR_LSB7_ADDR A:0xf998c910
y.create.l HWIO_PERIPH_SS_BAM_DMA_BAM_P_DESC_FIFO_ADDR_LSB8_ADDR A:0xf998d910
y.create.l HWIO_PERIPH_SS_BAM_DMA_BAM_P_DESC_FIFO_ADDR_LSB9_ADDR A:0xf998e910
y.create.l HWIO_PERIPH_SS_BAM_DMA_BAM_P_DESC_FIFO_ADDR_MSB0_ADDR A:0xf9985914
y.create.l HWIO_PERIPH_SS_BAM_DMA_BAM_P_DESC_FIFO_ADDR_MSB1_ADDR A:0xf9986914
y.create.l HWIO_PERIPH_SS_BAM_DMA_BAM_P_DESC_FIFO_ADDR_MSB2_ADDR A:0xf9987914
y.create.l HWIO_PERIPH_SS_BAM_DMA_BAM_P_DESC_FIFO_ADDR_MSB3_ADDR A:0xf9988914
y.create.l HWIO_PERIPH_SS_BAM_DMA_BAM_P_DESC_FIFO_ADDR_MSB4_ADDR A:0xf9989914
y.create.l HWIO_PERIPH_SS_BAM_DMA_BAM_P_DESC_FIFO_ADDR_MSB5_ADDR A:0xf998a914
y.create.l HWIO_PERIPH_SS_BAM_DMA_BAM_P_DESC_FIFO_ADDR_MSB6_ADDR A:0xf998b914
y.create.l HWIO_PERIPH_SS_BAM_DMA_BAM_P_DESC_FIFO_ADDR_MSB7_ADDR A:0xf998c914
y.create.l HWIO_PERIPH_SS_BAM_DMA_BAM_P_DESC_FIFO_ADDR_MSB8_ADDR A:0xf998d914
y.create.l HWIO_PERIPH_SS_BAM_DMA_BAM_P_DESC_FIFO_ADDR_MSB9_ADDR A:0xf998e914
y.create.l HWIO_PERIPH_SS_BAM_DMA_BAM_P_EVNT_GEN_TRSHLD0_ADDR A:0xf9985828
y.create.l HWIO_PERIPH_SS_BAM_DMA_BAM_P_EVNT_GEN_TRSHLD1_ADDR A:0xf9986828
y.create.l HWIO_PERIPH_SS_BAM_DMA_BAM_P_EVNT_GEN_TRSHLD2_ADDR A:0xf9987828
y.create.l HWIO_PERIPH_SS_BAM_DMA_BAM_P_EVNT_GEN_TRSHLD3_ADDR A:0xf9988828
y.create.l HWIO_PERIPH_SS_BAM_DMA_BAM_P_EVNT_GEN_TRSHLD4_ADDR A:0xf9989828
y.create.l HWIO_PERIPH_SS_BAM_DMA_BAM_P_EVNT_GEN_TRSHLD5_ADDR A:0xf998a828
y.create.l HWIO_PERIPH_SS_BAM_DMA_BAM_P_EVNT_GEN_TRSHLD6_ADDR A:0xf998b828
y.create.l HWIO_PERIPH_SS_BAM_DMA_BAM_P_EVNT_GEN_TRSHLD7_ADDR A:0xf998c828
y.create.l HWIO_PERIPH_SS_BAM_DMA_BAM_P_EVNT_GEN_TRSHLD8_ADDR A:0xf998d828
y.create.l HWIO_PERIPH_SS_BAM_DMA_BAM_P_EVNT_GEN_TRSHLD9_ADDR A:0xf998e828
y.create.l HWIO_PERIPH_SS_BAM_DMA_BAM_P_FIFO_SIZES0_ADDR A:0xf9985820
y.create.l HWIO_PERIPH_SS_BAM_DMA_BAM_P_FIFO_SIZES1_ADDR A:0xf9986820
y.create.l HWIO_PERIPH_SS_BAM_DMA_BAM_P_FIFO_SIZES2_ADDR A:0xf9987820
y.create.l HWIO_PERIPH_SS_BAM_DMA_BAM_P_FIFO_SIZES3_ADDR A:0xf9988820
y.create.l HWIO_PERIPH_SS_BAM_DMA_BAM_P_FIFO_SIZES4_ADDR A:0xf9989820
y.create.l HWIO_PERIPH_SS_BAM_DMA_BAM_P_FIFO_SIZES5_ADDR A:0xf998a820
y.create.l HWIO_PERIPH_SS_BAM_DMA_BAM_P_FIFO_SIZES6_ADDR A:0xf998b820
y.create.l HWIO_PERIPH_SS_BAM_DMA_BAM_P_FIFO_SIZES7_ADDR A:0xf998c820
y.create.l HWIO_PERIPH_SS_BAM_DMA_BAM_P_FIFO_SIZES8_ADDR A:0xf998d820
y.create.l HWIO_PERIPH_SS_BAM_DMA_BAM_P_FIFO_SIZES9_ADDR A:0xf998e820
y.create.l HWIO_PERIPH_SS_BAM_DMA_BAM_P_RETR_CNTXT_0_ADDR A:0xf9985834
y.create.l HWIO_PERIPH_SS_BAM_DMA_BAM_P_RETR_CNTXT_1_ADDR A:0xf9986834
y.create.l HWIO_PERIPH_SS_BAM_DMA_BAM_P_RETR_CNTXT_2_ADDR A:0xf9987834
y.create.l HWIO_PERIPH_SS_BAM_DMA_BAM_P_RETR_CNTXT_3_ADDR A:0xf9988834
y.create.l HWIO_PERIPH_SS_BAM_DMA_BAM_P_RETR_CNTXT_4_ADDR A:0xf9989834
y.create.l HWIO_PERIPH_SS_BAM_DMA_BAM_P_RETR_CNTXT_5_ADDR A:0xf998a834
y.create.l HWIO_PERIPH_SS_BAM_DMA_BAM_P_RETR_CNTXT_6_ADDR A:0xf998b834
y.create.l HWIO_PERIPH_SS_BAM_DMA_BAM_P_RETR_CNTXT_7_ADDR A:0xf998c834
y.create.l HWIO_PERIPH_SS_BAM_DMA_BAM_P_RETR_CNTXT_8_ADDR A:0xf998d834
y.create.l HWIO_PERIPH_SS_BAM_DMA_BAM_P_RETR_CNTXT_9_ADDR A:0xf998e834
y.create.l HWIO_PERIPH_SS_BAM_DMA_BAM_P_SI_CNTXT_0_ADDR A:0xf9985838
y.create.l HWIO_PERIPH_SS_BAM_DMA_BAM_P_SI_CNTXT_1_ADDR A:0xf9986838
y.create.l HWIO_PERIPH_SS_BAM_DMA_BAM_P_SI_CNTXT_2_ADDR A:0xf9987838
y.create.l HWIO_PERIPH_SS_BAM_DMA_BAM_P_SI_CNTXT_3_ADDR A:0xf9988838
y.create.l HWIO_PERIPH_SS_BAM_DMA_BAM_P_SI_CNTXT_4_ADDR A:0xf9989838
y.create.l HWIO_PERIPH_SS_BAM_DMA_BAM_P_SI_CNTXT_5_ADDR A:0xf998a838
y.create.l HWIO_PERIPH_SS_BAM_DMA_BAM_P_SI_CNTXT_6_ADDR A:0xf998b838
y.create.l HWIO_PERIPH_SS_BAM_DMA_BAM_P_SI_CNTXT_7_ADDR A:0xf998c838
y.create.l HWIO_PERIPH_SS_BAM_DMA_BAM_P_SI_CNTXT_8_ADDR A:0xf998d838
y.create.l HWIO_PERIPH_SS_BAM_DMA_BAM_P_SI_CNTXT_9_ADDR A:0xf998e838
y.create.l HWIO_PERIPH_SS_BAM_DMA_BAM_P_DF_CNTXT_0_ADDR A:0xf9985830
y.create.l HWIO_PERIPH_SS_BAM_DMA_BAM_P_DF_CNTXT_1_ADDR A:0xf9986830
y.create.l HWIO_PERIPH_SS_BAM_DMA_BAM_P_DF_CNTXT_2_ADDR A:0xf9987830
y.create.l HWIO_PERIPH_SS_BAM_DMA_BAM_P_DF_CNTXT_3_ADDR A:0xf9988830
y.create.l HWIO_PERIPH_SS_BAM_DMA_BAM_P_DF_CNTXT_4_ADDR A:0xf9989830
y.create.l HWIO_PERIPH_SS_BAM_DMA_BAM_P_DF_CNTXT_5_ADDR A:0xf998a830
y.create.l HWIO_PERIPH_SS_BAM_DMA_BAM_P_DF_CNTXT_6_ADDR A:0xf998b830
y.create.l HWIO_PERIPH_SS_BAM_DMA_BAM_P_DF_CNTXT_7_ADDR A:0xf998c830
y.create.l HWIO_PERIPH_SS_BAM_DMA_BAM_P_DF_CNTXT_8_ADDR A:0xf998d830
y.create.l HWIO_PERIPH_SS_BAM_DMA_BAM_P_DF_CNTXT_9_ADDR A:0xf998e830
y.create.l HWIO_PERIPH_SS_BAM_DMA_BAM_P_AU_PSM_CNTXT_1_0_ADDR A:0xf9985804
y.create.l HWIO_PERIPH_SS_BAM_DMA_BAM_P_AU_PSM_CNTXT_1_1_ADDR A:0xf9986804
y.create.l HWIO_PERIPH_SS_BAM_DMA_BAM_P_AU_PSM_CNTXT_1_2_ADDR A:0xf9987804
y.create.l HWIO_PERIPH_SS_BAM_DMA_BAM_P_AU_PSM_CNTXT_1_3_ADDR A:0xf9988804
y.create.l HWIO_PERIPH_SS_BAM_DMA_BAM_P_AU_PSM_CNTXT_1_4_ADDR A:0xf9989804
y.create.l HWIO_PERIPH_SS_BAM_DMA_BAM_P_AU_PSM_CNTXT_1_5_ADDR A:0xf998a804
y.create.l HWIO_PERIPH_SS_BAM_DMA_BAM_P_AU_PSM_CNTXT_1_6_ADDR A:0xf998b804
y.create.l HWIO_PERIPH_SS_BAM_DMA_BAM_P_AU_PSM_CNTXT_1_7_ADDR A:0xf998c804
y.create.l HWIO_PERIPH_SS_BAM_DMA_BAM_P_AU_PSM_CNTXT_1_8_ADDR A:0xf998d804
y.create.l HWIO_PERIPH_SS_BAM_DMA_BAM_P_AU_PSM_CNTXT_1_9_ADDR A:0xf998e804
y.create.l HWIO_PERIPH_SS_BAM_DMA_BAM_P_PSM_CNTXT_2_0_ADDR A:0xf9985808
y.create.l HWIO_PERIPH_SS_BAM_DMA_BAM_P_PSM_CNTXT_2_1_ADDR A:0xf9986808
y.create.l HWIO_PERIPH_SS_BAM_DMA_BAM_P_PSM_CNTXT_2_2_ADDR A:0xf9987808
y.create.l HWIO_PERIPH_SS_BAM_DMA_BAM_P_PSM_CNTXT_2_3_ADDR A:0xf9988808
y.create.l HWIO_PERIPH_SS_BAM_DMA_BAM_P_PSM_CNTXT_2_4_ADDR A:0xf9989808
y.create.l HWIO_PERIPH_SS_BAM_DMA_BAM_P_PSM_CNTXT_2_5_ADDR A:0xf998a808
y.create.l HWIO_PERIPH_SS_BAM_DMA_BAM_P_PSM_CNTXT_2_6_ADDR A:0xf998b808
y.create.l HWIO_PERIPH_SS_BAM_DMA_BAM_P_PSM_CNTXT_2_7_ADDR A:0xf998c808
y.create.l HWIO_PERIPH_SS_BAM_DMA_BAM_P_PSM_CNTXT_2_8_ADDR A:0xf998d808
y.create.l HWIO_PERIPH_SS_BAM_DMA_BAM_P_PSM_CNTXT_2_9_ADDR A:0xf998e808
y.create.l HWIO_PERIPH_SS_BAM_DMA_BAM_P_PSM_CNTXT_3_0_ADDR A:0xf998580c
y.create.l HWIO_PERIPH_SS_BAM_DMA_BAM_P_PSM_CNTXT_3_1_ADDR A:0xf998680c
y.create.l HWIO_PERIPH_SS_BAM_DMA_BAM_P_PSM_CNTXT_3_2_ADDR A:0xf998780c
y.create.l HWIO_PERIPH_SS_BAM_DMA_BAM_P_PSM_CNTXT_3_3_ADDR A:0xf998880c
y.create.l HWIO_PERIPH_SS_BAM_DMA_BAM_P_PSM_CNTXT_3_4_ADDR A:0xf998980c
y.create.l HWIO_PERIPH_SS_BAM_DMA_BAM_P_PSM_CNTXT_3_5_ADDR A:0xf998a80c
y.create.l HWIO_PERIPH_SS_BAM_DMA_BAM_P_PSM_CNTXT_3_6_ADDR A:0xf998b80c
y.create.l HWIO_PERIPH_SS_BAM_DMA_BAM_P_PSM_CNTXT_3_7_ADDR A:0xf998c80c
y.create.l HWIO_PERIPH_SS_BAM_DMA_BAM_P_PSM_CNTXT_3_8_ADDR A:0xf998d80c
y.create.l HWIO_PERIPH_SS_BAM_DMA_BAM_P_PSM_CNTXT_3_9_ADDR A:0xf998e80c
y.create.l HWIO_PERIPH_SS_BAM_DMA_BAM_P_PSM_CNTXT_3_LSB0_ADDR A:0xf9985900
y.create.l HWIO_PERIPH_SS_BAM_DMA_BAM_P_PSM_CNTXT_3_LSB1_ADDR A:0xf9986900
y.create.l HWIO_PERIPH_SS_BAM_DMA_BAM_P_PSM_CNTXT_3_LSB2_ADDR A:0xf9987900
y.create.l HWIO_PERIPH_SS_BAM_DMA_BAM_P_PSM_CNTXT_3_LSB3_ADDR A:0xf9988900
y.create.l HWIO_PERIPH_SS_BAM_DMA_BAM_P_PSM_CNTXT_3_LSB4_ADDR A:0xf9989900
y.create.l HWIO_PERIPH_SS_BAM_DMA_BAM_P_PSM_CNTXT_3_LSB5_ADDR A:0xf998a900
y.create.l HWIO_PERIPH_SS_BAM_DMA_BAM_P_PSM_CNTXT_3_LSB6_ADDR A:0xf998b900
y.create.l HWIO_PERIPH_SS_BAM_DMA_BAM_P_PSM_CNTXT_3_LSB7_ADDR A:0xf998c900
y.create.l HWIO_PERIPH_SS_BAM_DMA_BAM_P_PSM_CNTXT_3_LSB8_ADDR A:0xf998d900
y.create.l HWIO_PERIPH_SS_BAM_DMA_BAM_P_PSM_CNTXT_3_LSB9_ADDR A:0xf998e900
y.create.l HWIO_PERIPH_SS_BAM_DMA_BAM_P_PSM_CNTXT_3_MSB0_ADDR A:0xf9985904
y.create.l HWIO_PERIPH_SS_BAM_DMA_BAM_P_PSM_CNTXT_3_MSB1_ADDR A:0xf9986904
y.create.l HWIO_PERIPH_SS_BAM_DMA_BAM_P_PSM_CNTXT_3_MSB2_ADDR A:0xf9987904
y.create.l HWIO_PERIPH_SS_BAM_DMA_BAM_P_PSM_CNTXT_3_MSB3_ADDR A:0xf9988904
y.create.l HWIO_PERIPH_SS_BAM_DMA_BAM_P_PSM_CNTXT_3_MSB4_ADDR A:0xf9989904
y.create.l HWIO_PERIPH_SS_BAM_DMA_BAM_P_PSM_CNTXT_3_MSB5_ADDR A:0xf998a904
y.create.l HWIO_PERIPH_SS_BAM_DMA_BAM_P_PSM_CNTXT_3_MSB6_ADDR A:0xf998b904
y.create.l HWIO_PERIPH_SS_BAM_DMA_BAM_P_PSM_CNTXT_3_MSB7_ADDR A:0xf998c904
y.create.l HWIO_PERIPH_SS_BAM_DMA_BAM_P_PSM_CNTXT_3_MSB8_ADDR A:0xf998d904
y.create.l HWIO_PERIPH_SS_BAM_DMA_BAM_P_PSM_CNTXT_3_MSB9_ADDR A:0xf998e904
y.create.l HWIO_PERIPH_SS_BAM_DMA_BAM_P_PSM_CNTXT_4_0_ADDR A:0xf9985810
y.create.l HWIO_PERIPH_SS_BAM_DMA_BAM_P_PSM_CNTXT_4_1_ADDR A:0xf9986810
y.create.l HWIO_PERIPH_SS_BAM_DMA_BAM_P_PSM_CNTXT_4_2_ADDR A:0xf9987810
y.create.l HWIO_PERIPH_SS_BAM_DMA_BAM_P_PSM_CNTXT_4_3_ADDR A:0xf9988810
y.create.l HWIO_PERIPH_SS_BAM_DMA_BAM_P_PSM_CNTXT_4_4_ADDR A:0xf9989810
y.create.l HWIO_PERIPH_SS_BAM_DMA_BAM_P_PSM_CNTXT_4_5_ADDR A:0xf998a810
y.create.l HWIO_PERIPH_SS_BAM_DMA_BAM_P_PSM_CNTXT_4_6_ADDR A:0xf998b810
y.create.l HWIO_PERIPH_SS_BAM_DMA_BAM_P_PSM_CNTXT_4_7_ADDR A:0xf998c810
y.create.l HWIO_PERIPH_SS_BAM_DMA_BAM_P_PSM_CNTXT_4_8_ADDR A:0xf998d810
y.create.l HWIO_PERIPH_SS_BAM_DMA_BAM_P_PSM_CNTXT_4_9_ADDR A:0xf998e810
y.create.l HWIO_PERIPH_SS_BAM_DMA_BAM_P_PSM_CNTXT_5_0_ADDR A:0xf9985814
y.create.l HWIO_PERIPH_SS_BAM_DMA_BAM_P_PSM_CNTXT_5_1_ADDR A:0xf9986814
y.create.l HWIO_PERIPH_SS_BAM_DMA_BAM_P_PSM_CNTXT_5_2_ADDR A:0xf9987814
y.create.l HWIO_PERIPH_SS_BAM_DMA_BAM_P_PSM_CNTXT_5_3_ADDR A:0xf9988814
y.create.l HWIO_PERIPH_SS_BAM_DMA_BAM_P_PSM_CNTXT_5_4_ADDR A:0xf9989814
y.create.l HWIO_PERIPH_SS_BAM_DMA_BAM_P_PSM_CNTXT_5_5_ADDR A:0xf998a814
y.create.l HWIO_PERIPH_SS_BAM_DMA_BAM_P_PSM_CNTXT_5_6_ADDR A:0xf998b814
y.create.l HWIO_PERIPH_SS_BAM_DMA_BAM_P_PSM_CNTXT_5_7_ADDR A:0xf998c814
y.create.l HWIO_PERIPH_SS_BAM_DMA_BAM_P_PSM_CNTXT_5_8_ADDR A:0xf998d814
y.create.l HWIO_PERIPH_SS_BAM_DMA_BAM_P_PSM_CNTXT_5_9_ADDR A:0xf998e814
y.create.l HWIO_PERIPH_SS_BAM_DMA_XPU_SCR_ADDR A:0xf9982000
y.create.l HWIO_PERIPH_SS_BAM_DMA_XPU_SWDR_ADDR A:0xf9982004
y.create.l HWIO_PERIPH_SS_BAM_DMA_XPU_SEAR0_ADDR A:0xf9982040
y.create.l HWIO_PERIPH_SS_BAM_DMA_XPU_SESR_ADDR A:0xf9982048
y.create.l HWIO_PERIPH_SS_BAM_DMA_XPU_SESRRESTORE_ADDR A:0xf998204c
y.create.l HWIO_PERIPH_SS_BAM_DMA_XPU_SESYNR0_ADDR A:0xf9982050
y.create.l HWIO_PERIPH_SS_BAM_DMA_XPU_SESYNR1_ADDR A:0xf9982054
y.create.l HWIO_PERIPH_SS_BAM_DMA_XPU_SESYNR2_ADDR A:0xf9982058
y.create.l HWIO_PERIPH_SS_BAM_DMA_XPU_MCR_ADDR A:0xf9982100
y.create.l HWIO_PERIPH_SS_BAM_DMA_XPU_MEAR0_ADDR A:0xf9982140
y.create.l HWIO_PERIPH_SS_BAM_DMA_XPU_MESR_ADDR A:0xf9982148
y.create.l HWIO_PERIPH_SS_BAM_DMA_XPU_MESRRESTORE_ADDR A:0xf998214c
y.create.l HWIO_PERIPH_SS_BAM_DMA_XPU_MESYNR0_ADDR A:0xf9982150
y.create.l HWIO_PERIPH_SS_BAM_DMA_XPU_MESYNR1_ADDR A:0xf9982154
y.create.l HWIO_PERIPH_SS_BAM_DMA_XPU_MESYNR2_ADDR A:0xf9982158
y.create.l HWIO_PERIPH_SS_BAM_DMA_XPU_CR_ADDR A:0xf9982080
y.create.l HWIO_PERIPH_SS_BAM_DMA_XPU_RPU_ACR0_ADDR A:0xf99820a0
y.create.l HWIO_PERIPH_SS_BAM_DMA_XPU_EAR0_ADDR A:0xf99820c0
y.create.l HWIO_PERIPH_SS_BAM_DMA_XPU_ESR_ADDR A:0xf99820c8
y.create.l HWIO_PERIPH_SS_BAM_DMA_XPU_ESRRESTORE_ADDR A:0xf99820cc
y.create.l HWIO_PERIPH_SS_BAM_DMA_XPU_ESYNR0_ADDR A:0xf99820d0
y.create.l HWIO_PERIPH_SS_BAM_DMA_XPU_ESYNR1_ADDR A:0xf99820d4
y.create.l HWIO_PERIPH_SS_BAM_DMA_XPU_ESYNR2_ADDR A:0xf99820d8
y.create.l HWIO_PERIPH_SS_BAM_DMA_XPU_IDR0_ADDR A:0xf9982074
y.create.l HWIO_PERIPH_SS_BAM_DMA_XPU_IDR1_ADDR A:0xf9982078
y.create.l HWIO_PERIPH_SS_BAM_DMA_XPU_REV_ADDR A:0xf998207c
y.create.l HWIO_PERIPH_SS_BAM_DMA_XPU_RG0_RACR0_ADDR A:0xf9982200
y.create.l HWIO_PERIPH_SS_BAM_DMA_XPU_RG1_RACR0_ADDR A:0xf9982280
y.create.l HWIO_PERIPH_SS_BAM_DMA_XPU_RG2_RACR0_ADDR A:0xf9982300
y.create.l HWIO_PERIPH_SS_BAM_DMA_XPU_RG3_RACR0_ADDR A:0xf9982380
y.create.l HWIO_PERIPH_SS_BAM_DMA_XPU_RG4_RACR0_ADDR A:0xf9982400
y.create.l HWIO_PERIPH_SS_BAM_DMA_XPU_RG5_RACR0_ADDR A:0xf9982480
y.create.l HWIO_PERIPH_SS_BAM_DMA_XPU_RG6_RACR0_ADDR A:0xf9982500
y.create.l HWIO_PERIPH_SS_BAM_DMA_XPU_RG7_RACR0_ADDR A:0xf9982580
y.create.l HWIO_PERIPH_SS_BAM_DMA_XPU_RG8_RACR0_ADDR A:0xf9982600
y.create.l HWIO_PERIPH_SS_BAM_DMA_XPU_RG9_RACR0_ADDR A:0xf9982680
y.create.l HWIO_PERIPH_SS_BAM_DMA_XPU_RG0_SCR_ADDR A:0xf9982250
y.create.l HWIO_PERIPH_SS_BAM_DMA_XPU_RG1_SCR_ADDR A:0xf99822d0
y.create.l HWIO_PERIPH_SS_BAM_DMA_XPU_RG2_SCR_ADDR A:0xf9982350
y.create.l HWIO_PERIPH_SS_BAM_DMA_XPU_RG3_SCR_ADDR A:0xf99823d0
y.create.l HWIO_PERIPH_SS_BAM_DMA_XPU_RG4_SCR_ADDR A:0xf9982450
y.create.l HWIO_PERIPH_SS_BAM_DMA_XPU_RG5_SCR_ADDR A:0xf99824d0
y.create.l HWIO_PERIPH_SS_BAM_DMA_XPU_RG6_SCR_ADDR A:0xf9982550
y.create.l HWIO_PERIPH_SS_BAM_DMA_XPU_RG7_SCR_ADDR A:0xf99825d0
y.create.l HWIO_PERIPH_SS_BAM_DMA_XPU_RG8_SCR_ADDR A:0xf9982650
y.create.l HWIO_PERIPH_SS_BAM_DMA_XPU_RG9_SCR_ADDR A:0xf99826d0
y.create.l HWIO_PERIPH_SS_BAM_DMA_XPU_RG0_MCR_ADDR A:0xf9982254
y.create.l HWIO_PERIPH_SS_BAM_DMA_XPU_RG1_MCR_ADDR A:0xf99822d4
y.create.l HWIO_PERIPH_SS_BAM_DMA_XPU_RG2_MCR_ADDR A:0xf9982354
y.create.l HWIO_PERIPH_SS_BAM_DMA_XPU_RG3_MCR_ADDR A:0xf99823d4
y.create.l HWIO_PERIPH_SS_BAM_DMA_XPU_RG4_MCR_ADDR A:0xf9982454
y.create.l HWIO_PERIPH_SS_BAM_DMA_XPU_RG5_MCR_ADDR A:0xf99824d4
y.create.l HWIO_PERIPH_SS_BAM_DMA_XPU_RG6_MCR_ADDR A:0xf9982554
y.create.l HWIO_PERIPH_SS_BAM_DMA_XPU_RG7_MCR_ADDR A:0xf99825d4
y.create.l HWIO_PERIPH_SS_BAM_DMA_XPU_RG8_MCR_ADDR A:0xf9982654
y.create.l HWIO_PERIPH_SS_BAM_DMA_XPU_RG9_MCR_ADDR A:0xf99826d4
y.create.l HWIO_PERIPH_SS_BAM_DMA_VMIDMT_SCR0_ADDR A:0xf9980000
y.create.l HWIO_PERIPH_SS_BAM_DMA_VMIDMT_SCR1_ADDR A:0xf9980004
y.create.l HWIO_PERIPH_SS_BAM_DMA_VMIDMT_SCR2_ADDR A:0xf9980008
y.create.l HWIO_PERIPH_SS_BAM_DMA_VMIDMT_SACR_ADDR A:0xf9980010
y.create.l HWIO_PERIPH_SS_BAM_DMA_VMIDMT_SIDR0_ADDR A:0xf9980020
y.create.l HWIO_PERIPH_SS_BAM_DMA_VMIDMT_SIDR1_ADDR A:0xf9980024
y.create.l HWIO_PERIPH_SS_BAM_DMA_VMIDMT_SIDR2_ADDR A:0xf9980028
y.create.l HWIO_PERIPH_SS_BAM_DMA_VMIDMT_SIDR4_ADDR A:0xf9980030
y.create.l HWIO_PERIPH_SS_BAM_DMA_VMIDMT_SIDR5_ADDR A:0xf9980034
y.create.l HWIO_PERIPH_SS_BAM_DMA_VMIDMT_SIDR7_ADDR A:0xf998003c
y.create.l HWIO_PERIPH_SS_BAM_DMA_VMIDMT_SGFAR0_ADDR A:0xf9980040
y.create.l HWIO_PERIPH_SS_BAM_DMA_VMIDMT_SGFSR_ADDR A:0xf9980048
y.create.l HWIO_PERIPH_SS_BAM_DMA_VMIDMT_SGFSRRESTORE_ADDR A:0xf998004c
y.create.l HWIO_PERIPH_SS_BAM_DMA_VMIDMT_SGFSYNDR0_ADDR A:0xf9980050
y.create.l HWIO_PERIPH_SS_BAM_DMA_VMIDMT_SGFSYNDR1_ADDR A:0xf9980054
y.create.l HWIO_PERIPH_SS_BAM_DMA_VMIDMT_SGFSYNDR2_ADDR A:0xf9980058
y.create.l HWIO_PERIPH_SS_BAM_DMA_VMIDMT_VMIDMTSCR0_ADDR A:0xf9980090
y.create.l HWIO_PERIPH_SS_BAM_DMA_VMIDMT_CR0_ADDR A:0xf9980000
y.create.l HWIO_PERIPH_SS_BAM_DMA_VMIDMT_CR2_ADDR A:0xf9980008
y.create.l HWIO_PERIPH_SS_BAM_DMA_VMIDMT_ACR_ADDR A:0xf9980010
y.create.l HWIO_PERIPH_SS_BAM_DMA_VMIDMT_IDR0_ADDR A:0xf9980020
y.create.l HWIO_PERIPH_SS_BAM_DMA_VMIDMT_IDR1_ADDR A:0xf9980024
y.create.l HWIO_PERIPH_SS_BAM_DMA_VMIDMT_IDR2_ADDR A:0xf9980028
y.create.l HWIO_PERIPH_SS_BAM_DMA_VMIDMT_IDR4_ADDR A:0xf9980030
y.create.l HWIO_PERIPH_SS_BAM_DMA_VMIDMT_IDR5_ADDR A:0xf9980034
y.create.l HWIO_PERIPH_SS_BAM_DMA_VMIDMT_IDR7_ADDR A:0xf998003c
y.create.l HWIO_PERIPH_SS_BAM_DMA_VMIDMT_GFAR0_ADDR A:0xf9980040
y.create.l HWIO_PERIPH_SS_BAM_DMA_VMIDMT_GFSR_ADDR A:0xf9980048
y.create.l HWIO_PERIPH_SS_BAM_DMA_VMIDMT_GFSRRESTORE_ADDR A:0xf998004c
y.create.l HWIO_PERIPH_SS_BAM_DMA_VMIDMT_GFSYNDR0_ADDR A:0xf9980050
y.create.l HWIO_PERIPH_SS_BAM_DMA_VMIDMT_GFSYNDR1_ADDR A:0xf9980054
y.create.l HWIO_PERIPH_SS_BAM_DMA_VMIDMT_GFSYNDR2_ADDR A:0xf9980058
y.create.l HWIO_PERIPH_SS_BAM_DMA_VMIDMT_VMIDMTCR0_ADDR A:0xf9980090
y.create.l HWIO_PERIPH_SS_BAM_DMA_VMIDMT_VMIDMTACR_ADDR A:0xf998009c
y.create.l HWIO_PERIPH_SS_BAM_DMA_VMIDMT_NSCR0_ADDR A:0xf9980400
y.create.l HWIO_PERIPH_SS_BAM_DMA_VMIDMT_NSCR2_ADDR A:0xf9980408
y.create.l HWIO_PERIPH_SS_BAM_DMA_VMIDMT_NSACR_ADDR A:0xf9980410
y.create.l HWIO_PERIPH_SS_BAM_DMA_VMIDMT_NSGFAR0_ADDR A:0xf9980440
y.create.l HWIO_PERIPH_SS_BAM_DMA_VMIDMT_NSGFSR_ADDR A:0xf9980448
y.create.l HWIO_PERIPH_SS_BAM_DMA_VMIDMT_NSGFSRRESTORE_ADDR A:0xf998044c
y.create.l HWIO_PERIPH_SS_BAM_DMA_VMIDMT_NSGFSYNDR0_ADDR A:0xf9980450
y.create.l HWIO_PERIPH_SS_BAM_DMA_VMIDMT_NSGFSYNDR1_ADDR A:0xf9980454
y.create.l HWIO_PERIPH_SS_BAM_DMA_VMIDMT_NSGFSYNDR2_ADDR A:0xf9980458
y.create.l HWIO_PERIPH_SS_BAM_DMA_VMIDMT_NSVMIDMTCR0_ADDR A:0xf9980490
y.create.l HWIO_PERIPH_SS_BAM_DMA_VMIDMT_SSDR0_ADDR A:0xf9980080
y.create.l HWIO_PERIPH_SS_BAM_DMA_VMIDMT_MSDR0_ADDR A:0xf9980480
y.create.l HWIO_PERIPH_SS_BAM_DMA_VMIDMT_MCR_ADDR A:0xf9980494
y.create.l HWIO_PERIPH_SS_BAM_DMA_VMIDMT_S2VR0_ADDR A:0xf9980c00
y.create.l HWIO_PERIPH_SS_BAM_DMA_VMIDMT_S2VR1_ADDR A:0xf9980c04
y.create.l HWIO_PERIPH_SS_BAM_DMA_VMIDMT_S2VR2_ADDR A:0xf9980c08
y.create.l HWIO_PERIPH_SS_BAM_DMA_VMIDMT_S2VR3_ADDR A:0xf9980c0c
y.create.l HWIO_PERIPH_SS_BAM_DMA_VMIDMT_S2VR4_ADDR A:0xf9980c10
y.create.l HWIO_PERIPH_SS_BAM_DMA_VMIDMT_S2VR5_ADDR A:0xf9980c14
y.create.l HWIO_PERIPH_SS_BAM_DMA_VMIDMT_S2VR6_ADDR A:0xf9980c18
y.create.l HWIO_PERIPH_SS_BAM_DMA_VMIDMT_S2VR7_ADDR A:0xf9980c1c
y.create.l HWIO_PERIPH_SS_BAM_DMA_VMIDMT_S2VR8_ADDR A:0xf9980c20
y.create.l HWIO_PERIPH_SS_BAM_DMA_VMIDMT_S2VR9_ADDR A:0xf9980c24
y.create.l HWIO_PERIPH_SS_BAM_DMA_VMIDMT_AS2VR0_ADDR A:0xf9980e00
y.create.l HWIO_PERIPH_SS_BAM_DMA_VMIDMT_AS2VR1_ADDR A:0xf9980e04
y.create.l HWIO_PERIPH_SS_BAM_DMA_VMIDMT_AS2VR2_ADDR A:0xf9980e08
y.create.l HWIO_PERIPH_SS_BAM_DMA_VMIDMT_AS2VR3_ADDR A:0xf9980e0c
y.create.l HWIO_PERIPH_SS_BAM_DMA_VMIDMT_AS2VR4_ADDR A:0xf9980e10
y.create.l HWIO_PERIPH_SS_BAM_DMA_VMIDMT_AS2VR5_ADDR A:0xf9980e14
y.create.l HWIO_PERIPH_SS_BAM_DMA_VMIDMT_AS2VR6_ADDR A:0xf9980e18
y.create.l HWIO_PERIPH_SS_BAM_DMA_VMIDMT_AS2VR7_ADDR A:0xf9980e1c
y.create.l HWIO_PERIPH_SS_BAM_DMA_VMIDMT_AS2VR8_ADDR A:0xf9980e20
y.create.l HWIO_PERIPH_SS_BAM_DMA_VMIDMT_AS2VR9_ADDR A:0xf9980e24
y.create.l HWIO_PERIPH_SS_BAM_DMA_VMIDMT_SMR0_ADDR A:0xf9980800
y.create.l HWIO_PERIPH_SS_BAM_DMA_VMIDMT_SMR1_ADDR A:0xf9980804
y.create.l HWIO_PERIPH_SS_BAM_DMA_VMIDMT_SMR2_ADDR A:0xf9980808
y.create.l HWIO_PERIPH_SS_BAM_DMA_VMIDMT_SMR3_ADDR A:0xf998080c
y.create.l HWIO_PERIPH_SS_BAM_DMA_VMIDMT_SMR4_ADDR A:0xf9980810
y.create.l HWIO_PERIPH_SS_BAM_DMA_VMIDMT_SMR5_ADDR A:0xf9980814
y.create.l HWIO_PERIPH_SS_BAM_DMA_VMIDMT_SMR6_ADDR A:0xf9980818
y.create.l HWIO_PERIPH_SS_BAM_DMA_VMIDMT_SMR7_ADDR A:0xf998081c
y.create.l HWIO_PERIPH_SS_BAM_DMA_VMIDMT_SMR8_ADDR A:0xf9980820
y.create.l HWIO_PERIPH_SS_BAM_DMA_VMIDMT_SMR9_ADDR A:0xf9980824
y.create.l HWIO_PERIPH_SS_BAM_DMA_DMA_ENBL_ADDR A:0xf9999000
y.create.l HWIO_PERIPH_SS_BAM_DMA_DMA_CHNL_CONFIG0_ADDR A:0xf999a000
y.create.l HWIO_PERIPH_SS_BAM_DMA_DMA_CHNL_CONFIG1_ADDR A:0xf999b000
y.create.l HWIO_PERIPH_SS_BAM_DMA_DMA_CHNL_CONFIG2_ADDR A:0xf999c000
y.create.l HWIO_PERIPH_SS_BAM_DMA_DMA_CHNL_CONFIG3_ADDR A:0xf999d000
y.create.l HWIO_PERIPH_SS_BAM_DMA_DMA_CHNL_CONFIG4_ADDR A:0xf999e000
y.create.l HWIO_PERIPH_SS_BAM_DMA_DMA_CHNL_CONFIG5_ADDR A:0xf999f000
y.create.l HWIO_PERIPH_SS_BAM_DMA_DMA_CHNL_CONFIG6_ADDR A:0xf99a0000
y.create.l HWIO_PERIPH_SS_BAM_DMA_DMA_CHNL_CONFIG7_ADDR A:0xf99a1000
y.create.l HWIO_PERIPH_SS_BAM_DMA_DMA_CHNL_CONFIG8_ADDR A:0xf99a2000
y.create.l HWIO_PERIPH_SS_BAM_DMA_DMA_CHNL_CONFIG9_ADDR A:0xf99a3000
y.create.l HWIO_PERIPH_SS_BAM_DMA_DMA_REVISION_ADDR A:0xf9999004
y.create.l HWIO_PERIPH_SS_BAM_DMA_DMA_CONFIG_ADDR A:0xf9999008
y.create.l HWIO_PERIPH_SS_BAM_DMA_DMA_SW_VERSION_ADDR A:0xf999900c
y.create.l HWIO_PERIPH_SS_USB2_HSIC_USB_OTG_HS_ID_ADDR A:0xf9a15000
y.create.l HWIO_PERIPH_SS_USB2_HSIC_USB_OTG_HS_HWGENERAL_ADDR A:0xf9a15004
y.create.l HWIO_PERIPH_SS_USB2_HSIC_USB_OTG_HS_HWHOST_ADDR A:0xf9a15008
y.create.l HWIO_PERIPH_SS_USB2_HSIC_USB_OTG_HS_HWDEVICE_ADDR A:0xf9a1500c
y.create.l HWIO_PERIPH_SS_USB2_HSIC_USB_OTG_HS_HWTXBUF_ADDR A:0xf9a15010
y.create.l HWIO_PERIPH_SS_USB2_HSIC_USB_OTG_HS_HWRXBUF_ADDR A:0xf9a15014
y.create.l HWIO_PERIPH_SS_USB2_HSIC_USB_OTG_HS_SCRATCH_RAM0_ADDR A:0xf9a15040
y.create.l HWIO_PERIPH_SS_USB2_HSIC_USB_OTG_HS_SCRATCH_RAM1_ADDR A:0xf9a15044
y.create.l HWIO_PERIPH_SS_USB2_HSIC_USB_OTG_HS_SCRATCH_RAM2_ADDR A:0xf9a15048
y.create.l HWIO_PERIPH_SS_USB2_HSIC_USB_OTG_HS_SCRATCH_RAM3_ADDR A:0xf9a1504c
y.create.l HWIO_PERIPH_SS_USB2_HSIC_USB_OTG_HS_SCRATCH_RAM4_ADDR A:0xf9a15050
y.create.l HWIO_PERIPH_SS_USB2_HSIC_USB_OTG_HS_SCRATCH_RAM5_ADDR A:0xf9a15054
y.create.l HWIO_PERIPH_SS_USB2_HSIC_USB_OTG_HS_SCRATCH_RAM6_ADDR A:0xf9a15058
y.create.l HWIO_PERIPH_SS_USB2_HSIC_USB_OTG_HS_SCRATCH_RAM7_ADDR A:0xf9a1505c
y.create.l HWIO_PERIPH_SS_USB2_HSIC_USB_OTG_HS_SCRATCH_RAM8_ADDR A:0xf9a15060
y.create.l HWIO_PERIPH_SS_USB2_HSIC_USB_OTG_HS_SCRATCH_RAM9_ADDR A:0xf9a15064
y.create.l HWIO_PERIPH_SS_USB2_HSIC_USB_OTG_HS_GPTIMER0LD_ADDR A:0xf9a15080
y.create.l HWIO_PERIPH_SS_USB2_HSIC_USB_OTG_HS_GPTIMER0CTRL_ADDR A:0xf9a15084
y.create.l HWIO_PERIPH_SS_USB2_HSIC_USB_OTG_HS_GPTIMER1LD_ADDR A:0xf9a15088
y.create.l HWIO_PERIPH_SS_USB2_HSIC_USB_OTG_HS_GPTIMER1CTRL_ADDR A:0xf9a1508c
y.create.l HWIO_PERIPH_SS_USB2_HSIC_USB_OTG_HS_AHB_BURST_ADDR A:0xf9a15090
y.create.l HWIO_PERIPH_SS_USB2_HSIC_USB_OTG_HS_XTOR_STS_ADDR A:0xf9a15094
y.create.l HWIO_PERIPH_SS_USB2_HSIC_USB_OTG_HS_AHB_MODE_ADDR A:0xf9a15098
y.create.l HWIO_PERIPH_SS_USB2_HSIC_USB_OTG_HS_GEN_CONFIG_ADDR A:0xf9a1509c
y.create.l HWIO_PERIPH_SS_USB2_HSIC_USB_OTG_HS_GEN_CONFIG_2_ADDR A:0xf9a150a0
y.create.l HWIO_PERIPH_SS_USB2_HSIC_USB_OTG_HS_CAPLENGTH_ADDR A:0xf9a15100
y.create.l HWIO_PERIPH_SS_USB2_HSIC_USB_OTG_HS_HCSPARAMS_ADDR A:0xf9a15104
y.create.l HWIO_PERIPH_SS_USB2_HSIC_USB_OTG_HS_HCCPARAMS_ADDR A:0xf9a15108
y.create.l HWIO_PERIPH_SS_USB2_HSIC_USB_OTG_HS_DCIVERSION_ADDR A:0xf9a15120
y.create.l HWIO_PERIPH_SS_USB2_HSIC_USB_OTG_HS_DCCPARAMS_ADDR A:0xf9a15124
y.create.l HWIO_PERIPH_SS_USB2_HSIC_USB_OTG_HS_USBCMD_ADDR A:0xf9a15140
y.create.l HWIO_PERIPH_SS_USB2_HSIC_USB_OTG_HS_USBSTS_ADDR A:0xf9a15144
y.create.l HWIO_PERIPH_SS_USB2_HSIC_USB_OTG_HS_USBINTR_ADDR A:0xf9a15148
y.create.l HWIO_PERIPH_SS_USB2_HSIC_USB_OTG_HS_FRINDEX_ADDR A:0xf9a1514c
y.create.l HWIO_PERIPH_SS_USB2_HSIC_USB_OTG_HS_PERIODICLISTBASE_ADDR A:0xf9a15154
y.create.l HWIO_PERIPH_SS_USB2_HSIC_USB_OTG_HS_DEVICEADDR_ADDR A:0xf9a15154
y.create.l HWIO_PERIPH_SS_USB2_HSIC_USB_OTG_HS_ASYNCLISTADDR_ADDR A:0xf9a15158
y.create.l HWIO_PERIPH_SS_USB2_HSIC_USB_OTG_HS_ENDPOINTLISTADDR_ADDR A:0xf9a15158
y.create.l HWIO_PERIPH_SS_USB2_HSIC_USB_OTG_HS_TTCTRL_ADDR A:0xf9a1515c
y.create.l HWIO_PERIPH_SS_USB2_HSIC_USB_OTG_HS_BURSTSIZE_ADDR A:0xf9a15160
y.create.l HWIO_PERIPH_SS_USB2_HSIC_USB_OTG_HS_TXFILLTUNING_ADDR A:0xf9a15164
y.create.l HWIO_PERIPH_SS_USB2_HSIC_USB_OTG_HS_ULPI_VIEWPORT_ADDR A:0xf9a15170
y.create.l HWIO_PERIPH_SS_USB2_HSIC_USB_OTG_HS_ENDPTNAK_ADDR A:0xf9a15178
y.create.l HWIO_PERIPH_SS_USB2_HSIC_USB_OTG_HS_ENDPTNAKEN_ADDR A:0xf9a1517c
y.create.l HWIO_PERIPH_SS_USB2_HSIC_USB_OTG_HS_PORTSC_ADDR A:0xf9a15184
y.create.l HWIO_PERIPH_SS_USB2_HSIC_USB_OTG_HS_OTGSC_ADDR A:0xf9a151a4
y.create.l HWIO_PERIPH_SS_USB2_HSIC_USB_OTG_HS_USBMODE_ADDR A:0xf9a151a8
y.create.l HWIO_PERIPH_SS_USB2_HSIC_USB_OTG_HS_ENDPTSETUPSTAT_ADDR A:0xf9a151ac
y.create.l HWIO_PERIPH_SS_USB2_HSIC_USB_OTG_HS_ENDPTPRIME_ADDR A:0xf9a151b0
y.create.l HWIO_PERIPH_SS_USB2_HSIC_USB_OTG_HS_ENDPTFLUSH_ADDR A:0xf9a151b4
y.create.l HWIO_PERIPH_SS_USB2_HSIC_USB_OTG_HS_ENDPTSTAT_ADDR A:0xf9a151b8
y.create.l HWIO_PERIPH_SS_USB2_HSIC_USB_OTG_HS_ENDPTCOMPLETE_ADDR A:0xf9a151bc
y.create.l HWIO_PERIPH_SS_USB2_HSIC_USB_OTG_HS_ENDPTCTRL0_ADDR A:0xf9a151c0
y.create.l HWIO_PERIPH_SS_USB2_HSIC_USB_OTG_HS_ENDPTCTRL1_ADDR A:0xf9a151c4
y.create.l HWIO_PERIPH_SS_USB2_HSIC_USB_OTG_HS_ENDPTCTRL2_ADDR A:0xf9a151c8
y.create.l HWIO_PERIPH_SS_USB2_HSIC_USB_OTG_HS_ENDPTCTRL3_ADDR A:0xf9a151cc
y.create.l HWIO_PERIPH_SS_USB2_HSIC_USB_OTG_HS_ENDPTCTRL4_ADDR A:0xf9a151d0
y.create.l HWIO_PERIPH_SS_USB2_HSIC_USB_OTG_HS_ENDPTCTRL5_ADDR A:0xf9a151d4
y.create.l HWIO_PERIPH_SS_USB2_HSIC_USB_OTG_HS_ENDPTCTRL6_ADDR A:0xf9a151d8
y.create.l HWIO_PERIPH_SS_USB2_HSIC_USB_OTG_HS_ENDPTCTRL7_ADDR A:0xf9a151dc
y.create.l HWIO_PERIPH_SS_USB2_HSIC_USB_OTG_HS_ENDPTCTRL8_ADDR A:0xf9a151e0
y.create.l HWIO_PERIPH_SS_USB2_HSIC_USB_OTG_HS_ENDPTCTRL9_ADDR A:0xf9a151e4
y.create.l HWIO_PERIPH_SS_USB2_HSIC_USB_OTG_HS_ENDPTCTRL10_ADDR A:0xf9a151e8
y.create.l HWIO_PERIPH_SS_USB2_HSIC_USB_OTG_HS_ENDPT_PIPE_ID1_ADDR A:0xf9a15200
y.create.l HWIO_PERIPH_SS_USB2_HSIC_USB_OTG_HS_ENDPT_PIPE_ID2_ADDR A:0xf9a15204
y.create.l HWIO_PERIPH_SS_USB2_HSIC_USB_OTG_HS_ENDPT_PIPE_ID3_ADDR A:0xf9a15208
y.create.l HWIO_PERIPH_SS_USB2_HSIC_USB_OTG_HS_ENDPT_PIPE_ID4_ADDR A:0xf9a1520c
y.create.l HWIO_PERIPH_SS_USB2_HSIC_USB_OTG_HS_ENDPT_PIPE_ID5_ADDR A:0xf9a15210
y.create.l HWIO_PERIPH_SS_USB2_HSIC_USB_OTG_HS_ENDPT_PIPE_ID6_ADDR A:0xf9a15214
y.create.l HWIO_PERIPH_SS_USB2_HSIC_USB_OTG_HS_ENDPT_PIPE_ID7_ADDR A:0xf9a15218
y.create.l HWIO_PERIPH_SS_USB2_HSIC_USB_OTG_HS_ENDPT_PIPE_ID8_ADDR A:0xf9a1521c
y.create.l HWIO_PERIPH_SS_USB2_HSIC_USB_OTG_HS_ENDPT_PIPE_ID9_ADDR A:0xf9a15220
y.create.l HWIO_PERIPH_SS_USB2_HSIC_USB_OTG_HS_ENDPT_PIPE_ID10_ADDR A:0xf9a15224
y.create.l HWIO_PERIPH_SS_USB2_HSIC_USB_OTG_HS_GENERIC1_ADDR A:0xf9a15244
y.create.l HWIO_PERIPH_SS_USB2_HSIC_USB_OTG_HS_GENERIC2_ADDR A:0xf9a15248
y.create.l HWIO_PERIPH_SS_USB2_HSIC_USB_OTG_HS_L1_EP_CTRL_ADDR A:0xf9a15250
y.create.l HWIO_PERIPH_SS_USB2_HSIC_USB_OTG_HS_L1_CONFIG_ADDR A:0xf9a15254
y.create.l HWIO_PERIPH_SS_USB2_HSIC_USB_OTG_HS_LPM_DEBUG_1_ADDR A:0xf9a15258
y.create.l HWIO_PERIPH_SS_USB2_HSIC_USB_OTG_HS_LPM_DEBUG_2_ADDR A:0xf9a1525c
y.create.l HWIO_PERIPH_SS_USB2_HSIC_USB_OTG_HS_LPM_ATTRIBUTES_ADDR A:0xf9a15260
y.create.l HWIO_PERIPH_SS_USB2_HSIC_USB_OTG_HS_LPM_TIMERS_ADDR A:0xf9a15264
y.create.l HWIO_PERIPH_SS_USB2_HSIC_USB_OTG_HS_HW_VER_ADDR A:0xf9a15270
y.create.l HWIO_PERIPH_SS_USB2_HSIC_USB_OTG_HS_TEST_BUS_ADDR A:0xf9a15274
y.create.l HWIO_PERIPH_SS_USB2_HSIC_USB_OTG_HS_HBM_CFG_ADDR A:0xf9a15290
y.create.l HWIO_PERIPH_SS_USB2_HSIC_USB_OTG_HS_HBM_QH_MAP_PIPE0_ADDR A:0xf9a15294
y.create.l HWIO_PERIPH_SS_USB2_HSIC_USB_OTG_HS_HBM_QH_MAP_PIPE1_ADDR A:0xf9a15298
y.create.l HWIO_PERIPH_SS_USB2_HSIC_USB_OTG_HS_HBM_QH_MAP_PIPE2_ADDR A:0xf9a1529c
y.create.l HWIO_PERIPH_SS_USB2_HSIC_USB_OTG_HS_HBM_QH_MAP_PIPE3_ADDR A:0xf9a152a0
y.create.l HWIO_PERIPH_SS_USB2_HSIC_USB_OTG_HS_HBM_QH_MAP_PIPE4_ADDR A:0xf9a152a4
y.create.l HWIO_PERIPH_SS_USB2_HSIC_USB_OTG_HS_HBM_QH_MAP_PIPE5_ADDR A:0xf9a152a8
y.create.l HWIO_PERIPH_SS_USB2_HSIC_USB_OTG_HS_HBM_QH_MAP_PIPE6_ADDR A:0xf9a152ac
y.create.l HWIO_PERIPH_SS_USB2_HSIC_USB_OTG_HS_HBM_QH_MAP_PIPE7_ADDR A:0xf9a152b0
y.create.l HWIO_PERIPH_SS_USB2_HSIC_USB_OTG_HS_HBM_QH_MAP_PIPE8_ADDR A:0xf9a152b4
y.create.l HWIO_PERIPH_SS_USB2_HSIC_USB_OTG_HS_HBM_QH_MAP_PIPE9_ADDR A:0xf9a152b8
y.create.l HWIO_PERIPH_SS_USB2_HSIC_USB_OTG_HS_HBM_PIPE_EN_ADDR A:0xf9a15310
y.create.l HWIO_PERIPH_SS_USB2_HSIC_USB_OTG_HS_HBM_PIPE_PRODUCER_ADDR A:0xf9a15314
y.create.l HWIO_PERIPH_SS_USB2_HSIC_USB_OTG_HS_HBM_PARK_MODE_DISABLE_ADDR A:0xf9a15318
y.create.l HWIO_PERIPH_SS_USB2_HSIC_USB_OTG_HS_HBM_PIPE_ZLT_DISABLE_ADDR A:0xf9a1531c
y.create.l HWIO_PERIPH_SS_USB2_HSIC_USB_OTG_HS_HBM_SB_SW_RST_ADDR A:0xf9a15320
y.create.l HWIO_PERIPH_SS_USB2_HSIC_USB_OTG_HS_HBM_SW_RST_ADDR A:0xf9a15324
y.create.l HWIO_PERIPH_SS_USB2_HSIC_USB_OTG_HS_BTO_TIME_HS_ADDR A:0xf9a15340
y.create.l HWIO_PERIPH_SS_USB2_HSIC_USB_OTG_HS_BTO_TIME_FS_LS_ADDR A:0xf9a15344
y.create.l HWIO_PERIPH_SS_USB2_HSIC_USB_OTG_HS_QSB_VALUES_ADDR A:0xf9a15348
y.create.l HWIO_PERIPH_SS_USB2_HSIC_BAM_CTRL_ADDR A:0xf9a04000
y.create.l HWIO_PERIPH_SS_USB2_HSIC_BAM_REVISION_ADDR A:0xf9a04004
y.create.l HWIO_PERIPH_SS_USB2_HSIC_BAM_SW_VERSION_ADDR A:0xf9a04080
y.create.l HWIO_PERIPH_SS_USB2_HSIC_BAM_NUM_PIPES_ADDR A:0xf9a0403c
y.create.l HWIO_PERIPH_SS_USB2_HSIC_BAM_TIMER_ADDR A:0xf9a04040
y.create.l HWIO_PERIPH_SS_USB2_HSIC_BAM_TIMER_CTRL_ADDR A:0xf9a04044
y.create.l HWIO_PERIPH_SS_USB2_HSIC_BAM_DESC_CNT_TRSHLD_ADDR A:0xf9a04008
y.create.l HWIO_PERIPH_SS_USB2_HSIC_BAM_IRQ_SRCS_ADDR A:0xf9a0400c
y.create.l HWIO_PERIPH_SS_USB2_HSIC_BAM_IRQ_SRCS_MSK_ADDR A:0xf9a04010
y.create.l HWIO_PERIPH_SS_USB2_HSIC_BAM_IRQ_SRCS_UNMASKED_ADDR A:0xf9a04030
y.create.l HWIO_PERIPH_SS_USB2_HSIC_BAM_IRQ_STTS_ADDR A:0xf9a04014
y.create.l HWIO_PERIPH_SS_USB2_HSIC_BAM_IRQ_CLR_ADDR A:0xf9a04018
y.create.l HWIO_PERIPH_SS_USB2_HSIC_BAM_IRQ_EN_ADDR A:0xf9a0401c
y.create.l HWIO_PERIPH_SS_USB2_HSIC_BAM_AHB_MASTER_ERR_CTRLS_ADDR A:0xf9a04024
y.create.l HWIO_PERIPH_SS_USB2_HSIC_BAM_AHB_MASTER_ERR_ADDR_ADDR A:0xf9a04028
y.create.l HWIO_PERIPH_SS_USB2_HSIC_BAM_AHB_MASTER_ERR_ADDR_LSB_ADDR A:0xf9a04100
y.create.l HWIO_PERIPH_SS_USB2_HSIC_BAM_AHB_MASTER_ERR_ADDR_MSB_ADDR A:0xf9a04104
y.create.l HWIO_PERIPH_SS_USB2_HSIC_BAM_AHB_MASTER_ERR_DATA_ADDR A:0xf9a0402c
y.create.l HWIO_PERIPH_SS_USB2_HSIC_BAM_TRUST_REG_ADDR A:0xf9a04070
y.create.l HWIO_PERIPH_SS_USB2_HSIC_BAM_TEST_BUS_SEL_ADDR A:0xf9a04074
y.create.l HWIO_PERIPH_SS_USB2_HSIC_BAM_TEST_BUS_REG_ADDR A:0xf9a04078
y.create.l HWIO_PERIPH_SS_USB2_HSIC_BAM_CNFG_BITS_ADDR A:0xf9a0407c
y.create.l HWIO_PERIPH_SS_USB2_HSIC_BAM_IRQ_SRCS_EE0_ADDR A:0xf9a04800
y.create.l HWIO_PERIPH_SS_USB2_HSIC_BAM_IRQ_SRCS_EE1_ADDR A:0xf9a04880
y.create.l HWIO_PERIPH_SS_USB2_HSIC_BAM_IRQ_SRCS_EE2_ADDR A:0xf9a04900
y.create.l HWIO_PERIPH_SS_USB2_HSIC_BAM_IRQ_SRCS_EE3_ADDR A:0xf9a04980
y.create.l HWIO_PERIPH_SS_USB2_HSIC_BAM_IRQ_SRCS_EE4_ADDR A:0xf9a04a00
y.create.l HWIO_PERIPH_SS_USB2_HSIC_BAM_IRQ_SRCS_EE5_ADDR A:0xf9a04a80
y.create.l HWIO_PERIPH_SS_USB2_HSIC_BAM_IRQ_SRCS_EE6_ADDR A:0xf9a04b00
y.create.l HWIO_PERIPH_SS_USB2_HSIC_BAM_IRQ_SRCS_EE7_ADDR A:0xf9a04b80
y.create.l HWIO_PERIPH_SS_USB2_HSIC_BAM_IRQ_SRCS_MSK_EE0_ADDR A:0xf9a04804
y.create.l HWIO_PERIPH_SS_USB2_HSIC_BAM_IRQ_SRCS_MSK_EE1_ADDR A:0xf9a04884
y.create.l HWIO_PERIPH_SS_USB2_HSIC_BAM_IRQ_SRCS_MSK_EE2_ADDR A:0xf9a04904
y.create.l HWIO_PERIPH_SS_USB2_HSIC_BAM_IRQ_SRCS_MSK_EE3_ADDR A:0xf9a04984
y.create.l HWIO_PERIPH_SS_USB2_HSIC_BAM_IRQ_SRCS_MSK_EE4_ADDR A:0xf9a04a04
y.create.l HWIO_PERIPH_SS_USB2_HSIC_BAM_IRQ_SRCS_MSK_EE5_ADDR A:0xf9a04a84
y.create.l HWIO_PERIPH_SS_USB2_HSIC_BAM_IRQ_SRCS_MSK_EE6_ADDR A:0xf9a04b04
y.create.l HWIO_PERIPH_SS_USB2_HSIC_BAM_IRQ_SRCS_MSK_EE7_ADDR A:0xf9a04b84
y.create.l HWIO_PERIPH_SS_USB2_HSIC_BAM_IRQ_SRCS_UNMASKED_EE0_ADDR A:0xf9a04808
y.create.l HWIO_PERIPH_SS_USB2_HSIC_BAM_IRQ_SRCS_UNMASKED_EE1_ADDR A:0xf9a04888
y.create.l HWIO_PERIPH_SS_USB2_HSIC_BAM_IRQ_SRCS_UNMASKED_EE2_ADDR A:0xf9a04908
y.create.l HWIO_PERIPH_SS_USB2_HSIC_BAM_IRQ_SRCS_UNMASKED_EE3_ADDR A:0xf9a04988
y.create.l HWIO_PERIPH_SS_USB2_HSIC_BAM_IRQ_SRCS_UNMASKED_EE4_ADDR A:0xf9a04a08
y.create.l HWIO_PERIPH_SS_USB2_HSIC_BAM_IRQ_SRCS_UNMASKED_EE5_ADDR A:0xf9a04a88
y.create.l HWIO_PERIPH_SS_USB2_HSIC_BAM_IRQ_SRCS_UNMASKED_EE6_ADDR A:0xf9a04b08
y.create.l HWIO_PERIPH_SS_USB2_HSIC_BAM_IRQ_SRCS_UNMASKED_EE7_ADDR A:0xf9a04b88
y.create.l HWIO_PERIPH_SS_USB2_HSIC_BAM_PIPE_ATTR_EE0_ADDR A:0xf9a0480c
y.create.l HWIO_PERIPH_SS_USB2_HSIC_BAM_PIPE_ATTR_EE1_ADDR A:0xf9a0488c
y.create.l HWIO_PERIPH_SS_USB2_HSIC_BAM_PIPE_ATTR_EE2_ADDR A:0xf9a0490c
y.create.l HWIO_PERIPH_SS_USB2_HSIC_BAM_PIPE_ATTR_EE3_ADDR A:0xf9a0498c
y.create.l HWIO_PERIPH_SS_USB2_HSIC_BAM_PIPE_ATTR_EE4_ADDR A:0xf9a04a0c
y.create.l HWIO_PERIPH_SS_USB2_HSIC_BAM_PIPE_ATTR_EE5_ADDR A:0xf9a04a8c
y.create.l HWIO_PERIPH_SS_USB2_HSIC_BAM_PIPE_ATTR_EE6_ADDR A:0xf9a04b0c
y.create.l HWIO_PERIPH_SS_USB2_HSIC_BAM_PIPE_ATTR_EE7_ADDR A:0xf9a04b8c
y.create.l HWIO_PERIPH_SS_USB2_HSIC_BAM_P_CTRL0_ADDR A:0xf9a05000
y.create.l HWIO_PERIPH_SS_USB2_HSIC_BAM_P_CTRL1_ADDR A:0xf9a06000
y.create.l HWIO_PERIPH_SS_USB2_HSIC_BAM_P_CTRL2_ADDR A:0xf9a07000
y.create.l HWIO_PERIPH_SS_USB2_HSIC_BAM_P_CTRL3_ADDR A:0xf9a08000
y.create.l HWIO_PERIPH_SS_USB2_HSIC_BAM_P_CTRL4_ADDR A:0xf9a09000
y.create.l HWIO_PERIPH_SS_USB2_HSIC_BAM_P_CTRL5_ADDR A:0xf9a0a000
y.create.l HWIO_PERIPH_SS_USB2_HSIC_BAM_P_CTRL6_ADDR A:0xf9a0b000
y.create.l HWIO_PERIPH_SS_USB2_HSIC_BAM_P_CTRL7_ADDR A:0xf9a0c000
y.create.l HWIO_PERIPH_SS_USB2_HSIC_BAM_P_CTRL8_ADDR A:0xf9a0d000
y.create.l HWIO_PERIPH_SS_USB2_HSIC_BAM_P_CTRL9_ADDR A:0xf9a0e000
y.create.l HWIO_PERIPH_SS_USB2_HSIC_BAM_P_RST0_ADDR A:0xf9a05004
y.create.l HWIO_PERIPH_SS_USB2_HSIC_BAM_P_RST1_ADDR A:0xf9a06004
y.create.l HWIO_PERIPH_SS_USB2_HSIC_BAM_P_RST2_ADDR A:0xf9a07004
y.create.l HWIO_PERIPH_SS_USB2_HSIC_BAM_P_RST3_ADDR A:0xf9a08004
y.create.l HWIO_PERIPH_SS_USB2_HSIC_BAM_P_RST4_ADDR A:0xf9a09004
y.create.l HWIO_PERIPH_SS_USB2_HSIC_BAM_P_RST5_ADDR A:0xf9a0a004
y.create.l HWIO_PERIPH_SS_USB2_HSIC_BAM_P_RST6_ADDR A:0xf9a0b004
y.create.l HWIO_PERIPH_SS_USB2_HSIC_BAM_P_RST7_ADDR A:0xf9a0c004
y.create.l HWIO_PERIPH_SS_USB2_HSIC_BAM_P_RST8_ADDR A:0xf9a0d004
y.create.l HWIO_PERIPH_SS_USB2_HSIC_BAM_P_RST9_ADDR A:0xf9a0e004
y.create.l HWIO_PERIPH_SS_USB2_HSIC_BAM_P_HALT0_ADDR A:0xf9a05008
y.create.l HWIO_PERIPH_SS_USB2_HSIC_BAM_P_HALT1_ADDR A:0xf9a06008
y.create.l HWIO_PERIPH_SS_USB2_HSIC_BAM_P_HALT2_ADDR A:0xf9a07008
y.create.l HWIO_PERIPH_SS_USB2_HSIC_BAM_P_HALT3_ADDR A:0xf9a08008
y.create.l HWIO_PERIPH_SS_USB2_HSIC_BAM_P_HALT4_ADDR A:0xf9a09008
y.create.l HWIO_PERIPH_SS_USB2_HSIC_BAM_P_HALT5_ADDR A:0xf9a0a008
y.create.l HWIO_PERIPH_SS_USB2_HSIC_BAM_P_HALT6_ADDR A:0xf9a0b008
y.create.l HWIO_PERIPH_SS_USB2_HSIC_BAM_P_HALT7_ADDR A:0xf9a0c008
y.create.l HWIO_PERIPH_SS_USB2_HSIC_BAM_P_HALT8_ADDR A:0xf9a0d008
y.create.l HWIO_PERIPH_SS_USB2_HSIC_BAM_P_HALT9_ADDR A:0xf9a0e008
y.create.l HWIO_PERIPH_SS_USB2_HSIC_BAM_P_TRUST_REG0_ADDR A:0xf9a05030
y.create.l HWIO_PERIPH_SS_USB2_HSIC_BAM_P_TRUST_REG1_ADDR A:0xf9a06030
y.create.l HWIO_PERIPH_SS_USB2_HSIC_BAM_P_TRUST_REG2_ADDR A:0xf9a07030
y.create.l HWIO_PERIPH_SS_USB2_HSIC_BAM_P_TRUST_REG3_ADDR A:0xf9a08030
y.create.l HWIO_PERIPH_SS_USB2_HSIC_BAM_P_TRUST_REG4_ADDR A:0xf9a09030
y.create.l HWIO_PERIPH_SS_USB2_HSIC_BAM_P_TRUST_REG5_ADDR A:0xf9a0a030
y.create.l HWIO_PERIPH_SS_USB2_HSIC_BAM_P_TRUST_REG6_ADDR A:0xf9a0b030
y.create.l HWIO_PERIPH_SS_USB2_HSIC_BAM_P_TRUST_REG7_ADDR A:0xf9a0c030
y.create.l HWIO_PERIPH_SS_USB2_HSIC_BAM_P_TRUST_REG8_ADDR A:0xf9a0d030
y.create.l HWIO_PERIPH_SS_USB2_HSIC_BAM_P_TRUST_REG9_ADDR A:0xf9a0e030
y.create.l HWIO_PERIPH_SS_USB2_HSIC_BAM_P_IRQ_STTS0_ADDR A:0xf9a05010
y.create.l HWIO_PERIPH_SS_USB2_HSIC_BAM_P_IRQ_STTS1_ADDR A:0xf9a06010
y.create.l HWIO_PERIPH_SS_USB2_HSIC_BAM_P_IRQ_STTS2_ADDR A:0xf9a07010
y.create.l HWIO_PERIPH_SS_USB2_HSIC_BAM_P_IRQ_STTS3_ADDR A:0xf9a08010
y.create.l HWIO_PERIPH_SS_USB2_HSIC_BAM_P_IRQ_STTS4_ADDR A:0xf9a09010
y.create.l HWIO_PERIPH_SS_USB2_HSIC_BAM_P_IRQ_STTS5_ADDR A:0xf9a0a010
y.create.l HWIO_PERIPH_SS_USB2_HSIC_BAM_P_IRQ_STTS6_ADDR A:0xf9a0b010
y.create.l HWIO_PERIPH_SS_USB2_HSIC_BAM_P_IRQ_STTS7_ADDR A:0xf9a0c010
y.create.l HWIO_PERIPH_SS_USB2_HSIC_BAM_P_IRQ_STTS8_ADDR A:0xf9a0d010
y.create.l HWIO_PERIPH_SS_USB2_HSIC_BAM_P_IRQ_STTS9_ADDR A:0xf9a0e010
y.create.l HWIO_PERIPH_SS_USB2_HSIC_BAM_P_IRQ_CLR0_ADDR A:0xf9a05014
y.create.l HWIO_PERIPH_SS_USB2_HSIC_BAM_P_IRQ_CLR1_ADDR A:0xf9a06014
y.create.l HWIO_PERIPH_SS_USB2_HSIC_BAM_P_IRQ_CLR2_ADDR A:0xf9a07014
y.create.l HWIO_PERIPH_SS_USB2_HSIC_BAM_P_IRQ_CLR3_ADDR A:0xf9a08014
y.create.l HWIO_PERIPH_SS_USB2_HSIC_BAM_P_IRQ_CLR4_ADDR A:0xf9a09014
y.create.l HWIO_PERIPH_SS_USB2_HSIC_BAM_P_IRQ_CLR5_ADDR A:0xf9a0a014
y.create.l HWIO_PERIPH_SS_USB2_HSIC_BAM_P_IRQ_CLR6_ADDR A:0xf9a0b014
y.create.l HWIO_PERIPH_SS_USB2_HSIC_BAM_P_IRQ_CLR7_ADDR A:0xf9a0c014
y.create.l HWIO_PERIPH_SS_USB2_HSIC_BAM_P_IRQ_CLR8_ADDR A:0xf9a0d014
y.create.l HWIO_PERIPH_SS_USB2_HSIC_BAM_P_IRQ_CLR9_ADDR A:0xf9a0e014
y.create.l HWIO_PERIPH_SS_USB2_HSIC_BAM_P_IRQ_EN0_ADDR A:0xf9a05018
y.create.l HWIO_PERIPH_SS_USB2_HSIC_BAM_P_IRQ_EN1_ADDR A:0xf9a06018
y.create.l HWIO_PERIPH_SS_USB2_HSIC_BAM_P_IRQ_EN2_ADDR A:0xf9a07018
y.create.l HWIO_PERIPH_SS_USB2_HSIC_BAM_P_IRQ_EN3_ADDR A:0xf9a08018
y.create.l HWIO_PERIPH_SS_USB2_HSIC_BAM_P_IRQ_EN4_ADDR A:0xf9a09018
y.create.l HWIO_PERIPH_SS_USB2_HSIC_BAM_P_IRQ_EN5_ADDR A:0xf9a0a018
y.create.l HWIO_PERIPH_SS_USB2_HSIC_BAM_P_IRQ_EN6_ADDR A:0xf9a0b018
y.create.l HWIO_PERIPH_SS_USB2_HSIC_BAM_P_IRQ_EN7_ADDR A:0xf9a0c018
y.create.l HWIO_PERIPH_SS_USB2_HSIC_BAM_P_IRQ_EN8_ADDR A:0xf9a0d018
y.create.l HWIO_PERIPH_SS_USB2_HSIC_BAM_P_IRQ_EN9_ADDR A:0xf9a0e018
y.create.l HWIO_PERIPH_SS_USB2_HSIC_BAM_P_TIMER0_ADDR A:0xf9a0501c
y.create.l HWIO_PERIPH_SS_USB2_HSIC_BAM_P_TIMER1_ADDR A:0xf9a0601c
y.create.l HWIO_PERIPH_SS_USB2_HSIC_BAM_P_TIMER2_ADDR A:0xf9a0701c
y.create.l HWIO_PERIPH_SS_USB2_HSIC_BAM_P_TIMER3_ADDR A:0xf9a0801c
y.create.l HWIO_PERIPH_SS_USB2_HSIC_BAM_P_TIMER4_ADDR A:0xf9a0901c
y.create.l HWIO_PERIPH_SS_USB2_HSIC_BAM_P_TIMER5_ADDR A:0xf9a0a01c
y.create.l HWIO_PERIPH_SS_USB2_HSIC_BAM_P_TIMER6_ADDR A:0xf9a0b01c
y.create.l HWIO_PERIPH_SS_USB2_HSIC_BAM_P_TIMER7_ADDR A:0xf9a0c01c
y.create.l HWIO_PERIPH_SS_USB2_HSIC_BAM_P_TIMER8_ADDR A:0xf9a0d01c
y.create.l HWIO_PERIPH_SS_USB2_HSIC_BAM_P_TIMER9_ADDR A:0xf9a0e01c
y.create.l HWIO_PERIPH_SS_USB2_HSIC_BAM_P_TIMER_CTRL0_ADDR A:0xf9a05020
y.create.l HWIO_PERIPH_SS_USB2_HSIC_BAM_P_TIMER_CTRL1_ADDR A:0xf9a06020
y.create.l HWIO_PERIPH_SS_USB2_HSIC_BAM_P_TIMER_CTRL2_ADDR A:0xf9a07020
y.create.l HWIO_PERIPH_SS_USB2_HSIC_BAM_P_TIMER_CTRL3_ADDR A:0xf9a08020
y.create.l HWIO_PERIPH_SS_USB2_HSIC_BAM_P_TIMER_CTRL4_ADDR A:0xf9a09020
y.create.l HWIO_PERIPH_SS_USB2_HSIC_BAM_P_TIMER_CTRL5_ADDR A:0xf9a0a020
y.create.l HWIO_PERIPH_SS_USB2_HSIC_BAM_P_TIMER_CTRL6_ADDR A:0xf9a0b020
y.create.l HWIO_PERIPH_SS_USB2_HSIC_BAM_P_TIMER_CTRL7_ADDR A:0xf9a0c020
y.create.l HWIO_PERIPH_SS_USB2_HSIC_BAM_P_TIMER_CTRL8_ADDR A:0xf9a0d020
y.create.l HWIO_PERIPH_SS_USB2_HSIC_BAM_P_TIMER_CTRL9_ADDR A:0xf9a0e020
y.create.l HWIO_PERIPH_SS_USB2_HSIC_BAM_P_PRDCR_SDBND0_ADDR A:0xf9a05024
y.create.l HWIO_PERIPH_SS_USB2_HSIC_BAM_P_PRDCR_SDBND1_ADDR A:0xf9a06024
y.create.l HWIO_PERIPH_SS_USB2_HSIC_BAM_P_PRDCR_SDBND2_ADDR A:0xf9a07024
y.create.l HWIO_PERIPH_SS_USB2_HSIC_BAM_P_PRDCR_SDBND3_ADDR A:0xf9a08024
y.create.l HWIO_PERIPH_SS_USB2_HSIC_BAM_P_PRDCR_SDBND4_ADDR A:0xf9a09024
y.create.l HWIO_PERIPH_SS_USB2_HSIC_BAM_P_PRDCR_SDBND5_ADDR A:0xf9a0a024
y.create.l HWIO_PERIPH_SS_USB2_HSIC_BAM_P_PRDCR_SDBND6_ADDR A:0xf9a0b024
y.create.l HWIO_PERIPH_SS_USB2_HSIC_BAM_P_PRDCR_SDBND7_ADDR A:0xf9a0c024
y.create.l HWIO_PERIPH_SS_USB2_HSIC_BAM_P_PRDCR_SDBND8_ADDR A:0xf9a0d024
y.create.l HWIO_PERIPH_SS_USB2_HSIC_BAM_P_PRDCR_SDBND9_ADDR A:0xf9a0e024
y.create.l HWIO_PERIPH_SS_USB2_HSIC_BAM_P_CNSMR_SDBND0_ADDR A:0xf9a05028
y.create.l HWIO_PERIPH_SS_USB2_HSIC_BAM_P_CNSMR_SDBND1_ADDR A:0xf9a06028
y.create.l HWIO_PERIPH_SS_USB2_HSIC_BAM_P_CNSMR_SDBND2_ADDR A:0xf9a07028
y.create.l HWIO_PERIPH_SS_USB2_HSIC_BAM_P_CNSMR_SDBND3_ADDR A:0xf9a08028
y.create.l HWIO_PERIPH_SS_USB2_HSIC_BAM_P_CNSMR_SDBND4_ADDR A:0xf9a09028
y.create.l HWIO_PERIPH_SS_USB2_HSIC_BAM_P_CNSMR_SDBND5_ADDR A:0xf9a0a028
y.create.l HWIO_PERIPH_SS_USB2_HSIC_BAM_P_CNSMR_SDBND6_ADDR A:0xf9a0b028
y.create.l HWIO_PERIPH_SS_USB2_HSIC_BAM_P_CNSMR_SDBND7_ADDR A:0xf9a0c028
y.create.l HWIO_PERIPH_SS_USB2_HSIC_BAM_P_CNSMR_SDBND8_ADDR A:0xf9a0d028
y.create.l HWIO_PERIPH_SS_USB2_HSIC_BAM_P_CNSMR_SDBND9_ADDR A:0xf9a0e028
y.create.l HWIO_PERIPH_SS_USB2_HSIC_BAM_P_EVNT_DEST_ADDR0_ADDR A:0xf9a0582c
y.create.l HWIO_PERIPH_SS_USB2_HSIC_BAM_P_EVNT_DEST_ADDR1_ADDR A:0xf9a0682c
y.create.l HWIO_PERIPH_SS_USB2_HSIC_BAM_P_EVNT_DEST_ADDR2_ADDR A:0xf9a0782c
y.create.l HWIO_PERIPH_SS_USB2_HSIC_BAM_P_EVNT_DEST_ADDR3_ADDR A:0xf9a0882c
y.create.l HWIO_PERIPH_SS_USB2_HSIC_BAM_P_EVNT_DEST_ADDR4_ADDR A:0xf9a0982c
y.create.l HWIO_PERIPH_SS_USB2_HSIC_BAM_P_EVNT_DEST_ADDR5_ADDR A:0xf9a0a82c
y.create.l HWIO_PERIPH_SS_USB2_HSIC_BAM_P_EVNT_DEST_ADDR6_ADDR A:0xf9a0b82c
y.create.l HWIO_PERIPH_SS_USB2_HSIC_BAM_P_EVNT_DEST_ADDR7_ADDR A:0xf9a0c82c
y.create.l HWIO_PERIPH_SS_USB2_HSIC_BAM_P_EVNT_DEST_ADDR8_ADDR A:0xf9a0d82c
y.create.l HWIO_PERIPH_SS_USB2_HSIC_BAM_P_EVNT_DEST_ADDR9_ADDR A:0xf9a0e82c
y.create.l HWIO_PERIPH_SS_USB2_HSIC_BAM_P_EVNT_DEST_ADDR_LSB0_ADDR A:0xf9a05930
y.create.l HWIO_PERIPH_SS_USB2_HSIC_BAM_P_EVNT_DEST_ADDR_LSB1_ADDR A:0xf9a06930
y.create.l HWIO_PERIPH_SS_USB2_HSIC_BAM_P_EVNT_DEST_ADDR_LSB2_ADDR A:0xf9a07930
y.create.l HWIO_PERIPH_SS_USB2_HSIC_BAM_P_EVNT_DEST_ADDR_LSB3_ADDR A:0xf9a08930
y.create.l HWIO_PERIPH_SS_USB2_HSIC_BAM_P_EVNT_DEST_ADDR_LSB4_ADDR A:0xf9a09930
y.create.l HWIO_PERIPH_SS_USB2_HSIC_BAM_P_EVNT_DEST_ADDR_LSB5_ADDR A:0xf9a0a930
y.create.l HWIO_PERIPH_SS_USB2_HSIC_BAM_P_EVNT_DEST_ADDR_LSB6_ADDR A:0xf9a0b930
y.create.l HWIO_PERIPH_SS_USB2_HSIC_BAM_P_EVNT_DEST_ADDR_LSB7_ADDR A:0xf9a0c930
y.create.l HWIO_PERIPH_SS_USB2_HSIC_BAM_P_EVNT_DEST_ADDR_LSB8_ADDR A:0xf9a0d930
y.create.l HWIO_PERIPH_SS_USB2_HSIC_BAM_P_EVNT_DEST_ADDR_LSB9_ADDR A:0xf9a0e930
y.create.l HWIO_PERIPH_SS_USB2_HSIC_BAM_P_EVNT_DEST_ADDR_MSB0_ADDR A:0xf9a05934
y.create.l HWIO_PERIPH_SS_USB2_HSIC_BAM_P_EVNT_DEST_ADDR_MSB1_ADDR A:0xf9a06934
y.create.l HWIO_PERIPH_SS_USB2_HSIC_BAM_P_EVNT_DEST_ADDR_MSB2_ADDR A:0xf9a07934
y.create.l HWIO_PERIPH_SS_USB2_HSIC_BAM_P_EVNT_DEST_ADDR_MSB3_ADDR A:0xf9a08934
y.create.l HWIO_PERIPH_SS_USB2_HSIC_BAM_P_EVNT_DEST_ADDR_MSB4_ADDR A:0xf9a09934
y.create.l HWIO_PERIPH_SS_USB2_HSIC_BAM_P_EVNT_DEST_ADDR_MSB5_ADDR A:0xf9a0a934
y.create.l HWIO_PERIPH_SS_USB2_HSIC_BAM_P_EVNT_DEST_ADDR_MSB6_ADDR A:0xf9a0b934
y.create.l HWIO_PERIPH_SS_USB2_HSIC_BAM_P_EVNT_DEST_ADDR_MSB7_ADDR A:0xf9a0c934
y.create.l HWIO_PERIPH_SS_USB2_HSIC_BAM_P_EVNT_DEST_ADDR_MSB8_ADDR A:0xf9a0d934
y.create.l HWIO_PERIPH_SS_USB2_HSIC_BAM_P_EVNT_DEST_ADDR_MSB9_ADDR A:0xf9a0e934
y.create.l HWIO_PERIPH_SS_USB2_HSIC_BAM_P_EVNT_REG0_ADDR A:0xf9a05818
y.create.l HWIO_PERIPH_SS_USB2_HSIC_BAM_P_EVNT_REG1_ADDR A:0xf9a06818
y.create.l HWIO_PERIPH_SS_USB2_HSIC_BAM_P_EVNT_REG2_ADDR A:0xf9a07818
y.create.l HWIO_PERIPH_SS_USB2_HSIC_BAM_P_EVNT_REG3_ADDR A:0xf9a08818
y.create.l HWIO_PERIPH_SS_USB2_HSIC_BAM_P_EVNT_REG4_ADDR A:0xf9a09818
y.create.l HWIO_PERIPH_SS_USB2_HSIC_BAM_P_EVNT_REG5_ADDR A:0xf9a0a818
y.create.l HWIO_PERIPH_SS_USB2_HSIC_BAM_P_EVNT_REG6_ADDR A:0xf9a0b818
y.create.l HWIO_PERIPH_SS_USB2_HSIC_BAM_P_EVNT_REG7_ADDR A:0xf9a0c818
y.create.l HWIO_PERIPH_SS_USB2_HSIC_BAM_P_EVNT_REG8_ADDR A:0xf9a0d818
y.create.l HWIO_PERIPH_SS_USB2_HSIC_BAM_P_EVNT_REG9_ADDR A:0xf9a0e818
y.create.l HWIO_PERIPH_SS_USB2_HSIC_BAM_P_SW_OFSTS0_ADDR A:0xf9a05800
y.create.l HWIO_PERIPH_SS_USB2_HSIC_BAM_P_SW_OFSTS1_ADDR A:0xf9a06800
y.create.l HWIO_PERIPH_SS_USB2_HSIC_BAM_P_SW_OFSTS2_ADDR A:0xf9a07800
y.create.l HWIO_PERIPH_SS_USB2_HSIC_BAM_P_SW_OFSTS3_ADDR A:0xf9a08800
y.create.l HWIO_PERIPH_SS_USB2_HSIC_BAM_P_SW_OFSTS4_ADDR A:0xf9a09800
y.create.l HWIO_PERIPH_SS_USB2_HSIC_BAM_P_SW_OFSTS5_ADDR A:0xf9a0a800
y.create.l HWIO_PERIPH_SS_USB2_HSIC_BAM_P_SW_OFSTS6_ADDR A:0xf9a0b800
y.create.l HWIO_PERIPH_SS_USB2_HSIC_BAM_P_SW_OFSTS7_ADDR A:0xf9a0c800
y.create.l HWIO_PERIPH_SS_USB2_HSIC_BAM_P_SW_OFSTS8_ADDR A:0xf9a0d800
y.create.l HWIO_PERIPH_SS_USB2_HSIC_BAM_P_SW_OFSTS9_ADDR A:0xf9a0e800
y.create.l HWIO_PERIPH_SS_USB2_HSIC_BAM_P_DATA_FIFO_ADDR0_ADDR A:0xf9a05824
y.create.l HWIO_PERIPH_SS_USB2_HSIC_BAM_P_DATA_FIFO_ADDR1_ADDR A:0xf9a06824
y.create.l HWIO_PERIPH_SS_USB2_HSIC_BAM_P_DATA_FIFO_ADDR2_ADDR A:0xf9a07824
y.create.l HWIO_PERIPH_SS_USB2_HSIC_BAM_P_DATA_FIFO_ADDR3_ADDR A:0xf9a08824
y.create.l HWIO_PERIPH_SS_USB2_HSIC_BAM_P_DATA_FIFO_ADDR4_ADDR A:0xf9a09824
y.create.l HWIO_PERIPH_SS_USB2_HSIC_BAM_P_DATA_FIFO_ADDR5_ADDR A:0xf9a0a824
y.create.l HWIO_PERIPH_SS_USB2_HSIC_BAM_P_DATA_FIFO_ADDR6_ADDR A:0xf9a0b824
y.create.l HWIO_PERIPH_SS_USB2_HSIC_BAM_P_DATA_FIFO_ADDR7_ADDR A:0xf9a0c824
y.create.l HWIO_PERIPH_SS_USB2_HSIC_BAM_P_DATA_FIFO_ADDR8_ADDR A:0xf9a0d824
y.create.l HWIO_PERIPH_SS_USB2_HSIC_BAM_P_DATA_FIFO_ADDR9_ADDR A:0xf9a0e824
y.create.l HWIO_PERIPH_SS_USB2_HSIC_BAM_P_DATA_FIFO_ADDR_LSB0_ADDR A:0xf9a05920
y.create.l HWIO_PERIPH_SS_USB2_HSIC_BAM_P_DATA_FIFO_ADDR_LSB1_ADDR A:0xf9a06920
y.create.l HWIO_PERIPH_SS_USB2_HSIC_BAM_P_DATA_FIFO_ADDR_LSB2_ADDR A:0xf9a07920
y.create.l HWIO_PERIPH_SS_USB2_HSIC_BAM_P_DATA_FIFO_ADDR_LSB3_ADDR A:0xf9a08920
y.create.l HWIO_PERIPH_SS_USB2_HSIC_BAM_P_DATA_FIFO_ADDR_LSB4_ADDR A:0xf9a09920
y.create.l HWIO_PERIPH_SS_USB2_HSIC_BAM_P_DATA_FIFO_ADDR_LSB5_ADDR A:0xf9a0a920
y.create.l HWIO_PERIPH_SS_USB2_HSIC_BAM_P_DATA_FIFO_ADDR_LSB6_ADDR A:0xf9a0b920
y.create.l HWIO_PERIPH_SS_USB2_HSIC_BAM_P_DATA_FIFO_ADDR_LSB7_ADDR A:0xf9a0c920
y.create.l HWIO_PERIPH_SS_USB2_HSIC_BAM_P_DATA_FIFO_ADDR_LSB8_ADDR A:0xf9a0d920
y.create.l HWIO_PERIPH_SS_USB2_HSIC_BAM_P_DATA_FIFO_ADDR_LSB9_ADDR A:0xf9a0e920
y.create.l HWIO_PERIPH_SS_USB2_HSIC_BAM_P_DATA_FIFO_ADDR_MSB0_ADDR A:0xf9a05924
y.create.l HWIO_PERIPH_SS_USB2_HSIC_BAM_P_DATA_FIFO_ADDR_MSB1_ADDR A:0xf9a06924
y.create.l HWIO_PERIPH_SS_USB2_HSIC_BAM_P_DATA_FIFO_ADDR_MSB2_ADDR A:0xf9a07924
y.create.l HWIO_PERIPH_SS_USB2_HSIC_BAM_P_DATA_FIFO_ADDR_MSB3_ADDR A:0xf9a08924
y.create.l HWIO_PERIPH_SS_USB2_HSIC_BAM_P_DATA_FIFO_ADDR_MSB4_ADDR A:0xf9a09924
y.create.l HWIO_PERIPH_SS_USB2_HSIC_BAM_P_DATA_FIFO_ADDR_MSB5_ADDR A:0xf9a0a924
y.create.l HWIO_PERIPH_SS_USB2_HSIC_BAM_P_DATA_FIFO_ADDR_MSB6_ADDR A:0xf9a0b924
y.create.l HWIO_PERIPH_SS_USB2_HSIC_BAM_P_DATA_FIFO_ADDR_MSB7_ADDR A:0xf9a0c924
y.create.l HWIO_PERIPH_SS_USB2_HSIC_BAM_P_DATA_FIFO_ADDR_MSB8_ADDR A:0xf9a0d924
y.create.l HWIO_PERIPH_SS_USB2_HSIC_BAM_P_DATA_FIFO_ADDR_MSB9_ADDR A:0xf9a0e924
y.create.l HWIO_PERIPH_SS_USB2_HSIC_BAM_P_DESC_FIFO_ADDR0_ADDR A:0xf9a0581c
y.create.l HWIO_PERIPH_SS_USB2_HSIC_BAM_P_DESC_FIFO_ADDR1_ADDR A:0xf9a0681c
y.create.l HWIO_PERIPH_SS_USB2_HSIC_BAM_P_DESC_FIFO_ADDR2_ADDR A:0xf9a0781c
y.create.l HWIO_PERIPH_SS_USB2_HSIC_BAM_P_DESC_FIFO_ADDR3_ADDR A:0xf9a0881c
y.create.l HWIO_PERIPH_SS_USB2_HSIC_BAM_P_DESC_FIFO_ADDR4_ADDR A:0xf9a0981c
y.create.l HWIO_PERIPH_SS_USB2_HSIC_BAM_P_DESC_FIFO_ADDR5_ADDR A:0xf9a0a81c
y.create.l HWIO_PERIPH_SS_USB2_HSIC_BAM_P_DESC_FIFO_ADDR6_ADDR A:0xf9a0b81c
y.create.l HWIO_PERIPH_SS_USB2_HSIC_BAM_P_DESC_FIFO_ADDR7_ADDR A:0xf9a0c81c
y.create.l HWIO_PERIPH_SS_USB2_HSIC_BAM_P_DESC_FIFO_ADDR8_ADDR A:0xf9a0d81c
y.create.l HWIO_PERIPH_SS_USB2_HSIC_BAM_P_DESC_FIFO_ADDR9_ADDR A:0xf9a0e81c
y.create.l HWIO_PERIPH_SS_USB2_HSIC_BAM_P_DESC_FIFO_ADDR_LSB0_ADDR A:0xf9a05910
y.create.l HWIO_PERIPH_SS_USB2_HSIC_BAM_P_DESC_FIFO_ADDR_LSB1_ADDR A:0xf9a06910
y.create.l HWIO_PERIPH_SS_USB2_HSIC_BAM_P_DESC_FIFO_ADDR_LSB2_ADDR A:0xf9a07910
y.create.l HWIO_PERIPH_SS_USB2_HSIC_BAM_P_DESC_FIFO_ADDR_LSB3_ADDR A:0xf9a08910
y.create.l HWIO_PERIPH_SS_USB2_HSIC_BAM_P_DESC_FIFO_ADDR_LSB4_ADDR A:0xf9a09910
y.create.l HWIO_PERIPH_SS_USB2_HSIC_BAM_P_DESC_FIFO_ADDR_LSB5_ADDR A:0xf9a0a910
y.create.l HWIO_PERIPH_SS_USB2_HSIC_BAM_P_DESC_FIFO_ADDR_LSB6_ADDR A:0xf9a0b910
y.create.l HWIO_PERIPH_SS_USB2_HSIC_BAM_P_DESC_FIFO_ADDR_LSB7_ADDR A:0xf9a0c910
y.create.l HWIO_PERIPH_SS_USB2_HSIC_BAM_P_DESC_FIFO_ADDR_LSB8_ADDR A:0xf9a0d910
y.create.l HWIO_PERIPH_SS_USB2_HSIC_BAM_P_DESC_FIFO_ADDR_LSB9_ADDR A:0xf9a0e910
y.create.l HWIO_PERIPH_SS_USB2_HSIC_BAM_P_DESC_FIFO_ADDR_MSB0_ADDR A:0xf9a05914
y.create.l HWIO_PERIPH_SS_USB2_HSIC_BAM_P_DESC_FIFO_ADDR_MSB1_ADDR A:0xf9a06914
y.create.l HWIO_PERIPH_SS_USB2_HSIC_BAM_P_DESC_FIFO_ADDR_MSB2_ADDR A:0xf9a07914
y.create.l HWIO_PERIPH_SS_USB2_HSIC_BAM_P_DESC_FIFO_ADDR_MSB3_ADDR A:0xf9a08914
y.create.l HWIO_PERIPH_SS_USB2_HSIC_BAM_P_DESC_FIFO_ADDR_MSB4_ADDR A:0xf9a09914
y.create.l HWIO_PERIPH_SS_USB2_HSIC_BAM_P_DESC_FIFO_ADDR_MSB5_ADDR A:0xf9a0a914
y.create.l HWIO_PERIPH_SS_USB2_HSIC_BAM_P_DESC_FIFO_ADDR_MSB6_ADDR A:0xf9a0b914
y.create.l HWIO_PERIPH_SS_USB2_HSIC_BAM_P_DESC_FIFO_ADDR_MSB7_ADDR A:0xf9a0c914
y.create.l HWIO_PERIPH_SS_USB2_HSIC_BAM_P_DESC_FIFO_ADDR_MSB8_ADDR A:0xf9a0d914
y.create.l HWIO_PERIPH_SS_USB2_HSIC_BAM_P_DESC_FIFO_ADDR_MSB9_ADDR A:0xf9a0e914
y.create.l HWIO_PERIPH_SS_USB2_HSIC_BAM_P_EVNT_GEN_TRSHLD0_ADDR A:0xf9a05828
y.create.l HWIO_PERIPH_SS_USB2_HSIC_BAM_P_EVNT_GEN_TRSHLD1_ADDR A:0xf9a06828
y.create.l HWIO_PERIPH_SS_USB2_HSIC_BAM_P_EVNT_GEN_TRSHLD2_ADDR A:0xf9a07828
y.create.l HWIO_PERIPH_SS_USB2_HSIC_BAM_P_EVNT_GEN_TRSHLD3_ADDR A:0xf9a08828
y.create.l HWIO_PERIPH_SS_USB2_HSIC_BAM_P_EVNT_GEN_TRSHLD4_ADDR A:0xf9a09828
y.create.l HWIO_PERIPH_SS_USB2_HSIC_BAM_P_EVNT_GEN_TRSHLD5_ADDR A:0xf9a0a828
y.create.l HWIO_PERIPH_SS_USB2_HSIC_BAM_P_EVNT_GEN_TRSHLD6_ADDR A:0xf9a0b828
y.create.l HWIO_PERIPH_SS_USB2_HSIC_BAM_P_EVNT_GEN_TRSHLD7_ADDR A:0xf9a0c828
y.create.l HWIO_PERIPH_SS_USB2_HSIC_BAM_P_EVNT_GEN_TRSHLD8_ADDR A:0xf9a0d828
y.create.l HWIO_PERIPH_SS_USB2_HSIC_BAM_P_EVNT_GEN_TRSHLD9_ADDR A:0xf9a0e828
y.create.l HWIO_PERIPH_SS_USB2_HSIC_BAM_P_FIFO_SIZES0_ADDR A:0xf9a05820
y.create.l HWIO_PERIPH_SS_USB2_HSIC_BAM_P_FIFO_SIZES1_ADDR A:0xf9a06820
y.create.l HWIO_PERIPH_SS_USB2_HSIC_BAM_P_FIFO_SIZES2_ADDR A:0xf9a07820
y.create.l HWIO_PERIPH_SS_USB2_HSIC_BAM_P_FIFO_SIZES3_ADDR A:0xf9a08820
y.create.l HWIO_PERIPH_SS_USB2_HSIC_BAM_P_FIFO_SIZES4_ADDR A:0xf9a09820
y.create.l HWIO_PERIPH_SS_USB2_HSIC_BAM_P_FIFO_SIZES5_ADDR A:0xf9a0a820
y.create.l HWIO_PERIPH_SS_USB2_HSIC_BAM_P_FIFO_SIZES6_ADDR A:0xf9a0b820
y.create.l HWIO_PERIPH_SS_USB2_HSIC_BAM_P_FIFO_SIZES7_ADDR A:0xf9a0c820
y.create.l HWIO_PERIPH_SS_USB2_HSIC_BAM_P_FIFO_SIZES8_ADDR A:0xf9a0d820
y.create.l HWIO_PERIPH_SS_USB2_HSIC_BAM_P_FIFO_SIZES9_ADDR A:0xf9a0e820
y.create.l HWIO_PERIPH_SS_USB2_HSIC_BAM_P_RETR_CNTXT_0_ADDR A:0xf9a05834
y.create.l HWIO_PERIPH_SS_USB2_HSIC_BAM_P_RETR_CNTXT_1_ADDR A:0xf9a06834
y.create.l HWIO_PERIPH_SS_USB2_HSIC_BAM_P_RETR_CNTXT_2_ADDR A:0xf9a07834
y.create.l HWIO_PERIPH_SS_USB2_HSIC_BAM_P_RETR_CNTXT_3_ADDR A:0xf9a08834
y.create.l HWIO_PERIPH_SS_USB2_HSIC_BAM_P_RETR_CNTXT_4_ADDR A:0xf9a09834
y.create.l HWIO_PERIPH_SS_USB2_HSIC_BAM_P_RETR_CNTXT_5_ADDR A:0xf9a0a834
y.create.l HWIO_PERIPH_SS_USB2_HSIC_BAM_P_RETR_CNTXT_6_ADDR A:0xf9a0b834
y.create.l HWIO_PERIPH_SS_USB2_HSIC_BAM_P_RETR_CNTXT_7_ADDR A:0xf9a0c834
y.create.l HWIO_PERIPH_SS_USB2_HSIC_BAM_P_RETR_CNTXT_8_ADDR A:0xf9a0d834
y.create.l HWIO_PERIPH_SS_USB2_HSIC_BAM_P_RETR_CNTXT_9_ADDR A:0xf9a0e834
y.create.l HWIO_PERIPH_SS_USB2_HSIC_BAM_P_SI_CNTXT_0_ADDR A:0xf9a05838
y.create.l HWIO_PERIPH_SS_USB2_HSIC_BAM_P_SI_CNTXT_1_ADDR A:0xf9a06838
y.create.l HWIO_PERIPH_SS_USB2_HSIC_BAM_P_SI_CNTXT_2_ADDR A:0xf9a07838
y.create.l HWIO_PERIPH_SS_USB2_HSIC_BAM_P_SI_CNTXT_3_ADDR A:0xf9a08838
y.create.l HWIO_PERIPH_SS_USB2_HSIC_BAM_P_SI_CNTXT_4_ADDR A:0xf9a09838
y.create.l HWIO_PERIPH_SS_USB2_HSIC_BAM_P_SI_CNTXT_5_ADDR A:0xf9a0a838
y.create.l HWIO_PERIPH_SS_USB2_HSIC_BAM_P_SI_CNTXT_6_ADDR A:0xf9a0b838
y.create.l HWIO_PERIPH_SS_USB2_HSIC_BAM_P_SI_CNTXT_7_ADDR A:0xf9a0c838
y.create.l HWIO_PERIPH_SS_USB2_HSIC_BAM_P_SI_CNTXT_8_ADDR A:0xf9a0d838
y.create.l HWIO_PERIPH_SS_USB2_HSIC_BAM_P_SI_CNTXT_9_ADDR A:0xf9a0e838
y.create.l HWIO_PERIPH_SS_USB2_HSIC_BAM_P_DF_CNTXT_0_ADDR A:0xf9a05830
y.create.l HWIO_PERIPH_SS_USB2_HSIC_BAM_P_DF_CNTXT_1_ADDR A:0xf9a06830
y.create.l HWIO_PERIPH_SS_USB2_HSIC_BAM_P_DF_CNTXT_2_ADDR A:0xf9a07830
y.create.l HWIO_PERIPH_SS_USB2_HSIC_BAM_P_DF_CNTXT_3_ADDR A:0xf9a08830
y.create.l HWIO_PERIPH_SS_USB2_HSIC_BAM_P_DF_CNTXT_4_ADDR A:0xf9a09830
y.create.l HWIO_PERIPH_SS_USB2_HSIC_BAM_P_DF_CNTXT_5_ADDR A:0xf9a0a830
y.create.l HWIO_PERIPH_SS_USB2_HSIC_BAM_P_DF_CNTXT_6_ADDR A:0xf9a0b830
y.create.l HWIO_PERIPH_SS_USB2_HSIC_BAM_P_DF_CNTXT_7_ADDR A:0xf9a0c830
y.create.l HWIO_PERIPH_SS_USB2_HSIC_BAM_P_DF_CNTXT_8_ADDR A:0xf9a0d830
y.create.l HWIO_PERIPH_SS_USB2_HSIC_BAM_P_DF_CNTXT_9_ADDR A:0xf9a0e830
y.create.l HWIO_PERIPH_SS_USB2_HSIC_BAM_P_AU_PSM_CNTXT_1_0_ADDR A:0xf9a05804
y.create.l HWIO_PERIPH_SS_USB2_HSIC_BAM_P_AU_PSM_CNTXT_1_1_ADDR A:0xf9a06804
y.create.l HWIO_PERIPH_SS_USB2_HSIC_BAM_P_AU_PSM_CNTXT_1_2_ADDR A:0xf9a07804
y.create.l HWIO_PERIPH_SS_USB2_HSIC_BAM_P_AU_PSM_CNTXT_1_3_ADDR A:0xf9a08804
y.create.l HWIO_PERIPH_SS_USB2_HSIC_BAM_P_AU_PSM_CNTXT_1_4_ADDR A:0xf9a09804
y.create.l HWIO_PERIPH_SS_USB2_HSIC_BAM_P_AU_PSM_CNTXT_1_5_ADDR A:0xf9a0a804
y.create.l HWIO_PERIPH_SS_USB2_HSIC_BAM_P_AU_PSM_CNTXT_1_6_ADDR A:0xf9a0b804
y.create.l HWIO_PERIPH_SS_USB2_HSIC_BAM_P_AU_PSM_CNTXT_1_7_ADDR A:0xf9a0c804
y.create.l HWIO_PERIPH_SS_USB2_HSIC_BAM_P_AU_PSM_CNTXT_1_8_ADDR A:0xf9a0d804
y.create.l HWIO_PERIPH_SS_USB2_HSIC_BAM_P_AU_PSM_CNTXT_1_9_ADDR A:0xf9a0e804
y.create.l HWIO_PERIPH_SS_USB2_HSIC_BAM_P_PSM_CNTXT_2_0_ADDR A:0xf9a05808
y.create.l HWIO_PERIPH_SS_USB2_HSIC_BAM_P_PSM_CNTXT_2_1_ADDR A:0xf9a06808
y.create.l HWIO_PERIPH_SS_USB2_HSIC_BAM_P_PSM_CNTXT_2_2_ADDR A:0xf9a07808
y.create.l HWIO_PERIPH_SS_USB2_HSIC_BAM_P_PSM_CNTXT_2_3_ADDR A:0xf9a08808
y.create.l HWIO_PERIPH_SS_USB2_HSIC_BAM_P_PSM_CNTXT_2_4_ADDR A:0xf9a09808
y.create.l HWIO_PERIPH_SS_USB2_HSIC_BAM_P_PSM_CNTXT_2_5_ADDR A:0xf9a0a808
y.create.l HWIO_PERIPH_SS_USB2_HSIC_BAM_P_PSM_CNTXT_2_6_ADDR A:0xf9a0b808
y.create.l HWIO_PERIPH_SS_USB2_HSIC_BAM_P_PSM_CNTXT_2_7_ADDR A:0xf9a0c808
y.create.l HWIO_PERIPH_SS_USB2_HSIC_BAM_P_PSM_CNTXT_2_8_ADDR A:0xf9a0d808
y.create.l HWIO_PERIPH_SS_USB2_HSIC_BAM_P_PSM_CNTXT_2_9_ADDR A:0xf9a0e808
y.create.l HWIO_PERIPH_SS_USB2_HSIC_BAM_P_PSM_CNTXT_3_0_ADDR A:0xf9a0580c
y.create.l HWIO_PERIPH_SS_USB2_HSIC_BAM_P_PSM_CNTXT_3_1_ADDR A:0xf9a0680c
y.create.l HWIO_PERIPH_SS_USB2_HSIC_BAM_P_PSM_CNTXT_3_2_ADDR A:0xf9a0780c
y.create.l HWIO_PERIPH_SS_USB2_HSIC_BAM_P_PSM_CNTXT_3_3_ADDR A:0xf9a0880c
y.create.l HWIO_PERIPH_SS_USB2_HSIC_BAM_P_PSM_CNTXT_3_4_ADDR A:0xf9a0980c
y.create.l HWIO_PERIPH_SS_USB2_HSIC_BAM_P_PSM_CNTXT_3_5_ADDR A:0xf9a0a80c
y.create.l HWIO_PERIPH_SS_USB2_HSIC_BAM_P_PSM_CNTXT_3_6_ADDR A:0xf9a0b80c
y.create.l HWIO_PERIPH_SS_USB2_HSIC_BAM_P_PSM_CNTXT_3_7_ADDR A:0xf9a0c80c
y.create.l HWIO_PERIPH_SS_USB2_HSIC_BAM_P_PSM_CNTXT_3_8_ADDR A:0xf9a0d80c
y.create.l HWIO_PERIPH_SS_USB2_HSIC_BAM_P_PSM_CNTXT_3_9_ADDR A:0xf9a0e80c
y.create.l HWIO_PERIPH_SS_USB2_HSIC_BAM_P_PSM_CNTXT_3_LSB0_ADDR A:0xf9a05900
y.create.l HWIO_PERIPH_SS_USB2_HSIC_BAM_P_PSM_CNTXT_3_LSB1_ADDR A:0xf9a06900
y.create.l HWIO_PERIPH_SS_USB2_HSIC_BAM_P_PSM_CNTXT_3_LSB2_ADDR A:0xf9a07900
y.create.l HWIO_PERIPH_SS_USB2_HSIC_BAM_P_PSM_CNTXT_3_LSB3_ADDR A:0xf9a08900
y.create.l HWIO_PERIPH_SS_USB2_HSIC_BAM_P_PSM_CNTXT_3_LSB4_ADDR A:0xf9a09900
y.create.l HWIO_PERIPH_SS_USB2_HSIC_BAM_P_PSM_CNTXT_3_LSB5_ADDR A:0xf9a0a900
y.create.l HWIO_PERIPH_SS_USB2_HSIC_BAM_P_PSM_CNTXT_3_LSB6_ADDR A:0xf9a0b900
y.create.l HWIO_PERIPH_SS_USB2_HSIC_BAM_P_PSM_CNTXT_3_LSB7_ADDR A:0xf9a0c900
y.create.l HWIO_PERIPH_SS_USB2_HSIC_BAM_P_PSM_CNTXT_3_LSB8_ADDR A:0xf9a0d900
y.create.l HWIO_PERIPH_SS_USB2_HSIC_BAM_P_PSM_CNTXT_3_LSB9_ADDR A:0xf9a0e900
y.create.l HWIO_PERIPH_SS_USB2_HSIC_BAM_P_PSM_CNTXT_3_MSB0_ADDR A:0xf9a05904
y.create.l HWIO_PERIPH_SS_USB2_HSIC_BAM_P_PSM_CNTXT_3_MSB1_ADDR A:0xf9a06904
y.create.l HWIO_PERIPH_SS_USB2_HSIC_BAM_P_PSM_CNTXT_3_MSB2_ADDR A:0xf9a07904
y.create.l HWIO_PERIPH_SS_USB2_HSIC_BAM_P_PSM_CNTXT_3_MSB3_ADDR A:0xf9a08904
y.create.l HWIO_PERIPH_SS_USB2_HSIC_BAM_P_PSM_CNTXT_3_MSB4_ADDR A:0xf9a09904
y.create.l HWIO_PERIPH_SS_USB2_HSIC_BAM_P_PSM_CNTXT_3_MSB5_ADDR A:0xf9a0a904
y.create.l HWIO_PERIPH_SS_USB2_HSIC_BAM_P_PSM_CNTXT_3_MSB6_ADDR A:0xf9a0b904
y.create.l HWIO_PERIPH_SS_USB2_HSIC_BAM_P_PSM_CNTXT_3_MSB7_ADDR A:0xf9a0c904
y.create.l HWIO_PERIPH_SS_USB2_HSIC_BAM_P_PSM_CNTXT_3_MSB8_ADDR A:0xf9a0d904
y.create.l HWIO_PERIPH_SS_USB2_HSIC_BAM_P_PSM_CNTXT_3_MSB9_ADDR A:0xf9a0e904
y.create.l HWIO_PERIPH_SS_USB2_HSIC_BAM_P_PSM_CNTXT_4_0_ADDR A:0xf9a05810
y.create.l HWIO_PERIPH_SS_USB2_HSIC_BAM_P_PSM_CNTXT_4_1_ADDR A:0xf9a06810
y.create.l HWIO_PERIPH_SS_USB2_HSIC_BAM_P_PSM_CNTXT_4_2_ADDR A:0xf9a07810
y.create.l HWIO_PERIPH_SS_USB2_HSIC_BAM_P_PSM_CNTXT_4_3_ADDR A:0xf9a08810
y.create.l HWIO_PERIPH_SS_USB2_HSIC_BAM_P_PSM_CNTXT_4_4_ADDR A:0xf9a09810
y.create.l HWIO_PERIPH_SS_USB2_HSIC_BAM_P_PSM_CNTXT_4_5_ADDR A:0xf9a0a810
y.create.l HWIO_PERIPH_SS_USB2_HSIC_BAM_P_PSM_CNTXT_4_6_ADDR A:0xf9a0b810
y.create.l HWIO_PERIPH_SS_USB2_HSIC_BAM_P_PSM_CNTXT_4_7_ADDR A:0xf9a0c810
y.create.l HWIO_PERIPH_SS_USB2_HSIC_BAM_P_PSM_CNTXT_4_8_ADDR A:0xf9a0d810
y.create.l HWIO_PERIPH_SS_USB2_HSIC_BAM_P_PSM_CNTXT_4_9_ADDR A:0xf9a0e810
y.create.l HWIO_PERIPH_SS_USB2_HSIC_BAM_P_PSM_CNTXT_5_0_ADDR A:0xf9a05814
y.create.l HWIO_PERIPH_SS_USB2_HSIC_BAM_P_PSM_CNTXT_5_1_ADDR A:0xf9a06814
y.create.l HWIO_PERIPH_SS_USB2_HSIC_BAM_P_PSM_CNTXT_5_2_ADDR A:0xf9a07814
y.create.l HWIO_PERIPH_SS_USB2_HSIC_BAM_P_PSM_CNTXT_5_3_ADDR A:0xf9a08814
y.create.l HWIO_PERIPH_SS_USB2_HSIC_BAM_P_PSM_CNTXT_5_4_ADDR A:0xf9a09814
y.create.l HWIO_PERIPH_SS_USB2_HSIC_BAM_P_PSM_CNTXT_5_5_ADDR A:0xf9a0a814
y.create.l HWIO_PERIPH_SS_USB2_HSIC_BAM_P_PSM_CNTXT_5_6_ADDR A:0xf9a0b814
y.create.l HWIO_PERIPH_SS_USB2_HSIC_BAM_P_PSM_CNTXT_5_7_ADDR A:0xf9a0c814
y.create.l HWIO_PERIPH_SS_USB2_HSIC_BAM_P_PSM_CNTXT_5_8_ADDR A:0xf9a0d814
y.create.l HWIO_PERIPH_SS_USB2_HSIC_BAM_P_PSM_CNTXT_5_9_ADDR A:0xf9a0e814
y.create.l HWIO_PERIPH_SS_USB2_HSIC_XPU_SCR_ADDR A:0xf9a02000
y.create.l HWIO_PERIPH_SS_USB2_HSIC_XPU_SWDR_ADDR A:0xf9a02004
y.create.l HWIO_PERIPH_SS_USB2_HSIC_XPU_SEAR0_ADDR A:0xf9a02040
y.create.l HWIO_PERIPH_SS_USB2_HSIC_XPU_SESR_ADDR A:0xf9a02048
y.create.l HWIO_PERIPH_SS_USB2_HSIC_XPU_SESRRESTORE_ADDR A:0xf9a0204c
y.create.l HWIO_PERIPH_SS_USB2_HSIC_XPU_SESYNR0_ADDR A:0xf9a02050
y.create.l HWIO_PERIPH_SS_USB2_HSIC_XPU_SESYNR1_ADDR A:0xf9a02054
y.create.l HWIO_PERIPH_SS_USB2_HSIC_XPU_SESYNR2_ADDR A:0xf9a02058
y.create.l HWIO_PERIPH_SS_USB2_HSIC_XPU_MCR_ADDR A:0xf9a02100
y.create.l HWIO_PERIPH_SS_USB2_HSIC_XPU_MEAR0_ADDR A:0xf9a02140
y.create.l HWIO_PERIPH_SS_USB2_HSIC_XPU_MESR_ADDR A:0xf9a02148
y.create.l HWIO_PERIPH_SS_USB2_HSIC_XPU_MESRRESTORE_ADDR A:0xf9a0214c
y.create.l HWIO_PERIPH_SS_USB2_HSIC_XPU_MESYNR0_ADDR A:0xf9a02150
y.create.l HWIO_PERIPH_SS_USB2_HSIC_XPU_MESYNR1_ADDR A:0xf9a02154
y.create.l HWIO_PERIPH_SS_USB2_HSIC_XPU_MESYNR2_ADDR A:0xf9a02158
y.create.l HWIO_PERIPH_SS_USB2_HSIC_XPU_CR_ADDR A:0xf9a02080
y.create.l HWIO_PERIPH_SS_USB2_HSIC_XPU_RPU_ACR0_ADDR A:0xf9a020a0
y.create.l HWIO_PERIPH_SS_USB2_HSIC_XPU_EAR0_ADDR A:0xf9a020c0
y.create.l HWIO_PERIPH_SS_USB2_HSIC_XPU_ESR_ADDR A:0xf9a020c8
y.create.l HWIO_PERIPH_SS_USB2_HSIC_XPU_ESRRESTORE_ADDR A:0xf9a020cc
y.create.l HWIO_PERIPH_SS_USB2_HSIC_XPU_ESYNR0_ADDR A:0xf9a020d0
y.create.l HWIO_PERIPH_SS_USB2_HSIC_XPU_ESYNR1_ADDR A:0xf9a020d4
y.create.l HWIO_PERIPH_SS_USB2_HSIC_XPU_ESYNR2_ADDR A:0xf9a020d8
y.create.l HWIO_PERIPH_SS_USB2_HSIC_XPU_IDR0_ADDR A:0xf9a02074
y.create.l HWIO_PERIPH_SS_USB2_HSIC_XPU_IDR1_ADDR A:0xf9a02078
y.create.l HWIO_PERIPH_SS_USB2_HSIC_XPU_REV_ADDR A:0xf9a0207c
y.create.l HWIO_PERIPH_SS_USB2_HSIC_XPU_RG0_RACR0_ADDR A:0xf9a02200
y.create.l HWIO_PERIPH_SS_USB2_HSIC_XPU_RG1_RACR0_ADDR A:0xf9a02280
y.create.l HWIO_PERIPH_SS_USB2_HSIC_XPU_RG2_RACR0_ADDR A:0xf9a02300
y.create.l HWIO_PERIPH_SS_USB2_HSIC_XPU_RG3_RACR0_ADDR A:0xf9a02380
y.create.l HWIO_PERIPH_SS_USB2_HSIC_XPU_RG4_RACR0_ADDR A:0xf9a02400
y.create.l HWIO_PERIPH_SS_USB2_HSIC_XPU_RG5_RACR0_ADDR A:0xf9a02480
y.create.l HWIO_PERIPH_SS_USB2_HSIC_XPU_RG6_RACR0_ADDR A:0xf9a02500
y.create.l HWIO_PERIPH_SS_USB2_HSIC_XPU_RG7_RACR0_ADDR A:0xf9a02580
y.create.l HWIO_PERIPH_SS_USB2_HSIC_XPU_RG8_RACR0_ADDR A:0xf9a02600
y.create.l HWIO_PERIPH_SS_USB2_HSIC_XPU_RG9_RACR0_ADDR A:0xf9a02680
y.create.l HWIO_PERIPH_SS_USB2_HSIC_XPU_RG0_SCR_ADDR A:0xf9a02250
y.create.l HWIO_PERIPH_SS_USB2_HSIC_XPU_RG1_SCR_ADDR A:0xf9a022d0
y.create.l HWIO_PERIPH_SS_USB2_HSIC_XPU_RG2_SCR_ADDR A:0xf9a02350
y.create.l HWIO_PERIPH_SS_USB2_HSIC_XPU_RG3_SCR_ADDR A:0xf9a023d0
y.create.l HWIO_PERIPH_SS_USB2_HSIC_XPU_RG4_SCR_ADDR A:0xf9a02450
y.create.l HWIO_PERIPH_SS_USB2_HSIC_XPU_RG5_SCR_ADDR A:0xf9a024d0
y.create.l HWIO_PERIPH_SS_USB2_HSIC_XPU_RG6_SCR_ADDR A:0xf9a02550
y.create.l HWIO_PERIPH_SS_USB2_HSIC_XPU_RG7_SCR_ADDR A:0xf9a025d0
y.create.l HWIO_PERIPH_SS_USB2_HSIC_XPU_RG8_SCR_ADDR A:0xf9a02650
y.create.l HWIO_PERIPH_SS_USB2_HSIC_XPU_RG9_SCR_ADDR A:0xf9a026d0
y.create.l HWIO_PERIPH_SS_USB2_HSIC_XPU_RG0_MCR_ADDR A:0xf9a02254
y.create.l HWIO_PERIPH_SS_USB2_HSIC_XPU_RG1_MCR_ADDR A:0xf9a022d4
y.create.l HWIO_PERIPH_SS_USB2_HSIC_XPU_RG2_MCR_ADDR A:0xf9a02354
y.create.l HWIO_PERIPH_SS_USB2_HSIC_XPU_RG3_MCR_ADDR A:0xf9a023d4
y.create.l HWIO_PERIPH_SS_USB2_HSIC_XPU_RG4_MCR_ADDR A:0xf9a02454
y.create.l HWIO_PERIPH_SS_USB2_HSIC_XPU_RG5_MCR_ADDR A:0xf9a024d4
y.create.l HWIO_PERIPH_SS_USB2_HSIC_XPU_RG6_MCR_ADDR A:0xf9a02554
y.create.l HWIO_PERIPH_SS_USB2_HSIC_XPU_RG7_MCR_ADDR A:0xf9a025d4
y.create.l HWIO_PERIPH_SS_USB2_HSIC_XPU_RG8_MCR_ADDR A:0xf9a02654
y.create.l HWIO_PERIPH_SS_USB2_HSIC_XPU_RG9_MCR_ADDR A:0xf9a026d4
y.create.l HWIO_PERIPH_SS_USB2_HSIC_VMIDMT_SCR0_ADDR A:0xf9a00000
y.create.l HWIO_PERIPH_SS_USB2_HSIC_VMIDMT_SCR1_ADDR A:0xf9a00004
y.create.l HWIO_PERIPH_SS_USB2_HSIC_VMIDMT_SCR2_ADDR A:0xf9a00008
y.create.l HWIO_PERIPH_SS_USB2_HSIC_VMIDMT_SACR_ADDR A:0xf9a00010
y.create.l HWIO_PERIPH_SS_USB2_HSIC_VMIDMT_SIDR0_ADDR A:0xf9a00020
y.create.l HWIO_PERIPH_SS_USB2_HSIC_VMIDMT_SIDR1_ADDR A:0xf9a00024
y.create.l HWIO_PERIPH_SS_USB2_HSIC_VMIDMT_SIDR2_ADDR A:0xf9a00028
y.create.l HWIO_PERIPH_SS_USB2_HSIC_VMIDMT_SIDR4_ADDR A:0xf9a00030
y.create.l HWIO_PERIPH_SS_USB2_HSIC_VMIDMT_SIDR5_ADDR A:0xf9a00034
y.create.l HWIO_PERIPH_SS_USB2_HSIC_VMIDMT_SIDR7_ADDR A:0xf9a0003c
y.create.l HWIO_PERIPH_SS_USB2_HSIC_VMIDMT_SGFAR0_ADDR A:0xf9a00040
y.create.l HWIO_PERIPH_SS_USB2_HSIC_VMIDMT_SGFSR_ADDR A:0xf9a00048
y.create.l HWIO_PERIPH_SS_USB2_HSIC_VMIDMT_SGFSRRESTORE_ADDR A:0xf9a0004c
y.create.l HWIO_PERIPH_SS_USB2_HSIC_VMIDMT_SGFSYNDR0_ADDR A:0xf9a00050
y.create.l HWIO_PERIPH_SS_USB2_HSIC_VMIDMT_SGFSYNDR1_ADDR A:0xf9a00054
y.create.l HWIO_PERIPH_SS_USB2_HSIC_VMIDMT_SGFSYNDR2_ADDR A:0xf9a00058
y.create.l HWIO_PERIPH_SS_USB2_HSIC_VMIDMT_VMIDMTSCR0_ADDR A:0xf9a00090
y.create.l HWIO_PERIPH_SS_USB2_HSIC_VMIDMT_CR0_ADDR A:0xf9a00000
y.create.l HWIO_PERIPH_SS_USB2_HSIC_VMIDMT_CR2_ADDR A:0xf9a00008
y.create.l HWIO_PERIPH_SS_USB2_HSIC_VMIDMT_ACR_ADDR A:0xf9a00010
y.create.l HWIO_PERIPH_SS_USB2_HSIC_VMIDMT_IDR0_ADDR A:0xf9a00020
y.create.l HWIO_PERIPH_SS_USB2_HSIC_VMIDMT_IDR1_ADDR A:0xf9a00024
y.create.l HWIO_PERIPH_SS_USB2_HSIC_VMIDMT_IDR2_ADDR A:0xf9a00028
y.create.l HWIO_PERIPH_SS_USB2_HSIC_VMIDMT_IDR4_ADDR A:0xf9a00030
y.create.l HWIO_PERIPH_SS_USB2_HSIC_VMIDMT_IDR5_ADDR A:0xf9a00034
y.create.l HWIO_PERIPH_SS_USB2_HSIC_VMIDMT_IDR7_ADDR A:0xf9a0003c
y.create.l HWIO_PERIPH_SS_USB2_HSIC_VMIDMT_GFAR0_ADDR A:0xf9a00040
y.create.l HWIO_PERIPH_SS_USB2_HSIC_VMIDMT_GFSR_ADDR A:0xf9a00048
y.create.l HWIO_PERIPH_SS_USB2_HSIC_VMIDMT_GFSRRESTORE_ADDR A:0xf9a0004c
y.create.l HWIO_PERIPH_SS_USB2_HSIC_VMIDMT_GFSYNDR0_ADDR A:0xf9a00050
y.create.l HWIO_PERIPH_SS_USB2_HSIC_VMIDMT_GFSYNDR1_ADDR A:0xf9a00054
y.create.l HWIO_PERIPH_SS_USB2_HSIC_VMIDMT_GFSYNDR2_ADDR A:0xf9a00058
y.create.l HWIO_PERIPH_SS_USB2_HSIC_VMIDMT_VMIDMTCR0_ADDR A:0xf9a00090
y.create.l HWIO_PERIPH_SS_USB2_HSIC_VMIDMT_VMIDMTACR_ADDR A:0xf9a0009c
y.create.l HWIO_PERIPH_SS_USB2_HSIC_VMIDMT_NSCR0_ADDR A:0xf9a00400
y.create.l HWIO_PERIPH_SS_USB2_HSIC_VMIDMT_NSCR2_ADDR A:0xf9a00408
y.create.l HWIO_PERIPH_SS_USB2_HSIC_VMIDMT_NSACR_ADDR A:0xf9a00410
y.create.l HWIO_PERIPH_SS_USB2_HSIC_VMIDMT_NSGFAR0_ADDR A:0xf9a00440
y.create.l HWIO_PERIPH_SS_USB2_HSIC_VMIDMT_NSGFSR_ADDR A:0xf9a00448
y.create.l HWIO_PERIPH_SS_USB2_HSIC_VMIDMT_NSGFSRRESTORE_ADDR A:0xf9a0044c
y.create.l HWIO_PERIPH_SS_USB2_HSIC_VMIDMT_NSGFSYNDR0_ADDR A:0xf9a00450
y.create.l HWIO_PERIPH_SS_USB2_HSIC_VMIDMT_NSGFSYNDR1_ADDR A:0xf9a00454
y.create.l HWIO_PERIPH_SS_USB2_HSIC_VMIDMT_NSGFSYNDR2_ADDR A:0xf9a00458
y.create.l HWIO_PERIPH_SS_USB2_HSIC_VMIDMT_NSVMIDMTCR0_ADDR A:0xf9a00490
y.create.l HWIO_PERIPH_SS_USB2_HSIC_VMIDMT_SSDR0_ADDR A:0xf9a00080
y.create.l HWIO_PERIPH_SS_USB2_HSIC_VMIDMT_MSDR0_ADDR A:0xf9a00480
y.create.l HWIO_PERIPH_SS_USB2_HSIC_VMIDMT_MCR_ADDR A:0xf9a00494
y.create.l HWIO_PERIPH_SS_USB2_HSIC_VMIDMT_S2VR0_ADDR A:0xf9a00c00
y.create.l HWIO_PERIPH_SS_USB2_HSIC_VMIDMT_S2VR1_ADDR A:0xf9a00c04
y.create.l HWIO_PERIPH_SS_USB2_HSIC_VMIDMT_S2VR2_ADDR A:0xf9a00c08
y.create.l HWIO_PERIPH_SS_USB2_HSIC_VMIDMT_S2VR3_ADDR A:0xf9a00c0c
y.create.l HWIO_PERIPH_SS_USB2_HSIC_VMIDMT_S2VR4_ADDR A:0xf9a00c10
y.create.l HWIO_PERIPH_SS_USB2_HSIC_VMIDMT_S2VR5_ADDR A:0xf9a00c14
y.create.l HWIO_PERIPH_SS_USB2_HSIC_VMIDMT_S2VR6_ADDR A:0xf9a00c18
y.create.l HWIO_PERIPH_SS_USB2_HSIC_VMIDMT_S2VR7_ADDR A:0xf9a00c1c
y.create.l HWIO_PERIPH_SS_USB2_HSIC_VMIDMT_S2VR8_ADDR A:0xf9a00c20
y.create.l HWIO_PERIPH_SS_USB2_HSIC_VMIDMT_S2VR9_ADDR A:0xf9a00c24
y.create.l HWIO_PERIPH_SS_USB2_HSIC_VMIDMT_AS2VR0_ADDR A:0xf9a00e00
y.create.l HWIO_PERIPH_SS_USB2_HSIC_VMIDMT_AS2VR1_ADDR A:0xf9a00e04
y.create.l HWIO_PERIPH_SS_USB2_HSIC_VMIDMT_AS2VR2_ADDR A:0xf9a00e08
y.create.l HWIO_PERIPH_SS_USB2_HSIC_VMIDMT_AS2VR3_ADDR A:0xf9a00e0c
y.create.l HWIO_PERIPH_SS_USB2_HSIC_VMIDMT_AS2VR4_ADDR A:0xf9a00e10
y.create.l HWIO_PERIPH_SS_USB2_HSIC_VMIDMT_AS2VR5_ADDR A:0xf9a00e14
y.create.l HWIO_PERIPH_SS_USB2_HSIC_VMIDMT_AS2VR6_ADDR A:0xf9a00e18
y.create.l HWIO_PERIPH_SS_USB2_HSIC_VMIDMT_AS2VR7_ADDR A:0xf9a00e1c
y.create.l HWIO_PERIPH_SS_USB2_HSIC_VMIDMT_AS2VR8_ADDR A:0xf9a00e20
y.create.l HWIO_PERIPH_SS_USB2_HSIC_VMIDMT_AS2VR9_ADDR A:0xf9a00e24
y.create.l HWIO_PERIPH_SS_USB2_HSIC_VMIDMT_SMR0_ADDR A:0xf9a00800
y.create.l HWIO_PERIPH_SS_USB2_HSIC_VMIDMT_SMR1_ADDR A:0xf9a00804
y.create.l HWIO_PERIPH_SS_USB2_HSIC_VMIDMT_SMR2_ADDR A:0xf9a00808
y.create.l HWIO_PERIPH_SS_USB2_HSIC_VMIDMT_SMR3_ADDR A:0xf9a0080c
y.create.l HWIO_PERIPH_SS_USB2_HSIC_VMIDMT_SMR4_ADDR A:0xf9a00810
y.create.l HWIO_PERIPH_SS_USB2_HSIC_VMIDMT_SMR5_ADDR A:0xf9a00814
y.create.l HWIO_PERIPH_SS_USB2_HSIC_VMIDMT_SMR6_ADDR A:0xf9a00818
y.create.l HWIO_PERIPH_SS_USB2_HSIC_VMIDMT_SMR7_ADDR A:0xf9a0081c
y.create.l HWIO_PERIPH_SS_USB2_HSIC_VMIDMT_SMR8_ADDR A:0xf9a00820
y.create.l HWIO_PERIPH_SS_USB2_HSIC_VMIDMT_SMR9_ADDR A:0xf9a00824
y.create.l HWIO_PERIPH_SS_USB1_HS_USB_OTG_HS_ID_ADDR A:0xf9a55000
y.create.l HWIO_PERIPH_SS_USB1_HS_USB_OTG_HS_HWGENERAL_ADDR A:0xf9a55004
y.create.l HWIO_PERIPH_SS_USB1_HS_USB_OTG_HS_HWHOST_ADDR A:0xf9a55008
y.create.l HWIO_PERIPH_SS_USB1_HS_USB_OTG_HS_HWDEVICE_ADDR A:0xf9a5500c
y.create.l HWIO_PERIPH_SS_USB1_HS_USB_OTG_HS_HWTXBUF_ADDR A:0xf9a55010
y.create.l HWIO_PERIPH_SS_USB1_HS_USB_OTG_HS_HWRXBUF_ADDR A:0xf9a55014
y.create.l HWIO_PERIPH_SS_USB1_HS_USB_OTG_HS_SCRATCH_RAM0_ADDR A:0xf9a55040
y.create.l HWIO_PERIPH_SS_USB1_HS_USB_OTG_HS_SCRATCH_RAM1_ADDR A:0xf9a55044
y.create.l HWIO_PERIPH_SS_USB1_HS_USB_OTG_HS_SCRATCH_RAM2_ADDR A:0xf9a55048
y.create.l HWIO_PERIPH_SS_USB1_HS_USB_OTG_HS_SCRATCH_RAM3_ADDR A:0xf9a5504c
y.create.l HWIO_PERIPH_SS_USB1_HS_USB_OTG_HS_SCRATCH_RAM4_ADDR A:0xf9a55050
y.create.l HWIO_PERIPH_SS_USB1_HS_USB_OTG_HS_SCRATCH_RAM5_ADDR A:0xf9a55054
y.create.l HWIO_PERIPH_SS_USB1_HS_USB_OTG_HS_SCRATCH_RAM6_ADDR A:0xf9a55058
y.create.l HWIO_PERIPH_SS_USB1_HS_USB_OTG_HS_SCRATCH_RAM7_ADDR A:0xf9a5505c
y.create.l HWIO_PERIPH_SS_USB1_HS_USB_OTG_HS_SCRATCH_RAM8_ADDR A:0xf9a55060
y.create.l HWIO_PERIPH_SS_USB1_HS_USB_OTG_HS_SCRATCH_RAM9_ADDR A:0xf9a55064
y.create.l HWIO_PERIPH_SS_USB1_HS_USB_OTG_HS_GPTIMER0LD_ADDR A:0xf9a55080
y.create.l HWIO_PERIPH_SS_USB1_HS_USB_OTG_HS_GPTIMER0CTRL_ADDR A:0xf9a55084
y.create.l HWIO_PERIPH_SS_USB1_HS_USB_OTG_HS_GPTIMER1LD_ADDR A:0xf9a55088
y.create.l HWIO_PERIPH_SS_USB1_HS_USB_OTG_HS_GPTIMER1CTRL_ADDR A:0xf9a5508c
y.create.l HWIO_PERIPH_SS_USB1_HS_USB_OTG_HS_AHB_BURST_ADDR A:0xf9a55090
y.create.l HWIO_PERIPH_SS_USB1_HS_USB_OTG_HS_XTOR_STS_ADDR A:0xf9a55094
y.create.l HWIO_PERIPH_SS_USB1_HS_USB_OTG_HS_AHB_MODE_ADDR A:0xf9a55098
y.create.l HWIO_PERIPH_SS_USB1_HS_USB_OTG_HS_GEN_CONFIG_ADDR A:0xf9a5509c
y.create.l HWIO_PERIPH_SS_USB1_HS_USB_OTG_HS_GEN_CONFIG_2_ADDR A:0xf9a550a0
y.create.l HWIO_PERIPH_SS_USB1_HS_USB_OTG_HS_CAPLENGTH_ADDR A:0xf9a55100
y.create.l HWIO_PERIPH_SS_USB1_HS_USB_OTG_HS_HCSPARAMS_ADDR A:0xf9a55104
y.create.l HWIO_PERIPH_SS_USB1_HS_USB_OTG_HS_HCCPARAMS_ADDR A:0xf9a55108
y.create.l HWIO_PERIPH_SS_USB1_HS_USB_OTG_HS_DCIVERSION_ADDR A:0xf9a55120
y.create.l HWIO_PERIPH_SS_USB1_HS_USB_OTG_HS_DCCPARAMS_ADDR A:0xf9a55124
y.create.l HWIO_PERIPH_SS_USB1_HS_USB_OTG_HS_USBCMD_ADDR A:0xf9a55140
y.create.l HWIO_PERIPH_SS_USB1_HS_USB_OTG_HS_USBSTS_ADDR A:0xf9a55144
y.create.l HWIO_PERIPH_SS_USB1_HS_USB_OTG_HS_USBINTR_ADDR A:0xf9a55148
y.create.l HWIO_PERIPH_SS_USB1_HS_USB_OTG_HS_FRINDEX_ADDR A:0xf9a5514c
y.create.l HWIO_PERIPH_SS_USB1_HS_USB_OTG_HS_PERIODICLISTBASE_ADDR A:0xf9a55154
y.create.l HWIO_PERIPH_SS_USB1_HS_USB_OTG_HS_DEVICEADDR_ADDR A:0xf9a55154
y.create.l HWIO_PERIPH_SS_USB1_HS_USB_OTG_HS_ASYNCLISTADDR_ADDR A:0xf9a55158
y.create.l HWIO_PERIPH_SS_USB1_HS_USB_OTG_HS_ENDPOINTLISTADDR_ADDR A:0xf9a55158
y.create.l HWIO_PERIPH_SS_USB1_HS_USB_OTG_HS_TTCTRL_ADDR A:0xf9a5515c
y.create.l HWIO_PERIPH_SS_USB1_HS_USB_OTG_HS_BURSTSIZE_ADDR A:0xf9a55160
y.create.l HWIO_PERIPH_SS_USB1_HS_USB_OTG_HS_TXFILLTUNING_ADDR A:0xf9a55164
y.create.l HWIO_PERIPH_SS_USB1_HS_USB_OTG_HS_ULPI_VIEWPORT_ADDR A:0xf9a55170
y.create.l HWIO_PERIPH_SS_USB1_HS_USB_OTG_HS_ENDPTNAK_ADDR A:0xf9a55178
y.create.l HWIO_PERIPH_SS_USB1_HS_USB_OTG_HS_ENDPTNAKEN_ADDR A:0xf9a5517c
y.create.l HWIO_PERIPH_SS_USB1_HS_USB_OTG_HS_PORTSC_ADDR A:0xf9a55184
y.create.l HWIO_PERIPH_SS_USB1_HS_USB_OTG_HS_OTGSC_ADDR A:0xf9a551a4
y.create.l HWIO_PERIPH_SS_USB1_HS_USB_OTG_HS_USBMODE_ADDR A:0xf9a551a8
y.create.l HWIO_PERIPH_SS_USB1_HS_USB_OTG_HS_ENDPTSETUPSTAT_ADDR A:0xf9a551ac
y.create.l HWIO_PERIPH_SS_USB1_HS_USB_OTG_HS_ENDPTPRIME_ADDR A:0xf9a551b0
y.create.l HWIO_PERIPH_SS_USB1_HS_USB_OTG_HS_ENDPTFLUSH_ADDR A:0xf9a551b4
y.create.l HWIO_PERIPH_SS_USB1_HS_USB_OTG_HS_ENDPTSTAT_ADDR A:0xf9a551b8
y.create.l HWIO_PERIPH_SS_USB1_HS_USB_OTG_HS_ENDPTCOMPLETE_ADDR A:0xf9a551bc
y.create.l HWIO_PERIPH_SS_USB1_HS_USB_OTG_HS_ENDPTCTRL0_ADDR A:0xf9a551c0
y.create.l HWIO_PERIPH_SS_USB1_HS_USB_OTG_HS_ENDPTCTRL1_ADDR A:0xf9a551c4
y.create.l HWIO_PERIPH_SS_USB1_HS_USB_OTG_HS_ENDPTCTRL2_ADDR A:0xf9a551c8
y.create.l HWIO_PERIPH_SS_USB1_HS_USB_OTG_HS_ENDPTCTRL3_ADDR A:0xf9a551cc
y.create.l HWIO_PERIPH_SS_USB1_HS_USB_OTG_HS_ENDPTCTRL4_ADDR A:0xf9a551d0
y.create.l HWIO_PERIPH_SS_USB1_HS_USB_OTG_HS_ENDPTCTRL5_ADDR A:0xf9a551d4
y.create.l HWIO_PERIPH_SS_USB1_HS_USB_OTG_HS_ENDPTCTRL6_ADDR A:0xf9a551d8
y.create.l HWIO_PERIPH_SS_USB1_HS_USB_OTG_HS_ENDPTCTRL7_ADDR A:0xf9a551dc
y.create.l HWIO_PERIPH_SS_USB1_HS_USB_OTG_HS_ENDPTCTRL8_ADDR A:0xf9a551e0
y.create.l HWIO_PERIPH_SS_USB1_HS_USB_OTG_HS_ENDPTCTRL9_ADDR A:0xf9a551e4
y.create.l HWIO_PERIPH_SS_USB1_HS_USB_OTG_HS_ENDPTCTRL10_ADDR A:0xf9a551e8
y.create.l HWIO_PERIPH_SS_USB1_HS_USB_OTG_HS_ENDPT_PIPE_ID1_ADDR A:0xf9a55200
y.create.l HWIO_PERIPH_SS_USB1_HS_USB_OTG_HS_ENDPT_PIPE_ID2_ADDR A:0xf9a55204
y.create.l HWIO_PERIPH_SS_USB1_HS_USB_OTG_HS_ENDPT_PIPE_ID3_ADDR A:0xf9a55208
y.create.l HWIO_PERIPH_SS_USB1_HS_USB_OTG_HS_ENDPT_PIPE_ID4_ADDR A:0xf9a5520c
y.create.l HWIO_PERIPH_SS_USB1_HS_USB_OTG_HS_ENDPT_PIPE_ID5_ADDR A:0xf9a55210
y.create.l HWIO_PERIPH_SS_USB1_HS_USB_OTG_HS_ENDPT_PIPE_ID6_ADDR A:0xf9a55214
y.create.l HWIO_PERIPH_SS_USB1_HS_USB_OTG_HS_ENDPT_PIPE_ID7_ADDR A:0xf9a55218
y.create.l HWIO_PERIPH_SS_USB1_HS_USB_OTG_HS_ENDPT_PIPE_ID8_ADDR A:0xf9a5521c
y.create.l HWIO_PERIPH_SS_USB1_HS_USB_OTG_HS_ENDPT_PIPE_ID9_ADDR A:0xf9a55220
y.create.l HWIO_PERIPH_SS_USB1_HS_USB_OTG_HS_ENDPT_PIPE_ID10_ADDR A:0xf9a55224
y.create.l HWIO_PERIPH_SS_USB1_HS_USB_OTG_HS_PHY_CTRL_ADDR A:0xf9a55240
y.create.l HWIO_PERIPH_SS_USB1_HS_USB_OTG_HS_GENERIC1_ADDR A:0xf9a55244
y.create.l HWIO_PERIPH_SS_USB1_HS_USB_OTG_HS_GENERIC2_ADDR A:0xf9a55248
y.create.l HWIO_PERIPH_SS_USB1_HS_USB_OTG_HS_L1_EP_CTRL_ADDR A:0xf9a55250
y.create.l HWIO_PERIPH_SS_USB1_HS_USB_OTG_HS_L1_CONFIG_ADDR A:0xf9a55254
y.create.l HWIO_PERIPH_SS_USB1_HS_USB_OTG_HS_LPM_DEBUG_1_ADDR A:0xf9a55258
y.create.l HWIO_PERIPH_SS_USB1_HS_USB_OTG_HS_LPM_DEBUG_2_ADDR A:0xf9a5525c
y.create.l HWIO_PERIPH_SS_USB1_HS_USB_OTG_HS_LPM_ATTRIBUTES_ADDR A:0xf9a55260
y.create.l HWIO_PERIPH_SS_USB1_HS_USB_OTG_HS_LPM_TIMERS_ADDR A:0xf9a55264
y.create.l HWIO_PERIPH_SS_USB1_HS_USB_OTG_HS_HW_VER_ADDR A:0xf9a55270
y.create.l HWIO_PERIPH_SS_USB1_HS_USB_OTG_HS_TEST_BUS_ADDR A:0xf9a55274
y.create.l HWIO_PERIPH_SS_USB1_HS_USB_OTG_HS_PHY_SEC_CTRL_ADDR A:0xf9a55278
y.create.l HWIO_PERIPH_SS_USB1_HS_USB_OTG_HS_HBM_CFG_ADDR A:0xf9a55290
y.create.l HWIO_PERIPH_SS_USB1_HS_USB_OTG_HS_HBM_QH_MAP_PIPE0_ADDR A:0xf9a55294
y.create.l HWIO_PERIPH_SS_USB1_HS_USB_OTG_HS_HBM_QH_MAP_PIPE1_ADDR A:0xf9a55298
y.create.l HWIO_PERIPH_SS_USB1_HS_USB_OTG_HS_HBM_QH_MAP_PIPE2_ADDR A:0xf9a5529c
y.create.l HWIO_PERIPH_SS_USB1_HS_USB_OTG_HS_HBM_QH_MAP_PIPE3_ADDR A:0xf9a552a0
y.create.l HWIO_PERIPH_SS_USB1_HS_USB_OTG_HS_HBM_QH_MAP_PIPE4_ADDR A:0xf9a552a4
y.create.l HWIO_PERIPH_SS_USB1_HS_USB_OTG_HS_HBM_QH_MAP_PIPE5_ADDR A:0xf9a552a8
y.create.l HWIO_PERIPH_SS_USB1_HS_USB_OTG_HS_HBM_QH_MAP_PIPE6_ADDR A:0xf9a552ac
y.create.l HWIO_PERIPH_SS_USB1_HS_USB_OTG_HS_HBM_QH_MAP_PIPE7_ADDR A:0xf9a552b0
y.create.l HWIO_PERIPH_SS_USB1_HS_USB_OTG_HS_HBM_QH_MAP_PIPE8_ADDR A:0xf9a552b4
y.create.l HWIO_PERIPH_SS_USB1_HS_USB_OTG_HS_HBM_QH_MAP_PIPE9_ADDR A:0xf9a552b8
y.create.l HWIO_PERIPH_SS_USB1_HS_USB_OTG_HS_HBM_PIPE_EN_ADDR A:0xf9a55310
y.create.l HWIO_PERIPH_SS_USB1_HS_USB_OTG_HS_HBM_PIPE_PRODUCER_ADDR A:0xf9a55314
y.create.l HWIO_PERIPH_SS_USB1_HS_USB_OTG_HS_HBM_PARK_MODE_DISABLE_ADDR A:0xf9a55318
y.create.l HWIO_PERIPH_SS_USB1_HS_USB_OTG_HS_HBM_PIPE_ZLT_DISABLE_ADDR A:0xf9a5531c
y.create.l HWIO_PERIPH_SS_USB1_HS_USB_OTG_HS_HBM_SB_SW_RST_ADDR A:0xf9a55320
y.create.l HWIO_PERIPH_SS_USB1_HS_USB_OTG_HS_HBM_SW_RST_ADDR A:0xf9a55324
y.create.l HWIO_PERIPH_SS_USB1_HS_USB_OTG_HS_BTO_TIME_HS_ADDR A:0xf9a55340
y.create.l HWIO_PERIPH_SS_USB1_HS_USB_OTG_HS_BTO_TIME_FS_LS_ADDR A:0xf9a55344
y.create.l HWIO_PERIPH_SS_USB1_HS_USB_OTG_HS_QSB_VALUES_ADDR A:0xf9a55348
y.create.l HWIO_PERIPH_SS_USB1_HS_BAM_CTRL_ADDR A:0xf9a44000
y.create.l HWIO_PERIPH_SS_USB1_HS_BAM_REVISION_ADDR A:0xf9a44004
y.create.l HWIO_PERIPH_SS_USB1_HS_BAM_SW_VERSION_ADDR A:0xf9a44080
y.create.l HWIO_PERIPH_SS_USB1_HS_BAM_NUM_PIPES_ADDR A:0xf9a4403c
y.create.l HWIO_PERIPH_SS_USB1_HS_BAM_TIMER_ADDR A:0xf9a44040
y.create.l HWIO_PERIPH_SS_USB1_HS_BAM_TIMER_CTRL_ADDR A:0xf9a44044
y.create.l HWIO_PERIPH_SS_USB1_HS_BAM_DESC_CNT_TRSHLD_ADDR A:0xf9a44008
y.create.l HWIO_PERIPH_SS_USB1_HS_BAM_IRQ_SRCS_ADDR A:0xf9a4400c
y.create.l HWIO_PERIPH_SS_USB1_HS_BAM_IRQ_SRCS_MSK_ADDR A:0xf9a44010
y.create.l HWIO_PERIPH_SS_USB1_HS_BAM_IRQ_SRCS_UNMASKED_ADDR A:0xf9a44030
y.create.l HWIO_PERIPH_SS_USB1_HS_BAM_IRQ_STTS_ADDR A:0xf9a44014
y.create.l HWIO_PERIPH_SS_USB1_HS_BAM_IRQ_CLR_ADDR A:0xf9a44018
y.create.l HWIO_PERIPH_SS_USB1_HS_BAM_IRQ_EN_ADDR A:0xf9a4401c
y.create.l HWIO_PERIPH_SS_USB1_HS_BAM_AHB_MASTER_ERR_CTRLS_ADDR A:0xf9a44024
y.create.l HWIO_PERIPH_SS_USB1_HS_BAM_AHB_MASTER_ERR_ADDR_ADDR A:0xf9a44028
y.create.l HWIO_PERIPH_SS_USB1_HS_BAM_AHB_MASTER_ERR_ADDR_LSB_ADDR A:0xf9a44100
y.create.l HWIO_PERIPH_SS_USB1_HS_BAM_AHB_MASTER_ERR_ADDR_MSB_ADDR A:0xf9a44104
y.create.l HWIO_PERIPH_SS_USB1_HS_BAM_AHB_MASTER_ERR_DATA_ADDR A:0xf9a4402c
y.create.l HWIO_PERIPH_SS_USB1_HS_BAM_TRUST_REG_ADDR A:0xf9a44070
y.create.l HWIO_PERIPH_SS_USB1_HS_BAM_TEST_BUS_SEL_ADDR A:0xf9a44074
y.create.l HWIO_PERIPH_SS_USB1_HS_BAM_TEST_BUS_REG_ADDR A:0xf9a44078
y.create.l HWIO_PERIPH_SS_USB1_HS_BAM_CNFG_BITS_ADDR A:0xf9a4407c
y.create.l HWIO_PERIPH_SS_USB1_HS_BAM_IRQ_SRCS_EE0_ADDR A:0xf9a44800
y.create.l HWIO_PERIPH_SS_USB1_HS_BAM_IRQ_SRCS_EE1_ADDR A:0xf9a44880
y.create.l HWIO_PERIPH_SS_USB1_HS_BAM_IRQ_SRCS_EE2_ADDR A:0xf9a44900
y.create.l HWIO_PERIPH_SS_USB1_HS_BAM_IRQ_SRCS_EE3_ADDR A:0xf9a44980
y.create.l HWIO_PERIPH_SS_USB1_HS_BAM_IRQ_SRCS_EE4_ADDR A:0xf9a44a00
y.create.l HWIO_PERIPH_SS_USB1_HS_BAM_IRQ_SRCS_EE5_ADDR A:0xf9a44a80
y.create.l HWIO_PERIPH_SS_USB1_HS_BAM_IRQ_SRCS_EE6_ADDR A:0xf9a44b00
y.create.l HWIO_PERIPH_SS_USB1_HS_BAM_IRQ_SRCS_EE7_ADDR A:0xf9a44b80
y.create.l HWIO_PERIPH_SS_USB1_HS_BAM_IRQ_SRCS_MSK_EE0_ADDR A:0xf9a44804
y.create.l HWIO_PERIPH_SS_USB1_HS_BAM_IRQ_SRCS_MSK_EE1_ADDR A:0xf9a44884
y.create.l HWIO_PERIPH_SS_USB1_HS_BAM_IRQ_SRCS_MSK_EE2_ADDR A:0xf9a44904
y.create.l HWIO_PERIPH_SS_USB1_HS_BAM_IRQ_SRCS_MSK_EE3_ADDR A:0xf9a44984
y.create.l HWIO_PERIPH_SS_USB1_HS_BAM_IRQ_SRCS_MSK_EE4_ADDR A:0xf9a44a04
y.create.l HWIO_PERIPH_SS_USB1_HS_BAM_IRQ_SRCS_MSK_EE5_ADDR A:0xf9a44a84
y.create.l HWIO_PERIPH_SS_USB1_HS_BAM_IRQ_SRCS_MSK_EE6_ADDR A:0xf9a44b04
y.create.l HWIO_PERIPH_SS_USB1_HS_BAM_IRQ_SRCS_MSK_EE7_ADDR A:0xf9a44b84
y.create.l HWIO_PERIPH_SS_USB1_HS_BAM_IRQ_SRCS_UNMASKED_EE0_ADDR A:0xf9a44808
y.create.l HWIO_PERIPH_SS_USB1_HS_BAM_IRQ_SRCS_UNMASKED_EE1_ADDR A:0xf9a44888
y.create.l HWIO_PERIPH_SS_USB1_HS_BAM_IRQ_SRCS_UNMASKED_EE2_ADDR A:0xf9a44908
y.create.l HWIO_PERIPH_SS_USB1_HS_BAM_IRQ_SRCS_UNMASKED_EE3_ADDR A:0xf9a44988
y.create.l HWIO_PERIPH_SS_USB1_HS_BAM_IRQ_SRCS_UNMASKED_EE4_ADDR A:0xf9a44a08
y.create.l HWIO_PERIPH_SS_USB1_HS_BAM_IRQ_SRCS_UNMASKED_EE5_ADDR A:0xf9a44a88
y.create.l HWIO_PERIPH_SS_USB1_HS_BAM_IRQ_SRCS_UNMASKED_EE6_ADDR A:0xf9a44b08
y.create.l HWIO_PERIPH_SS_USB1_HS_BAM_IRQ_SRCS_UNMASKED_EE7_ADDR A:0xf9a44b88
y.create.l HWIO_PERIPH_SS_USB1_HS_BAM_PIPE_ATTR_EE0_ADDR A:0xf9a4480c
y.create.l HWIO_PERIPH_SS_USB1_HS_BAM_PIPE_ATTR_EE1_ADDR A:0xf9a4488c
y.create.l HWIO_PERIPH_SS_USB1_HS_BAM_PIPE_ATTR_EE2_ADDR A:0xf9a4490c
y.create.l HWIO_PERIPH_SS_USB1_HS_BAM_PIPE_ATTR_EE3_ADDR A:0xf9a4498c
y.create.l HWIO_PERIPH_SS_USB1_HS_BAM_PIPE_ATTR_EE4_ADDR A:0xf9a44a0c
y.create.l HWIO_PERIPH_SS_USB1_HS_BAM_PIPE_ATTR_EE5_ADDR A:0xf9a44a8c
y.create.l HWIO_PERIPH_SS_USB1_HS_BAM_PIPE_ATTR_EE6_ADDR A:0xf9a44b0c
y.create.l HWIO_PERIPH_SS_USB1_HS_BAM_PIPE_ATTR_EE7_ADDR A:0xf9a44b8c
y.create.l HWIO_PERIPH_SS_USB1_HS_BAM_P_CTRL0_ADDR A:0xf9a45000
y.create.l HWIO_PERIPH_SS_USB1_HS_BAM_P_CTRL1_ADDR A:0xf9a46000
y.create.l HWIO_PERIPH_SS_USB1_HS_BAM_P_CTRL2_ADDR A:0xf9a47000
y.create.l HWIO_PERIPH_SS_USB1_HS_BAM_P_CTRL3_ADDR A:0xf9a48000
y.create.l HWIO_PERIPH_SS_USB1_HS_BAM_P_CTRL4_ADDR A:0xf9a49000
y.create.l HWIO_PERIPH_SS_USB1_HS_BAM_P_CTRL5_ADDR A:0xf9a4a000
y.create.l HWIO_PERIPH_SS_USB1_HS_BAM_P_CTRL6_ADDR A:0xf9a4b000
y.create.l HWIO_PERIPH_SS_USB1_HS_BAM_P_CTRL7_ADDR A:0xf9a4c000
y.create.l HWIO_PERIPH_SS_USB1_HS_BAM_P_CTRL8_ADDR A:0xf9a4d000
y.create.l HWIO_PERIPH_SS_USB1_HS_BAM_P_CTRL9_ADDR A:0xf9a4e000
y.create.l HWIO_PERIPH_SS_USB1_HS_BAM_P_RST0_ADDR A:0xf9a45004
y.create.l HWIO_PERIPH_SS_USB1_HS_BAM_P_RST1_ADDR A:0xf9a46004
y.create.l HWIO_PERIPH_SS_USB1_HS_BAM_P_RST2_ADDR A:0xf9a47004
y.create.l HWIO_PERIPH_SS_USB1_HS_BAM_P_RST3_ADDR A:0xf9a48004
y.create.l HWIO_PERIPH_SS_USB1_HS_BAM_P_RST4_ADDR A:0xf9a49004
y.create.l HWIO_PERIPH_SS_USB1_HS_BAM_P_RST5_ADDR A:0xf9a4a004
y.create.l HWIO_PERIPH_SS_USB1_HS_BAM_P_RST6_ADDR A:0xf9a4b004
y.create.l HWIO_PERIPH_SS_USB1_HS_BAM_P_RST7_ADDR A:0xf9a4c004
y.create.l HWIO_PERIPH_SS_USB1_HS_BAM_P_RST8_ADDR A:0xf9a4d004
y.create.l HWIO_PERIPH_SS_USB1_HS_BAM_P_RST9_ADDR A:0xf9a4e004
y.create.l HWIO_PERIPH_SS_USB1_HS_BAM_P_HALT0_ADDR A:0xf9a45008
y.create.l HWIO_PERIPH_SS_USB1_HS_BAM_P_HALT1_ADDR A:0xf9a46008
y.create.l HWIO_PERIPH_SS_USB1_HS_BAM_P_HALT2_ADDR A:0xf9a47008
y.create.l HWIO_PERIPH_SS_USB1_HS_BAM_P_HALT3_ADDR A:0xf9a48008
y.create.l HWIO_PERIPH_SS_USB1_HS_BAM_P_HALT4_ADDR A:0xf9a49008
y.create.l HWIO_PERIPH_SS_USB1_HS_BAM_P_HALT5_ADDR A:0xf9a4a008
y.create.l HWIO_PERIPH_SS_USB1_HS_BAM_P_HALT6_ADDR A:0xf9a4b008
y.create.l HWIO_PERIPH_SS_USB1_HS_BAM_P_HALT7_ADDR A:0xf9a4c008
y.create.l HWIO_PERIPH_SS_USB1_HS_BAM_P_HALT8_ADDR A:0xf9a4d008
y.create.l HWIO_PERIPH_SS_USB1_HS_BAM_P_HALT9_ADDR A:0xf9a4e008
y.create.l HWIO_PERIPH_SS_USB1_HS_BAM_P_TRUST_REG0_ADDR A:0xf9a45030
y.create.l HWIO_PERIPH_SS_USB1_HS_BAM_P_TRUST_REG1_ADDR A:0xf9a46030
y.create.l HWIO_PERIPH_SS_USB1_HS_BAM_P_TRUST_REG2_ADDR A:0xf9a47030
y.create.l HWIO_PERIPH_SS_USB1_HS_BAM_P_TRUST_REG3_ADDR A:0xf9a48030
y.create.l HWIO_PERIPH_SS_USB1_HS_BAM_P_TRUST_REG4_ADDR A:0xf9a49030
y.create.l HWIO_PERIPH_SS_USB1_HS_BAM_P_TRUST_REG5_ADDR A:0xf9a4a030
y.create.l HWIO_PERIPH_SS_USB1_HS_BAM_P_TRUST_REG6_ADDR A:0xf9a4b030
y.create.l HWIO_PERIPH_SS_USB1_HS_BAM_P_TRUST_REG7_ADDR A:0xf9a4c030
y.create.l HWIO_PERIPH_SS_USB1_HS_BAM_P_TRUST_REG8_ADDR A:0xf9a4d030
y.create.l HWIO_PERIPH_SS_USB1_HS_BAM_P_TRUST_REG9_ADDR A:0xf9a4e030
y.create.l HWIO_PERIPH_SS_USB1_HS_BAM_P_IRQ_STTS0_ADDR A:0xf9a45010
y.create.l HWIO_PERIPH_SS_USB1_HS_BAM_P_IRQ_STTS1_ADDR A:0xf9a46010
y.create.l HWIO_PERIPH_SS_USB1_HS_BAM_P_IRQ_STTS2_ADDR A:0xf9a47010
y.create.l HWIO_PERIPH_SS_USB1_HS_BAM_P_IRQ_STTS3_ADDR A:0xf9a48010
y.create.l HWIO_PERIPH_SS_USB1_HS_BAM_P_IRQ_STTS4_ADDR A:0xf9a49010
y.create.l HWIO_PERIPH_SS_USB1_HS_BAM_P_IRQ_STTS5_ADDR A:0xf9a4a010
y.create.l HWIO_PERIPH_SS_USB1_HS_BAM_P_IRQ_STTS6_ADDR A:0xf9a4b010
y.create.l HWIO_PERIPH_SS_USB1_HS_BAM_P_IRQ_STTS7_ADDR A:0xf9a4c010
y.create.l HWIO_PERIPH_SS_USB1_HS_BAM_P_IRQ_STTS8_ADDR A:0xf9a4d010
y.create.l HWIO_PERIPH_SS_USB1_HS_BAM_P_IRQ_STTS9_ADDR A:0xf9a4e010
y.create.l HWIO_PERIPH_SS_USB1_HS_BAM_P_IRQ_CLR0_ADDR A:0xf9a45014
y.create.l HWIO_PERIPH_SS_USB1_HS_BAM_P_IRQ_CLR1_ADDR A:0xf9a46014
y.create.l HWIO_PERIPH_SS_USB1_HS_BAM_P_IRQ_CLR2_ADDR A:0xf9a47014
y.create.l HWIO_PERIPH_SS_USB1_HS_BAM_P_IRQ_CLR3_ADDR A:0xf9a48014
y.create.l HWIO_PERIPH_SS_USB1_HS_BAM_P_IRQ_CLR4_ADDR A:0xf9a49014
y.create.l HWIO_PERIPH_SS_USB1_HS_BAM_P_IRQ_CLR5_ADDR A:0xf9a4a014
y.create.l HWIO_PERIPH_SS_USB1_HS_BAM_P_IRQ_CLR6_ADDR A:0xf9a4b014
y.create.l HWIO_PERIPH_SS_USB1_HS_BAM_P_IRQ_CLR7_ADDR A:0xf9a4c014
y.create.l HWIO_PERIPH_SS_USB1_HS_BAM_P_IRQ_CLR8_ADDR A:0xf9a4d014
y.create.l HWIO_PERIPH_SS_USB1_HS_BAM_P_IRQ_CLR9_ADDR A:0xf9a4e014
y.create.l HWIO_PERIPH_SS_USB1_HS_BAM_P_IRQ_EN0_ADDR A:0xf9a45018
y.create.l HWIO_PERIPH_SS_USB1_HS_BAM_P_IRQ_EN1_ADDR A:0xf9a46018
y.create.l HWIO_PERIPH_SS_USB1_HS_BAM_P_IRQ_EN2_ADDR A:0xf9a47018
y.create.l HWIO_PERIPH_SS_USB1_HS_BAM_P_IRQ_EN3_ADDR A:0xf9a48018
y.create.l HWIO_PERIPH_SS_USB1_HS_BAM_P_IRQ_EN4_ADDR A:0xf9a49018
y.create.l HWIO_PERIPH_SS_USB1_HS_BAM_P_IRQ_EN5_ADDR A:0xf9a4a018
y.create.l HWIO_PERIPH_SS_USB1_HS_BAM_P_IRQ_EN6_ADDR A:0xf9a4b018
y.create.l HWIO_PERIPH_SS_USB1_HS_BAM_P_IRQ_EN7_ADDR A:0xf9a4c018
y.create.l HWIO_PERIPH_SS_USB1_HS_BAM_P_IRQ_EN8_ADDR A:0xf9a4d018
y.create.l HWIO_PERIPH_SS_USB1_HS_BAM_P_IRQ_EN9_ADDR A:0xf9a4e018
y.create.l HWIO_PERIPH_SS_USB1_HS_BAM_P_TIMER0_ADDR A:0xf9a4501c
y.create.l HWIO_PERIPH_SS_USB1_HS_BAM_P_TIMER1_ADDR A:0xf9a4601c
y.create.l HWIO_PERIPH_SS_USB1_HS_BAM_P_TIMER2_ADDR A:0xf9a4701c
y.create.l HWIO_PERIPH_SS_USB1_HS_BAM_P_TIMER3_ADDR A:0xf9a4801c
y.create.l HWIO_PERIPH_SS_USB1_HS_BAM_P_TIMER4_ADDR A:0xf9a4901c
y.create.l HWIO_PERIPH_SS_USB1_HS_BAM_P_TIMER5_ADDR A:0xf9a4a01c
y.create.l HWIO_PERIPH_SS_USB1_HS_BAM_P_TIMER6_ADDR A:0xf9a4b01c
y.create.l HWIO_PERIPH_SS_USB1_HS_BAM_P_TIMER7_ADDR A:0xf9a4c01c
y.create.l HWIO_PERIPH_SS_USB1_HS_BAM_P_TIMER8_ADDR A:0xf9a4d01c
y.create.l HWIO_PERIPH_SS_USB1_HS_BAM_P_TIMER9_ADDR A:0xf9a4e01c
y.create.l HWIO_PERIPH_SS_USB1_HS_BAM_P_TIMER_CTRL0_ADDR A:0xf9a45020
y.create.l HWIO_PERIPH_SS_USB1_HS_BAM_P_TIMER_CTRL1_ADDR A:0xf9a46020
y.create.l HWIO_PERIPH_SS_USB1_HS_BAM_P_TIMER_CTRL2_ADDR A:0xf9a47020
y.create.l HWIO_PERIPH_SS_USB1_HS_BAM_P_TIMER_CTRL3_ADDR A:0xf9a48020
y.create.l HWIO_PERIPH_SS_USB1_HS_BAM_P_TIMER_CTRL4_ADDR A:0xf9a49020
y.create.l HWIO_PERIPH_SS_USB1_HS_BAM_P_TIMER_CTRL5_ADDR A:0xf9a4a020
y.create.l HWIO_PERIPH_SS_USB1_HS_BAM_P_TIMER_CTRL6_ADDR A:0xf9a4b020
y.create.l HWIO_PERIPH_SS_USB1_HS_BAM_P_TIMER_CTRL7_ADDR A:0xf9a4c020
y.create.l HWIO_PERIPH_SS_USB1_HS_BAM_P_TIMER_CTRL8_ADDR A:0xf9a4d020
y.create.l HWIO_PERIPH_SS_USB1_HS_BAM_P_TIMER_CTRL9_ADDR A:0xf9a4e020
y.create.l HWIO_PERIPH_SS_USB1_HS_BAM_P_PRDCR_SDBND0_ADDR A:0xf9a45024
y.create.l HWIO_PERIPH_SS_USB1_HS_BAM_P_PRDCR_SDBND1_ADDR A:0xf9a46024
y.create.l HWIO_PERIPH_SS_USB1_HS_BAM_P_PRDCR_SDBND2_ADDR A:0xf9a47024
y.create.l HWIO_PERIPH_SS_USB1_HS_BAM_P_PRDCR_SDBND3_ADDR A:0xf9a48024
y.create.l HWIO_PERIPH_SS_USB1_HS_BAM_P_PRDCR_SDBND4_ADDR A:0xf9a49024
y.create.l HWIO_PERIPH_SS_USB1_HS_BAM_P_PRDCR_SDBND5_ADDR A:0xf9a4a024
y.create.l HWIO_PERIPH_SS_USB1_HS_BAM_P_PRDCR_SDBND6_ADDR A:0xf9a4b024
y.create.l HWIO_PERIPH_SS_USB1_HS_BAM_P_PRDCR_SDBND7_ADDR A:0xf9a4c024
y.create.l HWIO_PERIPH_SS_USB1_HS_BAM_P_PRDCR_SDBND8_ADDR A:0xf9a4d024
y.create.l HWIO_PERIPH_SS_USB1_HS_BAM_P_PRDCR_SDBND9_ADDR A:0xf9a4e024
y.create.l HWIO_PERIPH_SS_USB1_HS_BAM_P_CNSMR_SDBND0_ADDR A:0xf9a45028
y.create.l HWIO_PERIPH_SS_USB1_HS_BAM_P_CNSMR_SDBND1_ADDR A:0xf9a46028
y.create.l HWIO_PERIPH_SS_USB1_HS_BAM_P_CNSMR_SDBND2_ADDR A:0xf9a47028
y.create.l HWIO_PERIPH_SS_USB1_HS_BAM_P_CNSMR_SDBND3_ADDR A:0xf9a48028
y.create.l HWIO_PERIPH_SS_USB1_HS_BAM_P_CNSMR_SDBND4_ADDR A:0xf9a49028
y.create.l HWIO_PERIPH_SS_USB1_HS_BAM_P_CNSMR_SDBND5_ADDR A:0xf9a4a028
y.create.l HWIO_PERIPH_SS_USB1_HS_BAM_P_CNSMR_SDBND6_ADDR A:0xf9a4b028
y.create.l HWIO_PERIPH_SS_USB1_HS_BAM_P_CNSMR_SDBND7_ADDR A:0xf9a4c028
y.create.l HWIO_PERIPH_SS_USB1_HS_BAM_P_CNSMR_SDBND8_ADDR A:0xf9a4d028
y.create.l HWIO_PERIPH_SS_USB1_HS_BAM_P_CNSMR_SDBND9_ADDR A:0xf9a4e028
y.create.l HWIO_PERIPH_SS_USB1_HS_BAM_P_EVNT_DEST_ADDR0_ADDR A:0xf9a4582c
y.create.l HWIO_PERIPH_SS_USB1_HS_BAM_P_EVNT_DEST_ADDR1_ADDR A:0xf9a4682c
y.create.l HWIO_PERIPH_SS_USB1_HS_BAM_P_EVNT_DEST_ADDR2_ADDR A:0xf9a4782c
y.create.l HWIO_PERIPH_SS_USB1_HS_BAM_P_EVNT_DEST_ADDR3_ADDR A:0xf9a4882c
y.create.l HWIO_PERIPH_SS_USB1_HS_BAM_P_EVNT_DEST_ADDR4_ADDR A:0xf9a4982c
y.create.l HWIO_PERIPH_SS_USB1_HS_BAM_P_EVNT_DEST_ADDR5_ADDR A:0xf9a4a82c
y.create.l HWIO_PERIPH_SS_USB1_HS_BAM_P_EVNT_DEST_ADDR6_ADDR A:0xf9a4b82c
y.create.l HWIO_PERIPH_SS_USB1_HS_BAM_P_EVNT_DEST_ADDR7_ADDR A:0xf9a4c82c
y.create.l HWIO_PERIPH_SS_USB1_HS_BAM_P_EVNT_DEST_ADDR8_ADDR A:0xf9a4d82c
y.create.l HWIO_PERIPH_SS_USB1_HS_BAM_P_EVNT_DEST_ADDR9_ADDR A:0xf9a4e82c
y.create.l HWIO_PERIPH_SS_USB1_HS_BAM_P_EVNT_DEST_ADDR_LSB0_ADDR A:0xf9a45930
y.create.l HWIO_PERIPH_SS_USB1_HS_BAM_P_EVNT_DEST_ADDR_LSB1_ADDR A:0xf9a46930
y.create.l HWIO_PERIPH_SS_USB1_HS_BAM_P_EVNT_DEST_ADDR_LSB2_ADDR A:0xf9a47930
y.create.l HWIO_PERIPH_SS_USB1_HS_BAM_P_EVNT_DEST_ADDR_LSB3_ADDR A:0xf9a48930
y.create.l HWIO_PERIPH_SS_USB1_HS_BAM_P_EVNT_DEST_ADDR_LSB4_ADDR A:0xf9a49930
y.create.l HWIO_PERIPH_SS_USB1_HS_BAM_P_EVNT_DEST_ADDR_LSB5_ADDR A:0xf9a4a930
y.create.l HWIO_PERIPH_SS_USB1_HS_BAM_P_EVNT_DEST_ADDR_LSB6_ADDR A:0xf9a4b930
y.create.l HWIO_PERIPH_SS_USB1_HS_BAM_P_EVNT_DEST_ADDR_LSB7_ADDR A:0xf9a4c930
y.create.l HWIO_PERIPH_SS_USB1_HS_BAM_P_EVNT_DEST_ADDR_LSB8_ADDR A:0xf9a4d930
y.create.l HWIO_PERIPH_SS_USB1_HS_BAM_P_EVNT_DEST_ADDR_LSB9_ADDR A:0xf9a4e930
y.create.l HWIO_PERIPH_SS_USB1_HS_BAM_P_EVNT_DEST_ADDR_MSB0_ADDR A:0xf9a45934
y.create.l HWIO_PERIPH_SS_USB1_HS_BAM_P_EVNT_DEST_ADDR_MSB1_ADDR A:0xf9a46934
y.create.l HWIO_PERIPH_SS_USB1_HS_BAM_P_EVNT_DEST_ADDR_MSB2_ADDR A:0xf9a47934
y.create.l HWIO_PERIPH_SS_USB1_HS_BAM_P_EVNT_DEST_ADDR_MSB3_ADDR A:0xf9a48934
y.create.l HWIO_PERIPH_SS_USB1_HS_BAM_P_EVNT_DEST_ADDR_MSB4_ADDR A:0xf9a49934
y.create.l HWIO_PERIPH_SS_USB1_HS_BAM_P_EVNT_DEST_ADDR_MSB5_ADDR A:0xf9a4a934
y.create.l HWIO_PERIPH_SS_USB1_HS_BAM_P_EVNT_DEST_ADDR_MSB6_ADDR A:0xf9a4b934
y.create.l HWIO_PERIPH_SS_USB1_HS_BAM_P_EVNT_DEST_ADDR_MSB7_ADDR A:0xf9a4c934
y.create.l HWIO_PERIPH_SS_USB1_HS_BAM_P_EVNT_DEST_ADDR_MSB8_ADDR A:0xf9a4d934
y.create.l HWIO_PERIPH_SS_USB1_HS_BAM_P_EVNT_DEST_ADDR_MSB9_ADDR A:0xf9a4e934
y.create.l HWIO_PERIPH_SS_USB1_HS_BAM_P_EVNT_REG0_ADDR A:0xf9a45818
y.create.l HWIO_PERIPH_SS_USB1_HS_BAM_P_EVNT_REG1_ADDR A:0xf9a46818
y.create.l HWIO_PERIPH_SS_USB1_HS_BAM_P_EVNT_REG2_ADDR A:0xf9a47818
y.create.l HWIO_PERIPH_SS_USB1_HS_BAM_P_EVNT_REG3_ADDR A:0xf9a48818
y.create.l HWIO_PERIPH_SS_USB1_HS_BAM_P_EVNT_REG4_ADDR A:0xf9a49818
y.create.l HWIO_PERIPH_SS_USB1_HS_BAM_P_EVNT_REG5_ADDR A:0xf9a4a818
y.create.l HWIO_PERIPH_SS_USB1_HS_BAM_P_EVNT_REG6_ADDR A:0xf9a4b818
y.create.l HWIO_PERIPH_SS_USB1_HS_BAM_P_EVNT_REG7_ADDR A:0xf9a4c818
y.create.l HWIO_PERIPH_SS_USB1_HS_BAM_P_EVNT_REG8_ADDR A:0xf9a4d818
y.create.l HWIO_PERIPH_SS_USB1_HS_BAM_P_EVNT_REG9_ADDR A:0xf9a4e818
y.create.l HWIO_PERIPH_SS_USB1_HS_BAM_P_SW_OFSTS0_ADDR A:0xf9a45800
y.create.l HWIO_PERIPH_SS_USB1_HS_BAM_P_SW_OFSTS1_ADDR A:0xf9a46800
y.create.l HWIO_PERIPH_SS_USB1_HS_BAM_P_SW_OFSTS2_ADDR A:0xf9a47800
y.create.l HWIO_PERIPH_SS_USB1_HS_BAM_P_SW_OFSTS3_ADDR A:0xf9a48800
y.create.l HWIO_PERIPH_SS_USB1_HS_BAM_P_SW_OFSTS4_ADDR A:0xf9a49800
y.create.l HWIO_PERIPH_SS_USB1_HS_BAM_P_SW_OFSTS5_ADDR A:0xf9a4a800
y.create.l HWIO_PERIPH_SS_USB1_HS_BAM_P_SW_OFSTS6_ADDR A:0xf9a4b800
y.create.l HWIO_PERIPH_SS_USB1_HS_BAM_P_SW_OFSTS7_ADDR A:0xf9a4c800
y.create.l HWIO_PERIPH_SS_USB1_HS_BAM_P_SW_OFSTS8_ADDR A:0xf9a4d800
y.create.l HWIO_PERIPH_SS_USB1_HS_BAM_P_SW_OFSTS9_ADDR A:0xf9a4e800
y.create.l HWIO_PERIPH_SS_USB1_HS_BAM_P_DATA_FIFO_ADDR0_ADDR A:0xf9a45824
y.create.l HWIO_PERIPH_SS_USB1_HS_BAM_P_DATA_FIFO_ADDR1_ADDR A:0xf9a46824
y.create.l HWIO_PERIPH_SS_USB1_HS_BAM_P_DATA_FIFO_ADDR2_ADDR A:0xf9a47824
y.create.l HWIO_PERIPH_SS_USB1_HS_BAM_P_DATA_FIFO_ADDR3_ADDR A:0xf9a48824
y.create.l HWIO_PERIPH_SS_USB1_HS_BAM_P_DATA_FIFO_ADDR4_ADDR A:0xf9a49824
y.create.l HWIO_PERIPH_SS_USB1_HS_BAM_P_DATA_FIFO_ADDR5_ADDR A:0xf9a4a824
y.create.l HWIO_PERIPH_SS_USB1_HS_BAM_P_DATA_FIFO_ADDR6_ADDR A:0xf9a4b824
y.create.l HWIO_PERIPH_SS_USB1_HS_BAM_P_DATA_FIFO_ADDR7_ADDR A:0xf9a4c824
y.create.l HWIO_PERIPH_SS_USB1_HS_BAM_P_DATA_FIFO_ADDR8_ADDR A:0xf9a4d824
y.create.l HWIO_PERIPH_SS_USB1_HS_BAM_P_DATA_FIFO_ADDR9_ADDR A:0xf9a4e824
y.create.l HWIO_PERIPH_SS_USB1_HS_BAM_P_DATA_FIFO_ADDR_LSB0_ADDR A:0xf9a45920
y.create.l HWIO_PERIPH_SS_USB1_HS_BAM_P_DATA_FIFO_ADDR_LSB1_ADDR A:0xf9a46920
y.create.l HWIO_PERIPH_SS_USB1_HS_BAM_P_DATA_FIFO_ADDR_LSB2_ADDR A:0xf9a47920
y.create.l HWIO_PERIPH_SS_USB1_HS_BAM_P_DATA_FIFO_ADDR_LSB3_ADDR A:0xf9a48920
y.create.l HWIO_PERIPH_SS_USB1_HS_BAM_P_DATA_FIFO_ADDR_LSB4_ADDR A:0xf9a49920
y.create.l HWIO_PERIPH_SS_USB1_HS_BAM_P_DATA_FIFO_ADDR_LSB5_ADDR A:0xf9a4a920
y.create.l HWIO_PERIPH_SS_USB1_HS_BAM_P_DATA_FIFO_ADDR_LSB6_ADDR A:0xf9a4b920
y.create.l HWIO_PERIPH_SS_USB1_HS_BAM_P_DATA_FIFO_ADDR_LSB7_ADDR A:0xf9a4c920
y.create.l HWIO_PERIPH_SS_USB1_HS_BAM_P_DATA_FIFO_ADDR_LSB8_ADDR A:0xf9a4d920
y.create.l HWIO_PERIPH_SS_USB1_HS_BAM_P_DATA_FIFO_ADDR_LSB9_ADDR A:0xf9a4e920
y.create.l HWIO_PERIPH_SS_USB1_HS_BAM_P_DATA_FIFO_ADDR_MSB0_ADDR A:0xf9a45924
y.create.l HWIO_PERIPH_SS_USB1_HS_BAM_P_DATA_FIFO_ADDR_MSB1_ADDR A:0xf9a46924
y.create.l HWIO_PERIPH_SS_USB1_HS_BAM_P_DATA_FIFO_ADDR_MSB2_ADDR A:0xf9a47924
y.create.l HWIO_PERIPH_SS_USB1_HS_BAM_P_DATA_FIFO_ADDR_MSB3_ADDR A:0xf9a48924
y.create.l HWIO_PERIPH_SS_USB1_HS_BAM_P_DATA_FIFO_ADDR_MSB4_ADDR A:0xf9a49924
y.create.l HWIO_PERIPH_SS_USB1_HS_BAM_P_DATA_FIFO_ADDR_MSB5_ADDR A:0xf9a4a924
y.create.l HWIO_PERIPH_SS_USB1_HS_BAM_P_DATA_FIFO_ADDR_MSB6_ADDR A:0xf9a4b924
y.create.l HWIO_PERIPH_SS_USB1_HS_BAM_P_DATA_FIFO_ADDR_MSB7_ADDR A:0xf9a4c924
y.create.l HWIO_PERIPH_SS_USB1_HS_BAM_P_DATA_FIFO_ADDR_MSB8_ADDR A:0xf9a4d924
y.create.l HWIO_PERIPH_SS_USB1_HS_BAM_P_DATA_FIFO_ADDR_MSB9_ADDR A:0xf9a4e924
y.create.l HWIO_PERIPH_SS_USB1_HS_BAM_P_DESC_FIFO_ADDR0_ADDR A:0xf9a4581c
y.create.l HWIO_PERIPH_SS_USB1_HS_BAM_P_DESC_FIFO_ADDR1_ADDR A:0xf9a4681c
y.create.l HWIO_PERIPH_SS_USB1_HS_BAM_P_DESC_FIFO_ADDR2_ADDR A:0xf9a4781c
y.create.l HWIO_PERIPH_SS_USB1_HS_BAM_P_DESC_FIFO_ADDR3_ADDR A:0xf9a4881c
y.create.l HWIO_PERIPH_SS_USB1_HS_BAM_P_DESC_FIFO_ADDR4_ADDR A:0xf9a4981c
y.create.l HWIO_PERIPH_SS_USB1_HS_BAM_P_DESC_FIFO_ADDR5_ADDR A:0xf9a4a81c
y.create.l HWIO_PERIPH_SS_USB1_HS_BAM_P_DESC_FIFO_ADDR6_ADDR A:0xf9a4b81c
y.create.l HWIO_PERIPH_SS_USB1_HS_BAM_P_DESC_FIFO_ADDR7_ADDR A:0xf9a4c81c
y.create.l HWIO_PERIPH_SS_USB1_HS_BAM_P_DESC_FIFO_ADDR8_ADDR A:0xf9a4d81c
y.create.l HWIO_PERIPH_SS_USB1_HS_BAM_P_DESC_FIFO_ADDR9_ADDR A:0xf9a4e81c
y.create.l HWIO_PERIPH_SS_USB1_HS_BAM_P_DESC_FIFO_ADDR_LSB0_ADDR A:0xf9a45910
y.create.l HWIO_PERIPH_SS_USB1_HS_BAM_P_DESC_FIFO_ADDR_LSB1_ADDR A:0xf9a46910
y.create.l HWIO_PERIPH_SS_USB1_HS_BAM_P_DESC_FIFO_ADDR_LSB2_ADDR A:0xf9a47910
y.create.l HWIO_PERIPH_SS_USB1_HS_BAM_P_DESC_FIFO_ADDR_LSB3_ADDR A:0xf9a48910
y.create.l HWIO_PERIPH_SS_USB1_HS_BAM_P_DESC_FIFO_ADDR_LSB4_ADDR A:0xf9a49910
y.create.l HWIO_PERIPH_SS_USB1_HS_BAM_P_DESC_FIFO_ADDR_LSB5_ADDR A:0xf9a4a910
y.create.l HWIO_PERIPH_SS_USB1_HS_BAM_P_DESC_FIFO_ADDR_LSB6_ADDR A:0xf9a4b910
y.create.l HWIO_PERIPH_SS_USB1_HS_BAM_P_DESC_FIFO_ADDR_LSB7_ADDR A:0xf9a4c910
y.create.l HWIO_PERIPH_SS_USB1_HS_BAM_P_DESC_FIFO_ADDR_LSB8_ADDR A:0xf9a4d910
y.create.l HWIO_PERIPH_SS_USB1_HS_BAM_P_DESC_FIFO_ADDR_LSB9_ADDR A:0xf9a4e910
y.create.l HWIO_PERIPH_SS_USB1_HS_BAM_P_DESC_FIFO_ADDR_MSB0_ADDR A:0xf9a45914
y.create.l HWIO_PERIPH_SS_USB1_HS_BAM_P_DESC_FIFO_ADDR_MSB1_ADDR A:0xf9a46914
y.create.l HWIO_PERIPH_SS_USB1_HS_BAM_P_DESC_FIFO_ADDR_MSB2_ADDR A:0xf9a47914
y.create.l HWIO_PERIPH_SS_USB1_HS_BAM_P_DESC_FIFO_ADDR_MSB3_ADDR A:0xf9a48914
y.create.l HWIO_PERIPH_SS_USB1_HS_BAM_P_DESC_FIFO_ADDR_MSB4_ADDR A:0xf9a49914
y.create.l HWIO_PERIPH_SS_USB1_HS_BAM_P_DESC_FIFO_ADDR_MSB5_ADDR A:0xf9a4a914
y.create.l HWIO_PERIPH_SS_USB1_HS_BAM_P_DESC_FIFO_ADDR_MSB6_ADDR A:0xf9a4b914
y.create.l HWIO_PERIPH_SS_USB1_HS_BAM_P_DESC_FIFO_ADDR_MSB7_ADDR A:0xf9a4c914
y.create.l HWIO_PERIPH_SS_USB1_HS_BAM_P_DESC_FIFO_ADDR_MSB8_ADDR A:0xf9a4d914
y.create.l HWIO_PERIPH_SS_USB1_HS_BAM_P_DESC_FIFO_ADDR_MSB9_ADDR A:0xf9a4e914
y.create.l HWIO_PERIPH_SS_USB1_HS_BAM_P_EVNT_GEN_TRSHLD0_ADDR A:0xf9a45828
y.create.l HWIO_PERIPH_SS_USB1_HS_BAM_P_EVNT_GEN_TRSHLD1_ADDR A:0xf9a46828
y.create.l HWIO_PERIPH_SS_USB1_HS_BAM_P_EVNT_GEN_TRSHLD2_ADDR A:0xf9a47828
y.create.l HWIO_PERIPH_SS_USB1_HS_BAM_P_EVNT_GEN_TRSHLD3_ADDR A:0xf9a48828
y.create.l HWIO_PERIPH_SS_USB1_HS_BAM_P_EVNT_GEN_TRSHLD4_ADDR A:0xf9a49828
y.create.l HWIO_PERIPH_SS_USB1_HS_BAM_P_EVNT_GEN_TRSHLD5_ADDR A:0xf9a4a828
y.create.l HWIO_PERIPH_SS_USB1_HS_BAM_P_EVNT_GEN_TRSHLD6_ADDR A:0xf9a4b828
y.create.l HWIO_PERIPH_SS_USB1_HS_BAM_P_EVNT_GEN_TRSHLD7_ADDR A:0xf9a4c828
y.create.l HWIO_PERIPH_SS_USB1_HS_BAM_P_EVNT_GEN_TRSHLD8_ADDR A:0xf9a4d828
y.create.l HWIO_PERIPH_SS_USB1_HS_BAM_P_EVNT_GEN_TRSHLD9_ADDR A:0xf9a4e828
y.create.l HWIO_PERIPH_SS_USB1_HS_BAM_P_FIFO_SIZES0_ADDR A:0xf9a45820
y.create.l HWIO_PERIPH_SS_USB1_HS_BAM_P_FIFO_SIZES1_ADDR A:0xf9a46820
y.create.l HWIO_PERIPH_SS_USB1_HS_BAM_P_FIFO_SIZES2_ADDR A:0xf9a47820
y.create.l HWIO_PERIPH_SS_USB1_HS_BAM_P_FIFO_SIZES3_ADDR A:0xf9a48820
y.create.l HWIO_PERIPH_SS_USB1_HS_BAM_P_FIFO_SIZES4_ADDR A:0xf9a49820
y.create.l HWIO_PERIPH_SS_USB1_HS_BAM_P_FIFO_SIZES5_ADDR A:0xf9a4a820
y.create.l HWIO_PERIPH_SS_USB1_HS_BAM_P_FIFO_SIZES6_ADDR A:0xf9a4b820
y.create.l HWIO_PERIPH_SS_USB1_HS_BAM_P_FIFO_SIZES7_ADDR A:0xf9a4c820
y.create.l HWIO_PERIPH_SS_USB1_HS_BAM_P_FIFO_SIZES8_ADDR A:0xf9a4d820
y.create.l HWIO_PERIPH_SS_USB1_HS_BAM_P_FIFO_SIZES9_ADDR A:0xf9a4e820
y.create.l HWIO_PERIPH_SS_USB1_HS_BAM_P_RETR_CNTXT_0_ADDR A:0xf9a45834
y.create.l HWIO_PERIPH_SS_USB1_HS_BAM_P_RETR_CNTXT_1_ADDR A:0xf9a46834
y.create.l HWIO_PERIPH_SS_USB1_HS_BAM_P_RETR_CNTXT_2_ADDR A:0xf9a47834
y.create.l HWIO_PERIPH_SS_USB1_HS_BAM_P_RETR_CNTXT_3_ADDR A:0xf9a48834
y.create.l HWIO_PERIPH_SS_USB1_HS_BAM_P_RETR_CNTXT_4_ADDR A:0xf9a49834
y.create.l HWIO_PERIPH_SS_USB1_HS_BAM_P_RETR_CNTXT_5_ADDR A:0xf9a4a834
y.create.l HWIO_PERIPH_SS_USB1_HS_BAM_P_RETR_CNTXT_6_ADDR A:0xf9a4b834
y.create.l HWIO_PERIPH_SS_USB1_HS_BAM_P_RETR_CNTXT_7_ADDR A:0xf9a4c834
y.create.l HWIO_PERIPH_SS_USB1_HS_BAM_P_RETR_CNTXT_8_ADDR A:0xf9a4d834
y.create.l HWIO_PERIPH_SS_USB1_HS_BAM_P_RETR_CNTXT_9_ADDR A:0xf9a4e834
y.create.l HWIO_PERIPH_SS_USB1_HS_BAM_P_SI_CNTXT_0_ADDR A:0xf9a45838
y.create.l HWIO_PERIPH_SS_USB1_HS_BAM_P_SI_CNTXT_1_ADDR A:0xf9a46838
y.create.l HWIO_PERIPH_SS_USB1_HS_BAM_P_SI_CNTXT_2_ADDR A:0xf9a47838
y.create.l HWIO_PERIPH_SS_USB1_HS_BAM_P_SI_CNTXT_3_ADDR A:0xf9a48838
y.create.l HWIO_PERIPH_SS_USB1_HS_BAM_P_SI_CNTXT_4_ADDR A:0xf9a49838
y.create.l HWIO_PERIPH_SS_USB1_HS_BAM_P_SI_CNTXT_5_ADDR A:0xf9a4a838
y.create.l HWIO_PERIPH_SS_USB1_HS_BAM_P_SI_CNTXT_6_ADDR A:0xf9a4b838
y.create.l HWIO_PERIPH_SS_USB1_HS_BAM_P_SI_CNTXT_7_ADDR A:0xf9a4c838
y.create.l HWIO_PERIPH_SS_USB1_HS_BAM_P_SI_CNTXT_8_ADDR A:0xf9a4d838
y.create.l HWIO_PERIPH_SS_USB1_HS_BAM_P_SI_CNTXT_9_ADDR A:0xf9a4e838
y.create.l HWIO_PERIPH_SS_USB1_HS_BAM_P_DF_CNTXT_0_ADDR A:0xf9a45830
y.create.l HWIO_PERIPH_SS_USB1_HS_BAM_P_DF_CNTXT_1_ADDR A:0xf9a46830
y.create.l HWIO_PERIPH_SS_USB1_HS_BAM_P_DF_CNTXT_2_ADDR A:0xf9a47830
y.create.l HWIO_PERIPH_SS_USB1_HS_BAM_P_DF_CNTXT_3_ADDR A:0xf9a48830
y.create.l HWIO_PERIPH_SS_USB1_HS_BAM_P_DF_CNTXT_4_ADDR A:0xf9a49830
y.create.l HWIO_PERIPH_SS_USB1_HS_BAM_P_DF_CNTXT_5_ADDR A:0xf9a4a830
y.create.l HWIO_PERIPH_SS_USB1_HS_BAM_P_DF_CNTXT_6_ADDR A:0xf9a4b830
y.create.l HWIO_PERIPH_SS_USB1_HS_BAM_P_DF_CNTXT_7_ADDR A:0xf9a4c830
y.create.l HWIO_PERIPH_SS_USB1_HS_BAM_P_DF_CNTXT_8_ADDR A:0xf9a4d830
y.create.l HWIO_PERIPH_SS_USB1_HS_BAM_P_DF_CNTXT_9_ADDR A:0xf9a4e830
y.create.l HWIO_PERIPH_SS_USB1_HS_BAM_P_AU_PSM_CNTXT_1_0_ADDR A:0xf9a45804
y.create.l HWIO_PERIPH_SS_USB1_HS_BAM_P_AU_PSM_CNTXT_1_1_ADDR A:0xf9a46804
y.create.l HWIO_PERIPH_SS_USB1_HS_BAM_P_AU_PSM_CNTXT_1_2_ADDR A:0xf9a47804
y.create.l HWIO_PERIPH_SS_USB1_HS_BAM_P_AU_PSM_CNTXT_1_3_ADDR A:0xf9a48804
y.create.l HWIO_PERIPH_SS_USB1_HS_BAM_P_AU_PSM_CNTXT_1_4_ADDR A:0xf9a49804
y.create.l HWIO_PERIPH_SS_USB1_HS_BAM_P_AU_PSM_CNTXT_1_5_ADDR A:0xf9a4a804
y.create.l HWIO_PERIPH_SS_USB1_HS_BAM_P_AU_PSM_CNTXT_1_6_ADDR A:0xf9a4b804
y.create.l HWIO_PERIPH_SS_USB1_HS_BAM_P_AU_PSM_CNTXT_1_7_ADDR A:0xf9a4c804
y.create.l HWIO_PERIPH_SS_USB1_HS_BAM_P_AU_PSM_CNTXT_1_8_ADDR A:0xf9a4d804
y.create.l HWIO_PERIPH_SS_USB1_HS_BAM_P_AU_PSM_CNTXT_1_9_ADDR A:0xf9a4e804
y.create.l HWIO_PERIPH_SS_USB1_HS_BAM_P_PSM_CNTXT_2_0_ADDR A:0xf9a45808
y.create.l HWIO_PERIPH_SS_USB1_HS_BAM_P_PSM_CNTXT_2_1_ADDR A:0xf9a46808
y.create.l HWIO_PERIPH_SS_USB1_HS_BAM_P_PSM_CNTXT_2_2_ADDR A:0xf9a47808
y.create.l HWIO_PERIPH_SS_USB1_HS_BAM_P_PSM_CNTXT_2_3_ADDR A:0xf9a48808
y.create.l HWIO_PERIPH_SS_USB1_HS_BAM_P_PSM_CNTXT_2_4_ADDR A:0xf9a49808
y.create.l HWIO_PERIPH_SS_USB1_HS_BAM_P_PSM_CNTXT_2_5_ADDR A:0xf9a4a808
y.create.l HWIO_PERIPH_SS_USB1_HS_BAM_P_PSM_CNTXT_2_6_ADDR A:0xf9a4b808
y.create.l HWIO_PERIPH_SS_USB1_HS_BAM_P_PSM_CNTXT_2_7_ADDR A:0xf9a4c808
y.create.l HWIO_PERIPH_SS_USB1_HS_BAM_P_PSM_CNTXT_2_8_ADDR A:0xf9a4d808
y.create.l HWIO_PERIPH_SS_USB1_HS_BAM_P_PSM_CNTXT_2_9_ADDR A:0xf9a4e808
y.create.l HWIO_PERIPH_SS_USB1_HS_BAM_P_PSM_CNTXT_3_0_ADDR A:0xf9a4580c
y.create.l HWIO_PERIPH_SS_USB1_HS_BAM_P_PSM_CNTXT_3_1_ADDR A:0xf9a4680c
y.create.l HWIO_PERIPH_SS_USB1_HS_BAM_P_PSM_CNTXT_3_2_ADDR A:0xf9a4780c
y.create.l HWIO_PERIPH_SS_USB1_HS_BAM_P_PSM_CNTXT_3_3_ADDR A:0xf9a4880c
y.create.l HWIO_PERIPH_SS_USB1_HS_BAM_P_PSM_CNTXT_3_4_ADDR A:0xf9a4980c
y.create.l HWIO_PERIPH_SS_USB1_HS_BAM_P_PSM_CNTXT_3_5_ADDR A:0xf9a4a80c
y.create.l HWIO_PERIPH_SS_USB1_HS_BAM_P_PSM_CNTXT_3_6_ADDR A:0xf9a4b80c
y.create.l HWIO_PERIPH_SS_USB1_HS_BAM_P_PSM_CNTXT_3_7_ADDR A:0xf9a4c80c
y.create.l HWIO_PERIPH_SS_USB1_HS_BAM_P_PSM_CNTXT_3_8_ADDR A:0xf9a4d80c
y.create.l HWIO_PERIPH_SS_USB1_HS_BAM_P_PSM_CNTXT_3_9_ADDR A:0xf9a4e80c
y.create.l HWIO_PERIPH_SS_USB1_HS_BAM_P_PSM_CNTXT_3_LSB0_ADDR A:0xf9a45900
y.create.l HWIO_PERIPH_SS_USB1_HS_BAM_P_PSM_CNTXT_3_LSB1_ADDR A:0xf9a46900
y.create.l HWIO_PERIPH_SS_USB1_HS_BAM_P_PSM_CNTXT_3_LSB2_ADDR A:0xf9a47900
y.create.l HWIO_PERIPH_SS_USB1_HS_BAM_P_PSM_CNTXT_3_LSB3_ADDR A:0xf9a48900
y.create.l HWIO_PERIPH_SS_USB1_HS_BAM_P_PSM_CNTXT_3_LSB4_ADDR A:0xf9a49900
y.create.l HWIO_PERIPH_SS_USB1_HS_BAM_P_PSM_CNTXT_3_LSB5_ADDR A:0xf9a4a900
y.create.l HWIO_PERIPH_SS_USB1_HS_BAM_P_PSM_CNTXT_3_LSB6_ADDR A:0xf9a4b900
y.create.l HWIO_PERIPH_SS_USB1_HS_BAM_P_PSM_CNTXT_3_LSB7_ADDR A:0xf9a4c900
y.create.l HWIO_PERIPH_SS_USB1_HS_BAM_P_PSM_CNTXT_3_LSB8_ADDR A:0xf9a4d900
y.create.l HWIO_PERIPH_SS_USB1_HS_BAM_P_PSM_CNTXT_3_LSB9_ADDR A:0xf9a4e900
y.create.l HWIO_PERIPH_SS_USB1_HS_BAM_P_PSM_CNTXT_3_MSB0_ADDR A:0xf9a45904
y.create.l HWIO_PERIPH_SS_USB1_HS_BAM_P_PSM_CNTXT_3_MSB1_ADDR A:0xf9a46904
y.create.l HWIO_PERIPH_SS_USB1_HS_BAM_P_PSM_CNTXT_3_MSB2_ADDR A:0xf9a47904
y.create.l HWIO_PERIPH_SS_USB1_HS_BAM_P_PSM_CNTXT_3_MSB3_ADDR A:0xf9a48904
y.create.l HWIO_PERIPH_SS_USB1_HS_BAM_P_PSM_CNTXT_3_MSB4_ADDR A:0xf9a49904
y.create.l HWIO_PERIPH_SS_USB1_HS_BAM_P_PSM_CNTXT_3_MSB5_ADDR A:0xf9a4a904
y.create.l HWIO_PERIPH_SS_USB1_HS_BAM_P_PSM_CNTXT_3_MSB6_ADDR A:0xf9a4b904
y.create.l HWIO_PERIPH_SS_USB1_HS_BAM_P_PSM_CNTXT_3_MSB7_ADDR A:0xf9a4c904
y.create.l HWIO_PERIPH_SS_USB1_HS_BAM_P_PSM_CNTXT_3_MSB8_ADDR A:0xf9a4d904
y.create.l HWIO_PERIPH_SS_USB1_HS_BAM_P_PSM_CNTXT_3_MSB9_ADDR A:0xf9a4e904
y.create.l HWIO_PERIPH_SS_USB1_HS_BAM_P_PSM_CNTXT_4_0_ADDR A:0xf9a45810
y.create.l HWIO_PERIPH_SS_USB1_HS_BAM_P_PSM_CNTXT_4_1_ADDR A:0xf9a46810
y.create.l HWIO_PERIPH_SS_USB1_HS_BAM_P_PSM_CNTXT_4_2_ADDR A:0xf9a47810
y.create.l HWIO_PERIPH_SS_USB1_HS_BAM_P_PSM_CNTXT_4_3_ADDR A:0xf9a48810
y.create.l HWIO_PERIPH_SS_USB1_HS_BAM_P_PSM_CNTXT_4_4_ADDR A:0xf9a49810
y.create.l HWIO_PERIPH_SS_USB1_HS_BAM_P_PSM_CNTXT_4_5_ADDR A:0xf9a4a810
y.create.l HWIO_PERIPH_SS_USB1_HS_BAM_P_PSM_CNTXT_4_6_ADDR A:0xf9a4b810
y.create.l HWIO_PERIPH_SS_USB1_HS_BAM_P_PSM_CNTXT_4_7_ADDR A:0xf9a4c810
y.create.l HWIO_PERIPH_SS_USB1_HS_BAM_P_PSM_CNTXT_4_8_ADDR A:0xf9a4d810
y.create.l HWIO_PERIPH_SS_USB1_HS_BAM_P_PSM_CNTXT_4_9_ADDR A:0xf9a4e810
y.create.l HWIO_PERIPH_SS_USB1_HS_BAM_P_PSM_CNTXT_5_0_ADDR A:0xf9a45814
y.create.l HWIO_PERIPH_SS_USB1_HS_BAM_P_PSM_CNTXT_5_1_ADDR A:0xf9a46814
y.create.l HWIO_PERIPH_SS_USB1_HS_BAM_P_PSM_CNTXT_5_2_ADDR A:0xf9a47814
y.create.l HWIO_PERIPH_SS_USB1_HS_BAM_P_PSM_CNTXT_5_3_ADDR A:0xf9a48814
y.create.l HWIO_PERIPH_SS_USB1_HS_BAM_P_PSM_CNTXT_5_4_ADDR A:0xf9a49814
y.create.l HWIO_PERIPH_SS_USB1_HS_BAM_P_PSM_CNTXT_5_5_ADDR A:0xf9a4a814
y.create.l HWIO_PERIPH_SS_USB1_HS_BAM_P_PSM_CNTXT_5_6_ADDR A:0xf9a4b814
y.create.l HWIO_PERIPH_SS_USB1_HS_BAM_P_PSM_CNTXT_5_7_ADDR A:0xf9a4c814
y.create.l HWIO_PERIPH_SS_USB1_HS_BAM_P_PSM_CNTXT_5_8_ADDR A:0xf9a4d814
y.create.l HWIO_PERIPH_SS_USB1_HS_BAM_P_PSM_CNTXT_5_9_ADDR A:0xf9a4e814
y.create.l HWIO_PERIPH_SS_USB1_HS_XPU_SCR_ADDR A:0xf9a42000
y.create.l HWIO_PERIPH_SS_USB1_HS_XPU_SWDR_ADDR A:0xf9a42004
y.create.l HWIO_PERIPH_SS_USB1_HS_XPU_SEAR0_ADDR A:0xf9a42040
y.create.l HWIO_PERIPH_SS_USB1_HS_XPU_SESR_ADDR A:0xf9a42048
y.create.l HWIO_PERIPH_SS_USB1_HS_XPU_SESRRESTORE_ADDR A:0xf9a4204c
y.create.l HWIO_PERIPH_SS_USB1_HS_XPU_SESYNR0_ADDR A:0xf9a42050
y.create.l HWIO_PERIPH_SS_USB1_HS_XPU_SESYNR1_ADDR A:0xf9a42054
y.create.l HWIO_PERIPH_SS_USB1_HS_XPU_SESYNR2_ADDR A:0xf9a42058
y.create.l HWIO_PERIPH_SS_USB1_HS_XPU_MCR_ADDR A:0xf9a42100
y.create.l HWIO_PERIPH_SS_USB1_HS_XPU_MEAR0_ADDR A:0xf9a42140
y.create.l HWIO_PERIPH_SS_USB1_HS_XPU_MESR_ADDR A:0xf9a42148
y.create.l HWIO_PERIPH_SS_USB1_HS_XPU_MESRRESTORE_ADDR A:0xf9a4214c
y.create.l HWIO_PERIPH_SS_USB1_HS_XPU_MESYNR0_ADDR A:0xf9a42150
y.create.l HWIO_PERIPH_SS_USB1_HS_XPU_MESYNR1_ADDR A:0xf9a42154
y.create.l HWIO_PERIPH_SS_USB1_HS_XPU_MESYNR2_ADDR A:0xf9a42158
y.create.l HWIO_PERIPH_SS_USB1_HS_XPU_CR_ADDR A:0xf9a42080
y.create.l HWIO_PERIPH_SS_USB1_HS_XPU_RPU_ACR0_ADDR A:0xf9a420a0
y.create.l HWIO_PERIPH_SS_USB1_HS_XPU_EAR0_ADDR A:0xf9a420c0
y.create.l HWIO_PERIPH_SS_USB1_HS_XPU_ESR_ADDR A:0xf9a420c8
y.create.l HWIO_PERIPH_SS_USB1_HS_XPU_ESRRESTORE_ADDR A:0xf9a420cc
y.create.l HWIO_PERIPH_SS_USB1_HS_XPU_ESYNR0_ADDR A:0xf9a420d0
y.create.l HWIO_PERIPH_SS_USB1_HS_XPU_ESYNR1_ADDR A:0xf9a420d4
y.create.l HWIO_PERIPH_SS_USB1_HS_XPU_ESYNR2_ADDR A:0xf9a420d8
y.create.l HWIO_PERIPH_SS_USB1_HS_XPU_IDR0_ADDR A:0xf9a42074
y.create.l HWIO_PERIPH_SS_USB1_HS_XPU_IDR1_ADDR A:0xf9a42078
y.create.l HWIO_PERIPH_SS_USB1_HS_XPU_REV_ADDR A:0xf9a4207c
y.create.l HWIO_PERIPH_SS_USB1_HS_XPU_RG0_RACR0_ADDR A:0xf9a42200
y.create.l HWIO_PERIPH_SS_USB1_HS_XPU_RG1_RACR0_ADDR A:0xf9a42280
y.create.l HWIO_PERIPH_SS_USB1_HS_XPU_RG2_RACR0_ADDR A:0xf9a42300
y.create.l HWIO_PERIPH_SS_USB1_HS_XPU_RG3_RACR0_ADDR A:0xf9a42380
y.create.l HWIO_PERIPH_SS_USB1_HS_XPU_RG4_RACR0_ADDR A:0xf9a42400
y.create.l HWIO_PERIPH_SS_USB1_HS_XPU_RG5_RACR0_ADDR A:0xf9a42480
y.create.l HWIO_PERIPH_SS_USB1_HS_XPU_RG6_RACR0_ADDR A:0xf9a42500
y.create.l HWIO_PERIPH_SS_USB1_HS_XPU_RG7_RACR0_ADDR A:0xf9a42580
y.create.l HWIO_PERIPH_SS_USB1_HS_XPU_RG8_RACR0_ADDR A:0xf9a42600
y.create.l HWIO_PERIPH_SS_USB1_HS_XPU_RG9_RACR0_ADDR A:0xf9a42680
y.create.l HWIO_PERIPH_SS_USB1_HS_XPU_RG0_SCR_ADDR A:0xf9a42250
y.create.l HWIO_PERIPH_SS_USB1_HS_XPU_RG1_SCR_ADDR A:0xf9a422d0
y.create.l HWIO_PERIPH_SS_USB1_HS_XPU_RG2_SCR_ADDR A:0xf9a42350
y.create.l HWIO_PERIPH_SS_USB1_HS_XPU_RG3_SCR_ADDR A:0xf9a423d0
y.create.l HWIO_PERIPH_SS_USB1_HS_XPU_RG4_SCR_ADDR A:0xf9a42450
y.create.l HWIO_PERIPH_SS_USB1_HS_XPU_RG5_SCR_ADDR A:0xf9a424d0
y.create.l HWIO_PERIPH_SS_USB1_HS_XPU_RG6_SCR_ADDR A:0xf9a42550
y.create.l HWIO_PERIPH_SS_USB1_HS_XPU_RG7_SCR_ADDR A:0xf9a425d0
y.create.l HWIO_PERIPH_SS_USB1_HS_XPU_RG8_SCR_ADDR A:0xf9a42650
y.create.l HWIO_PERIPH_SS_USB1_HS_XPU_RG9_SCR_ADDR A:0xf9a426d0
y.create.l HWIO_PERIPH_SS_USB1_HS_XPU_RG0_MCR_ADDR A:0xf9a42254
y.create.l HWIO_PERIPH_SS_USB1_HS_XPU_RG1_MCR_ADDR A:0xf9a422d4
y.create.l HWIO_PERIPH_SS_USB1_HS_XPU_RG2_MCR_ADDR A:0xf9a42354
y.create.l HWIO_PERIPH_SS_USB1_HS_XPU_RG3_MCR_ADDR A:0xf9a423d4
y.create.l HWIO_PERIPH_SS_USB1_HS_XPU_RG4_MCR_ADDR A:0xf9a42454
y.create.l HWIO_PERIPH_SS_USB1_HS_XPU_RG5_MCR_ADDR A:0xf9a424d4
y.create.l HWIO_PERIPH_SS_USB1_HS_XPU_RG6_MCR_ADDR A:0xf9a42554
y.create.l HWIO_PERIPH_SS_USB1_HS_XPU_RG7_MCR_ADDR A:0xf9a425d4
y.create.l HWIO_PERIPH_SS_USB1_HS_XPU_RG8_MCR_ADDR A:0xf9a42654
y.create.l HWIO_PERIPH_SS_USB1_HS_XPU_RG9_MCR_ADDR A:0xf9a426d4
y.create.l HWIO_PERIPH_SS_USB1_HS_VMIDMT_SCR0_ADDR A:0xf9a40000
y.create.l HWIO_PERIPH_SS_USB1_HS_VMIDMT_SCR1_ADDR A:0xf9a40004
y.create.l HWIO_PERIPH_SS_USB1_HS_VMIDMT_SCR2_ADDR A:0xf9a40008
y.create.l HWIO_PERIPH_SS_USB1_HS_VMIDMT_SACR_ADDR A:0xf9a40010
y.create.l HWIO_PERIPH_SS_USB1_HS_VMIDMT_SIDR0_ADDR A:0xf9a40020
y.create.l HWIO_PERIPH_SS_USB1_HS_VMIDMT_SIDR1_ADDR A:0xf9a40024
y.create.l HWIO_PERIPH_SS_USB1_HS_VMIDMT_SIDR2_ADDR A:0xf9a40028
y.create.l HWIO_PERIPH_SS_USB1_HS_VMIDMT_SIDR4_ADDR A:0xf9a40030
y.create.l HWIO_PERIPH_SS_USB1_HS_VMIDMT_SIDR5_ADDR A:0xf9a40034
y.create.l HWIO_PERIPH_SS_USB1_HS_VMIDMT_SIDR7_ADDR A:0xf9a4003c
y.create.l HWIO_PERIPH_SS_USB1_HS_VMIDMT_SGFAR0_ADDR A:0xf9a40040
y.create.l HWIO_PERIPH_SS_USB1_HS_VMIDMT_SGFSR_ADDR A:0xf9a40048
y.create.l HWIO_PERIPH_SS_USB1_HS_VMIDMT_SGFSRRESTORE_ADDR A:0xf9a4004c
y.create.l HWIO_PERIPH_SS_USB1_HS_VMIDMT_SGFSYNDR0_ADDR A:0xf9a40050
y.create.l HWIO_PERIPH_SS_USB1_HS_VMIDMT_SGFSYNDR1_ADDR A:0xf9a40054
y.create.l HWIO_PERIPH_SS_USB1_HS_VMIDMT_SGFSYNDR2_ADDR A:0xf9a40058
y.create.l HWIO_PERIPH_SS_USB1_HS_VMIDMT_VMIDMTSCR0_ADDR A:0xf9a40090
y.create.l HWIO_PERIPH_SS_USB1_HS_VMIDMT_CR0_ADDR A:0xf9a40000
y.create.l HWIO_PERIPH_SS_USB1_HS_VMIDMT_CR2_ADDR A:0xf9a40008
y.create.l HWIO_PERIPH_SS_USB1_HS_VMIDMT_ACR_ADDR A:0xf9a40010
y.create.l HWIO_PERIPH_SS_USB1_HS_VMIDMT_IDR0_ADDR A:0xf9a40020
y.create.l HWIO_PERIPH_SS_USB1_HS_VMIDMT_IDR1_ADDR A:0xf9a40024
y.create.l HWIO_PERIPH_SS_USB1_HS_VMIDMT_IDR2_ADDR A:0xf9a40028
y.create.l HWIO_PERIPH_SS_USB1_HS_VMIDMT_IDR4_ADDR A:0xf9a40030
y.create.l HWIO_PERIPH_SS_USB1_HS_VMIDMT_IDR5_ADDR A:0xf9a40034
y.create.l HWIO_PERIPH_SS_USB1_HS_VMIDMT_IDR7_ADDR A:0xf9a4003c
y.create.l HWIO_PERIPH_SS_USB1_HS_VMIDMT_GFAR0_ADDR A:0xf9a40040
y.create.l HWIO_PERIPH_SS_USB1_HS_VMIDMT_GFSR_ADDR A:0xf9a40048
y.create.l HWIO_PERIPH_SS_USB1_HS_VMIDMT_GFSRRESTORE_ADDR A:0xf9a4004c
y.create.l HWIO_PERIPH_SS_USB1_HS_VMIDMT_GFSYNDR0_ADDR A:0xf9a40050
y.create.l HWIO_PERIPH_SS_USB1_HS_VMIDMT_GFSYNDR1_ADDR A:0xf9a40054
y.create.l HWIO_PERIPH_SS_USB1_HS_VMIDMT_GFSYNDR2_ADDR A:0xf9a40058
y.create.l HWIO_PERIPH_SS_USB1_HS_VMIDMT_VMIDMTCR0_ADDR A:0xf9a40090
y.create.l HWIO_PERIPH_SS_USB1_HS_VMIDMT_VMIDMTACR_ADDR A:0xf9a4009c
y.create.l HWIO_PERIPH_SS_USB1_HS_VMIDMT_NSCR0_ADDR A:0xf9a40400
y.create.l HWIO_PERIPH_SS_USB1_HS_VMIDMT_NSCR2_ADDR A:0xf9a40408
y.create.l HWIO_PERIPH_SS_USB1_HS_VMIDMT_NSACR_ADDR A:0xf9a40410
y.create.l HWIO_PERIPH_SS_USB1_HS_VMIDMT_NSGFAR0_ADDR A:0xf9a40440
y.create.l HWIO_PERIPH_SS_USB1_HS_VMIDMT_NSGFSR_ADDR A:0xf9a40448
y.create.l HWIO_PERIPH_SS_USB1_HS_VMIDMT_NSGFSRRESTORE_ADDR A:0xf9a4044c
y.create.l HWIO_PERIPH_SS_USB1_HS_VMIDMT_NSGFSYNDR0_ADDR A:0xf9a40450
y.create.l HWIO_PERIPH_SS_USB1_HS_VMIDMT_NSGFSYNDR1_ADDR A:0xf9a40454
y.create.l HWIO_PERIPH_SS_USB1_HS_VMIDMT_NSGFSYNDR2_ADDR A:0xf9a40458
y.create.l HWIO_PERIPH_SS_USB1_HS_VMIDMT_NSVMIDMTCR0_ADDR A:0xf9a40490
y.create.l HWIO_PERIPH_SS_USB1_HS_VMIDMT_SSDR0_ADDR A:0xf9a40080
y.create.l HWIO_PERIPH_SS_USB1_HS_VMIDMT_MSDR0_ADDR A:0xf9a40480
y.create.l HWIO_PERIPH_SS_USB1_HS_VMIDMT_MCR_ADDR A:0xf9a40494
y.create.l HWIO_PERIPH_SS_USB1_HS_VMIDMT_S2VR0_ADDR A:0xf9a40c00
y.create.l HWIO_PERIPH_SS_USB1_HS_VMIDMT_S2VR1_ADDR A:0xf9a40c04
y.create.l HWIO_PERIPH_SS_USB1_HS_VMIDMT_S2VR2_ADDR A:0xf9a40c08
y.create.l HWIO_PERIPH_SS_USB1_HS_VMIDMT_S2VR3_ADDR A:0xf9a40c0c
y.create.l HWIO_PERIPH_SS_USB1_HS_VMIDMT_S2VR4_ADDR A:0xf9a40c10
y.create.l HWIO_PERIPH_SS_USB1_HS_VMIDMT_S2VR5_ADDR A:0xf9a40c14
y.create.l HWIO_PERIPH_SS_USB1_HS_VMIDMT_S2VR6_ADDR A:0xf9a40c18
y.create.l HWIO_PERIPH_SS_USB1_HS_VMIDMT_S2VR7_ADDR A:0xf9a40c1c
y.create.l HWIO_PERIPH_SS_USB1_HS_VMIDMT_S2VR8_ADDR A:0xf9a40c20
y.create.l HWIO_PERIPH_SS_USB1_HS_VMIDMT_S2VR9_ADDR A:0xf9a40c24
y.create.l HWIO_PERIPH_SS_USB1_HS_VMIDMT_AS2VR0_ADDR A:0xf9a40e00
y.create.l HWIO_PERIPH_SS_USB1_HS_VMIDMT_AS2VR1_ADDR A:0xf9a40e04
y.create.l HWIO_PERIPH_SS_USB1_HS_VMIDMT_AS2VR2_ADDR A:0xf9a40e08
y.create.l HWIO_PERIPH_SS_USB1_HS_VMIDMT_AS2VR3_ADDR A:0xf9a40e0c
y.create.l HWIO_PERIPH_SS_USB1_HS_VMIDMT_AS2VR4_ADDR A:0xf9a40e10
y.create.l HWIO_PERIPH_SS_USB1_HS_VMIDMT_AS2VR5_ADDR A:0xf9a40e14
y.create.l HWIO_PERIPH_SS_USB1_HS_VMIDMT_AS2VR6_ADDR A:0xf9a40e18
y.create.l HWIO_PERIPH_SS_USB1_HS_VMIDMT_AS2VR7_ADDR A:0xf9a40e1c
y.create.l HWIO_PERIPH_SS_USB1_HS_VMIDMT_AS2VR8_ADDR A:0xf9a40e20
y.create.l HWIO_PERIPH_SS_USB1_HS_VMIDMT_AS2VR9_ADDR A:0xf9a40e24
y.create.l HWIO_PERIPH_SS_USB1_HS_VMIDMT_SMR0_ADDR A:0xf9a40800
y.create.l HWIO_PERIPH_SS_USB1_HS_VMIDMT_SMR1_ADDR A:0xf9a40804
y.create.l HWIO_PERIPH_SS_USB1_HS_VMIDMT_SMR2_ADDR A:0xf9a40808
y.create.l HWIO_PERIPH_SS_USB1_HS_VMIDMT_SMR3_ADDR A:0xf9a4080c
y.create.l HWIO_PERIPH_SS_USB1_HS_VMIDMT_SMR4_ADDR A:0xf9a40810
y.create.l HWIO_PERIPH_SS_USB1_HS_VMIDMT_SMR5_ADDR A:0xf9a40814
y.create.l HWIO_PERIPH_SS_USB1_HS_VMIDMT_SMR6_ADDR A:0xf9a40818
y.create.l HWIO_PERIPH_SS_USB1_HS_VMIDMT_SMR7_ADDR A:0xf9a4081c
y.create.l HWIO_PERIPH_SS_USB1_HS_VMIDMT_SMR8_ADDR A:0xf9a40820
y.create.l HWIO_PERIPH_SS_USB1_HS_VMIDMT_SMR9_ADDR A:0xf9a40824
y.create.l HWIO_PERIPH_SS_QPIC_QPIC_BAM_CTRL_ADDR A:0xf9ac4000
y.create.l HWIO_PERIPH_SS_QPIC_QPIC_BAM_REVISION_ADDR A:0xf9ac4004
y.create.l HWIO_PERIPH_SS_QPIC_QPIC_BAM_SW_VERSION_ADDR A:0xf9ac4080
y.create.l HWIO_PERIPH_SS_QPIC_QPIC_BAM_NUM_PIPES_ADDR A:0xf9ac403c
y.create.l HWIO_PERIPH_SS_QPIC_QPIC_BAM_TIMER_ADDR A:0xf9ac4040
y.create.l HWIO_PERIPH_SS_QPIC_QPIC_BAM_TIMER_CTRL_ADDR A:0xf9ac4044
y.create.l HWIO_PERIPH_SS_QPIC_QPIC_BAM_DESC_CNT_TRSHLD_ADDR A:0xf9ac4008
y.create.l HWIO_PERIPH_SS_QPIC_QPIC_BAM_IRQ_SRCS_ADDR A:0xf9ac400c
y.create.l HWIO_PERIPH_SS_QPIC_QPIC_BAM_IRQ_SRCS_MSK_ADDR A:0xf9ac4010
y.create.l HWIO_PERIPH_SS_QPIC_QPIC_BAM_IRQ_SRCS_UNMASKED_ADDR A:0xf9ac4030
y.create.l HWIO_PERIPH_SS_QPIC_QPIC_BAM_IRQ_STTS_ADDR A:0xf9ac4014
y.create.l HWIO_PERIPH_SS_QPIC_QPIC_BAM_IRQ_CLR_ADDR A:0xf9ac4018
y.create.l HWIO_PERIPH_SS_QPIC_QPIC_BAM_IRQ_EN_ADDR A:0xf9ac401c
y.create.l HWIO_PERIPH_SS_QPIC_QPIC_BAM_AHB_MASTER_ERR_CTRLS_ADDR A:0xf9ac4024
y.create.l HWIO_PERIPH_SS_QPIC_QPIC_BAM_AHB_MASTER_ERR_ADDR_ADDR A:0xf9ac4028
y.create.l HWIO_PERIPH_SS_QPIC_QPIC_BAM_AHB_MASTER_ERR_ADDR_LSB_ADDR A:0xf9ac4100
y.create.l HWIO_PERIPH_SS_QPIC_QPIC_BAM_AHB_MASTER_ERR_ADDR_MSB_ADDR A:0xf9ac4104
y.create.l HWIO_PERIPH_SS_QPIC_QPIC_BAM_AHB_MASTER_ERR_DATA_ADDR A:0xf9ac402c
y.create.l HWIO_PERIPH_SS_QPIC_QPIC_BAM_TRUST_REG_ADDR A:0xf9ac4070
y.create.l HWIO_PERIPH_SS_QPIC_QPIC_BAM_TEST_BUS_SEL_ADDR A:0xf9ac4074
y.create.l HWIO_PERIPH_SS_QPIC_QPIC_BAM_TEST_BUS_REG_ADDR A:0xf9ac4078
y.create.l HWIO_PERIPH_SS_QPIC_QPIC_BAM_CNFG_BITS_ADDR A:0xf9ac407c
y.create.l HWIO_PERIPH_SS_QPIC_QPIC_BAM_IRQ_SRCS_EE0_ADDR A:0xf9ac4800
y.create.l HWIO_PERIPH_SS_QPIC_QPIC_BAM_IRQ_SRCS_EE1_ADDR A:0xf9ac4880
y.create.l HWIO_PERIPH_SS_QPIC_QPIC_BAM_IRQ_SRCS_EE2_ADDR A:0xf9ac4900
y.create.l HWIO_PERIPH_SS_QPIC_QPIC_BAM_IRQ_SRCS_EE3_ADDR A:0xf9ac4980
y.create.l HWIO_PERIPH_SS_QPIC_QPIC_BAM_IRQ_SRCS_EE4_ADDR A:0xf9ac4a00
y.create.l HWIO_PERIPH_SS_QPIC_QPIC_BAM_IRQ_SRCS_EE5_ADDR A:0xf9ac4a80
y.create.l HWIO_PERIPH_SS_QPIC_QPIC_BAM_IRQ_SRCS_EE6_ADDR A:0xf9ac4b00
y.create.l HWIO_PERIPH_SS_QPIC_QPIC_BAM_IRQ_SRCS_EE7_ADDR A:0xf9ac4b80
y.create.l HWIO_PERIPH_SS_QPIC_QPIC_BAM_IRQ_SRCS_MSK_EE0_ADDR A:0xf9ac4804
y.create.l HWIO_PERIPH_SS_QPIC_QPIC_BAM_IRQ_SRCS_MSK_EE1_ADDR A:0xf9ac4884
y.create.l HWIO_PERIPH_SS_QPIC_QPIC_BAM_IRQ_SRCS_MSK_EE2_ADDR A:0xf9ac4904
y.create.l HWIO_PERIPH_SS_QPIC_QPIC_BAM_IRQ_SRCS_MSK_EE3_ADDR A:0xf9ac4984
y.create.l HWIO_PERIPH_SS_QPIC_QPIC_BAM_IRQ_SRCS_MSK_EE4_ADDR A:0xf9ac4a04
y.create.l HWIO_PERIPH_SS_QPIC_QPIC_BAM_IRQ_SRCS_MSK_EE5_ADDR A:0xf9ac4a84
y.create.l HWIO_PERIPH_SS_QPIC_QPIC_BAM_IRQ_SRCS_MSK_EE6_ADDR A:0xf9ac4b04
y.create.l HWIO_PERIPH_SS_QPIC_QPIC_BAM_IRQ_SRCS_MSK_EE7_ADDR A:0xf9ac4b84
y.create.l HWIO_PERIPH_SS_QPIC_QPIC_BAM_IRQ_SRCS_UNMASKED_EE0_ADDR A:0xf9ac4808
y.create.l HWIO_PERIPH_SS_QPIC_QPIC_BAM_IRQ_SRCS_UNMASKED_EE1_ADDR A:0xf9ac4888
y.create.l HWIO_PERIPH_SS_QPIC_QPIC_BAM_IRQ_SRCS_UNMASKED_EE2_ADDR A:0xf9ac4908
y.create.l HWIO_PERIPH_SS_QPIC_QPIC_BAM_IRQ_SRCS_UNMASKED_EE3_ADDR A:0xf9ac4988
y.create.l HWIO_PERIPH_SS_QPIC_QPIC_BAM_IRQ_SRCS_UNMASKED_EE4_ADDR A:0xf9ac4a08
y.create.l HWIO_PERIPH_SS_QPIC_QPIC_BAM_IRQ_SRCS_UNMASKED_EE5_ADDR A:0xf9ac4a88
y.create.l HWIO_PERIPH_SS_QPIC_QPIC_BAM_IRQ_SRCS_UNMASKED_EE6_ADDR A:0xf9ac4b08
y.create.l HWIO_PERIPH_SS_QPIC_QPIC_BAM_IRQ_SRCS_UNMASKED_EE7_ADDR A:0xf9ac4b88
y.create.l HWIO_PERIPH_SS_QPIC_QPIC_BAM_PIPE_ATTR_EE0_ADDR A:0xf9ac480c
y.create.l HWIO_PERIPH_SS_QPIC_QPIC_BAM_PIPE_ATTR_EE1_ADDR A:0xf9ac488c
y.create.l HWIO_PERIPH_SS_QPIC_QPIC_BAM_PIPE_ATTR_EE2_ADDR A:0xf9ac490c
y.create.l HWIO_PERIPH_SS_QPIC_QPIC_BAM_PIPE_ATTR_EE3_ADDR A:0xf9ac498c
y.create.l HWIO_PERIPH_SS_QPIC_QPIC_BAM_PIPE_ATTR_EE4_ADDR A:0xf9ac4a0c
y.create.l HWIO_PERIPH_SS_QPIC_QPIC_BAM_PIPE_ATTR_EE5_ADDR A:0xf9ac4a8c
y.create.l HWIO_PERIPH_SS_QPIC_QPIC_BAM_PIPE_ATTR_EE6_ADDR A:0xf9ac4b0c
y.create.l HWIO_PERIPH_SS_QPIC_QPIC_BAM_PIPE_ATTR_EE7_ADDR A:0xf9ac4b8c
y.create.l HWIO_PERIPH_SS_QPIC_QPIC_BAM_P_CTRL0_ADDR A:0xf9ac5000
y.create.l HWIO_PERIPH_SS_QPIC_QPIC_BAM_P_CTRL1_ADDR A:0xf9ac6000
y.create.l HWIO_PERIPH_SS_QPIC_QPIC_BAM_P_CTRL2_ADDR A:0xf9ac7000
y.create.l HWIO_PERIPH_SS_QPIC_QPIC_BAM_P_CTRL3_ADDR A:0xf9ac8000
y.create.l HWIO_PERIPH_SS_QPIC_QPIC_BAM_P_CTRL4_ADDR A:0xf9ac9000
y.create.l HWIO_PERIPH_SS_QPIC_QPIC_BAM_P_CTRL5_ADDR A:0xf9aca000
y.create.l HWIO_PERIPH_SS_QPIC_QPIC_BAM_P_CTRL6_ADDR A:0xf9acb000
y.create.l HWIO_PERIPH_SS_QPIC_QPIC_BAM_P_RST0_ADDR A:0xf9ac5004
y.create.l HWIO_PERIPH_SS_QPIC_QPIC_BAM_P_RST1_ADDR A:0xf9ac6004
y.create.l HWIO_PERIPH_SS_QPIC_QPIC_BAM_P_RST2_ADDR A:0xf9ac7004
y.create.l HWIO_PERIPH_SS_QPIC_QPIC_BAM_P_RST3_ADDR A:0xf9ac8004
y.create.l HWIO_PERIPH_SS_QPIC_QPIC_BAM_P_RST4_ADDR A:0xf9ac9004
y.create.l HWIO_PERIPH_SS_QPIC_QPIC_BAM_P_RST5_ADDR A:0xf9aca004
y.create.l HWIO_PERIPH_SS_QPIC_QPIC_BAM_P_RST6_ADDR A:0xf9acb004
y.create.l HWIO_PERIPH_SS_QPIC_QPIC_BAM_P_HALT0_ADDR A:0xf9ac5008
y.create.l HWIO_PERIPH_SS_QPIC_QPIC_BAM_P_HALT1_ADDR A:0xf9ac6008
y.create.l HWIO_PERIPH_SS_QPIC_QPIC_BAM_P_HALT2_ADDR A:0xf9ac7008
y.create.l HWIO_PERIPH_SS_QPIC_QPIC_BAM_P_HALT3_ADDR A:0xf9ac8008
y.create.l HWIO_PERIPH_SS_QPIC_QPIC_BAM_P_HALT4_ADDR A:0xf9ac9008
y.create.l HWIO_PERIPH_SS_QPIC_QPIC_BAM_P_HALT5_ADDR A:0xf9aca008
y.create.l HWIO_PERIPH_SS_QPIC_QPIC_BAM_P_HALT6_ADDR A:0xf9acb008
y.create.l HWIO_PERIPH_SS_QPIC_QPIC_BAM_P_TRUST_REG0_ADDR A:0xf9ac5030
y.create.l HWIO_PERIPH_SS_QPIC_QPIC_BAM_P_TRUST_REG1_ADDR A:0xf9ac6030
y.create.l HWIO_PERIPH_SS_QPIC_QPIC_BAM_P_TRUST_REG2_ADDR A:0xf9ac7030
y.create.l HWIO_PERIPH_SS_QPIC_QPIC_BAM_P_TRUST_REG3_ADDR A:0xf9ac8030
y.create.l HWIO_PERIPH_SS_QPIC_QPIC_BAM_P_TRUST_REG4_ADDR A:0xf9ac9030
y.create.l HWIO_PERIPH_SS_QPIC_QPIC_BAM_P_TRUST_REG5_ADDR A:0xf9aca030
y.create.l HWIO_PERIPH_SS_QPIC_QPIC_BAM_P_TRUST_REG6_ADDR A:0xf9acb030
y.create.l HWIO_PERIPH_SS_QPIC_QPIC_BAM_P_IRQ_STTS0_ADDR A:0xf9ac5010
y.create.l HWIO_PERIPH_SS_QPIC_QPIC_BAM_P_IRQ_STTS1_ADDR A:0xf9ac6010
y.create.l HWIO_PERIPH_SS_QPIC_QPIC_BAM_P_IRQ_STTS2_ADDR A:0xf9ac7010
y.create.l HWIO_PERIPH_SS_QPIC_QPIC_BAM_P_IRQ_STTS3_ADDR A:0xf9ac8010
y.create.l HWIO_PERIPH_SS_QPIC_QPIC_BAM_P_IRQ_STTS4_ADDR A:0xf9ac9010
y.create.l HWIO_PERIPH_SS_QPIC_QPIC_BAM_P_IRQ_STTS5_ADDR A:0xf9aca010
y.create.l HWIO_PERIPH_SS_QPIC_QPIC_BAM_P_IRQ_STTS6_ADDR A:0xf9acb010
y.create.l HWIO_PERIPH_SS_QPIC_QPIC_BAM_P_IRQ_CLR0_ADDR A:0xf9ac5014
y.create.l HWIO_PERIPH_SS_QPIC_QPIC_BAM_P_IRQ_CLR1_ADDR A:0xf9ac6014
y.create.l HWIO_PERIPH_SS_QPIC_QPIC_BAM_P_IRQ_CLR2_ADDR A:0xf9ac7014
y.create.l HWIO_PERIPH_SS_QPIC_QPIC_BAM_P_IRQ_CLR3_ADDR A:0xf9ac8014
y.create.l HWIO_PERIPH_SS_QPIC_QPIC_BAM_P_IRQ_CLR4_ADDR A:0xf9ac9014
y.create.l HWIO_PERIPH_SS_QPIC_QPIC_BAM_P_IRQ_CLR5_ADDR A:0xf9aca014
y.create.l HWIO_PERIPH_SS_QPIC_QPIC_BAM_P_IRQ_CLR6_ADDR A:0xf9acb014
y.create.l HWIO_PERIPH_SS_QPIC_QPIC_BAM_P_IRQ_EN0_ADDR A:0xf9ac5018
y.create.l HWIO_PERIPH_SS_QPIC_QPIC_BAM_P_IRQ_EN1_ADDR A:0xf9ac6018
y.create.l HWIO_PERIPH_SS_QPIC_QPIC_BAM_P_IRQ_EN2_ADDR A:0xf9ac7018
y.create.l HWIO_PERIPH_SS_QPIC_QPIC_BAM_P_IRQ_EN3_ADDR A:0xf9ac8018
y.create.l HWIO_PERIPH_SS_QPIC_QPIC_BAM_P_IRQ_EN4_ADDR A:0xf9ac9018
y.create.l HWIO_PERIPH_SS_QPIC_QPIC_BAM_P_IRQ_EN5_ADDR A:0xf9aca018
y.create.l HWIO_PERIPH_SS_QPIC_QPIC_BAM_P_IRQ_EN6_ADDR A:0xf9acb018
y.create.l HWIO_PERIPH_SS_QPIC_QPIC_BAM_P_TIMER0_ADDR A:0xf9ac501c
y.create.l HWIO_PERIPH_SS_QPIC_QPIC_BAM_P_TIMER1_ADDR A:0xf9ac601c
y.create.l HWIO_PERIPH_SS_QPIC_QPIC_BAM_P_TIMER2_ADDR A:0xf9ac701c
y.create.l HWIO_PERIPH_SS_QPIC_QPIC_BAM_P_TIMER3_ADDR A:0xf9ac801c
y.create.l HWIO_PERIPH_SS_QPIC_QPIC_BAM_P_TIMER4_ADDR A:0xf9ac901c
y.create.l HWIO_PERIPH_SS_QPIC_QPIC_BAM_P_TIMER5_ADDR A:0xf9aca01c
y.create.l HWIO_PERIPH_SS_QPIC_QPIC_BAM_P_TIMER6_ADDR A:0xf9acb01c
y.create.l HWIO_PERIPH_SS_QPIC_QPIC_BAM_P_TIMER_CTRL0_ADDR A:0xf9ac5020
y.create.l HWIO_PERIPH_SS_QPIC_QPIC_BAM_P_TIMER_CTRL1_ADDR A:0xf9ac6020
y.create.l HWIO_PERIPH_SS_QPIC_QPIC_BAM_P_TIMER_CTRL2_ADDR A:0xf9ac7020
y.create.l HWIO_PERIPH_SS_QPIC_QPIC_BAM_P_TIMER_CTRL3_ADDR A:0xf9ac8020
y.create.l HWIO_PERIPH_SS_QPIC_QPIC_BAM_P_TIMER_CTRL4_ADDR A:0xf9ac9020
y.create.l HWIO_PERIPH_SS_QPIC_QPIC_BAM_P_TIMER_CTRL5_ADDR A:0xf9aca020
y.create.l HWIO_PERIPH_SS_QPIC_QPIC_BAM_P_TIMER_CTRL6_ADDR A:0xf9acb020
y.create.l HWIO_PERIPH_SS_QPIC_QPIC_BAM_P_PRDCR_SDBND0_ADDR A:0xf9ac5024
y.create.l HWIO_PERIPH_SS_QPIC_QPIC_BAM_P_PRDCR_SDBND1_ADDR A:0xf9ac6024
y.create.l HWIO_PERIPH_SS_QPIC_QPIC_BAM_P_PRDCR_SDBND2_ADDR A:0xf9ac7024
y.create.l HWIO_PERIPH_SS_QPIC_QPIC_BAM_P_PRDCR_SDBND3_ADDR A:0xf9ac8024
y.create.l HWIO_PERIPH_SS_QPIC_QPIC_BAM_P_PRDCR_SDBND4_ADDR A:0xf9ac9024
y.create.l HWIO_PERIPH_SS_QPIC_QPIC_BAM_P_PRDCR_SDBND5_ADDR A:0xf9aca024
y.create.l HWIO_PERIPH_SS_QPIC_QPIC_BAM_P_PRDCR_SDBND6_ADDR A:0xf9acb024
y.create.l HWIO_PERIPH_SS_QPIC_QPIC_BAM_P_CNSMR_SDBND0_ADDR A:0xf9ac5028
y.create.l HWIO_PERIPH_SS_QPIC_QPIC_BAM_P_CNSMR_SDBND1_ADDR A:0xf9ac6028
y.create.l HWIO_PERIPH_SS_QPIC_QPIC_BAM_P_CNSMR_SDBND2_ADDR A:0xf9ac7028
y.create.l HWIO_PERIPH_SS_QPIC_QPIC_BAM_P_CNSMR_SDBND3_ADDR A:0xf9ac8028
y.create.l HWIO_PERIPH_SS_QPIC_QPIC_BAM_P_CNSMR_SDBND4_ADDR A:0xf9ac9028
y.create.l HWIO_PERIPH_SS_QPIC_QPIC_BAM_P_CNSMR_SDBND5_ADDR A:0xf9aca028
y.create.l HWIO_PERIPH_SS_QPIC_QPIC_BAM_P_CNSMR_SDBND6_ADDR A:0xf9acb028
y.create.l HWIO_PERIPH_SS_QPIC_QPIC_BAM_P_EVNT_DEST_ADDR0_ADDR A:0xf9ac582c
y.create.l HWIO_PERIPH_SS_QPIC_QPIC_BAM_P_EVNT_DEST_ADDR1_ADDR A:0xf9ac682c
y.create.l HWIO_PERIPH_SS_QPIC_QPIC_BAM_P_EVNT_DEST_ADDR2_ADDR A:0xf9ac782c
y.create.l HWIO_PERIPH_SS_QPIC_QPIC_BAM_P_EVNT_DEST_ADDR3_ADDR A:0xf9ac882c
y.create.l HWIO_PERIPH_SS_QPIC_QPIC_BAM_P_EVNT_DEST_ADDR4_ADDR A:0xf9ac982c
y.create.l HWIO_PERIPH_SS_QPIC_QPIC_BAM_P_EVNT_DEST_ADDR5_ADDR A:0xf9aca82c
y.create.l HWIO_PERIPH_SS_QPIC_QPIC_BAM_P_EVNT_DEST_ADDR6_ADDR A:0xf9acb82c
y.create.l HWIO_PERIPH_SS_QPIC_QPIC_BAM_P_EVNT_DEST_ADDR_LSB0_ADDR A:0xf9ac5930
y.create.l HWIO_PERIPH_SS_QPIC_QPIC_BAM_P_EVNT_DEST_ADDR_LSB1_ADDR A:0xf9ac6930
y.create.l HWIO_PERIPH_SS_QPIC_QPIC_BAM_P_EVNT_DEST_ADDR_LSB2_ADDR A:0xf9ac7930
y.create.l HWIO_PERIPH_SS_QPIC_QPIC_BAM_P_EVNT_DEST_ADDR_LSB3_ADDR A:0xf9ac8930
y.create.l HWIO_PERIPH_SS_QPIC_QPIC_BAM_P_EVNT_DEST_ADDR_LSB4_ADDR A:0xf9ac9930
y.create.l HWIO_PERIPH_SS_QPIC_QPIC_BAM_P_EVNT_DEST_ADDR_LSB5_ADDR A:0xf9aca930
y.create.l HWIO_PERIPH_SS_QPIC_QPIC_BAM_P_EVNT_DEST_ADDR_LSB6_ADDR A:0xf9acb930
y.create.l HWIO_PERIPH_SS_QPIC_QPIC_BAM_P_EVNT_DEST_ADDR_MSB0_ADDR A:0xf9ac5934
y.create.l HWIO_PERIPH_SS_QPIC_QPIC_BAM_P_EVNT_DEST_ADDR_MSB1_ADDR A:0xf9ac6934
y.create.l HWIO_PERIPH_SS_QPIC_QPIC_BAM_P_EVNT_DEST_ADDR_MSB2_ADDR A:0xf9ac7934
y.create.l HWIO_PERIPH_SS_QPIC_QPIC_BAM_P_EVNT_DEST_ADDR_MSB3_ADDR A:0xf9ac8934
y.create.l HWIO_PERIPH_SS_QPIC_QPIC_BAM_P_EVNT_DEST_ADDR_MSB4_ADDR A:0xf9ac9934
y.create.l HWIO_PERIPH_SS_QPIC_QPIC_BAM_P_EVNT_DEST_ADDR_MSB5_ADDR A:0xf9aca934
y.create.l HWIO_PERIPH_SS_QPIC_QPIC_BAM_P_EVNT_DEST_ADDR_MSB6_ADDR A:0xf9acb934
y.create.l HWIO_PERIPH_SS_QPIC_QPIC_BAM_P_EVNT_REG0_ADDR A:0xf9ac5818
y.create.l HWIO_PERIPH_SS_QPIC_QPIC_BAM_P_EVNT_REG1_ADDR A:0xf9ac6818
y.create.l HWIO_PERIPH_SS_QPIC_QPIC_BAM_P_EVNT_REG2_ADDR A:0xf9ac7818
y.create.l HWIO_PERIPH_SS_QPIC_QPIC_BAM_P_EVNT_REG3_ADDR A:0xf9ac8818
y.create.l HWIO_PERIPH_SS_QPIC_QPIC_BAM_P_EVNT_REG4_ADDR A:0xf9ac9818
y.create.l HWIO_PERIPH_SS_QPIC_QPIC_BAM_P_EVNT_REG5_ADDR A:0xf9aca818
y.create.l HWIO_PERIPH_SS_QPIC_QPIC_BAM_P_EVNT_REG6_ADDR A:0xf9acb818
y.create.l HWIO_PERIPH_SS_QPIC_QPIC_BAM_P_SW_OFSTS0_ADDR A:0xf9ac5800
y.create.l HWIO_PERIPH_SS_QPIC_QPIC_BAM_P_SW_OFSTS1_ADDR A:0xf9ac6800
y.create.l HWIO_PERIPH_SS_QPIC_QPIC_BAM_P_SW_OFSTS2_ADDR A:0xf9ac7800
y.create.l HWIO_PERIPH_SS_QPIC_QPIC_BAM_P_SW_OFSTS3_ADDR A:0xf9ac8800
y.create.l HWIO_PERIPH_SS_QPIC_QPIC_BAM_P_SW_OFSTS4_ADDR A:0xf9ac9800
y.create.l HWIO_PERIPH_SS_QPIC_QPIC_BAM_P_SW_OFSTS5_ADDR A:0xf9aca800
y.create.l HWIO_PERIPH_SS_QPIC_QPIC_BAM_P_SW_OFSTS6_ADDR A:0xf9acb800
y.create.l HWIO_PERIPH_SS_QPIC_QPIC_BAM_P_DATA_FIFO_ADDR0_ADDR A:0xf9ac5824
y.create.l HWIO_PERIPH_SS_QPIC_QPIC_BAM_P_DATA_FIFO_ADDR1_ADDR A:0xf9ac6824
y.create.l HWIO_PERIPH_SS_QPIC_QPIC_BAM_P_DATA_FIFO_ADDR2_ADDR A:0xf9ac7824
y.create.l HWIO_PERIPH_SS_QPIC_QPIC_BAM_P_DATA_FIFO_ADDR3_ADDR A:0xf9ac8824
y.create.l HWIO_PERIPH_SS_QPIC_QPIC_BAM_P_DATA_FIFO_ADDR4_ADDR A:0xf9ac9824
y.create.l HWIO_PERIPH_SS_QPIC_QPIC_BAM_P_DATA_FIFO_ADDR5_ADDR A:0xf9aca824
y.create.l HWIO_PERIPH_SS_QPIC_QPIC_BAM_P_DATA_FIFO_ADDR6_ADDR A:0xf9acb824
y.create.l HWIO_PERIPH_SS_QPIC_QPIC_BAM_P_DATA_FIFO_ADDR_LSB0_ADDR A:0xf9ac5920
y.create.l HWIO_PERIPH_SS_QPIC_QPIC_BAM_P_DATA_FIFO_ADDR_LSB1_ADDR A:0xf9ac6920
y.create.l HWIO_PERIPH_SS_QPIC_QPIC_BAM_P_DATA_FIFO_ADDR_LSB2_ADDR A:0xf9ac7920
y.create.l HWIO_PERIPH_SS_QPIC_QPIC_BAM_P_DATA_FIFO_ADDR_LSB3_ADDR A:0xf9ac8920
y.create.l HWIO_PERIPH_SS_QPIC_QPIC_BAM_P_DATA_FIFO_ADDR_LSB4_ADDR A:0xf9ac9920
y.create.l HWIO_PERIPH_SS_QPIC_QPIC_BAM_P_DATA_FIFO_ADDR_LSB5_ADDR A:0xf9aca920
y.create.l HWIO_PERIPH_SS_QPIC_QPIC_BAM_P_DATA_FIFO_ADDR_LSB6_ADDR A:0xf9acb920
y.create.l HWIO_PERIPH_SS_QPIC_QPIC_BAM_P_DATA_FIFO_ADDR_MSB0_ADDR A:0xf9ac5924
y.create.l HWIO_PERIPH_SS_QPIC_QPIC_BAM_P_DATA_FIFO_ADDR_MSB1_ADDR A:0xf9ac6924
y.create.l HWIO_PERIPH_SS_QPIC_QPIC_BAM_P_DATA_FIFO_ADDR_MSB2_ADDR A:0xf9ac7924
y.create.l HWIO_PERIPH_SS_QPIC_QPIC_BAM_P_DATA_FIFO_ADDR_MSB3_ADDR A:0xf9ac8924
y.create.l HWIO_PERIPH_SS_QPIC_QPIC_BAM_P_DATA_FIFO_ADDR_MSB4_ADDR A:0xf9ac9924
y.create.l HWIO_PERIPH_SS_QPIC_QPIC_BAM_P_DATA_FIFO_ADDR_MSB5_ADDR A:0xf9aca924
y.create.l HWIO_PERIPH_SS_QPIC_QPIC_BAM_P_DATA_FIFO_ADDR_MSB6_ADDR A:0xf9acb924
y.create.l HWIO_PERIPH_SS_QPIC_QPIC_BAM_P_DESC_FIFO_ADDR0_ADDR A:0xf9ac581c
y.create.l HWIO_PERIPH_SS_QPIC_QPIC_BAM_P_DESC_FIFO_ADDR1_ADDR A:0xf9ac681c
y.create.l HWIO_PERIPH_SS_QPIC_QPIC_BAM_P_DESC_FIFO_ADDR2_ADDR A:0xf9ac781c
y.create.l HWIO_PERIPH_SS_QPIC_QPIC_BAM_P_DESC_FIFO_ADDR3_ADDR A:0xf9ac881c
y.create.l HWIO_PERIPH_SS_QPIC_QPIC_BAM_P_DESC_FIFO_ADDR4_ADDR A:0xf9ac981c
y.create.l HWIO_PERIPH_SS_QPIC_QPIC_BAM_P_DESC_FIFO_ADDR5_ADDR A:0xf9aca81c
y.create.l HWIO_PERIPH_SS_QPIC_QPIC_BAM_P_DESC_FIFO_ADDR6_ADDR A:0xf9acb81c
y.create.l HWIO_PERIPH_SS_QPIC_QPIC_BAM_P_DESC_FIFO_ADDR_LSB0_ADDR A:0xf9ac5910
y.create.l HWIO_PERIPH_SS_QPIC_QPIC_BAM_P_DESC_FIFO_ADDR_LSB1_ADDR A:0xf9ac6910
y.create.l HWIO_PERIPH_SS_QPIC_QPIC_BAM_P_DESC_FIFO_ADDR_LSB2_ADDR A:0xf9ac7910
y.create.l HWIO_PERIPH_SS_QPIC_QPIC_BAM_P_DESC_FIFO_ADDR_LSB3_ADDR A:0xf9ac8910
y.create.l HWIO_PERIPH_SS_QPIC_QPIC_BAM_P_DESC_FIFO_ADDR_LSB4_ADDR A:0xf9ac9910
y.create.l HWIO_PERIPH_SS_QPIC_QPIC_BAM_P_DESC_FIFO_ADDR_LSB5_ADDR A:0xf9aca910
y.create.l HWIO_PERIPH_SS_QPIC_QPIC_BAM_P_DESC_FIFO_ADDR_LSB6_ADDR A:0xf9acb910
y.create.l HWIO_PERIPH_SS_QPIC_QPIC_BAM_P_DESC_FIFO_ADDR_MSB0_ADDR A:0xf9ac5914
y.create.l HWIO_PERIPH_SS_QPIC_QPIC_BAM_P_DESC_FIFO_ADDR_MSB1_ADDR A:0xf9ac6914
y.create.l HWIO_PERIPH_SS_QPIC_QPIC_BAM_P_DESC_FIFO_ADDR_MSB2_ADDR A:0xf9ac7914
y.create.l HWIO_PERIPH_SS_QPIC_QPIC_BAM_P_DESC_FIFO_ADDR_MSB3_ADDR A:0xf9ac8914
y.create.l HWIO_PERIPH_SS_QPIC_QPIC_BAM_P_DESC_FIFO_ADDR_MSB4_ADDR A:0xf9ac9914
y.create.l HWIO_PERIPH_SS_QPIC_QPIC_BAM_P_DESC_FIFO_ADDR_MSB5_ADDR A:0xf9aca914
y.create.l HWIO_PERIPH_SS_QPIC_QPIC_BAM_P_DESC_FIFO_ADDR_MSB6_ADDR A:0xf9acb914
y.create.l HWIO_PERIPH_SS_QPIC_QPIC_BAM_P_EVNT_GEN_TRSHLD0_ADDR A:0xf9ac5828
y.create.l HWIO_PERIPH_SS_QPIC_QPIC_BAM_P_EVNT_GEN_TRSHLD1_ADDR A:0xf9ac6828
y.create.l HWIO_PERIPH_SS_QPIC_QPIC_BAM_P_EVNT_GEN_TRSHLD2_ADDR A:0xf9ac7828
y.create.l HWIO_PERIPH_SS_QPIC_QPIC_BAM_P_EVNT_GEN_TRSHLD3_ADDR A:0xf9ac8828
y.create.l HWIO_PERIPH_SS_QPIC_QPIC_BAM_P_EVNT_GEN_TRSHLD4_ADDR A:0xf9ac9828
y.create.l HWIO_PERIPH_SS_QPIC_QPIC_BAM_P_EVNT_GEN_TRSHLD5_ADDR A:0xf9aca828
y.create.l HWIO_PERIPH_SS_QPIC_QPIC_BAM_P_EVNT_GEN_TRSHLD6_ADDR A:0xf9acb828
y.create.l HWIO_PERIPH_SS_QPIC_QPIC_BAM_P_FIFO_SIZES0_ADDR A:0xf9ac5820
y.create.l HWIO_PERIPH_SS_QPIC_QPIC_BAM_P_FIFO_SIZES1_ADDR A:0xf9ac6820
y.create.l HWIO_PERIPH_SS_QPIC_QPIC_BAM_P_FIFO_SIZES2_ADDR A:0xf9ac7820
y.create.l HWIO_PERIPH_SS_QPIC_QPIC_BAM_P_FIFO_SIZES3_ADDR A:0xf9ac8820
y.create.l HWIO_PERIPH_SS_QPIC_QPIC_BAM_P_FIFO_SIZES4_ADDR A:0xf9ac9820
y.create.l HWIO_PERIPH_SS_QPIC_QPIC_BAM_P_FIFO_SIZES5_ADDR A:0xf9aca820
y.create.l HWIO_PERIPH_SS_QPIC_QPIC_BAM_P_FIFO_SIZES6_ADDR A:0xf9acb820
y.create.l HWIO_PERIPH_SS_QPIC_QPIC_BAM_P_RETR_CNTXT_0_ADDR A:0xf9ac5834
y.create.l HWIO_PERIPH_SS_QPIC_QPIC_BAM_P_RETR_CNTXT_1_ADDR A:0xf9ac6834
y.create.l HWIO_PERIPH_SS_QPIC_QPIC_BAM_P_RETR_CNTXT_2_ADDR A:0xf9ac7834
y.create.l HWIO_PERIPH_SS_QPIC_QPIC_BAM_P_RETR_CNTXT_3_ADDR A:0xf9ac8834
y.create.l HWIO_PERIPH_SS_QPIC_QPIC_BAM_P_RETR_CNTXT_4_ADDR A:0xf9ac9834
y.create.l HWIO_PERIPH_SS_QPIC_QPIC_BAM_P_RETR_CNTXT_5_ADDR A:0xf9aca834
y.create.l HWIO_PERIPH_SS_QPIC_QPIC_BAM_P_RETR_CNTXT_6_ADDR A:0xf9acb834
y.create.l HWIO_PERIPH_SS_QPIC_QPIC_BAM_P_SI_CNTXT_0_ADDR A:0xf9ac5838
y.create.l HWIO_PERIPH_SS_QPIC_QPIC_BAM_P_SI_CNTXT_1_ADDR A:0xf9ac6838
y.create.l HWIO_PERIPH_SS_QPIC_QPIC_BAM_P_SI_CNTXT_2_ADDR A:0xf9ac7838
y.create.l HWIO_PERIPH_SS_QPIC_QPIC_BAM_P_SI_CNTXT_3_ADDR A:0xf9ac8838
y.create.l HWIO_PERIPH_SS_QPIC_QPIC_BAM_P_SI_CNTXT_4_ADDR A:0xf9ac9838
y.create.l HWIO_PERIPH_SS_QPIC_QPIC_BAM_P_SI_CNTXT_5_ADDR A:0xf9aca838
y.create.l HWIO_PERIPH_SS_QPIC_QPIC_BAM_P_SI_CNTXT_6_ADDR A:0xf9acb838
y.create.l HWIO_PERIPH_SS_QPIC_QPIC_BAM_P_DF_CNTXT_0_ADDR A:0xf9ac5830
y.create.l HWIO_PERIPH_SS_QPIC_QPIC_BAM_P_DF_CNTXT_1_ADDR A:0xf9ac6830
y.create.l HWIO_PERIPH_SS_QPIC_QPIC_BAM_P_DF_CNTXT_2_ADDR A:0xf9ac7830
y.create.l HWIO_PERIPH_SS_QPIC_QPIC_BAM_P_DF_CNTXT_3_ADDR A:0xf9ac8830
y.create.l HWIO_PERIPH_SS_QPIC_QPIC_BAM_P_DF_CNTXT_4_ADDR A:0xf9ac9830
y.create.l HWIO_PERIPH_SS_QPIC_QPIC_BAM_P_DF_CNTXT_5_ADDR A:0xf9aca830
y.create.l HWIO_PERIPH_SS_QPIC_QPIC_BAM_P_DF_CNTXT_6_ADDR A:0xf9acb830
y.create.l HWIO_PERIPH_SS_QPIC_QPIC_BAM_P_AU_PSM_CNTXT_1_0_ADDR A:0xf9ac5804
y.create.l HWIO_PERIPH_SS_QPIC_QPIC_BAM_P_AU_PSM_CNTXT_1_1_ADDR A:0xf9ac6804
y.create.l HWIO_PERIPH_SS_QPIC_QPIC_BAM_P_AU_PSM_CNTXT_1_2_ADDR A:0xf9ac7804
y.create.l HWIO_PERIPH_SS_QPIC_QPIC_BAM_P_AU_PSM_CNTXT_1_3_ADDR A:0xf9ac8804
y.create.l HWIO_PERIPH_SS_QPIC_QPIC_BAM_P_AU_PSM_CNTXT_1_4_ADDR A:0xf9ac9804
y.create.l HWIO_PERIPH_SS_QPIC_QPIC_BAM_P_AU_PSM_CNTXT_1_5_ADDR A:0xf9aca804
y.create.l HWIO_PERIPH_SS_QPIC_QPIC_BAM_P_AU_PSM_CNTXT_1_6_ADDR A:0xf9acb804
y.create.l HWIO_PERIPH_SS_QPIC_QPIC_BAM_P_PSM_CNTXT_2_0_ADDR A:0xf9ac5808
y.create.l HWIO_PERIPH_SS_QPIC_QPIC_BAM_P_PSM_CNTXT_2_1_ADDR A:0xf9ac6808
y.create.l HWIO_PERIPH_SS_QPIC_QPIC_BAM_P_PSM_CNTXT_2_2_ADDR A:0xf9ac7808
y.create.l HWIO_PERIPH_SS_QPIC_QPIC_BAM_P_PSM_CNTXT_2_3_ADDR A:0xf9ac8808
y.create.l HWIO_PERIPH_SS_QPIC_QPIC_BAM_P_PSM_CNTXT_2_4_ADDR A:0xf9ac9808
y.create.l HWIO_PERIPH_SS_QPIC_QPIC_BAM_P_PSM_CNTXT_2_5_ADDR A:0xf9aca808
y.create.l HWIO_PERIPH_SS_QPIC_QPIC_BAM_P_PSM_CNTXT_2_6_ADDR A:0xf9acb808
y.create.l HWIO_PERIPH_SS_QPIC_QPIC_BAM_P_PSM_CNTXT_3_0_ADDR A:0xf9ac580c
y.create.l HWIO_PERIPH_SS_QPIC_QPIC_BAM_P_PSM_CNTXT_3_1_ADDR A:0xf9ac680c
y.create.l HWIO_PERIPH_SS_QPIC_QPIC_BAM_P_PSM_CNTXT_3_2_ADDR A:0xf9ac780c
y.create.l HWIO_PERIPH_SS_QPIC_QPIC_BAM_P_PSM_CNTXT_3_3_ADDR A:0xf9ac880c
y.create.l HWIO_PERIPH_SS_QPIC_QPIC_BAM_P_PSM_CNTXT_3_4_ADDR A:0xf9ac980c
y.create.l HWIO_PERIPH_SS_QPIC_QPIC_BAM_P_PSM_CNTXT_3_5_ADDR A:0xf9aca80c
y.create.l HWIO_PERIPH_SS_QPIC_QPIC_BAM_P_PSM_CNTXT_3_6_ADDR A:0xf9acb80c
y.create.l HWIO_PERIPH_SS_QPIC_QPIC_BAM_P_PSM_CNTXT_3_LSB0_ADDR A:0xf9ac5900
y.create.l HWIO_PERIPH_SS_QPIC_QPIC_BAM_P_PSM_CNTXT_3_LSB1_ADDR A:0xf9ac6900
y.create.l HWIO_PERIPH_SS_QPIC_QPIC_BAM_P_PSM_CNTXT_3_LSB2_ADDR A:0xf9ac7900
y.create.l HWIO_PERIPH_SS_QPIC_QPIC_BAM_P_PSM_CNTXT_3_LSB3_ADDR A:0xf9ac8900
y.create.l HWIO_PERIPH_SS_QPIC_QPIC_BAM_P_PSM_CNTXT_3_LSB4_ADDR A:0xf9ac9900
y.create.l HWIO_PERIPH_SS_QPIC_QPIC_BAM_P_PSM_CNTXT_3_LSB5_ADDR A:0xf9aca900
y.create.l HWIO_PERIPH_SS_QPIC_QPIC_BAM_P_PSM_CNTXT_3_LSB6_ADDR A:0xf9acb900
y.create.l HWIO_PERIPH_SS_QPIC_QPIC_BAM_P_PSM_CNTXT_3_MSB0_ADDR A:0xf9ac5904
y.create.l HWIO_PERIPH_SS_QPIC_QPIC_BAM_P_PSM_CNTXT_3_MSB1_ADDR A:0xf9ac6904
y.create.l HWIO_PERIPH_SS_QPIC_QPIC_BAM_P_PSM_CNTXT_3_MSB2_ADDR A:0xf9ac7904
y.create.l HWIO_PERIPH_SS_QPIC_QPIC_BAM_P_PSM_CNTXT_3_MSB3_ADDR A:0xf9ac8904
y.create.l HWIO_PERIPH_SS_QPIC_QPIC_BAM_P_PSM_CNTXT_3_MSB4_ADDR A:0xf9ac9904
y.create.l HWIO_PERIPH_SS_QPIC_QPIC_BAM_P_PSM_CNTXT_3_MSB5_ADDR A:0xf9aca904
y.create.l HWIO_PERIPH_SS_QPIC_QPIC_BAM_P_PSM_CNTXT_3_MSB6_ADDR A:0xf9acb904
y.create.l HWIO_PERIPH_SS_QPIC_QPIC_BAM_P_PSM_CNTXT_4_0_ADDR A:0xf9ac5810
y.create.l HWIO_PERIPH_SS_QPIC_QPIC_BAM_P_PSM_CNTXT_4_1_ADDR A:0xf9ac6810
y.create.l HWIO_PERIPH_SS_QPIC_QPIC_BAM_P_PSM_CNTXT_4_2_ADDR A:0xf9ac7810
y.create.l HWIO_PERIPH_SS_QPIC_QPIC_BAM_P_PSM_CNTXT_4_3_ADDR A:0xf9ac8810
y.create.l HWIO_PERIPH_SS_QPIC_QPIC_BAM_P_PSM_CNTXT_4_4_ADDR A:0xf9ac9810
y.create.l HWIO_PERIPH_SS_QPIC_QPIC_BAM_P_PSM_CNTXT_4_5_ADDR A:0xf9aca810
y.create.l HWIO_PERIPH_SS_QPIC_QPIC_BAM_P_PSM_CNTXT_4_6_ADDR A:0xf9acb810
y.create.l HWIO_PERIPH_SS_QPIC_QPIC_BAM_P_PSM_CNTXT_5_0_ADDR A:0xf9ac5814
y.create.l HWIO_PERIPH_SS_QPIC_QPIC_BAM_P_PSM_CNTXT_5_1_ADDR A:0xf9ac6814
y.create.l HWIO_PERIPH_SS_QPIC_QPIC_BAM_P_PSM_CNTXT_5_2_ADDR A:0xf9ac7814
y.create.l HWIO_PERIPH_SS_QPIC_QPIC_BAM_P_PSM_CNTXT_5_3_ADDR A:0xf9ac8814
y.create.l HWIO_PERIPH_SS_QPIC_QPIC_BAM_P_PSM_CNTXT_5_4_ADDR A:0xf9ac9814
y.create.l HWIO_PERIPH_SS_QPIC_QPIC_BAM_P_PSM_CNTXT_5_5_ADDR A:0xf9aca814
y.create.l HWIO_PERIPH_SS_QPIC_QPIC_BAM_P_PSM_CNTXT_5_6_ADDR A:0xf9acb814
y.create.l HWIO_PERIPH_SS_QPIC_QPIC_XPU_SCR_ADDR A:0xf9ac2000
y.create.l HWIO_PERIPH_SS_QPIC_QPIC_XPU_SWDR_ADDR A:0xf9ac2004
y.create.l HWIO_PERIPH_SS_QPIC_QPIC_XPU_SEAR0_ADDR A:0xf9ac2040
y.create.l HWIO_PERIPH_SS_QPIC_QPIC_XPU_SESR_ADDR A:0xf9ac2048
y.create.l HWIO_PERIPH_SS_QPIC_QPIC_XPU_SESRRESTORE_ADDR A:0xf9ac204c
y.create.l HWIO_PERIPH_SS_QPIC_QPIC_XPU_SESYNR0_ADDR A:0xf9ac2050
y.create.l HWIO_PERIPH_SS_QPIC_QPIC_XPU_SESYNR1_ADDR A:0xf9ac2054
y.create.l HWIO_PERIPH_SS_QPIC_QPIC_XPU_SESYNR2_ADDR A:0xf9ac2058
y.create.l HWIO_PERIPH_SS_QPIC_QPIC_XPU_MCR_ADDR A:0xf9ac2100
y.create.l HWIO_PERIPH_SS_QPIC_QPIC_XPU_MEAR0_ADDR A:0xf9ac2140
y.create.l HWIO_PERIPH_SS_QPIC_QPIC_XPU_MESR_ADDR A:0xf9ac2148
y.create.l HWIO_PERIPH_SS_QPIC_QPIC_XPU_MESRRESTORE_ADDR A:0xf9ac214c
y.create.l HWIO_PERIPH_SS_QPIC_QPIC_XPU_MESYNR0_ADDR A:0xf9ac2150
y.create.l HWIO_PERIPH_SS_QPIC_QPIC_XPU_MESYNR1_ADDR A:0xf9ac2154
y.create.l HWIO_PERIPH_SS_QPIC_QPIC_XPU_MESYNR2_ADDR A:0xf9ac2158
y.create.l HWIO_PERIPH_SS_QPIC_QPIC_XPU_CR_ADDR A:0xf9ac2080
y.create.l HWIO_PERIPH_SS_QPIC_QPIC_XPU_RPU_ACR0_ADDR A:0xf9ac20a0
y.create.l HWIO_PERIPH_SS_QPIC_QPIC_XPU_EAR0_ADDR A:0xf9ac20c0
y.create.l HWIO_PERIPH_SS_QPIC_QPIC_XPU_ESR_ADDR A:0xf9ac20c8
y.create.l HWIO_PERIPH_SS_QPIC_QPIC_XPU_ESRRESTORE_ADDR A:0xf9ac20cc
y.create.l HWIO_PERIPH_SS_QPIC_QPIC_XPU_ESYNR0_ADDR A:0xf9ac20d0
y.create.l HWIO_PERIPH_SS_QPIC_QPIC_XPU_ESYNR1_ADDR A:0xf9ac20d4
y.create.l HWIO_PERIPH_SS_QPIC_QPIC_XPU_ESYNR2_ADDR A:0xf9ac20d8
y.create.l HWIO_PERIPH_SS_QPIC_QPIC_XPU_IDR0_ADDR A:0xf9ac2074
y.create.l HWIO_PERIPH_SS_QPIC_QPIC_XPU_IDR1_ADDR A:0xf9ac2078
y.create.l HWIO_PERIPH_SS_QPIC_QPIC_XPU_REV_ADDR A:0xf9ac207c
y.create.l HWIO_PERIPH_SS_QPIC_QPIC_XPU_RG0_RACR0_ADDR A:0xf9ac2200
y.create.l HWIO_PERIPH_SS_QPIC_QPIC_XPU_RG1_RACR0_ADDR A:0xf9ac2280
y.create.l HWIO_PERIPH_SS_QPIC_QPIC_XPU_RG2_RACR0_ADDR A:0xf9ac2300
y.create.l HWIO_PERIPH_SS_QPIC_QPIC_XPU_RG3_RACR0_ADDR A:0xf9ac2380
y.create.l HWIO_PERIPH_SS_QPIC_QPIC_XPU_RG4_RACR0_ADDR A:0xf9ac2400
y.create.l HWIO_PERIPH_SS_QPIC_QPIC_XPU_RG5_RACR0_ADDR A:0xf9ac2480
y.create.l HWIO_PERIPH_SS_QPIC_QPIC_XPU_RG6_RACR0_ADDR A:0xf9ac2500
y.create.l HWIO_PERIPH_SS_QPIC_QPIC_XPU_RG7_RACR0_ADDR A:0xf9ac2580
y.create.l HWIO_PERIPH_SS_QPIC_QPIC_XPU_RG8_RACR0_ADDR A:0xf9ac2600
y.create.l HWIO_PERIPH_SS_QPIC_QPIC_XPU_RG9_RACR0_ADDR A:0xf9ac2680
y.create.l HWIO_PERIPH_SS_QPIC_QPIC_XPU_RG0_SCR_ADDR A:0xf9ac2250
y.create.l HWIO_PERIPH_SS_QPIC_QPIC_XPU_RG1_SCR_ADDR A:0xf9ac22d0
y.create.l HWIO_PERIPH_SS_QPIC_QPIC_XPU_RG2_SCR_ADDR A:0xf9ac2350
y.create.l HWIO_PERIPH_SS_QPIC_QPIC_XPU_RG3_SCR_ADDR A:0xf9ac23d0
y.create.l HWIO_PERIPH_SS_QPIC_QPIC_XPU_RG4_SCR_ADDR A:0xf9ac2450
y.create.l HWIO_PERIPH_SS_QPIC_QPIC_XPU_RG5_SCR_ADDR A:0xf9ac24d0
y.create.l HWIO_PERIPH_SS_QPIC_QPIC_XPU_RG6_SCR_ADDR A:0xf9ac2550
y.create.l HWIO_PERIPH_SS_QPIC_QPIC_XPU_RG7_SCR_ADDR A:0xf9ac25d0
y.create.l HWIO_PERIPH_SS_QPIC_QPIC_XPU_RG8_SCR_ADDR A:0xf9ac2650
y.create.l HWIO_PERIPH_SS_QPIC_QPIC_XPU_RG9_SCR_ADDR A:0xf9ac26d0
y.create.l HWIO_PERIPH_SS_QPIC_QPIC_XPU_RG0_MCR_ADDR A:0xf9ac2254
y.create.l HWIO_PERIPH_SS_QPIC_QPIC_XPU_RG1_MCR_ADDR A:0xf9ac22d4
y.create.l HWIO_PERIPH_SS_QPIC_QPIC_XPU_RG2_MCR_ADDR A:0xf9ac2354
y.create.l HWIO_PERIPH_SS_QPIC_QPIC_XPU_RG3_MCR_ADDR A:0xf9ac23d4
y.create.l HWIO_PERIPH_SS_QPIC_QPIC_XPU_RG4_MCR_ADDR A:0xf9ac2454
y.create.l HWIO_PERIPH_SS_QPIC_QPIC_XPU_RG5_MCR_ADDR A:0xf9ac24d4
y.create.l HWIO_PERIPH_SS_QPIC_QPIC_XPU_RG6_MCR_ADDR A:0xf9ac2554
y.create.l HWIO_PERIPH_SS_QPIC_QPIC_XPU_RG7_MCR_ADDR A:0xf9ac25d4
y.create.l HWIO_PERIPH_SS_QPIC_QPIC_XPU_RG8_MCR_ADDR A:0xf9ac2654
y.create.l HWIO_PERIPH_SS_QPIC_QPIC_XPU_RG9_MCR_ADDR A:0xf9ac26d4
y.create.l HWIO_PERIPH_SS_QPIC_QPIC_VMIDMT_SCR0_ADDR A:0xf9ac0000
y.create.l HWIO_PERIPH_SS_QPIC_QPIC_VMIDMT_SCR1_ADDR A:0xf9ac0004
y.create.l HWIO_PERIPH_SS_QPIC_QPIC_VMIDMT_SCR2_ADDR A:0xf9ac0008
y.create.l HWIO_PERIPH_SS_QPIC_QPIC_VMIDMT_SACR_ADDR A:0xf9ac0010
y.create.l HWIO_PERIPH_SS_QPIC_QPIC_VMIDMT_SIDR0_ADDR A:0xf9ac0020
y.create.l HWIO_PERIPH_SS_QPIC_QPIC_VMIDMT_SIDR1_ADDR A:0xf9ac0024
y.create.l HWIO_PERIPH_SS_QPIC_QPIC_VMIDMT_SIDR2_ADDR A:0xf9ac0028
y.create.l HWIO_PERIPH_SS_QPIC_QPIC_VMIDMT_SIDR4_ADDR A:0xf9ac0030
y.create.l HWIO_PERIPH_SS_QPIC_QPIC_VMIDMT_SIDR5_ADDR A:0xf9ac0034
y.create.l HWIO_PERIPH_SS_QPIC_QPIC_VMIDMT_SIDR7_ADDR A:0xf9ac003c
y.create.l HWIO_PERIPH_SS_QPIC_QPIC_VMIDMT_SGFAR0_ADDR A:0xf9ac0040
y.create.l HWIO_PERIPH_SS_QPIC_QPIC_VMIDMT_SGFSR_ADDR A:0xf9ac0048
y.create.l HWIO_PERIPH_SS_QPIC_QPIC_VMIDMT_SGFSRRESTORE_ADDR A:0xf9ac004c
y.create.l HWIO_PERIPH_SS_QPIC_QPIC_VMIDMT_SGFSYNDR0_ADDR A:0xf9ac0050
y.create.l HWIO_PERIPH_SS_QPIC_QPIC_VMIDMT_SGFSYNDR1_ADDR A:0xf9ac0054
y.create.l HWIO_PERIPH_SS_QPIC_QPIC_VMIDMT_SGFSYNDR2_ADDR A:0xf9ac0058
y.create.l HWIO_PERIPH_SS_QPIC_QPIC_VMIDMT_VMIDMTSCR0_ADDR A:0xf9ac0090
y.create.l HWIO_PERIPH_SS_QPIC_QPIC_VMIDMT_CR0_ADDR A:0xf9ac0000
y.create.l HWIO_PERIPH_SS_QPIC_QPIC_VMIDMT_CR2_ADDR A:0xf9ac0008
y.create.l HWIO_PERIPH_SS_QPIC_QPIC_VMIDMT_ACR_ADDR A:0xf9ac0010
y.create.l HWIO_PERIPH_SS_QPIC_QPIC_VMIDMT_IDR0_ADDR A:0xf9ac0020
y.create.l HWIO_PERIPH_SS_QPIC_QPIC_VMIDMT_IDR1_ADDR A:0xf9ac0024
y.create.l HWIO_PERIPH_SS_QPIC_QPIC_VMIDMT_IDR2_ADDR A:0xf9ac0028
y.create.l HWIO_PERIPH_SS_QPIC_QPIC_VMIDMT_IDR4_ADDR A:0xf9ac0030
y.create.l HWIO_PERIPH_SS_QPIC_QPIC_VMIDMT_IDR5_ADDR A:0xf9ac0034
y.create.l HWIO_PERIPH_SS_QPIC_QPIC_VMIDMT_IDR7_ADDR A:0xf9ac003c
y.create.l HWIO_PERIPH_SS_QPIC_QPIC_VMIDMT_GFAR0_ADDR A:0xf9ac0040
y.create.l HWIO_PERIPH_SS_QPIC_QPIC_VMIDMT_GFSR_ADDR A:0xf9ac0048
y.create.l HWIO_PERIPH_SS_QPIC_QPIC_VMIDMT_GFSRRESTORE_ADDR A:0xf9ac004c
y.create.l HWIO_PERIPH_SS_QPIC_QPIC_VMIDMT_GFSYNDR0_ADDR A:0xf9ac0050
y.create.l HWIO_PERIPH_SS_QPIC_QPIC_VMIDMT_GFSYNDR1_ADDR A:0xf9ac0054
y.create.l HWIO_PERIPH_SS_QPIC_QPIC_VMIDMT_GFSYNDR2_ADDR A:0xf9ac0058
y.create.l HWIO_PERIPH_SS_QPIC_QPIC_VMIDMT_VMIDMTCR0_ADDR A:0xf9ac0090
y.create.l HWIO_PERIPH_SS_QPIC_QPIC_VMIDMT_VMIDMTACR_ADDR A:0xf9ac009c
y.create.l HWIO_PERIPH_SS_QPIC_QPIC_VMIDMT_NSCR0_ADDR A:0xf9ac0400
y.create.l HWIO_PERIPH_SS_QPIC_QPIC_VMIDMT_NSCR2_ADDR A:0xf9ac0408
y.create.l HWIO_PERIPH_SS_QPIC_QPIC_VMIDMT_NSACR_ADDR A:0xf9ac0410
y.create.l HWIO_PERIPH_SS_QPIC_QPIC_VMIDMT_NSGFAR0_ADDR A:0xf9ac0440
y.create.l HWIO_PERIPH_SS_QPIC_QPIC_VMIDMT_NSGFSR_ADDR A:0xf9ac0448
y.create.l HWIO_PERIPH_SS_QPIC_QPIC_VMIDMT_NSGFSRRESTORE_ADDR A:0xf9ac044c
y.create.l HWIO_PERIPH_SS_QPIC_QPIC_VMIDMT_NSGFSYNDR0_ADDR A:0xf9ac0450
y.create.l HWIO_PERIPH_SS_QPIC_QPIC_VMIDMT_NSGFSYNDR1_ADDR A:0xf9ac0454
y.create.l HWIO_PERIPH_SS_QPIC_QPIC_VMIDMT_NSGFSYNDR2_ADDR A:0xf9ac0458
y.create.l HWIO_PERIPH_SS_QPIC_QPIC_VMIDMT_NSVMIDMTCR0_ADDR A:0xf9ac0490
y.create.l HWIO_PERIPH_SS_QPIC_QPIC_VMIDMT_SSDR0_ADDR A:0xf9ac0080
y.create.l HWIO_PERIPH_SS_QPIC_QPIC_VMIDMT_MSDR0_ADDR A:0xf9ac0480
y.create.l HWIO_PERIPH_SS_QPIC_QPIC_VMIDMT_MCR_ADDR A:0xf9ac0494
y.create.l HWIO_PERIPH_SS_QPIC_QPIC_VMIDMT_S2VR0_ADDR A:0xf9ac0c00
y.create.l HWIO_PERIPH_SS_QPIC_QPIC_VMIDMT_S2VR1_ADDR A:0xf9ac0c04
y.create.l HWIO_PERIPH_SS_QPIC_QPIC_VMIDMT_S2VR2_ADDR A:0xf9ac0c08
y.create.l HWIO_PERIPH_SS_QPIC_QPIC_VMIDMT_S2VR3_ADDR A:0xf9ac0c0c
y.create.l HWIO_PERIPH_SS_QPIC_QPIC_VMIDMT_S2VR4_ADDR A:0xf9ac0c10
y.create.l HWIO_PERIPH_SS_QPIC_QPIC_VMIDMT_S2VR5_ADDR A:0xf9ac0c14
y.create.l HWIO_PERIPH_SS_QPIC_QPIC_VMIDMT_S2VR6_ADDR A:0xf9ac0c18
y.create.l HWIO_PERIPH_SS_QPIC_QPIC_VMIDMT_S2VR7_ADDR A:0xf9ac0c1c
y.create.l HWIO_PERIPH_SS_QPIC_QPIC_VMIDMT_AS2VR0_ADDR A:0xf9ac0e00
y.create.l HWIO_PERIPH_SS_QPIC_QPIC_VMIDMT_AS2VR1_ADDR A:0xf9ac0e04
y.create.l HWIO_PERIPH_SS_QPIC_QPIC_VMIDMT_AS2VR2_ADDR A:0xf9ac0e08
y.create.l HWIO_PERIPH_SS_QPIC_QPIC_VMIDMT_AS2VR3_ADDR A:0xf9ac0e0c
y.create.l HWIO_PERIPH_SS_QPIC_QPIC_VMIDMT_AS2VR4_ADDR A:0xf9ac0e10
y.create.l HWIO_PERIPH_SS_QPIC_QPIC_VMIDMT_AS2VR5_ADDR A:0xf9ac0e14
y.create.l HWIO_PERIPH_SS_QPIC_QPIC_VMIDMT_AS2VR6_ADDR A:0xf9ac0e18
y.create.l HWIO_PERIPH_SS_QPIC_QPIC_VMIDMT_AS2VR7_ADDR A:0xf9ac0e1c
y.create.l HWIO_PERIPH_SS_QPIC_QPIC_VMIDMT_SMR0_ADDR A:0xf9ac0800
y.create.l HWIO_PERIPH_SS_QPIC_QPIC_VMIDMT_SMR1_ADDR A:0xf9ac0804
y.create.l HWIO_PERIPH_SS_QPIC_QPIC_VMIDMT_SMR2_ADDR A:0xf9ac0808
y.create.l HWIO_PERIPH_SS_QPIC_QPIC_VMIDMT_SMR3_ADDR A:0xf9ac080c
y.create.l HWIO_PERIPH_SS_QPIC_QPIC_VMIDMT_SMR4_ADDR A:0xf9ac0810
y.create.l HWIO_PERIPH_SS_QPIC_QPIC_VMIDMT_SMR5_ADDR A:0xf9ac0814
y.create.l HWIO_PERIPH_SS_QPIC_QPIC_VMIDMT_SMR6_ADDR A:0xf9ac0818
y.create.l HWIO_PERIPH_SS_QPIC_QPIC_VMIDMT_SMR7_ADDR A:0xf9ac081c
y.create.l HWIO_PERIPH_SS_QPIC_EBI2_CHIP_SELECT_CFG0_ADDR A:0xf9ae0000
y.create.l HWIO_PERIPH_SS_QPIC_EBI2_CFG_ADDR A:0xf9ae0004
y.create.l HWIO_PERIPH_SS_QPIC_EBI2_ARBITER_CFG_ADDR A:0xf9ae0030
y.create.l HWIO_PERIPH_SS_QPIC_EBI2_DEBUG_REG_LSB_ADDR A:0xf9ae0048
y.create.l HWIO_PERIPH_SS_QPIC_EBI2_DEBUG_REG_MSB_ADDR A:0xf9ae004c
y.create.l HWIO_PERIPH_SS_QPIC_EBI2_DEBUG_SEL_ADDR A:0xf9ae0050
y.create.l HWIO_PERIPH_SS_QPIC_EBI2_CRC_CFG_ADDR A:0xf9ae0054
y.create.l HWIO_PERIPH_SS_QPIC_EBI2_CRC_REMINDER_CFG_ADDR A:0xf9ae0058
y.create.l HWIO_PERIPH_SS_QPIC_EBI2_NAND_ADM_MUX_ADDR A:0xf9ae005c
y.create.l HWIO_PERIPH_SS_QPIC_EBI2_CLKON_CFG_ADDR A:0xf9ae0068
y.create.l HWIO_PERIPH_SS_QPIC_EBI2_CORE_CLKON_CFG_ADDR A:0xf9ae006c
y.create.l HWIO_PERIPH_SS_QPIC_QPIC_LCDC_CTRL_ADDR A:0xf9ae2000
y.create.l HWIO_PERIPH_SS_QPIC_LCDC_VERSION_ADDR A:0xf9ae2004
y.create.l HWIO_PERIPH_SS_QPIC_QPIC_LCDC_IRQ_EN_ADDR A:0xf9ae2008
y.create.l HWIO_PERIPH_SS_QPIC_QPIC_LCDC_IRQ_STTS_ADDR A:0xf9ae200c
y.create.l HWIO_PERIPH_SS_QPIC_QPIC_LCDC_IRQ_CLR_ADDR A:0xf9ae2010
y.create.l HWIO_PERIPH_SS_QPIC_QPIC_LCDC_STTS_ADDR A:0xf9ae2014
y.create.l HWIO_PERIPH_SS_QPIC_QPIC_LCDC_CMD_DATA_CYCLE_CNT_ADDR A:0xf9ae2018
y.create.l HWIO_PERIPH_SS_QPIC_QPIC_LCDC_CFG0_ADDR A:0xf9ae2020
y.create.l HWIO_PERIPH_SS_QPIC_QPIC_LCDC_CFG1_ADDR A:0xf9ae2024
y.create.l HWIO_PERIPH_SS_QPIC_QPIC_LCDC_CFG2_ADDR A:0xf9ae2028
y.create.l HWIO_PERIPH_SS_QPIC_QPIC_LCDC_RESET_ADDR A:0xf9ae202c
y.create.l HWIO_PERIPH_SS_QPIC_QPIC_LCD_DEVICE_RESET_ADDR A:0xf9ae2030
y.create.l HWIO_PERIPH_SS_QPIC_QPIC_LCDC_FIFO_SOF_ADDR A:0xf9ae2100
y.create.l HWIO_PERIPH_SS_QPIC_QPIC_LCDC_FIFO_DATA_PORT0_ADDR A:0xf9ae2140
y.create.l HWIO_PERIPH_SS_QPIC_QPIC_LCDC_FIFO_DATA_PORT1_ADDR A:0xf9ae2144
y.create.l HWIO_PERIPH_SS_QPIC_QPIC_LCDC_FIFO_DATA_PORT2_ADDR A:0xf9ae2148
y.create.l HWIO_PERIPH_SS_QPIC_QPIC_LCDC_FIFO_DATA_PORT3_ADDR A:0xf9ae214c
y.create.l HWIO_PERIPH_SS_QPIC_QPIC_LCDC_FIFO_DATA_PORT4_ADDR A:0xf9ae2150
y.create.l HWIO_PERIPH_SS_QPIC_QPIC_LCDC_FIFO_DATA_PORT5_ADDR A:0xf9ae2154
y.create.l HWIO_PERIPH_SS_QPIC_QPIC_LCDC_FIFO_DATA_PORT6_ADDR A:0xf9ae2158
y.create.l HWIO_PERIPH_SS_QPIC_QPIC_LCDC_FIFO_DATA_PORT7_ADDR A:0xf9ae215c
y.create.l HWIO_PERIPH_SS_QPIC_QPIC_LCDC_FIFO_DATA_PORT8_ADDR A:0xf9ae2160
y.create.l HWIO_PERIPH_SS_QPIC_QPIC_LCDC_FIFO_DATA_PORT9_ADDR A:0xf9ae2164
y.create.l HWIO_PERIPH_SS_QPIC_QPIC_LCDC_FIFO_EOF_ADDR A:0xf9ae2180
y.create.l HWIO_PERIPH_SS_QPIC_LCD_DEVICE_CMD0_ADDR A:0xf9ae3000
y.create.l HWIO_PERIPH_SS_QPIC_LCD_DEVICE_CMD1_ADDR A:0xf9ae3004
y.create.l HWIO_PERIPH_SS_QPIC_LCD_DEVICE_CMD2_ADDR A:0xf9ae3008
y.create.l HWIO_PERIPH_SS_QPIC_LCD_DEVICE_CMD3_ADDR A:0xf9ae300c
y.create.l HWIO_PERIPH_SS_QPIC_LCD_DEVICE_CMD4_ADDR A:0xf9ae3010
y.create.l HWIO_PERIPH_SS_QPIC_LCD_DEVICE_CMD5_ADDR A:0xf9ae3014
y.create.l HWIO_PERIPH_SS_QPIC_LCD_DEVICE_CMD6_ADDR A:0xf9ae3018
y.create.l HWIO_PERIPH_SS_QPIC_LCD_DEVICE_CMD7_ADDR A:0xf9ae301c
y.create.l HWIO_PERIPH_SS_QPIC_LCD_DEVICE_CMD8_ADDR A:0xf9ae3020
y.create.l HWIO_PERIPH_SS_QPIC_LCD_DEVICE_CMD9_ADDR A:0xf9ae3024
y.create.l HWIO_PERIPH_SS_QPIC_QPIC_VERSION_ADDR A:0xf9ae0100
y.create.l HWIO_PERIPH_SS_QPIC_QPIC_CTRL_ADDR A:0xf9ae0104
y.create.l HWIO_PERIPH_SS_QPIC_QPIC_HW_INFO_ADDR A:0xf9ae0108
y.create.l HWIO_PERIPH_SS_QPIC_QPIC_REG_PERMISSION_ADDR A:0xf9ae010c
y.create.l HWIO_PERIPH_SS_QPIC_QPIC_DEBUG_ADDR A:0xf9ae0110
y.create.l HWIO_PERIPH_SS_QPIC_QPIC_HW_GENERICS_ADDR A:0xf9ae0114
y.create.l HWIO_PERIPH_SS_QPIC_NAND_FLASH_CMD_ADDR A:0xf9af0000
y.create.l HWIO_PERIPH_SS_QPIC_NAND_ADDR0_ADDR A:0xf9af0004
y.create.l HWIO_PERIPH_SS_QPIC_NAND_ADDR1_ADDR A:0xf9af0008
y.create.l HWIO_PERIPH_SS_QPIC_NAND_FLASH_CHIP_SELECT_ADDR A:0xf9af000c
y.create.l HWIO_PERIPH_SS_QPIC_NANDC_EXEC_CMD_ADDR A:0xf9af0010
y.create.l HWIO_PERIPH_SS_QPIC_NAND_FLASH_STATUS_ADDR A:0xf9af0014
y.create.l HWIO_PERIPH_SS_QPIC_NANDC_BUFFER_STATUS_ADDR A:0xf9af0018
y.create.l HWIO_PERIPH_SS_QPIC_NAND_DEV0_CFG0_ADDR A:0xf9af0020
y.create.l HWIO_PERIPH_SS_QPIC_NAND_DEV1_CFG0_ADDR A:0xf9af0030
y.create.l HWIO_PERIPH_SS_QPIC_NAND_DEV0_CFG1_ADDR A:0xf9af0024
y.create.l HWIO_PERIPH_SS_QPIC_NAND_DEV1_CFG1_ADDR A:0xf9af0034
y.create.l HWIO_PERIPH_SS_QPIC_NAND_DEV0_ECC_CFG_ADDR A:0xf9af0028
y.create.l HWIO_PERIPH_SS_QPIC_NAND_DEV1_ECC_CFG_ADDR A:0xf9af002c
y.create.l HWIO_PERIPH_SS_QPIC_NAND_FLASH_READ_ID_ADDR A:0xf9af0040
y.create.l HWIO_PERIPH_SS_QPIC_NAND_FLASH_READ_ID2_ADDR A:0xf9af0048
y.create.l HWIO_PERIPH_SS_QPIC_NAND_FLASH_READ_STATUS_ADDR A:0xf9af0044
y.create.l HWIO_PERIPH_SS_QPIC_NAND_FLASH_CONFIG_DATA_ADDR A:0xf9af0050
y.create.l HWIO_PERIPH_SS_QPIC_NAND_FLASH_CONFIG_ADDR A:0xf9af0054
y.create.l HWIO_PERIPH_SS_QPIC_NAND_FLASH_CONFIG_MODE_ADDR A:0xf9af0058
y.create.l HWIO_PERIPH_SS_QPIC_NAND_FLASH_CONFIG_STATUS_ADDR A:0xf9af0060
y.create.l HWIO_PERIPH_SS_QPIC_FLASH_MACRO1_REG_ADDR A:0xf9af0064
y.create.l HWIO_PERIPH_SS_QPIC_HSDDR_NAND_CFG_ADDR A:0xf9af0068
y.create.l HWIO_PERIPH_SS_QPIC_FLASH_XFR_STEP1_ADDR A:0xf9af0070
y.create.l HWIO_PERIPH_SS_QPIC_FLASH_XFR_STEP2_ADDR A:0xf9af0074
y.create.l HWIO_PERIPH_SS_QPIC_FLASH_XFR_STEP3_ADDR A:0xf9af0078
y.create.l HWIO_PERIPH_SS_QPIC_FLASH_XFR_STEP4_ADDR A:0xf9af007c
y.create.l HWIO_PERIPH_SS_QPIC_FLASH_XFR_STEP5_ADDR A:0xf9af0080
y.create.l HWIO_PERIPH_SS_QPIC_FLASH_XFR_STEP6_ADDR A:0xf9af0084
y.create.l HWIO_PERIPH_SS_QPIC_FLASH_XFR_STEP7_ADDR A:0xf9af0088
y.create.l HWIO_PERIPH_SS_QPIC_NAND_GENP_REG0_ADDR A:0xf9af0090
y.create.l HWIO_PERIPH_SS_QPIC_NAND_GENP_REG1_ADDR A:0xf9af0094
y.create.l HWIO_PERIPH_SS_QPIC_NAND_GENP_REG2_ADDR A:0xf9af0098
y.create.l HWIO_PERIPH_SS_QPIC_NAND_GENP_REG3_ADDR A:0xf9af009c
y.create.l HWIO_PERIPH_SS_QPIC_FLASH_DEV_CMD0_ADDR A:0xf9af00a0
y.create.l HWIO_PERIPH_SS_QPIC_FLASH_DEV_CMD1_ADDR A:0xf9af00a4
y.create.l HWIO_PERIPH_SS_QPIC_FLASH_DEV_CMD2_ADDR A:0xf9af00a8
y.create.l HWIO_PERIPH_SS_QPIC_FLASH_DEV_CMD_VLD_ADDR A:0xf9af00ac
y.create.l HWIO_PERIPH_SS_QPIC_NAND_ADDR2_ADDR A:0xf9af00c0
y.create.l HWIO_PERIPH_SS_QPIC_NAND_ADDR3_ADDR A:0xf9af00c4
y.create.l HWIO_PERIPH_SS_QPIC_NAND_ADDR4_ADDR A:0xf9af00c8
y.create.l HWIO_PERIPH_SS_QPIC_NAND_ADDR5_ADDR A:0xf9af00cc
y.create.l HWIO_PERIPH_SS_QPIC_FLASH_DEV_CMD3_ADDR A:0xf9af00d0
y.create.l HWIO_PERIPH_SS_QPIC_FLASH_DEV_CMD4_ADDR A:0xf9af00d4
y.create.l HWIO_PERIPH_SS_QPIC_FLASH_DEV_CMD5_ADDR A:0xf9af00d8
y.create.l HWIO_PERIPH_SS_QPIC_FLASH_DEV_CMD6_ADDR A:0xf9af00dc
y.create.l HWIO_PERIPH_SS_QPIC_NAND_ADDR6_ADDR A:0xf9af00e4
y.create.l HWIO_PERIPH_SS_QPIC_NAND_ERASED_CW_DETECT_CFG_ADDR A:0xf9af00e8
y.create.l HWIO_PERIPH_SS_QPIC_NAND_ERASED_CW_DETECT_STATUS_ADDR A:0xf9af00ec
y.create.l HWIO_PERIPH_SS_QPIC_EBI2_ECC_BUF_CFG_ADDR A:0xf9af00f0
y.create.l HWIO_PERIPH_SS_QPIC_NANDC_DBG_CFG_ADDR A:0xf9af00f4
y.create.l HWIO_PERIPH_SS_QPIC_NANDC_HW_PROFILE_CFG_ADDR A:0xf9af00f8
y.create.l HWIO_PERIPH_SS_QPIC_FLASH_BUFF0_ACC_ADDR A:0xf9af0100
y.create.l HWIO_PERIPH_SS_QPIC_FLASH_BUFF1_ACC_ADDR A:0xf9af0104
y.create.l HWIO_PERIPH_SS_QPIC_FLASH_BUFF2_ACC_ADDR A:0xf9af0108
y.create.l HWIO_PERIPH_SS_QPIC_FLASH_BUFF3_ACC_ADDR A:0xf9af010c
y.create.l HWIO_PERIPH_SS_QPIC_FLASH_BUFF4_ACC_ADDR A:0xf9af0110
y.create.l HWIO_PERIPH_SS_QPIC_FLASH_BUFF5_ACC_ADDR A:0xf9af0114
y.create.l HWIO_PERIPH_SS_QPIC_FLASH_BUFF6_ACC_ADDR A:0xf9af0118
y.create.l HWIO_PERIPH_SS_QPIC_FLASH_BUFF7_ACC_ADDR A:0xf9af011c
y.create.l HWIO_PERIPH_SS_QPIC_FLASH_BUFF8_ACC_ADDR A:0xf9af0120
y.create.l HWIO_PERIPH_SS_QPIC_FLASH_BUFF9_ACC_ADDR A:0xf9af0124
y.create.l HWIO_PERIPH_SS_QPIC_NAND_CTRL_ADDR A:0xf9af0f00
y.create.l HWIO_PERIPH_SS_QPIC_NAND_STATUS_ADDR A:0xf9af0f04
y.create.l HWIO_PERIPH_SS_QPIC_NAND_VERSION_ADDR A:0xf9af0f08
y.create.l HWIO_PERIPH_SS_QPIC_NAND_MPU_BYPASS_ADDR A:0xf9af0f44
y.create.l HWIO_PERIPH_SS_QPIC_NAND_DEBUG_ADDR A:0xf9af0f0c
y.create.l HWIO_PERIPH_SS_QPIC_NAND_IRQ_STTS_ADDR A:0xf9af0f10
y.create.l HWIO_PERIPH_SS_QPIC_NAND_IRQ_CLR_ADDR A:0xf9af0f14
y.create.l HWIO_PERIPH_SS_QPIC_NAND_IRQ_EN_ADDR A:0xf9af0f18
y.create.l HWIO_PERIPH_SS_QPIC_NAND_MUTEX_ADDR A:0xf9af0f1c
y.create.l HWIO_PERIPH_SS_QPIC_NAND_CONFIG_BITS_ADDR A:0xf9af0f40
y.create.l HWIO_PERIPH_SS_QPIC_NAND_READ_LOCATION_0_ADDR A:0xf9af0f20
y.create.l HWIO_PERIPH_SS_QPIC_NAND_READ_LOCATION_1_ADDR A:0xf9af0f24
y.create.l HWIO_PERIPH_SS_QPIC_NAND_READ_LOCATION_2_ADDR A:0xf9af0f28
y.create.l HWIO_PERIPH_SS_QPIC_NAND_READ_LOCATION_3_ADDR A:0xf9af0f2c
y.create.l HWIO_PERIPH_SS_QPIC_NAND_READ_LOCATION_4_ADDR A:0xf9af0f30
y.create.l HWIO_PERIPH_SS_QPIC_NAND_TEST_BUS_LSB_ADDR A:0xf9af0f48
y.create.l HWIO_PERIPH_SS_QPIC_NAND_TEST_BUS_MSB_ADDR A:0xf9af0f4c
y.create.l HWIO_PERIPH_SS_QPIC_NAND_OP_DONE_CNT_ADDR A:0xf9af0f50
y.create.l HWIO_PERIPH_SS_QPIC_NAND_ERR_RESP_TIME_OUT_ADDR A:0xf9af0f54
y.create.l HWIO_PERIPH_SS_QPIC_QPIC_MPU_XPU_SCR_ADDR A:0xf9af1000
y.create.l HWIO_PERIPH_SS_QPIC_QPIC_MPU_XPU_SWDR_ADDR A:0xf9af1004
y.create.l HWIO_PERIPH_SS_QPIC_QPIC_MPU_XPU_PRTN_RACR_SSHADOW_ADDR A:0xf9af1008
y.create.l HWIO_PERIPH_SS_QPIC_QPIC_MPU_XPU_PRTN_WACR_SSHADOW_ADDR A:0xf9af100c
y.create.l HWIO_PERIPH_SS_QPIC_QPIC_MPU_XPU_PRTN_START_SSHADOW0_ADDR A:0xf9af1010
y.create.l HWIO_PERIPH_SS_QPIC_QPIC_MPU_XPU_PRTN_START_SSHADOW1_ADDR A:0xf9af1014
y.create.l HWIO_PERIPH_SS_QPIC_QPIC_MPU_XPU_PRTN_END_SSHADOW0_ADDR A:0xf9af1018
y.create.l HWIO_PERIPH_SS_QPIC_QPIC_MPU_XPU_PRTN_END_SSHADOW1_ADDR A:0xf9af101c
y.create.l HWIO_PERIPH_SS_QPIC_QPIC_MPU_XPU_SEAR0_ADDR A:0xf9af1040
y.create.l HWIO_PERIPH_SS_QPIC_QPIC_MPU_XPU_SEAR1_ADDR A:0xf9af1044
y.create.l HWIO_PERIPH_SS_QPIC_QPIC_MPU_XPU_SESR_ADDR A:0xf9af1048
y.create.l HWIO_PERIPH_SS_QPIC_QPIC_MPU_XPU_SESRRESTORE_ADDR A:0xf9af104c
y.create.l HWIO_PERIPH_SS_QPIC_QPIC_MPU_XPU_SESYNR0_ADDR A:0xf9af1050
y.create.l HWIO_PERIPH_SS_QPIC_QPIC_MPU_XPU_SESYNR1_ADDR A:0xf9af1054
y.create.l HWIO_PERIPH_SS_QPIC_QPIC_MPU_XPU_SESYNR2_ADDR A:0xf9af1058
y.create.l HWIO_PERIPH_SS_QPIC_QPIC_MPU_XPU_MCR_ADDR A:0xf9af1100
y.create.l HWIO_PERIPH_SS_QPIC_QPIC_MPU_XPU_MEAR0_ADDR A:0xf9af1140
y.create.l HWIO_PERIPH_SS_QPIC_QPIC_MPU_XPU_MEAR1_ADDR A:0xf9af1144
y.create.l HWIO_PERIPH_SS_QPIC_QPIC_MPU_XPU_MESR_ADDR A:0xf9af1148
y.create.l HWIO_PERIPH_SS_QPIC_QPIC_MPU_XPU_MESRRESTORE_ADDR A:0xf9af114c
y.create.l HWIO_PERIPH_SS_QPIC_QPIC_MPU_XPU_MESYNR0_ADDR A:0xf9af1150
y.create.l HWIO_PERIPH_SS_QPIC_QPIC_MPU_XPU_MESYNR1_ADDR A:0xf9af1154
y.create.l HWIO_PERIPH_SS_QPIC_QPIC_MPU_XPU_MESYNR2_ADDR A:0xf9af1158
y.create.l HWIO_PERIPH_SS_QPIC_QPIC_MPU_XPU_CR_ADDR A:0xf9af1080
y.create.l HWIO_PERIPH_SS_QPIC_QPIC_MPU_XPU_PRTN_RACR_SHADOW_ADDR A:0xf9af1088
y.create.l HWIO_PERIPH_SS_QPIC_QPIC_MPU_XPU_PRTN_WACR_SHADOW_ADDR A:0xf9af108c
y.create.l HWIO_PERIPH_SS_QPIC_QPIC_MPU_XPU_PRTN_START_SHADOW0_ADDR A:0xf9af1090
y.create.l HWIO_PERIPH_SS_QPIC_QPIC_MPU_XPU_PRTN_START_SHADOW1_ADDR A:0xf9af1094
y.create.l HWIO_PERIPH_SS_QPIC_QPIC_MPU_XPU_PRTN_END_SHADOW0_ADDR A:0xf9af1098
y.create.l HWIO_PERIPH_SS_QPIC_QPIC_MPU_XPU_PRTN_END_SHADOW1_ADDR A:0xf9af109c
y.create.l HWIO_PERIPH_SS_QPIC_QPIC_MPU_XPU_RPU_ACR0_ADDR A:0xf9af10a0
y.create.l HWIO_PERIPH_SS_QPIC_QPIC_MPU_XPU_EAR0_ADDR A:0xf9af10c0
y.create.l HWIO_PERIPH_SS_QPIC_QPIC_MPU_XPU_EAR1_ADDR A:0xf9af10c4
y.create.l HWIO_PERIPH_SS_QPIC_QPIC_MPU_XPU_ESR_ADDR A:0xf9af10c8
y.create.l HWIO_PERIPH_SS_QPIC_QPIC_MPU_XPU_ESRRESTORE_ADDR A:0xf9af10cc
y.create.l HWIO_PERIPH_SS_QPIC_QPIC_MPU_XPU_ESYNR0_ADDR A:0xf9af10d0
y.create.l HWIO_PERIPH_SS_QPIC_QPIC_MPU_XPU_ESYNR1_ADDR A:0xf9af10d4
y.create.l HWIO_PERIPH_SS_QPIC_QPIC_MPU_XPU_ESYNR2_ADDR A:0xf9af10d8
y.create.l HWIO_PERIPH_SS_QPIC_QPIC_MPU_XPU_UMR_RACR_ADDR A:0xf9af10e0
y.create.l HWIO_PERIPH_SS_QPIC_QPIC_MPU_XPU_UMR_WACR_ADDR A:0xf9af10e4
y.create.l HWIO_PERIPH_SS_QPIC_QPIC_MPU_XPU_IDR0_ADDR A:0xf9af1074
y.create.l HWIO_PERIPH_SS_QPIC_QPIC_MPU_XPU_IDR1_ADDR A:0xf9af1078
y.create.l HWIO_PERIPH_SS_QPIC_QPIC_MPU_XPU_REV_ADDR A:0xf9af107c
y.create.l HWIO_PERIPH_SS_QPIC_QPIC_MPU_XPU_PRT0_RACR0_ADDR A:0xf9af1200
y.create.l HWIO_PERIPH_SS_QPIC_QPIC_MPU_XPU_PRT1_RACR0_ADDR A:0xf9af1280
y.create.l HWIO_PERIPH_SS_QPIC_QPIC_MPU_XPU_PRT2_RACR0_ADDR A:0xf9af1300
y.create.l HWIO_PERIPH_SS_QPIC_QPIC_MPU_XPU_PRT3_RACR0_ADDR A:0xf9af1380
y.create.l HWIO_PERIPH_SS_QPIC_QPIC_MPU_XPU_PRT4_RACR0_ADDR A:0xf9af1400
y.create.l HWIO_PERIPH_SS_QPIC_QPIC_MPU_XPU_PRT5_RACR0_ADDR A:0xf9af1480
y.create.l HWIO_PERIPH_SS_QPIC_QPIC_MPU_XPU_PRT6_RACR0_ADDR A:0xf9af1500
y.create.l HWIO_PERIPH_SS_QPIC_QPIC_MPU_XPU_PRT7_RACR0_ADDR A:0xf9af1580
y.create.l HWIO_PERIPH_SS_QPIC_QPIC_MPU_XPU_PRT0_WACR0_ADDR A:0xf9af1220
y.create.l HWIO_PERIPH_SS_QPIC_QPIC_MPU_XPU_PRT1_WACR0_ADDR A:0xf9af12a0
y.create.l HWIO_PERIPH_SS_QPIC_QPIC_MPU_XPU_PRT2_WACR0_ADDR A:0xf9af1320
y.create.l HWIO_PERIPH_SS_QPIC_QPIC_MPU_XPU_PRT3_WACR0_ADDR A:0xf9af13a0
y.create.l HWIO_PERIPH_SS_QPIC_QPIC_MPU_XPU_PRT4_WACR0_ADDR A:0xf9af1420
y.create.l HWIO_PERIPH_SS_QPIC_QPIC_MPU_XPU_PRT5_WACR0_ADDR A:0xf9af14a0
y.create.l HWIO_PERIPH_SS_QPIC_QPIC_MPU_XPU_PRT6_WACR0_ADDR A:0xf9af1520
y.create.l HWIO_PERIPH_SS_QPIC_QPIC_MPU_XPU_PRT7_WACR0_ADDR A:0xf9af15a0
y.create.l HWIO_PERIPH_SS_QPIC_QPIC_MPU_XPU_PRT0_START0_ADDR A:0xf9af1240
y.create.l HWIO_PERIPH_SS_QPIC_QPIC_MPU_XPU_PRT1_START0_ADDR A:0xf9af12c0
y.create.l HWIO_PERIPH_SS_QPIC_QPIC_MPU_XPU_PRT2_START0_ADDR A:0xf9af1340
y.create.l HWIO_PERIPH_SS_QPIC_QPIC_MPU_XPU_PRT3_START0_ADDR A:0xf9af13c0
y.create.l HWIO_PERIPH_SS_QPIC_QPIC_MPU_XPU_PRT4_START0_ADDR A:0xf9af1440
y.create.l HWIO_PERIPH_SS_QPIC_QPIC_MPU_XPU_PRT5_START0_ADDR A:0xf9af14c0
y.create.l HWIO_PERIPH_SS_QPIC_QPIC_MPU_XPU_PRT6_START0_ADDR A:0xf9af1540
y.create.l HWIO_PERIPH_SS_QPIC_QPIC_MPU_XPU_PRT7_START0_ADDR A:0xf9af15c0
y.create.l HWIO_PERIPH_SS_QPIC_QPIC_MPU_XPU_PRT0_START1_ADDR A:0xf9af1244
y.create.l HWIO_PERIPH_SS_QPIC_QPIC_MPU_XPU_PRT1_START1_ADDR A:0xf9af12c4
y.create.l HWIO_PERIPH_SS_QPIC_QPIC_MPU_XPU_PRT2_START1_ADDR A:0xf9af1344
y.create.l HWIO_PERIPH_SS_QPIC_QPIC_MPU_XPU_PRT3_START1_ADDR A:0xf9af13c4
y.create.l HWIO_PERIPH_SS_QPIC_QPIC_MPU_XPU_PRT4_START1_ADDR A:0xf9af1444
y.create.l HWIO_PERIPH_SS_QPIC_QPIC_MPU_XPU_PRT5_START1_ADDR A:0xf9af14c4
y.create.l HWIO_PERIPH_SS_QPIC_QPIC_MPU_XPU_PRT6_START1_ADDR A:0xf9af1544
y.create.l HWIO_PERIPH_SS_QPIC_QPIC_MPU_XPU_PRT7_START1_ADDR A:0xf9af15c4
y.create.l HWIO_PERIPH_SS_QPIC_QPIC_MPU_XPU_PRT0_END0_ADDR A:0xf9af1248
y.create.l HWIO_PERIPH_SS_QPIC_QPIC_MPU_XPU_PRT1_END0_ADDR A:0xf9af12c8
y.create.l HWIO_PERIPH_SS_QPIC_QPIC_MPU_XPU_PRT2_END0_ADDR A:0xf9af1348
y.create.l HWIO_PERIPH_SS_QPIC_QPIC_MPU_XPU_PRT3_END0_ADDR A:0xf9af13c8
y.create.l HWIO_PERIPH_SS_QPIC_QPIC_MPU_XPU_PRT4_END0_ADDR A:0xf9af1448
y.create.l HWIO_PERIPH_SS_QPIC_QPIC_MPU_XPU_PRT5_END0_ADDR A:0xf9af14c8
y.create.l HWIO_PERIPH_SS_QPIC_QPIC_MPU_XPU_PRT6_END0_ADDR A:0xf9af1548
y.create.l HWIO_PERIPH_SS_QPIC_QPIC_MPU_XPU_PRT7_END0_ADDR A:0xf9af15c8
y.create.l HWIO_PERIPH_SS_QPIC_QPIC_MPU_XPU_PRT0_END1_ADDR A:0xf9af124c
y.create.l HWIO_PERIPH_SS_QPIC_QPIC_MPU_XPU_PRT1_END1_ADDR A:0xf9af12cc
y.create.l HWIO_PERIPH_SS_QPIC_QPIC_MPU_XPU_PRT2_END1_ADDR A:0xf9af134c
y.create.l HWIO_PERIPH_SS_QPIC_QPIC_MPU_XPU_PRT3_END1_ADDR A:0xf9af13cc
y.create.l HWIO_PERIPH_SS_QPIC_QPIC_MPU_XPU_PRT4_END1_ADDR A:0xf9af144c
y.create.l HWIO_PERIPH_SS_QPIC_QPIC_MPU_XPU_PRT5_END1_ADDR A:0xf9af14cc
y.create.l HWIO_PERIPH_SS_QPIC_QPIC_MPU_XPU_PRT6_END1_ADDR A:0xf9af154c
y.create.l HWIO_PERIPH_SS_QPIC_QPIC_MPU_XPU_PRT7_END1_ADDR A:0xf9af15cc
y.create.l HWIO_PERIPH_SS_QPIC_QPIC_MPU_XPU_PRT0_SCR_ADDR A:0xf9af1250
y.create.l HWIO_PERIPH_SS_QPIC_QPIC_MPU_XPU_PRT1_SCR_ADDR A:0xf9af12d0
y.create.l HWIO_PERIPH_SS_QPIC_QPIC_MPU_XPU_PRT2_SCR_ADDR A:0xf9af1350
y.create.l HWIO_PERIPH_SS_QPIC_QPIC_MPU_XPU_PRT3_SCR_ADDR A:0xf9af13d0
y.create.l HWIO_PERIPH_SS_QPIC_QPIC_MPU_XPU_PRT4_SCR_ADDR A:0xf9af1450
y.create.l HWIO_PERIPH_SS_QPIC_QPIC_MPU_XPU_PRT5_SCR_ADDR A:0xf9af14d0
y.create.l HWIO_PERIPH_SS_QPIC_QPIC_MPU_XPU_PRT6_SCR_ADDR A:0xf9af1550
y.create.l HWIO_PERIPH_SS_QPIC_QPIC_MPU_XPU_PRT7_SCR_ADDR A:0xf9af15d0
y.create.l HWIO_PERIPH_SS_QPIC_QPIC_MPU_XPU_PRT0_MCR_ADDR A:0xf9af1254
y.create.l HWIO_PERIPH_SS_QPIC_QPIC_MPU_XPU_PRT1_MCR_ADDR A:0xf9af12d4
y.create.l HWIO_PERIPH_SS_QPIC_QPIC_MPU_XPU_PRT2_MCR_ADDR A:0xf9af1354
y.create.l HWIO_PERIPH_SS_QPIC_QPIC_MPU_XPU_PRT3_MCR_ADDR A:0xf9af13d4
y.create.l HWIO_PERIPH_SS_QPIC_QPIC_MPU_XPU_PRT4_MCR_ADDR A:0xf9af1454
y.create.l HWIO_PERIPH_SS_QPIC_QPIC_MPU_XPU_PRT5_MCR_ADDR A:0xf9af14d4
y.create.l HWIO_PERIPH_SS_QPIC_QPIC_MPU_XPU_PRT6_MCR_ADDR A:0xf9af1554
y.create.l HWIO_PERIPH_SS_QPIC_QPIC_MPU_XPU_PRT7_MCR_ADDR A:0xf9af15d4
y.create.l HWIO_PERIPH_SS_QPIC_QPIC_MPU_XPU_PRT0_CNTL0_ADDR A:0xf9af1258
y.create.l HWIO_PERIPH_SS_QPIC_QPIC_MPU_XPU_PRT1_CNTL0_ADDR A:0xf9af12d8
y.create.l HWIO_PERIPH_SS_QPIC_QPIC_MPU_XPU_PRT2_CNTL0_ADDR A:0xf9af1358
y.create.l HWIO_PERIPH_SS_QPIC_QPIC_MPU_XPU_PRT3_CNTL0_ADDR A:0xf9af13d8
y.create.l HWIO_PERIPH_SS_QPIC_QPIC_MPU_XPU_PRT4_CNTL0_ADDR A:0xf9af1458
y.create.l HWIO_PERIPH_SS_QPIC_QPIC_MPU_XPU_PRT5_CNTL0_ADDR A:0xf9af14d8
y.create.l HWIO_PERIPH_SS_QPIC_QPIC_MPU_XPU_PRT6_CNTL0_ADDR A:0xf9af1558
y.create.l HWIO_PERIPH_SS_QPIC_QPIC_MPU_XPU_PRT7_CNTL0_ADDR A:0xf9af15d8
y.create.l HWIO_PERIPH_SS_QPIC_QPIC_MPU_XPU_PRT0_CNTL1_ADDR A:0xf9af125c
y.create.l HWIO_PERIPH_SS_QPIC_QPIC_MPU_XPU_PRT1_CNTL1_ADDR A:0xf9af12dc
y.create.l HWIO_PERIPH_SS_QPIC_QPIC_MPU_XPU_PRT2_CNTL1_ADDR A:0xf9af135c
y.create.l HWIO_PERIPH_SS_QPIC_QPIC_MPU_XPU_PRT3_CNTL1_ADDR A:0xf9af13dc
y.create.l HWIO_PERIPH_SS_QPIC_QPIC_MPU_XPU_PRT4_CNTL1_ADDR A:0xf9af145c
y.create.l HWIO_PERIPH_SS_QPIC_QPIC_MPU_XPU_PRT5_CNTL1_ADDR A:0xf9af14dc
y.create.l HWIO_PERIPH_SS_QPIC_QPIC_MPU_XPU_PRT6_CNTL1_ADDR A:0xf9af155c
y.create.l HWIO_PERIPH_SS_QPIC_QPIC_MPU_XPU_PRT7_CNTL1_ADDR A:0xf9af15dc
y.create.l HWIO_PERIPH_SS_PDM_TCXO_PDM0_TOP_CTL_ADDR A:0xf9b10000
y.create.l HWIO_PERIPH_SS_PDM_PDM0_CTL_ADDR A:0xf9b10004
y.create.l HWIO_PERIPH_SS_PDM_WEB_TCXO4_TEST_ADDR A:0xf9b10008
y.create.l HWIO_PERIPH_SS_PDM_TCXO_PDM1_TOP_CTL_ADDR A:0xf9b11000
y.create.l HWIO_PERIPH_SS_PDM_PDM1_CTL_ADDR A:0xf9b11004
y.create.l HWIO_PERIPH_SS_PDM_TCXO_PDM2_TOP_CTL_ADDR A:0xf9b12000
y.create.l HWIO_PERIPH_SS_PDM_PDM2_CTL_ADDR A:0xf9b12004
y.create.l HWIO_PERIPH_SS_PDM_GP_MN_CLK_MDIV_ADDR A:0xf9b13000
y.create.l HWIO_PERIPH_SS_PDM_GP_MN_CLK_NDIV_ADDR A:0xf9b13004
y.create.l HWIO_PERIPH_SS_PDM_GP_MN_CLK_DUTY_ADDR A:0xf9b13008
y.create.l HWIO_PERIPH_SS_USB3PHY_QSERDES_COM_SYS_CLK_CTRL_ADDR A:0xf9b38000
y.create.l HWIO_PERIPH_SS_USB3PHY_QSERDES_COM_PLL_VCOTAIL_EN_ADDR A:0xf9b38004
y.create.l HWIO_PERIPH_SS_USB3PHY_QSERDES_COM_CMN_MODE_ADDR A:0xf9b38008
y.create.l HWIO_PERIPH_SS_USB3PHY_QSERDES_COM_IE_TRIM_ADDR A:0xf9b3800c
y.create.l HWIO_PERIPH_SS_USB3PHY_QSERDES_COM_IP_TRIM_ADDR A:0xf9b38010
y.create.l HWIO_PERIPH_SS_USB3PHY_QSERDES_COM_PLL_CNTRL_ADDR A:0xf9b38014
y.create.l HWIO_PERIPH_SS_USB3PHY_QSERDES_COM_PLL_PHSEL_CONTROL_ADDR A:0xf9b38018
y.create.l HWIO_PERIPH_SS_USB3PHY_QSERDES_COM_IPTAT_TRIM_VCCA_TX_SEL_ADDR A:0xf9b3801c
y.create.l HWIO_PERIPH_SS_USB3PHY_QSERDES_COM_PLL_PHSEL_DC_ADDR A:0xf9b38020
y.create.l HWIO_PERIPH_SS_USB3PHY_QSERDES_COM_PLL_IP_SETI_ADDR A:0xf9b38024
y.create.l HWIO_PERIPH_SS_USB3PHY_QSERDES_COM_CORE_CLK_IN_SYNC_SEL_ADDR A:0xf9b38028
y.create.l HWIO_PERIPH_SS_USB3PHY_QSERDES_COM_PLL_BKG_KVCO_CAL_EN_ADDR A:0xf9b3802c
y.create.l HWIO_PERIPH_SS_USB3PHY_QSERDES_COM_BIAS_EN_CLKBUFLR_EN_ADDR A:0xf9b38030
y.create.l HWIO_PERIPH_SS_USB3PHY_QSERDES_COM_PLL_CP_SETI_ADDR A:0xf9b38034
y.create.l HWIO_PERIPH_SS_USB3PHY_QSERDES_COM_PLL_IP_SETP_ADDR A:0xf9b38038
y.create.l HWIO_PERIPH_SS_USB3PHY_QSERDES_COM_PLL_CP_SETP_ADDR A:0xf9b3803c
y.create.l HWIO_PERIPH_SS_USB3PHY_QSERDES_COM_ATB_SEL1_ADDR A:0xf9b38040
y.create.l HWIO_PERIPH_SS_USB3PHY_QSERDES_COM_ATB_SEL2_ADDR A:0xf9b38044
y.create.l HWIO_PERIPH_SS_USB3PHY_QSERDES_COM_SYSCLK_EN_SEL_TXBAND_ADDR A:0xf9b38048
y.create.l HWIO_PERIPH_SS_USB3PHY_QSERDES_COM_RESETSM_CNTRL_ADDR A:0xf9b3804c
y.create.l HWIO_PERIPH_SS_USB3PHY_QSERDES_COM_RESETSM_CNTRL2_ADDR A:0xf9b38050
y.create.l HWIO_PERIPH_SS_USB3PHY_QSERDES_COM_RESETSM_CNTRL3_ADDR A:0xf9b38054
y.create.l HWIO_PERIPH_SS_USB3PHY_QSERDES_COM_DIV_REF1_ADDR A:0xf9b38058
y.create.l HWIO_PERIPH_SS_USB3PHY_QSERDES_COM_DIV_REF2_ADDR A:0xf9b3805c
y.create.l HWIO_PERIPH_SS_USB3PHY_QSERDES_COM_KVCO_COUNT1_ADDR A:0xf9b38060
y.create.l HWIO_PERIPH_SS_USB3PHY_QSERDES_COM_KVCO_COUNT2_ADDR A:0xf9b38064
y.create.l HWIO_PERIPH_SS_USB3PHY_QSERDES_COM_KVCO_CAL_CNTRL_ADDR A:0xf9b38068
y.create.l HWIO_PERIPH_SS_USB3PHY_QSERDES_COM_KVCO_CODE_ADDR A:0xf9b3806c
y.create.l HWIO_PERIPH_SS_USB3PHY_QSERDES_COM_VREF_CFG1_ADDR A:0xf9b38070
y.create.l HWIO_PERIPH_SS_USB3PHY_QSERDES_COM_VREF_CFG2_ADDR A:0xf9b38074
y.create.l HWIO_PERIPH_SS_USB3PHY_QSERDES_COM_VREF_CFG3_ADDR A:0xf9b38078
y.create.l HWIO_PERIPH_SS_USB3PHY_QSERDES_COM_VREF_CFG4_ADDR A:0xf9b3807c
y.create.l HWIO_PERIPH_SS_USB3PHY_QSERDES_COM_VREF_CFG5_ADDR A:0xf9b38080
y.create.l HWIO_PERIPH_SS_USB3PHY_QSERDES_COM_VREF_CFG6_ADDR A:0xf9b38084
y.create.l HWIO_PERIPH_SS_USB3PHY_QSERDES_COM_PLLLOCK_CMP1_ADDR A:0xf9b38088
y.create.l HWIO_PERIPH_SS_USB3PHY_QSERDES_COM_PLLLOCK_CMP2_ADDR A:0xf9b3808c
y.create.l HWIO_PERIPH_SS_USB3PHY_QSERDES_COM_PLLLOCK_CMP3_ADDR A:0xf9b38090
y.create.l HWIO_PERIPH_SS_USB3PHY_QSERDES_COM_PLLLOCK_CMP_EN_ADDR A:0xf9b38094
y.create.l HWIO_PERIPH_SS_USB3PHY_QSERDES_COM_BGTC_ADDR A:0xf9b38098
y.create.l HWIO_PERIPH_SS_USB3PHY_QSERDES_COM_PLL_TEST_UPDN_ADDR A:0xf9b3809c
y.create.l HWIO_PERIPH_SS_USB3PHY_QSERDES_COM_PLL_VCO_TUNE_ADDR A:0xf9b380a0
y.create.l HWIO_PERIPH_SS_USB3PHY_QSERDES_COM_DEC_START1_ADDR A:0xf9b380a4
y.create.l HWIO_PERIPH_SS_USB3PHY_QSERDES_COM_PLL_AMP_OS_ADDR A:0xf9b380a8
y.create.l HWIO_PERIPH_SS_USB3PHY_QSERDES_COM_SSC_EN_CENTER_ADDR A:0xf9b380ac
y.create.l HWIO_PERIPH_SS_USB3PHY_QSERDES_COM_SSC_ADJ_PER1_ADDR A:0xf9b380b0
y.create.l HWIO_PERIPH_SS_USB3PHY_QSERDES_COM_SSC_ADJ_PER2_ADDR A:0xf9b380b4
y.create.l HWIO_PERIPH_SS_USB3PHY_QSERDES_COM_SSC_PER1_ADDR A:0xf9b380b8
y.create.l HWIO_PERIPH_SS_USB3PHY_QSERDES_COM_SSC_PER2_ADDR A:0xf9b380bc
y.create.l HWIO_PERIPH_SS_USB3PHY_QSERDES_COM_SSC_STEP_SIZE1_ADDR A:0xf9b380c0
y.create.l HWIO_PERIPH_SS_USB3PHY_QSERDES_COM_SSC_STEP_SIZE2_ADDR A:0xf9b380c4
y.create.l HWIO_PERIPH_SS_USB3PHY_QSERDES_COM_RES_CODE_UP_ADDR A:0xf9b380c8
y.create.l HWIO_PERIPH_SS_USB3PHY_QSERDES_COM_RES_CODE_DN_ADDR A:0xf9b380cc
y.create.l HWIO_PERIPH_SS_USB3PHY_QSERDES_COM_RES_CODE_UP_OFFSET_ADDR A:0xf9b380d0
y.create.l HWIO_PERIPH_SS_USB3PHY_QSERDES_COM_RES_CODE_DN_OFFSET_ADDR A:0xf9b380d4
y.create.l HWIO_PERIPH_SS_USB3PHY_QSERDES_COM_RES_CODE_START_SEG1_ADDR A:0xf9b380d8
y.create.l HWIO_PERIPH_SS_USB3PHY_QSERDES_COM_RES_CODE_START_SEG2_ADDR A:0xf9b380dc
y.create.l HWIO_PERIPH_SS_USB3PHY_QSERDES_COM_RES_CODE_CAL_CSR_ADDR A:0xf9b380e0
y.create.l HWIO_PERIPH_SS_USB3PHY_QSERDES_COM_RES_CODE_ADDR A:0xf9b380e4
y.create.l HWIO_PERIPH_SS_USB3PHY_QSERDES_COM_RES_TRIM_CONTROL_ADDR A:0xf9b380e8
y.create.l HWIO_PERIPH_SS_USB3PHY_QSERDES_COM_RES_TRIM_CONTROL2_ADDR A:0xf9b380ec
y.create.l HWIO_PERIPH_SS_USB3PHY_QSERDES_COM_RES_TRIM_EN_VCOCALDONE_ADDR A:0xf9b380f0
y.create.l HWIO_PERIPH_SS_USB3PHY_QSERDES_COM_FAUX_EN_ADDR A:0xf9b380f4
y.create.l HWIO_PERIPH_SS_USB3PHY_QSERDES_COM_DIV_FRAC_START1_ADDR A:0xf9b380f8
y.create.l HWIO_PERIPH_SS_USB3PHY_QSERDES_COM_DIV_FRAC_START2_ADDR A:0xf9b380fc
y.create.l HWIO_PERIPH_SS_USB3PHY_QSERDES_COM_DIV_FRAC_START3_ADDR A:0xf9b38100
y.create.l HWIO_PERIPH_SS_USB3PHY_QSERDES_COM_DEC_START2_ADDR A:0xf9b38104
y.create.l HWIO_PERIPH_SS_USB3PHY_QSERDES_COM_PLL_RXTXEPCLK_EN_ADDR A:0xf9b38108
y.create.l HWIO_PERIPH_SS_USB3PHY_QSERDES_COM_PLL_CRCTRL_ADDR A:0xf9b3810c
y.create.l HWIO_PERIPH_SS_USB3PHY_QSERDES_COM_PLL_CLKEPDIV_ADDR A:0xf9b38110
y.create.l HWIO_PERIPH_SS_USB3PHY_QSERDES_COM_PLL_FREQUPDATE_ADDR A:0xf9b38114
y.create.l HWIO_PERIPH_SS_USB3PHY_QSERDES_COM_PLL_BKGCAL_TRIM_UP_ADDR A:0xf9b38118
y.create.l HWIO_PERIPH_SS_USB3PHY_QSERDES_COM_PLL_BKGCAL_TRIM_DN_ADDR A:0xf9b3811c
y.create.l HWIO_PERIPH_SS_USB3PHY_QSERDES_COM_PLL_BKGCAL_TRIM_MUX_ADDR A:0xf9b38120
y.create.l HWIO_PERIPH_SS_USB3PHY_QSERDES_COM_PLL_BKGCAL_VREF_CFG_ADDR A:0xf9b38124
y.create.l HWIO_PERIPH_SS_USB3PHY_QSERDES_COM_PLL_BKGCAL_DIV_REF1_ADDR A:0xf9b38128
y.create.l HWIO_PERIPH_SS_USB3PHY_QSERDES_COM_PLL_BKGCAL_DIV_REF2_ADDR A:0xf9b3812c
y.create.l HWIO_PERIPH_SS_USB3PHY_QSERDES_COM_MUXADDR_ADDR A:0xf9b38130
y.create.l HWIO_PERIPH_SS_USB3PHY_QSERDES_COM_LOW_POWER_RO_CONTROL_ADDR A:0xf9b38134
y.create.l HWIO_PERIPH_SS_USB3PHY_QSERDES_COM_POST_DIVIDER_CONTROL_ADDR A:0xf9b38138
y.create.l HWIO_PERIPH_SS_USB3PHY_QSERDES_COM_HR_OCLK2_DIVIDER_ADDR A:0xf9b3813c
y.create.l HWIO_PERIPH_SS_USB3PHY_QSERDES_COM_HR_OCLK3_DIVIDER_ADDR A:0xf9b38140
y.create.l HWIO_PERIPH_SS_USB3PHY_QSERDES_COM_PLL_VCO_HIGH_ADDR A:0xf9b38144
y.create.l HWIO_PERIPH_SS_USB3PHY_QSERDES_COM_RESET_SM_ADDR A:0xf9b38148
y.create.l HWIO_PERIPH_SS_USB3PHY_QSERDES_COM_MUXVAL_ADDR A:0xf9b3814c
y.create.l HWIO_PERIPH_SS_USB3PHY_QSERDES_TX_BIST_MODE_LANENO_ADDR A:0xf9b38200
y.create.l HWIO_PERIPH_SS_USB3PHY_QSERDES_TX_CLKBUF_ENABLE_ADDR A:0xf9b38204
y.create.l HWIO_PERIPH_SS_USB3PHY_QSERDES_TX_TX_EMP_POST1_LVL_ADDR A:0xf9b38208
y.create.l HWIO_PERIPH_SS_USB3PHY_QSERDES_TX_TX_DRV_LVL_ADDR A:0xf9b3820c
y.create.l HWIO_PERIPH_SS_USB3PHY_QSERDES_TX_RESET_TSYNC_EN_ADDR A:0xf9b38210
y.create.l HWIO_PERIPH_SS_USB3PHY_QSERDES_TX_LPB_EN_ADDR A:0xf9b38214
y.create.l HWIO_PERIPH_SS_USB3PHY_QSERDES_TX_RES_CODE_UP_ADDR A:0xf9b38218
y.create.l HWIO_PERIPH_SS_USB3PHY_QSERDES_TX_RES_CODE_DN_ADDR A:0xf9b3821c
y.create.l HWIO_PERIPH_SS_USB3PHY_QSERDES_TX_PERL_LENGTH1_ADDR A:0xf9b38220
y.create.l HWIO_PERIPH_SS_USB3PHY_QSERDES_TX_PERL_LENGTH2_ADDR A:0xf9b38224
y.create.l HWIO_PERIPH_SS_USB3PHY_QSERDES_TX_SERDES_BYP_EN_OUT_ADDR A:0xf9b38228
y.create.l HWIO_PERIPH_SS_USB3PHY_QSERDES_TX_HIGHZ_TRANSCEIVEREN_BIAS_DRVR_EN_ADDR A:0xf9b3822c
y.create.l HWIO_PERIPH_SS_USB3PHY_QSERDES_TX_PARRATE_REC_DETECT_IDLE_EN_ADDR A:0xf9b38230
y.create.l HWIO_PERIPH_SS_USB3PHY_QSERDES_TX_BIST_PATTERN1_ADDR A:0xf9b38234
y.create.l HWIO_PERIPH_SS_USB3PHY_QSERDES_TX_BIST_PATTERN2_ADDR A:0xf9b38238
y.create.l HWIO_PERIPH_SS_USB3PHY_QSERDES_TX_BIST_PATTERN3_ADDR A:0xf9b3823c
y.create.l HWIO_PERIPH_SS_USB3PHY_QSERDES_TX_BIST_PATTERN4_ADDR A:0xf9b38240
y.create.l HWIO_PERIPH_SS_USB3PHY_QSERDES_TX_BIST_PATTERN5_ADDR A:0xf9b38244
y.create.l HWIO_PERIPH_SS_USB3PHY_QSERDES_TX_BIST_PATTERN6_ADDR A:0xf9b38248
y.create.l HWIO_PERIPH_SS_USB3PHY_QSERDES_TX_BIST_PATTERN7_ADDR A:0xf9b3824c
y.create.l HWIO_PERIPH_SS_USB3PHY_QSERDES_TX_BIST_PATTERN8_ADDR A:0xf9b38250
y.create.l HWIO_PERIPH_SS_USB3PHY_QSERDES_TX_LANE_MODE_ADDR A:0xf9b38254
y.create.l HWIO_PERIPH_SS_USB3PHY_QSERDES_TX_IDAC_CAL_LANE_MODE_ADDR A:0xf9b38258
y.create.l HWIO_PERIPH_SS_USB3PHY_QSERDES_TX_IDAC_CAL_LANE_MODE_CONFIGURATION_ADDR A:0xf9b3825c
y.create.l HWIO_PERIPH_SS_USB3PHY_QSERDES_TX_ATB_SEL1_ADDR A:0xf9b38260
y.create.l HWIO_PERIPH_SS_USB3PHY_QSERDES_TX_ATB_SEL2_ADDR A:0xf9b38264
y.create.l HWIO_PERIPH_SS_USB3PHY_QSERDES_TX_RCV_DETECT_LVL_ADDR A:0xf9b38268
y.create.l HWIO_PERIPH_SS_USB3PHY_QSERDES_TX_PRBS_SEED1_ADDR A:0xf9b3826c
y.create.l HWIO_PERIPH_SS_USB3PHY_QSERDES_TX_PRBS_SEED2_ADDR A:0xf9b38270
y.create.l HWIO_PERIPH_SS_USB3PHY_QSERDES_TX_PRBS_SEED3_ADDR A:0xf9b38274
y.create.l HWIO_PERIPH_SS_USB3PHY_QSERDES_TX_PRBS_SEED4_ADDR A:0xf9b38278
y.create.l HWIO_PERIPH_SS_USB3PHY_QSERDES_TX_RESET_GEN_ADDR A:0xf9b3827c
y.create.l HWIO_PERIPH_SS_USB3PHY_QSERDES_TX_TRAN_DRVR_EMP_EN_ADDR A:0xf9b38280
y.create.l HWIO_PERIPH_SS_USB3PHY_QSERDES_TX_TX_INTERFACE_MODE_ADDR A:0xf9b38284
y.create.l HWIO_PERIPH_SS_USB3PHY_QSERDES_TX_PWM_CTRL_ADDR A:0xf9b38288
y.create.l HWIO_PERIPH_SS_USB3PHY_QSERDES_TX_PWM_DATA_ADDR A:0xf9b3828c
y.create.l HWIO_PERIPH_SS_USB3PHY_QSERDES_TX_PWM_ENC_DIV_CTRL_ADDR A:0xf9b38290
y.create.l HWIO_PERIPH_SS_USB3PHY_QSERDES_TX_VMODE_CTRL1_ADDR A:0xf9b38294
y.create.l HWIO_PERIPH_SS_USB3PHY_QSERDES_TX_VMODE_CTRL2_ADDR A:0xf9b38298
y.create.l HWIO_PERIPH_SS_USB3PHY_QSERDES_TX_VMODE_CTRL3_ADDR A:0xf9b3829c
y.create.l HWIO_PERIPH_SS_USB3PHY_QSERDES_TX_VMODE_CTRL4_ADDR A:0xf9b382a0
y.create.l HWIO_PERIPH_SS_USB3PHY_QSERDES_TX_VMODE_CTRL5_ADDR A:0xf9b382a4
y.create.l HWIO_PERIPH_SS_USB3PHY_QSERDES_TX_VMODE_CTRL6_ADDR A:0xf9b382a8
y.create.l HWIO_PERIPH_SS_USB3PHY_QSERDES_TX_VMODE_CTRL7_ADDR A:0xf9b382ac
y.create.l HWIO_PERIPH_SS_USB3PHY_QSERDES_TX_TX_ALOG_INTF_OBSV_CNTL_ADDR A:0xf9b382b0
y.create.l HWIO_PERIPH_SS_USB3PHY_QSERDES_TX_BIST_STATUS_ADDR A:0xf9b382b4
y.create.l HWIO_PERIPH_SS_USB3PHY_QSERDES_TX_BIST_ERROR_COUNT1_ADDR A:0xf9b382b8
y.create.l HWIO_PERIPH_SS_USB3PHY_QSERDES_TX_BIST_ERROR_COUNT2_ADDR A:0xf9b382bc
y.create.l HWIO_PERIPH_SS_USB3PHY_QSERDES_TX_TX_ALOG_INTF_OBSV_ADDR A:0xf9b382c0
y.create.l HWIO_PERIPH_SS_USB3PHY_QSERDES_TX_PWM_DEC_STATUS_ADDR A:0xf9b382c4
y.create.l HWIO_PERIPH_SS_USB3PHY_QSERDES_RX_CDR_CONTROL1_ADDR A:0xf9b38400
y.create.l HWIO_PERIPH_SS_USB3PHY_QSERDES_RX_CDR_CONTROL2_ADDR A:0xf9b38404
y.create.l HWIO_PERIPH_SS_USB3PHY_QSERDES_RX_CDR_CONTROL_HALF_ADDR A:0xf9b38408
y.create.l HWIO_PERIPH_SS_USB3PHY_QSERDES_RX_CDR_CONTROL_QUARTER_ADDR A:0xf9b3840c
y.create.l HWIO_PERIPH_SS_USB3PHY_QSERDES_RX_CDR_CONTROL_EIGHTH_ADDR A:0xf9b38410
y.create.l HWIO_PERIPH_SS_USB3PHY_QSERDES_RX_UCDR_FO_GAIN_ADDR A:0xf9b38414
y.create.l HWIO_PERIPH_SS_USB3PHY_QSERDES_RX_UCDR_SO_GAIN_ADDR A:0xf9b38418
y.create.l HWIO_PERIPH_SS_USB3PHY_QSERDES_RX_UCDR_SO_SATURATION_AND_ENABLE_ADDR A:0xf9b3841c
y.create.l HWIO_PERIPH_SS_USB3PHY_QSERDES_RX_UCDR_FO_TO_SO_DELAY_ADDR A:0xf9b38420
y.create.l HWIO_PERIPH_SS_USB3PHY_QSERDES_RX_AUX_CONTROL_ADDR A:0xf9b38424
y.create.l HWIO_PERIPH_SS_USB3PHY_QSERDES_RX_AUX_DATA_TCOARSE_ADDR A:0xf9b38428
y.create.l HWIO_PERIPH_SS_USB3PHY_QSERDES_RX_AUX_DATA_TFINE_LSB_ADDR A:0xf9b3842c
y.create.l HWIO_PERIPH_SS_USB3PHY_QSERDES_RX_AUX_DATA_TFINE_MSB_ADDR A:0xf9b38430
y.create.l HWIO_PERIPH_SS_USB3PHY_QSERDES_RX_RCLK_AUXDATA_SEL_ADDR A:0xf9b38434
y.create.l HWIO_PERIPH_SS_USB3PHY_QSERDES_RX_AC_JTAG_ENABLE_ADDR A:0xf9b38438
y.create.l HWIO_PERIPH_SS_USB3PHY_QSERDES_RX_AC_JTAG_INITP_ADDR A:0xf9b3843c
y.create.l HWIO_PERIPH_SS_USB3PHY_QSERDES_RX_AC_JTAG_INITN_ADDR A:0xf9b38440
y.create.l HWIO_PERIPH_SS_USB3PHY_QSERDES_RX_AC_JTAG_LVL_ADDR A:0xf9b38444
y.create.l HWIO_PERIPH_SS_USB3PHY_QSERDES_RX_AC_JTAG_MODE_ADDR A:0xf9b38448
y.create.l HWIO_PERIPH_SS_USB3PHY_QSERDES_RX_AC_JTAG_RESET_ADDR A:0xf9b3844c
y.create.l HWIO_PERIPH_SS_USB3PHY_QSERDES_RX_RX_RCVR_IQ_EN_ADDR A:0xf9b38450
y.create.l HWIO_PERIPH_SS_USB3PHY_QSERDES_RX_RX_IDAC_I_DC_OFFSETS_ADDR A:0xf9b38454
y.create.l HWIO_PERIPH_SS_USB3PHY_QSERDES_RX_RX_IDAC_Q_DC_OFFSETS_ADDR A:0xf9b38458
y.create.l HWIO_PERIPH_SS_USB3PHY_QSERDES_RX_RX_IDAC_A_DC_OFFSETS_ADDR A:0xf9b3845c
y.create.l HWIO_PERIPH_SS_USB3PHY_QSERDES_RX_RX_IDAC_EN_ADDR A:0xf9b38460
y.create.l HWIO_PERIPH_SS_USB3PHY_QSERDES_RX_RX_IDAC_CTRL0_ADDR A:0xf9b38464
y.create.l HWIO_PERIPH_SS_USB3PHY_QSERDES_RX_RX_IDAC_CTRL1_ADDR A:0xf9b38468
y.create.l HWIO_PERIPH_SS_USB3PHY_QSERDES_RX_RX_EOM_EN_ADDR A:0xf9b3846c
y.create.l HWIO_PERIPH_SS_USB3PHY_QSERDES_RX_RX_EOM_CTRL0_ADDR A:0xf9b38470
y.create.l HWIO_PERIPH_SS_USB3PHY_QSERDES_RX_RX_EOM_CTRL1_ADDR A:0xf9b38474
y.create.l HWIO_PERIPH_SS_USB3PHY_QSERDES_RX_RX_EOM_CTRL2_ADDR A:0xf9b38478
y.create.l HWIO_PERIPH_SS_USB3PHY_QSERDES_RX_RX_EOM_CTRL3_ADDR A:0xf9b3847c
y.create.l HWIO_PERIPH_SS_USB3PHY_QSERDES_RX_RX_EOM_CTRL4_ADDR A:0xf9b38480
y.create.l HWIO_PERIPH_SS_USB3PHY_QSERDES_RX_RX_EOM_CTRL5_ADDR A:0xf9b38484
y.create.l HWIO_PERIPH_SS_USB3PHY_QSERDES_RX_RX_EOM_CTRL6_ADDR A:0xf9b38488
y.create.l HWIO_PERIPH_SS_USB3PHY_QSERDES_RX_RX_EOM_CTRL7_ADDR A:0xf9b3848c
y.create.l HWIO_PERIPH_SS_USB3PHY_QSERDES_RX_RX_EOM_CTRL8_ADDR A:0xf9b38490
y.create.l HWIO_PERIPH_SS_USB3PHY_QSERDES_RX_RX_EOM_CTRL9_ADDR A:0xf9b38494
y.create.l HWIO_PERIPH_SS_USB3PHY_QSERDES_RX_RX_EOM_CTRL10_ADDR A:0xf9b38498
y.create.l HWIO_PERIPH_SS_USB3PHY_QSERDES_RX_RX_EOM_CTRL11_ADDR A:0xf9b3849c
y.create.l HWIO_PERIPH_SS_USB3PHY_QSERDES_RX_RX_HIGHZ_HIGHRATE_ADDR A:0xf9b384a0
y.create.l HWIO_PERIPH_SS_USB3PHY_QSERDES_RX_RX_TERM_AC_BYPASS_DC_COUPLE_OFFSET_ADDR A:0xf9b384a4
y.create.l HWIO_PERIPH_SS_USB3PHY_QSERDES_RX_RX_EQ_GAIN1_LSB_ADDR A:0xf9b384a8
y.create.l HWIO_PERIPH_SS_USB3PHY_QSERDES_RX_RX_EQ_GAIN1_MSB_ADDR A:0xf9b384ac
y.create.l HWIO_PERIPH_SS_USB3PHY_QSERDES_RX_RX_EQ_GAIN2_LSB_ADDR A:0xf9b384b0
y.create.l HWIO_PERIPH_SS_USB3PHY_QSERDES_RX_RX_EQ_GAIN2_MSB_ADDR A:0xf9b384b4
y.create.l HWIO_PERIPH_SS_USB3PHY_QSERDES_RX_RX_EQU_ADAPTOR_CNTRL1_ADDR A:0xf9b384b8
y.create.l HWIO_PERIPH_SS_USB3PHY_QSERDES_RX_RX_EQU_ADAPTOR_CNTRL2_ADDR A:0xf9b384bc
y.create.l HWIO_PERIPH_SS_USB3PHY_QSERDES_RX_RX_EQU_ADAPTOR_CNTRL3_ADDR A:0xf9b384c0
y.create.l HWIO_PERIPH_SS_USB3PHY_QSERDES_RX_RX_EQU_ADAPTOR_CNTRL4_ADDR A:0xf9b384c4
y.create.l HWIO_PERIPH_SS_USB3PHY_QSERDES_RX_RX_IDAC_CAL_CONFIGURATION_ADDR A:0xf9b384c8
y.create.l HWIO_PERIPH_SS_USB3PHY_QSERDES_RX_RX_IDAC_CAL_CONFIGURATION_2_ADDR A:0xf9b384cc
y.create.l HWIO_PERIPH_SS_USB3PHY_QSERDES_RX_RX_IDAC_TSETTLE_LOW_ADDR A:0xf9b384d0
y.create.l HWIO_PERIPH_SS_USB3PHY_QSERDES_RX_RX_IDAC_TSETTLE_HIGH_ADDR A:0xf9b384d4
y.create.l HWIO_PERIPH_SS_USB3PHY_QSERDES_RX_RX_IDAC_ENDSAMP_LOW_ADDR A:0xf9b384d8
y.create.l HWIO_PERIPH_SS_USB3PHY_QSERDES_RX_RX_IDAC_ENDSAMP_HIGH_ADDR A:0xf9b384dc
y.create.l HWIO_PERIPH_SS_USB3PHY_QSERDES_RX_RX_IDAC_MIDPOINT_LOW_ADDR A:0xf9b384e0
y.create.l HWIO_PERIPH_SS_USB3PHY_QSERDES_RX_RX_IDAC_MIDPOINT_HIGH_ADDR A:0xf9b384e4
y.create.l HWIO_PERIPH_SS_USB3PHY_QSERDES_RX_RX_EQ_OFFSET_LSB_ADDR A:0xf9b384e8
y.create.l HWIO_PERIPH_SS_USB3PHY_QSERDES_RX_RX_EQ_OFFSET_MSB_ADDR A:0xf9b384ec
y.create.l HWIO_PERIPH_SS_USB3PHY_QSERDES_RX_RX_EQ_OFFSET_ADAPTOR_CNTRL1_ADDR A:0xf9b384f0
y.create.l HWIO_PERIPH_SS_USB3PHY_QSERDES_RX_RX_OFFSET_ADAPTOR_CNTRL2_ADDR A:0xf9b384f4
y.create.l HWIO_PERIPH_SS_USB3PHY_QSERDES_RX_SIGDET_ENABLES_ADDR A:0xf9b384f8
y.create.l HWIO_PERIPH_SS_USB3PHY_QSERDES_RX_SIGDET_ENABLES_2_ADDR A:0xf9b384fc
y.create.l HWIO_PERIPH_SS_USB3PHY_QSERDES_RX_SIGDET_CNTRL_ADDR A:0xf9b38500
y.create.l HWIO_PERIPH_SS_USB3PHY_QSERDES_RX_SIGDET_DEGLITCH_CNTRL_ADDR A:0xf9b38504
y.create.l HWIO_PERIPH_SS_USB3PHY_QSERDES_RX_SIGDET_TIMER_LIMIT_ADDR A:0xf9b38508
y.create.l HWIO_PERIPH_SS_USB3PHY_QSERDES_RX_RX_BAND_ADDR A:0xf9b3850c
y.create.l HWIO_PERIPH_SS_USB3PHY_QSERDES_RX_CDR_FREEZE_UP_DN_ADDR A:0xf9b38510
y.create.l HWIO_PERIPH_SS_USB3PHY_QSERDES_RX_RX_INTERFACE_MODE_ADDR A:0xf9b38514
y.create.l HWIO_PERIPH_SS_USB3PHY_QSERDES_RX_JITTER_GEN_MODE_ADDR A:0xf9b38518
y.create.l HWIO_PERIPH_SS_USB3PHY_QSERDES_RX_BUJ_AMP_ADDR A:0xf9b3851c
y.create.l HWIO_PERIPH_SS_USB3PHY_QSERDES_RX_SJ_AMP1_ADDR A:0xf9b38520
y.create.l HWIO_PERIPH_SS_USB3PHY_QSERDES_RX_SJ_AMP2_ADDR A:0xf9b38524
y.create.l HWIO_PERIPH_SS_USB3PHY_QSERDES_RX_SJ_PER1_ADDR A:0xf9b38528
y.create.l HWIO_PERIPH_SS_USB3PHY_QSERDES_RX_SJ_PER2_ADDR A:0xf9b3852c
y.create.l HWIO_PERIPH_SS_USB3PHY_QSERDES_RX_BUJ_STEP_FREQ1_ADDR A:0xf9b38530
y.create.l HWIO_PERIPH_SS_USB3PHY_QSERDES_RX_BUJ_STEP_FREQ2_ADDR A:0xf9b38534
y.create.l HWIO_PERIPH_SS_USB3PHY_QSERDES_RX_PPM_OFFSET1_ADDR A:0xf9b38538
y.create.l HWIO_PERIPH_SS_USB3PHY_QSERDES_RX_PPM_OFFSET2_ADDR A:0xf9b3853c
y.create.l HWIO_PERIPH_SS_USB3PHY_QSERDES_RX_SIGN_PPM_PERIOD1_ADDR A:0xf9b38540
y.create.l HWIO_PERIPH_SS_USB3PHY_QSERDES_RX_SIGN_PPM_PERIOD2_ADDR A:0xf9b38544
y.create.l HWIO_PERIPH_SS_USB3PHY_QSERDES_RX_SSC_CTRL_ADDR A:0xf9b38548
y.create.l HWIO_PERIPH_SS_USB3PHY_QSERDES_RX_SSC_COUNT1_ADDR A:0xf9b3854c
y.create.l HWIO_PERIPH_SS_USB3PHY_QSERDES_RX_SSC_COUNT2_ADDR A:0xf9b38550
y.create.l HWIO_PERIPH_SS_USB3PHY_QSERDES_RX_RX_ALOG_INTF_OBSV_CNTL_ADDR A:0xf9b38554
y.create.l HWIO_PERIPH_SS_USB3PHY_QSERDES_RX_PI_CTRL1_ADDR A:0xf9b38558
y.create.l HWIO_PERIPH_SS_USB3PHY_QSERDES_RX_PI_CTRL2_ADDR A:0xf9b3855c
y.create.l HWIO_PERIPH_SS_USB3PHY_QSERDES_RX_PI_QUAD_ADDR A:0xf9b38560
y.create.l HWIO_PERIPH_SS_USB3PHY_QSERDES_RX_IDATA1_ADDR A:0xf9b38564
y.create.l HWIO_PERIPH_SS_USB3PHY_QSERDES_RX_IDATA2_ADDR A:0xf9b38568
y.create.l HWIO_PERIPH_SS_USB3PHY_QSERDES_RX_AUX_DATA1_ADDR A:0xf9b3856c
y.create.l HWIO_PERIPH_SS_USB3PHY_QSERDES_RX_AUX_DATA2_ADDR A:0xf9b38570
y.create.l HWIO_PERIPH_SS_USB3PHY_QSERDES_RX_AC_JTAG_OUTP_ADDR A:0xf9b38574
y.create.l HWIO_PERIPH_SS_USB3PHY_QSERDES_RX_AC_JTAG_OUTN_ADDR A:0xf9b38578
y.create.l HWIO_PERIPH_SS_USB3PHY_QSERDES_RX_RX_SIGDET_ADDR A:0xf9b3857c
y.create.l HWIO_PERIPH_SS_USB3PHY_QSERDES_RX_RX_VDCOFF_ADDR A:0xf9b38580
y.create.l HWIO_PERIPH_SS_USB3PHY_QSERDES_RX_IDAC_CAL_ON_ADDR A:0xf9b38584
y.create.l HWIO_PERIPH_SS_USB3PHY_QSERDES_RX_IDAC_STATUS_I_ADDR A:0xf9b38588
y.create.l HWIO_PERIPH_SS_USB3PHY_QSERDES_RX_IDAC_STATUS_Q_ADDR A:0xf9b3858c
y.create.l HWIO_PERIPH_SS_USB3PHY_QSERDES_RX_IDAC_STATUS_A_ADDR A:0xf9b38590
y.create.l HWIO_PERIPH_SS_USB3PHY_QSERDES_RX_CALST_STATUS_I_ADDR A:0xf9b38594
y.create.l HWIO_PERIPH_SS_USB3PHY_QSERDES_RX_CALST_STATUS_Q_ADDR A:0xf9b38598
y.create.l HWIO_PERIPH_SS_USB3PHY_QSERDES_RX_CALST_STATUS_A_ADDR A:0xf9b3859c
y.create.l HWIO_PERIPH_SS_USB3PHY_QSERDES_RX_EOM_STATUS0_ADDR A:0xf9b385a0
y.create.l HWIO_PERIPH_SS_USB3PHY_QSERDES_RX_EOM_STATUS1_ADDR A:0xf9b385a4
y.create.l HWIO_PERIPH_SS_USB3PHY_QSERDES_RX_EOM_STATUS2_ADDR A:0xf9b385a8
y.create.l HWIO_PERIPH_SS_USB3PHY_QSERDES_RX_EOM_STATUS3_ADDR A:0xf9b385ac
y.create.l HWIO_PERIPH_SS_USB3PHY_QSERDES_RX_EOM_STATUS4_ADDR A:0xf9b385b0
y.create.l HWIO_PERIPH_SS_USB3PHY_QSERDES_RX_EOM_STATUS5_ADDR A:0xf9b385b4
y.create.l HWIO_PERIPH_SS_USB3PHY_QSERDES_RX_EOM_STATUS6_ADDR A:0xf9b385b8
y.create.l HWIO_PERIPH_SS_USB3PHY_QSERDES_RX_EOM_STATUS7_ADDR A:0xf9b385bc
y.create.l HWIO_PERIPH_SS_USB3PHY_QSERDES_RX_EOM_STATUS8_ADDR A:0xf9b385c0
y.create.l HWIO_PERIPH_SS_USB3PHY_QSERDES_RX_EOM_STATUS9_ADDR A:0xf9b385c4
y.create.l HWIO_PERIPH_SS_USB3PHY_QSERDES_RX_RX_ALOG_INTF_OBSV_ADDR A:0xf9b385c8
y.create.l HWIO_PERIPH_SS_USB3PHY_QSERDES_RX_READ_EQCODE_ADDR A:0xf9b385cc
y.create.l HWIO_PERIPH_SS_USB3PHY_QSERDES_RX_READ_OFFSETCODE_ADDR A:0xf9b385d0
y.create.l HWIO_PERIPH_SS_USB3PHY_PCIE_USB3_PHY_SW_RESET_ADDR A:0xf9b38600
y.create.l HWIO_PERIPH_SS_USB3PHY_PCIE_USB3_PHY_POWER_DOWN_CONTROL_ADDR A:0xf9b38604
y.create.l HWIO_PERIPH_SS_USB3PHY_PCIE_USB3_PHY_START_ADDR A:0xf9b38608
y.create.l HWIO_PERIPH_SS_USB3PHY_PCIE_USB3_PHY_TXMGN_V1_V0_ADDR A:0xf9b3860c
y.create.l HWIO_PERIPH_SS_USB3PHY_PCIE_USB3_PHY_TXMGN_V3_V2_ADDR A:0xf9b38610
y.create.l HWIO_PERIPH_SS_USB3PHY_PCIE_USB3_PHY_TXMGN_LS_V4_ADDR A:0xf9b38614
y.create.l HWIO_PERIPH_SS_USB3PHY_PCIE_USB3_PHY_TXDEEMPH_M6DB_V0_ADDR A:0xf9b38618
y.create.l HWIO_PERIPH_SS_USB3PHY_PCIE_USB3_PHY_TXDEEMPH_M3P5DB_V0_ADDR A:0xf9b3861c
y.create.l HWIO_PERIPH_SS_USB3PHY_PCIE_USB3_PHY_TXDEEMPH_M6DB_V1_ADDR A:0xf9b38620
y.create.l HWIO_PERIPH_SS_USB3PHY_PCIE_USB3_PHY_TXDEEMPH_M3P5DB_V1_ADDR A:0xf9b38624
y.create.l HWIO_PERIPH_SS_USB3PHY_PCIE_USB3_PHY_TXDEEMPH_M6DB_V2_ADDR A:0xf9b38628
y.create.l HWIO_PERIPH_SS_USB3PHY_PCIE_USB3_PHY_TXDEEMPH_M3P5DB_V2_ADDR A:0xf9b3862c
y.create.l HWIO_PERIPH_SS_USB3PHY_PCIE_USB3_PHY_TXDEEMPH_M6DB_V3_ADDR A:0xf9b38630
y.create.l HWIO_PERIPH_SS_USB3PHY_PCIE_USB3_PHY_TXDEEMPH_M3P5DB_V3_ADDR A:0xf9b38634
y.create.l HWIO_PERIPH_SS_USB3PHY_PCIE_USB3_PHY_TXDEEMPH_M6DB_V4_ADDR A:0xf9b38638
y.create.l HWIO_PERIPH_SS_USB3PHY_PCIE_USB3_PHY_TXDEEMPH_M3P5DB_V4_ADDR A:0xf9b3863c
y.create.l HWIO_PERIPH_SS_USB3PHY_PCIE_USB3_PHY_TXDEEMPH_M6DB_LS_ADDR A:0xf9b38640
y.create.l HWIO_PERIPH_SS_USB3PHY_PCIE_USB3_PHY_TXDEEMPH_M3P5DB_LS_ADDR A:0xf9b38644
y.create.l HWIO_PERIPH_SS_USB3PHY_PCIE_USB3_PHY_ENDPOINT_REFCLK_DRIVE_ADDR A:0xf9b38648
y.create.l HWIO_PERIPH_SS_USB3PHY_PCIE_USB3_PHY_RX_IDLE_DTCT_CNTRL_ADDR A:0xf9b3864c
y.create.l HWIO_PERIPH_SS_USB3PHY_PCIE_USB3_PHY_POWER_STATE_CONFIG1_ADDR A:0xf9b38650
y.create.l HWIO_PERIPH_SS_USB3PHY_PCIE_USB3_PHY_POWER_STATE_CONFIG2_ADDR A:0xf9b38654
y.create.l HWIO_PERIPH_SS_USB3PHY_PCIE_USB3_PHY_POWER_STATE_CONFIG3_ADDR A:0xf9b38658
y.create.l HWIO_PERIPH_SS_USB3PHY_PCIE_USB3_PHY_RCVR_DTCT_DLY_P1U2_L_ADDR A:0xf9b3865c
y.create.l HWIO_PERIPH_SS_USB3PHY_PCIE_USB3_PHY_RCVR_DTCT_DLY_P1U2_H_ADDR A:0xf9b38660
y.create.l HWIO_PERIPH_SS_USB3PHY_PCIE_USB3_PHY_RCVR_DTCT_DLY_U3_L_ADDR A:0xf9b38664
y.create.l HWIO_PERIPH_SS_USB3PHY_PCIE_USB3_PHY_RCVR_DTCT_DLY_U3_H_ADDR A:0xf9b38668
y.create.l HWIO_PERIPH_SS_USB3PHY_PCIE_USB3_PHY_LOCK_DETECT_CONFIG1_ADDR A:0xf9b3866c
y.create.l HWIO_PERIPH_SS_USB3PHY_PCIE_USB3_PHY_LOCK_DETECT_CONFIG2_ADDR A:0xf9b38670
y.create.l HWIO_PERIPH_SS_USB3PHY_PCIE_USB3_PHY_LOCK_DETECT_CONFIG3_ADDR A:0xf9b38674
y.create.l HWIO_PERIPH_SS_USB3PHY_PCIE_USB3_PHY_TSYNC_RSYNC_TIME_ADDR A:0xf9b38678
y.create.l HWIO_PERIPH_SS_USB3PHY_PCIE_USB3_PHY_SIGDET_LOW_2_IDLE_TIME_ADDR A:0xf9b3867c
y.create.l HWIO_PERIPH_SS_USB3PHY_PCIE_USB3_PHY_BEACON_2_IDLE_TIME_L_ADDR A:0xf9b38680
y.create.l HWIO_PERIPH_SS_USB3PHY_PCIE_USB3_PHY_BEACON_2_IDLE_TIME_H_ADDR A:0xf9b38684
y.create.l HWIO_PERIPH_SS_USB3PHY_PCIE_USB3_PHY_PWRUP_RESET_DLY_TIME_SYSCLK_ADDR A:0xf9b38688
y.create.l HWIO_PERIPH_SS_USB3PHY_PCIE_USB3_PHY_PWRUP_RESET_DLY_TIME_AUXCLK_ADDR A:0xf9b3868c
y.create.l HWIO_PERIPH_SS_USB3PHY_PCIE_USB3_PHY_LFPS_DET_HIGH_COUNT_VAL_ADDR A:0xf9b38690
y.create.l HWIO_PERIPH_SS_USB3PHY_PCIE_USB3_PHY_LFPS_TX_ECSTART_EQTLOCK_ADDR A:0xf9b38694
y.create.l HWIO_PERIPH_SS_USB3PHY_PCIE_USB3_PHY_LFPS_TX_END_CNT_P2U3_START_ADDR A:0xf9b38698
y.create.l HWIO_PERIPH_SS_USB3PHY_PCIE_USB3_PHY_RXEQTRAINING_WAIT_TIME_ADDR A:0xf9b3869c
y.create.l HWIO_PERIPH_SS_USB3PHY_PCIE_USB3_PHY_RXEQTRAINING_RUN_TIME_ADDR A:0xf9b386a0
y.create.l HWIO_PERIPH_SS_USB3PHY_PCIE_USB3_PHY_TXONESZEROS_RUN_LENGTH_ADDR A:0xf9b386a4
y.create.l HWIO_PERIPH_SS_USB3PHY_PCIE_USB3_PHY_FLL_CNTRL1_ADDR A:0xf9b386a8
y.create.l HWIO_PERIPH_SS_USB3PHY_PCIE_USB3_PHY_FLL_CNTRL2_ADDR A:0xf9b386ac
y.create.l HWIO_PERIPH_SS_USB3PHY_PCIE_USB3_PHY_FLL_CNT_VAL_L_ADDR A:0xf9b386b0
y.create.l HWIO_PERIPH_SS_USB3PHY_PCIE_USB3_PHY_FLL_CNT_VAL_H_TOL_ADDR A:0xf9b386b4
y.create.l HWIO_PERIPH_SS_USB3PHY_PCIE_USB3_PHY_FLL_MAN_CODE_ADDR A:0xf9b386b8
y.create.l HWIO_PERIPH_SS_USB3PHY_PCIE_USB3_PHY_AUTONOMOUS_MODE_CTRL_ADDR A:0xf9b386bc
y.create.l HWIO_PERIPH_SS_USB3PHY_PCIE_USB3_PHY_LFPS_RXTERM_IRQ_CLEAR_ADDR A:0xf9b386c0
y.create.l HWIO_PERIPH_SS_USB3PHY_PCIE_USB3_PHY_ARCVR_DTCT_EN_PERIOD_ADDR A:0xf9b386c4
y.create.l HWIO_PERIPH_SS_USB3PHY_PCIE_USB3_PHY_ARCVR_DTCT_CM_DLY_ADDR A:0xf9b386c8
y.create.l HWIO_PERIPH_SS_USB3PHY_PCIE_USB3_PHY_ALFPS_DEGLITCH_VAL_ADDR A:0xf9b386cc
y.create.l HWIO_PERIPH_SS_USB3PHY_PCIE_USB3_PHY_INSIG_SW_CTRL1_ADDR A:0xf9b386d0
y.create.l HWIO_PERIPH_SS_USB3PHY_PCIE_USB3_PHY_INSIG_SW_CTRL2_ADDR A:0xf9b386d4
y.create.l HWIO_PERIPH_SS_USB3PHY_PCIE_USB3_PHY_INSIG_SW_CTRL3_ADDR A:0xf9b386d8
y.create.l HWIO_PERIPH_SS_USB3PHY_PCIE_USB3_PHY_INSIG_MX_CTRL1_ADDR A:0xf9b386dc
y.create.l HWIO_PERIPH_SS_USB3PHY_PCIE_USB3_PHY_INSIG_MX_CTRL2_ADDR A:0xf9b386e0
y.create.l HWIO_PERIPH_SS_USB3PHY_PCIE_USB3_PHY_INSIG_MX_CTRL3_ADDR A:0xf9b386e4
y.create.l HWIO_PERIPH_SS_USB3PHY_PCIE_USB3_PHY_TEST_CONTROL_ADDR A:0xf9b386e8
y.create.l HWIO_PERIPH_SS_USB3PHY_PCIE_USB3_PHY_BIST_CTRL_ADDR A:0xf9b386ec
y.create.l HWIO_PERIPH_SS_USB3PHY_PCIE_USB3_PHY_PRBS_POLY0_ADDR A:0xf9b386f0
y.create.l HWIO_PERIPH_SS_USB3PHY_PCIE_USB3_PHY_PRBS_POLY1_ADDR A:0xf9b386f4
y.create.l HWIO_PERIPH_SS_USB3PHY_PCIE_USB3_PHY_PRBS_SEED0_ADDR A:0xf9b386f8
y.create.l HWIO_PERIPH_SS_USB3PHY_PCIE_USB3_PHY_PRBS_SEED1_ADDR A:0xf9b386fc
y.create.l HWIO_PERIPH_SS_USB3PHY_PCIE_USB3_PHY_FIXED_PAT_CTRL_ADDR A:0xf9b38700
y.create.l HWIO_PERIPH_SS_USB3PHY_PCIE_USB3_PHY_FIXED_PAT0_ADDR A:0xf9b38704
y.create.l HWIO_PERIPH_SS_USB3PHY_PCIE_USB3_PHY_FIXED_PAT1_ADDR A:0xf9b38708
y.create.l HWIO_PERIPH_SS_USB3PHY_PCIE_USB3_PHY_FIXED_PAT2_ADDR A:0xf9b3870c
y.create.l HWIO_PERIPH_SS_USB3PHY_PCIE_USB3_PHY_FIXED_PAT3_ADDR A:0xf9b38710
y.create.l HWIO_PERIPH_SS_USB3PHY_PCIE_USB3_PHY_SPARE1_ADDR A:0xf9b38714
y.create.l HWIO_PERIPH_SS_USB3PHY_PCIE_USB3_PHY_BIST_CHK_ERR_CNT_L_ADDR A:0xf9b38718
y.create.l HWIO_PERIPH_SS_USB3PHY_PCIE_USB3_PHY_BIST_CHK_ERR_CNT_H_ADDR A:0xf9b3871c
y.create.l HWIO_PERIPH_SS_USB3PHY_PCIE_USB3_PHY_BIST_CHK_STATUS_ADDR A:0xf9b38720
y.create.l HWIO_PERIPH_SS_USB3PHY_PCIE_USB3_PHY_LFPS_RXTERM_IRQ_SOURCE_ADDR A:0xf9b38724
y.create.l HWIO_PERIPH_SS_USB3PHY_PCIE_USB3_PHY_PCS_STATUS_ADDR A:0xf9b38728
y.create.l HWIO_PERIPH_SS_USB3PHY_PCIE_USB3_PHY_PCS_STATUS2_ADDR A:0xf9b3872c
y.create.l HWIO_PERIPH_SS_USB3PHY_PCIE_USB3_PHY_REVISION_ID0_ADDR A:0xf9b38730
y.create.l HWIO_PERIPH_SS_USB3PHY_PCIE_USB3_PHY_REVISION_ID1_ADDR A:0xf9b38734
y.create.l HWIO_PERIPH_SS_USB3PHY_PCIE_USB3_PHY_REVISION_ID2_ADDR A:0xf9b38738
y.create.l HWIO_PERIPH_SS_USB3PHY_PCIE_USB3_PHY_REVISION_ID3_ADDR A:0xf9b3873c
y.create.l HWIO_PERIPH_SS_USB3PHY_PCIE_USB3_PHY_DEBUG_BUS_0_STATUS_ADDR A:0xf9b38740
y.create.l HWIO_PERIPH_SS_USB3PHY_PCIE_USB3_PHY_DEBUG_BUS_1_STATUS_ADDR A:0xf9b38744
y.create.l HWIO_PERIPH_SS_USB3PHY_PCIE_USB3_PHY_DEBUG_BUS_2_STATUS_ADDR A:0xf9b38748
y.create.l HWIO_PERIPH_SS_USB3PHY_PCIE_USB3_PHY_DEBUG_BUS_3_STATUS_ADDR A:0xf9b3874c
y.create.l HWIO_PERIPH_SS_HW_VERSION_ADDR A:0xf9b3e000
y.create.l HWIO_PERIPH_SS_HW_INFO_ADDR A:0xf9b3e004
y.create.l HWIO_PERIPH_SS_AHB2PHY_BROADCAST_EN_CFG_LOWER_ADDR A:0xf9b3e008
y.create.l HWIO_PERIPH_SS_AHB2PHY_BROADCAST_EN_CFG_UPPER_ADDR A:0xf9b3e00c
y.create.l HWIO_PERIPH_SS_AHB2PHY_TOP_CFG_ADDR A:0xf9b3e010
y.create.l HWIO_PERIPH_SS_AHB2PHY_DEBUG_BUS_CFG_ADDR A:0xf9b3e014
y.create.l HWIO_PERIPH_SS_AHB2PHY_BROADCAST_ADDRESS_SPACE_0_ADDR A:0xf9b3f000
y.create.l HWIO_PERIPH_SS_AHB2PHY_BROADCAST_ADDRESS_SPACE_1_ADDR A:0xf9b3f004
y.create.l HWIO_PERIPH_SS_AHB2PHY_BROADCAST_ADDRESS_SPACE_2_ADDR A:0xf9b3f008
y.create.l HWIO_PERIPH_SS_AHB2PHY_BROADCAST_ADDRESS_SPACE_3_ADDR A:0xf9b3f00c
y.create.l HWIO_PERIPH_SS_AHB2PHY_BROADCAST_ADDRESS_SPACE_4_ADDR A:0xf9b3f010
y.create.l HWIO_PERIPH_SS_AHB2PHY_BROADCAST_ADDRESS_SPACE_5_ADDR A:0xf9b3f014
y.create.l HWIO_PERIPH_SS_AHB2PHY_BROADCAST_ADDRESS_SPACE_6_ADDR A:0xf9b3f018
y.create.l HWIO_PERIPH_SS_AHB2PHY_BROADCAST_ADDRESS_SPACE_7_ADDR A:0xf9b3f01c
y.create.l HWIO_PERIPH_SS_AHB2PHY_BROADCAST_ADDRESS_SPACE_8_ADDR A:0xf9b3f020
y.create.l HWIO_PERIPH_SS_AHB2PHY_BROADCAST_ADDRESS_SPACE_9_ADDR A:0xf9b3f024
y.create.l HWIO_PERIPH_SS_BUS_TIMEOUT_0_ABT_HW_VERSION_ADDR A:0xf9bf7000
y.create.l HWIO_PERIPH_SS_BUS_TIMEOUT_0_ABT_INST_ID_ADDR A:0xf9bf7004
y.create.l HWIO_PERIPH_SS_BUS_TIMEOUT_0_ABT_NUM_SLAVES_ADDR A:0xf9bf7008
y.create.l HWIO_PERIPH_SS_BUS_TIMEOUT_0_ABT_TIMER_LOADVAL_ADDR A:0xf9bf700c
y.create.l HWIO_PERIPH_SS_BUS_TIMEOUT_0_ABT_TIMER_MODE_ADDR A:0xf9bf7010
y.create.l HWIO_PERIPH_SS_BUS_TIMEOUT_0_ABT_INTR_STATUS_ADDR A:0xf9bf7014
y.create.l HWIO_PERIPH_SS_BUS_TIMEOUT_0_ABT_INTR_CLEAR_ADDR A:0xf9bf7018
y.create.l HWIO_PERIPH_SS_BUS_TIMEOUT_0_ABT_INTR_ENABLE_ADDR A:0xf9bf701c
y.create.l HWIO_PERIPH_SS_BUS_TIMEOUT_0_ABT_SYND_VALID_ADDR A:0xf9bf7020
y.create.l HWIO_PERIPH_SS_BUS_TIMEOUT_0_ABT_SYND_CLEAR_ADDR A:0xf9bf7024
y.create.l HWIO_PERIPH_SS_BUS_TIMEOUT_0_ABT_SYND_ID_ADDR A:0xf9bf7028
y.create.l HWIO_PERIPH_SS_BUS_TIMEOUT_0_ABT_SYND_ADDR0_ADDR A:0xf9bf702c
y.create.l HWIO_PERIPH_SS_BUS_TIMEOUT_0_ABT_SYND_ADDR1_ADDR A:0xf9bf7030
y.create.l HWIO_PERIPH_SS_BUS_TIMEOUT_0_ABT_SYND_HREADY_ADDR A:0xf9bf7034
y.create.l HWIO_PERIPH_SS_BUS_TIMEOUT_1_ABT_HW_VERSION_ADDR A:0xf9bf8000
y.create.l HWIO_PERIPH_SS_BUS_TIMEOUT_1_ABT_INST_ID_ADDR A:0xf9bf8004
y.create.l HWIO_PERIPH_SS_BUS_TIMEOUT_1_ABT_NUM_SLAVES_ADDR A:0xf9bf8008
y.create.l HWIO_PERIPH_SS_BUS_TIMEOUT_1_ABT_TIMER_LOADVAL_ADDR A:0xf9bf800c
y.create.l HWIO_PERIPH_SS_BUS_TIMEOUT_1_ABT_TIMER_MODE_ADDR A:0xf9bf8010
y.create.l HWIO_PERIPH_SS_BUS_TIMEOUT_1_ABT_INTR_STATUS_ADDR A:0xf9bf8014
y.create.l HWIO_PERIPH_SS_BUS_TIMEOUT_1_ABT_INTR_CLEAR_ADDR A:0xf9bf8018
y.create.l HWIO_PERIPH_SS_BUS_TIMEOUT_1_ABT_INTR_ENABLE_ADDR A:0xf9bf801c
y.create.l HWIO_PERIPH_SS_BUS_TIMEOUT_1_ABT_SYND_VALID_ADDR A:0xf9bf8020
y.create.l HWIO_PERIPH_SS_BUS_TIMEOUT_1_ABT_SYND_CLEAR_ADDR A:0xf9bf8024
y.create.l HWIO_PERIPH_SS_BUS_TIMEOUT_1_ABT_SYND_ID_ADDR A:0xf9bf8028
y.create.l HWIO_PERIPH_SS_BUS_TIMEOUT_1_ABT_SYND_ADDR0_ADDR A:0xf9bf802c
y.create.l HWIO_PERIPH_SS_BUS_TIMEOUT_1_ABT_SYND_ADDR1_ADDR A:0xf9bf8030
y.create.l HWIO_PERIPH_SS_BUS_TIMEOUT_1_ABT_SYND_HREADY_ADDR A:0xf9bf8034
y.create.l HWIO_PERIPH_SS_BUS_TIMEOUT_2_ABT_HW_VERSION_ADDR A:0xf9bf9000
y.create.l HWIO_PERIPH_SS_BUS_TIMEOUT_2_ABT_INST_ID_ADDR A:0xf9bf9004
y.create.l HWIO_PERIPH_SS_BUS_TIMEOUT_2_ABT_NUM_SLAVES_ADDR A:0xf9bf9008
y.create.l HWIO_PERIPH_SS_BUS_TIMEOUT_2_ABT_TIMER_LOADVAL_ADDR A:0xf9bf900c
y.create.l HWIO_PERIPH_SS_BUS_TIMEOUT_2_ABT_TIMER_MODE_ADDR A:0xf9bf9010
y.create.l HWIO_PERIPH_SS_BUS_TIMEOUT_2_ABT_INTR_STATUS_ADDR A:0xf9bf9014
y.create.l HWIO_PERIPH_SS_BUS_TIMEOUT_2_ABT_INTR_CLEAR_ADDR A:0xf9bf9018
y.create.l HWIO_PERIPH_SS_BUS_TIMEOUT_2_ABT_INTR_ENABLE_ADDR A:0xf9bf901c
y.create.l HWIO_PERIPH_SS_BUS_TIMEOUT_2_ABT_SYND_VALID_ADDR A:0xf9bf9020
y.create.l HWIO_PERIPH_SS_BUS_TIMEOUT_2_ABT_SYND_CLEAR_ADDR A:0xf9bf9024
y.create.l HWIO_PERIPH_SS_BUS_TIMEOUT_2_ABT_SYND_ID_ADDR A:0xf9bf9028
y.create.l HWIO_PERIPH_SS_BUS_TIMEOUT_2_ABT_SYND_ADDR0_ADDR A:0xf9bf902c
y.create.l HWIO_PERIPH_SS_BUS_TIMEOUT_2_ABT_SYND_ADDR1_ADDR A:0xf9bf9030
y.create.l HWIO_PERIPH_SS_BUS_TIMEOUT_2_ABT_SYND_HREADY_ADDR A:0xf9bf9034
y.create.l HWIO_PERIPH_SS_BUS_TIMEOUT_3_ABT_HW_VERSION_ADDR A:0xf9bfa000
y.create.l HWIO_PERIPH_SS_BUS_TIMEOUT_3_ABT_INST_ID_ADDR A:0xf9bfa004
y.create.l HWIO_PERIPH_SS_BUS_TIMEOUT_3_ABT_NUM_SLAVES_ADDR A:0xf9bfa008
y.create.l HWIO_PERIPH_SS_BUS_TIMEOUT_3_ABT_TIMER_LOADVAL_ADDR A:0xf9bfa00c
y.create.l HWIO_PERIPH_SS_BUS_TIMEOUT_3_ABT_TIMER_MODE_ADDR A:0xf9bfa010
y.create.l HWIO_PERIPH_SS_BUS_TIMEOUT_3_ABT_INTR_STATUS_ADDR A:0xf9bfa014
y.create.l HWIO_PERIPH_SS_BUS_TIMEOUT_3_ABT_INTR_CLEAR_ADDR A:0xf9bfa018
y.create.l HWIO_PERIPH_SS_BUS_TIMEOUT_3_ABT_INTR_ENABLE_ADDR A:0xf9bfa01c
y.create.l HWIO_PERIPH_SS_BUS_TIMEOUT_3_ABT_SYND_VALID_ADDR A:0xf9bfa020
y.create.l HWIO_PERIPH_SS_BUS_TIMEOUT_3_ABT_SYND_CLEAR_ADDR A:0xf9bfa024
y.create.l HWIO_PERIPH_SS_BUS_TIMEOUT_3_ABT_SYND_ID_ADDR A:0xf9bfa028
y.create.l HWIO_PERIPH_SS_BUS_TIMEOUT_3_ABT_SYND_ADDR0_ADDR A:0xf9bfa02c
y.create.l HWIO_PERIPH_SS_BUS_TIMEOUT_3_ABT_SYND_ADDR1_ADDR A:0xf9bfa030
y.create.l HWIO_PERIPH_SS_BUS_TIMEOUT_3_ABT_SYND_HREADY_ADDR A:0xf9bfa034
y.create.l HWIO_PERIPH_SS_BUS_TIMEOUT_4_ABT_HW_VERSION_ADDR A:0xf9bfb000
y.create.l HWIO_PERIPH_SS_BUS_TIMEOUT_4_ABT_INST_ID_ADDR A:0xf9bfb004
y.create.l HWIO_PERIPH_SS_BUS_TIMEOUT_4_ABT_NUM_SLAVES_ADDR A:0xf9bfb008
y.create.l HWIO_PERIPH_SS_BUS_TIMEOUT_4_ABT_TIMER_LOADVAL_ADDR A:0xf9bfb00c
y.create.l HWIO_PERIPH_SS_BUS_TIMEOUT_4_ABT_TIMER_MODE_ADDR A:0xf9bfb010
y.create.l HWIO_PERIPH_SS_BUS_TIMEOUT_4_ABT_INTR_STATUS_ADDR A:0xf9bfb014
y.create.l HWIO_PERIPH_SS_BUS_TIMEOUT_4_ABT_INTR_CLEAR_ADDR A:0xf9bfb018
y.create.l HWIO_PERIPH_SS_BUS_TIMEOUT_4_ABT_INTR_ENABLE_ADDR A:0xf9bfb01c
y.create.l HWIO_PERIPH_SS_BUS_TIMEOUT_4_ABT_SYND_VALID_ADDR A:0xf9bfb020
y.create.l HWIO_PERIPH_SS_BUS_TIMEOUT_4_ABT_SYND_CLEAR_ADDR A:0xf9bfb024
y.create.l HWIO_PERIPH_SS_BUS_TIMEOUT_4_ABT_SYND_ID_ADDR A:0xf9bfb028
y.create.l HWIO_PERIPH_SS_BUS_TIMEOUT_4_ABT_SYND_ADDR0_ADDR A:0xf9bfb02c
y.create.l HWIO_PERIPH_SS_BUS_TIMEOUT_4_ABT_SYND_ADDR1_ADDR A:0xf9bfb030
y.create.l HWIO_PERIPH_SS_BUS_TIMEOUT_4_ABT_SYND_HREADY_ADDR A:0xf9bfb034
y.create.l HWIO_PERIPH_SS_MPU_XPU_SCR_ADDR A:0xf9bfc000
y.create.l HWIO_PERIPH_SS_MPU_XPU_SWDR_ADDR A:0xf9bfc004
y.create.l HWIO_PERIPH_SS_MPU_XPU_PRTN_RACR_SSHADOW_ADDR A:0xf9bfc008
y.create.l HWIO_PERIPH_SS_MPU_XPU_PRTN_WACR_SSHADOW_ADDR A:0xf9bfc00c
y.create.l HWIO_PERIPH_SS_MPU_XPU_PRTN_START_SSHADOW0_ADDR A:0xf9bfc010
y.create.l HWIO_PERIPH_SS_MPU_XPU_PRTN_END_SSHADOW0_ADDR A:0xf9bfc018
y.create.l HWIO_PERIPH_SS_MPU_XPU_SEAR0_ADDR A:0xf9bfc040
y.create.l HWIO_PERIPH_SS_MPU_XPU_SESR_ADDR A:0xf9bfc048
y.create.l HWIO_PERIPH_SS_MPU_XPU_SESRRESTORE_ADDR A:0xf9bfc04c
y.create.l HWIO_PERIPH_SS_MPU_XPU_SESYNR0_ADDR A:0xf9bfc050
y.create.l HWIO_PERIPH_SS_MPU_XPU_SESYNR1_ADDR A:0xf9bfc054
y.create.l HWIO_PERIPH_SS_MPU_XPU_SESYNR2_ADDR A:0xf9bfc058
y.create.l HWIO_PERIPH_SS_MPU_XPU_MCR_ADDR A:0xf9bfc100
y.create.l HWIO_PERIPH_SS_MPU_XPU_MEAR0_ADDR A:0xf9bfc140
y.create.l HWIO_PERIPH_SS_MPU_XPU_MESR_ADDR A:0xf9bfc148
y.create.l HWIO_PERIPH_SS_MPU_XPU_MESRRESTORE_ADDR A:0xf9bfc14c
y.create.l HWIO_PERIPH_SS_MPU_XPU_MESYNR0_ADDR A:0xf9bfc150
y.create.l HWIO_PERIPH_SS_MPU_XPU_MESYNR1_ADDR A:0xf9bfc154
y.create.l HWIO_PERIPH_SS_MPU_XPU_MESYNR2_ADDR A:0xf9bfc158
y.create.l HWIO_PERIPH_SS_MPU_XPU_CR_ADDR A:0xf9bfc080
y.create.l HWIO_PERIPH_SS_MPU_XPU_PRTN_RACR_SHADOW_ADDR A:0xf9bfc088
y.create.l HWIO_PERIPH_SS_MPU_XPU_PRTN_WACR_SHADOW_ADDR A:0xf9bfc08c
y.create.l HWIO_PERIPH_SS_MPU_XPU_PRTN_START_SHADOW0_ADDR A:0xf9bfc090
y.create.l HWIO_PERIPH_SS_MPU_XPU_PRTN_END_SHADOW0_ADDR A:0xf9bfc098
y.create.l HWIO_PERIPH_SS_MPU_XPU_RPU_ACR0_ADDR A:0xf9bfc0a0
y.create.l HWIO_PERIPH_SS_MPU_XPU_EAR0_ADDR A:0xf9bfc0c0
y.create.l HWIO_PERIPH_SS_MPU_XPU_ESR_ADDR A:0xf9bfc0c8
y.create.l HWIO_PERIPH_SS_MPU_XPU_ESRRESTORE_ADDR A:0xf9bfc0cc
y.create.l HWIO_PERIPH_SS_MPU_XPU_ESYNR0_ADDR A:0xf9bfc0d0
y.create.l HWIO_PERIPH_SS_MPU_XPU_ESYNR1_ADDR A:0xf9bfc0d4
y.create.l HWIO_PERIPH_SS_MPU_XPU_ESYNR2_ADDR A:0xf9bfc0d8
y.create.l HWIO_PERIPH_SS_MPU_XPU_UMR_RACR_ADDR A:0xf9bfc0e0
y.create.l HWIO_PERIPH_SS_MPU_XPU_UMR_WACR_ADDR A:0xf9bfc0e4
y.create.l HWIO_PERIPH_SS_MPU_XPU_IDR0_ADDR A:0xf9bfc074
y.create.l HWIO_PERIPH_SS_MPU_XPU_IDR1_ADDR A:0xf9bfc078
y.create.l HWIO_PERIPH_SS_MPU_XPU_REV_ADDR A:0xf9bfc07c
y.create.l HWIO_PERIPH_SS_MPU_XPU_PRT0_RACR0_ADDR A:0xf9bfc200
y.create.l HWIO_PERIPH_SS_MPU_XPU_PRT1_RACR0_ADDR A:0xf9bfc280
y.create.l HWIO_PERIPH_SS_MPU_XPU_PRT2_RACR0_ADDR A:0xf9bfc300
y.create.l HWIO_PERIPH_SS_MPU_XPU_PRT3_RACR0_ADDR A:0xf9bfc380
y.create.l HWIO_PERIPH_SS_MPU_XPU_PRT0_WACR0_ADDR A:0xf9bfc220
y.create.l HWIO_PERIPH_SS_MPU_XPU_PRT1_WACR0_ADDR A:0xf9bfc2a0
y.create.l HWIO_PERIPH_SS_MPU_XPU_PRT2_WACR0_ADDR A:0xf9bfc320
y.create.l HWIO_PERIPH_SS_MPU_XPU_PRT3_WACR0_ADDR A:0xf9bfc3a0
y.create.l HWIO_PERIPH_SS_MPU_XPU_PRT0_START0_ADDR A:0xf9bfc240
y.create.l HWIO_PERIPH_SS_MPU_XPU_PRT1_START0_ADDR A:0xf9bfc2c0
y.create.l HWIO_PERIPH_SS_MPU_XPU_PRT2_START0_ADDR A:0xf9bfc340
y.create.l HWIO_PERIPH_SS_MPU_XPU_PRT3_START0_ADDR A:0xf9bfc3c0
y.create.l HWIO_PERIPH_SS_MPU_XPU_PRT0_END0_ADDR A:0xf9bfc248
y.create.l HWIO_PERIPH_SS_MPU_XPU_PRT1_END0_ADDR A:0xf9bfc2c8
y.create.l HWIO_PERIPH_SS_MPU_XPU_PRT2_END0_ADDR A:0xf9bfc348
y.create.l HWIO_PERIPH_SS_MPU_XPU_PRT3_END0_ADDR A:0xf9bfc3c8
y.create.l HWIO_PERIPH_SS_MPU_XPU_PRT0_SCR_ADDR A:0xf9bfc250
y.create.l HWIO_PERIPH_SS_MPU_XPU_PRT1_SCR_ADDR A:0xf9bfc2d0
y.create.l HWIO_PERIPH_SS_MPU_XPU_PRT2_SCR_ADDR A:0xf9bfc350
y.create.l HWIO_PERIPH_SS_MPU_XPU_PRT3_SCR_ADDR A:0xf9bfc3d0
y.create.l HWIO_PERIPH_SS_MPU_XPU_PRT0_MCR_ADDR A:0xf9bfc254
y.create.l HWIO_PERIPH_SS_MPU_XPU_PRT1_MCR_ADDR A:0xf9bfc2d4
y.create.l HWIO_PERIPH_SS_MPU_XPU_PRT2_MCR_ADDR A:0xf9bfc354
y.create.l HWIO_PERIPH_SS_MPU_XPU_PRT3_MCR_ADDR A:0xf9bfc3d4
y.create.l HWIO_PERIPH_SS_MPU_XPU_PRT0_CNTL0_ADDR A:0xf9bfc258
y.create.l HWIO_PERIPH_SS_MPU_XPU_PRT1_CNTL0_ADDR A:0xf9bfc2d8
y.create.l HWIO_PERIPH_SS_MPU_XPU_PRT2_CNTL0_ADDR A:0xf9bfc358
y.create.l HWIO_PERIPH_SS_MPU_XPU_PRT3_CNTL0_ADDR A:0xf9bfc3d8
y.create.l HWIO_PERIPH_SS_MPU_XPU_PRT0_CNTL1_ADDR A:0xf9bfc25c
y.create.l HWIO_PERIPH_SS_MPU_XPU_PRT1_CNTL1_ADDR A:0xf9bfc2dc
y.create.l HWIO_PERIPH_SS_MPU_XPU_PRT2_CNTL1_ADDR A:0xf9bfc35c
y.create.l HWIO_PERIPH_SS_MPU_XPU_PRT3_CNTL1_ADDR A:0xf9bfc3dc
y.create.l HWIO_PERIPH_SS_APU_XPU_SCR_ADDR A:0xf9bfd000
y.create.l HWIO_PERIPH_SS_APU_XPU_SWDR_ADDR A:0xf9bfd004
y.create.l HWIO_PERIPH_SS_APU_XPU_SEAR0_ADDR A:0xf9bfd040
y.create.l HWIO_PERIPH_SS_APU_XPU_SESR_ADDR A:0xf9bfd048
y.create.l HWIO_PERIPH_SS_APU_XPU_SESRRESTORE_ADDR A:0xf9bfd04c
y.create.l HWIO_PERIPH_SS_APU_XPU_SESYNR0_ADDR A:0xf9bfd050
y.create.l HWIO_PERIPH_SS_APU_XPU_SESYNR1_ADDR A:0xf9bfd054
y.create.l HWIO_PERIPH_SS_APU_XPU_SESYNR2_ADDR A:0xf9bfd058
y.create.l HWIO_PERIPH_SS_APU_XPU_MCR_ADDR A:0xf9bfd100
y.create.l HWIO_PERIPH_SS_APU_XPU_MEAR0_ADDR A:0xf9bfd140
y.create.l HWIO_PERIPH_SS_APU_XPU_MESR_ADDR A:0xf9bfd148
y.create.l HWIO_PERIPH_SS_APU_XPU_MESRRESTORE_ADDR A:0xf9bfd14c
y.create.l HWIO_PERIPH_SS_APU_XPU_MESYNR0_ADDR A:0xf9bfd150
y.create.l HWIO_PERIPH_SS_APU_XPU_MESYNR1_ADDR A:0xf9bfd154
y.create.l HWIO_PERIPH_SS_APU_XPU_MESYNR2_ADDR A:0xf9bfd158
y.create.l HWIO_PERIPH_SS_APU_XPU_CR_ADDR A:0xf9bfd080
y.create.l HWIO_PERIPH_SS_APU_XPU_RPU_ACR0_ADDR A:0xf9bfd0a0
y.create.l HWIO_PERIPH_SS_APU_XPU_EAR0_ADDR A:0xf9bfd0c0
y.create.l HWIO_PERIPH_SS_APU_XPU_ESR_ADDR A:0xf9bfd0c8
y.create.l HWIO_PERIPH_SS_APU_XPU_ESRRESTORE_ADDR A:0xf9bfd0cc
y.create.l HWIO_PERIPH_SS_APU_XPU_ESYNR0_ADDR A:0xf9bfd0d0
y.create.l HWIO_PERIPH_SS_APU_XPU_ESYNR1_ADDR A:0xf9bfd0d4
y.create.l HWIO_PERIPH_SS_APU_XPU_ESYNR2_ADDR A:0xf9bfd0d8
y.create.l HWIO_PERIPH_SS_APU_XPU_IDR0_ADDR A:0xf9bfd074
y.create.l HWIO_PERIPH_SS_APU_XPU_IDR1_ADDR A:0xf9bfd078
y.create.l HWIO_PERIPH_SS_APU_XPU_REV_ADDR A:0xf9bfd07c
y.create.l HWIO_PERIPH_SS_APU_XPU_RG0_RACR0_ADDR A:0xf9bfd200
y.create.l HWIO_PERIPH_SS_APU_XPU_RG1_RACR0_ADDR A:0xf9bfd280
y.create.l HWIO_PERIPH_SS_APU_XPU_RG2_RACR0_ADDR A:0xf9bfd300
y.create.l HWIO_PERIPH_SS_APU_XPU_RG3_RACR0_ADDR A:0xf9bfd380
y.create.l HWIO_PERIPH_SS_APU_XPU_RG0_SCR_ADDR A:0xf9bfd250
y.create.l HWIO_PERIPH_SS_APU_XPU_RG1_SCR_ADDR A:0xf9bfd2d0
y.create.l HWIO_PERIPH_SS_APU_XPU_RG2_SCR_ADDR A:0xf9bfd350
y.create.l HWIO_PERIPH_SS_APU_XPU_RG3_SCR_ADDR A:0xf9bfd3d0
y.create.l HWIO_PERIPH_SS_APU_XPU_RG0_MCR_ADDR A:0xf9bfd254
y.create.l HWIO_PERIPH_SS_APU_XPU_RG1_MCR_ADDR A:0xf9bfd2d4
y.create.l HWIO_PERIPH_SS_APU_XPU_RG2_MCR_ADDR A:0xf9bfd354
y.create.l HWIO_PERIPH_SS_APU_XPU_RG3_MCR_ADDR A:0xf9bfd3d4
y.create.l HWIO_PERIPH_SS_PRNG_PRNG_DATA_OUT_ADDR A:0xf9bff000
y.create.l HWIO_PERIPH_SS_PRNG_PRNG_STATUS_ADDR A:0xf9bff004
y.create.l HWIO_PERIPH_SS_PRNG_PRNG_HW_VERSION_ADDR A:0xf9bff008
y.create.l HWIO_PERIPH_SS_PRNG_PRNG_ENTROPY_CNTR_ADDR A:0xf9bff010
y.create.l HWIO_PERIPH_SS_PRNG_PRNG_SAMPLE_CNTR_ADDR A:0xf9bff014
y.create.l HWIO_PERIPH_SS_PRNG_PRNG_GEN_CNTR_ADDR A:0xf9bff018
y.create.l HWIO_PERIPH_SS_PRNG_PRNG_RESEED_CNTR_ADDR A:0xf9bff01c
y.create.l HWIO_PERIPH_SS_PRNG_PRNG_INSTANTIATE_CNTR_ADDR A:0xf9bff020
y.create.l HWIO_PERIPH_SS_PRNG_PRNG_DEBUG_ADDR A:0xf9bff024
y.create.l HWIO_PERIPH_SS_PRNG_PRNG_LFSR_CFG_ADDR A:0xf9bff100
y.create.l HWIO_PERIPH_SS_PRNG_PRNG_CONFIG_ADDR A:0xf9bff104
y.create.l HWIO_PERIPH_SS_PRNG_PRNG_PERSONALIZATION_STRING_ADDR A:0xf9bff108
y.create.l HWIO_PERIPH_SS_PRNG_PRNG_NUM_ENTROPY_ADDR A:0xf9bff110
y.create.l HWIO_PERIPH_SS_PRNG_PRNG_SAMPLE_FREQ_ADDR A:0xf9bff114
y.create.l HWIO_PERIPH_SS_PRNG_PRNG_GEN_WORDS_ADDR A:0xf9bff118
y.create.l HWIO_PERIPH_SS_PRNG_PRNG_RESEED_FREQ_ADDR A:0xf9bff11c
y.create.l HWIO_PERIPH_SS_PRNG_PRNG_INSTANTIATE_FREQ_ADDR A:0xf9bff120
y.create.l HWIO_PMIC_ARB_SPMI_GENI_CLK_CTRL_ADDR A:0xfc4ca000
y.create.l HWIO_PMIC_ARB_SPMI_GENI_HW_VERSION_ADDR A:0xfc4ca004
y.create.l HWIO_PMIC_ARB_SPMI_GENI_FW_REVISION_ADDR A:0xfc4ca008
y.create.l HWIO_PMIC_ARB_SPMI_GENI_S_FW_REVISION_ADDR A:0xfc4ca00c
y.create.l HWIO_PMIC_ARB_SPMI_GENI_FORCE_DEFAULT_REG_ADDR A:0xfc4ca010
y.create.l HWIO_PMIC_ARB_SPMI_GENI_OUTPUT_CTRL_ADDR A:0xfc4ca014
y.create.l HWIO_PMIC_ARB_SPMI_GENI_CGC_CTRL_ADDR A:0xfc4ca018
y.create.l HWIO_PMIC_ARB_SPMI_GENI_CHAR_CFG_ADDR A:0xfc4ca01c
y.create.l HWIO_PMIC_ARB_SPMI_GENI_CHAR_DATA_0_ADDR A:0xfc4ca020
y.create.l HWIO_PMIC_ARB_SPMI_GENI_CHAR_DATA_1_ADDR A:0xfc4ca024
y.create.l HWIO_PMIC_ARB_SPMI_GENI_CTRL_ADDR A:0xfc4ca028
y.create.l HWIO_PMIC_ARB_SPMI_GENI_STATUS_ADDR A:0xfc4ca02c
y.create.l HWIO_PMIC_ARB_SPMI_GENI_TEST_BUS_CTRL_ADDR A:0xfc4ca030
y.create.l HWIO_PMIC_ARB_SPMI_GENI_SER_CLK_CFG_ADDR A:0xfc4ca034
y.create.l HWIO_PMIC_ARB_SPMI_GENI_TX_WATERMARK_REG_ADDR A:0xfc4ca038
y.create.l HWIO_PMIC_ARB_SPMI_GENI_RX_WATERMARK_REG_ADDR A:0xfc4ca03c
y.create.l HWIO_PMIC_ARB_SPMI_GENI_STOP_REG_ADDR A:0xfc4ca040
y.create.l HWIO_PMIC_ARB_SPMI_GENI_SW_COMP_REG_ADDR A:0xfc4ca044
y.create.l HWIO_PMIC_ARB_SPMI_GENI_PROG_ROM_CTRL_REG_ADDR A:0xfc4ca048
y.create.l HWIO_PMIC_ARB_SPMI_GENI_CFG_REG0_ADDR A:0xfc4ca100
y.create.l HWIO_PMIC_ARB_SPMI_GENI_CFG_REG1_ADDR A:0xfc4ca104
y.create.l HWIO_PMIC_ARB_SPMI_GENI_CFG_REG2_ADDR A:0xfc4ca108
y.create.l HWIO_PMIC_ARB_SPMI_GENI_CFG_REG3_ADDR A:0xfc4ca10c
y.create.l HWIO_PMIC_ARB_SPMI_GENI_CFG_REG4_ADDR A:0xfc4ca110
y.create.l HWIO_PMIC_ARB_SPMI_GENI_CFG_REG5_ADDR A:0xfc4ca114
y.create.l HWIO_PMIC_ARB_SPMI_GENI_CFG_REG6_ADDR A:0xfc4ca118
y.create.l HWIO_PMIC_ARB_SPMI_GENI_CFG_REG7_ADDR A:0xfc4ca11c
y.create.l HWIO_PMIC_ARB_SPMI_GENI_CFG_REG8_ADDR A:0xfc4ca120
y.create.l HWIO_PMIC_ARB_SPMI_GENI_CFG_REG9_ADDR A:0xfc4ca124
y.create.l HWIO_PMIC_ARB_SPMI_GENI_CFG_REG10_ADDR A:0xfc4ca128
y.create.l HWIO_PMIC_ARB_SPMI_GENI_CFG_REG11_ADDR A:0xfc4ca12c
y.create.l HWIO_PMIC_ARB_SPMI_GENI_CFG_REG12_ADDR A:0xfc4ca130
y.create.l HWIO_PMIC_ARB_SPMI_GENI_CFG_REG13_ADDR A:0xfc4ca134
y.create.l HWIO_PMIC_ARB_SPMI_GENI_CFG_REG14_ADDR A:0xfc4ca138
y.create.l HWIO_PMIC_ARB_SPMI_GENI_CFG_REG15_ADDR A:0xfc4ca13c
y.create.l HWIO_PMIC_ARB_SPMI_GENI_CFG_REG16_ADDR A:0xfc4ca140
y.create.l HWIO_PMIC_ARB_SPMI_GENI_CFG_REG17_ADDR A:0xfc4ca144
y.create.l HWIO_PMIC_ARB_SPMI_GENI_CFG_REG18_ADDR A:0xfc4ca148
y.create.l HWIO_PMIC_ARB_SPMI_GENI_CFG_REG19_ADDR A:0xfc4ca14c
y.create.l HWIO_PMIC_ARB_SPMI_GENI_CFG_REG20_ADDR A:0xfc4ca150
y.create.l HWIO_PMIC_ARB_SPMI_GENI_CFG_REG21_ADDR A:0xfc4ca154
y.create.l HWIO_PMIC_ARB_SPMI_GENI_CFG_REG22_ADDR A:0xfc4ca158
y.create.l HWIO_PMIC_ARB_SPMI_GENI_CFG_REG23_ADDR A:0xfc4ca15c
y.create.l HWIO_PMIC_ARB_SPMI_GENI_CFG_REG24_ADDR A:0xfc4ca160
y.create.l HWIO_PMIC_ARB_SPMI_GENI_CFG_REG25_ADDR A:0xfc4ca164
y.create.l HWIO_PMIC_ARB_SPMI_GENI_CFG_REG26_ADDR A:0xfc4ca168
y.create.l HWIO_PMIC_ARB_SPMI_GENI_CFG_REG27_ADDR A:0xfc4ca16c
y.create.l HWIO_PMIC_ARB_SPMI_GENI_CFG_REG28_ADDR A:0xfc4ca170
y.create.l HWIO_PMIC_ARB_SPMI_GENI_CFG_REG29_ADDR A:0xfc4ca174
y.create.l HWIO_PMIC_ARB_SPMI_GENI_CFG_REG30_ADDR A:0xfc4ca178
y.create.l HWIO_PMIC_ARB_SPMI_GENI_CFG_RAM0_ADDR A:0xfc4ca200
y.create.l HWIO_PMIC_ARB_SPMI_GENI_CFG_RAM1_ADDR A:0xfc4ca204
y.create.l HWIO_PMIC_ARB_SPMI_GENI_CFG_RAM2_ADDR A:0xfc4ca208
y.create.l HWIO_PMIC_ARB_SPMI_GENI_CFG_RAM3_ADDR A:0xfc4ca20c
y.create.l HWIO_PMIC_ARB_SPMI_GENI_CFG_RAM4_ADDR A:0xfc4ca210
y.create.l HWIO_PMIC_ARB_SPMI_GENI_CFG_RAM5_ADDR A:0xfc4ca214
y.create.l HWIO_PMIC_ARB_SPMI_GENI_CFG_RAM6_ADDR A:0xfc4ca218
y.create.l HWIO_PMIC_ARB_SPMI_GENI_CFG_RAM7_ADDR A:0xfc4ca21c
y.create.l HWIO_PMIC_ARB_SPMI_GENI_CFG_RAM8_ADDR A:0xfc4ca220
y.create.l HWIO_PMIC_ARB_SPMI_GENI_CFG_RAM9_ADDR A:0xfc4ca224
y.create.l HWIO_PMIC_ARB_SPMI_PERIPH0_2OWNER_TABLE_REG_ADDR A:0xfc4ca700
y.create.l HWIO_PMIC_ARB_SPMI_PERIPH1_2OWNER_TABLE_REG_ADDR A:0xfc4ca704
y.create.l HWIO_PMIC_ARB_SPMI_PERIPH2_2OWNER_TABLE_REG_ADDR A:0xfc4ca708
y.create.l HWIO_PMIC_ARB_SPMI_PERIPH3_2OWNER_TABLE_REG_ADDR A:0xfc4ca70c
y.create.l HWIO_PMIC_ARB_SPMI_PERIPH4_2OWNER_TABLE_REG_ADDR A:0xfc4ca710
y.create.l HWIO_PMIC_ARB_SPMI_PERIPH5_2OWNER_TABLE_REG_ADDR A:0xfc4ca714
y.create.l HWIO_PMIC_ARB_SPMI_PERIPH6_2OWNER_TABLE_REG_ADDR A:0xfc4ca718
y.create.l HWIO_PMIC_ARB_SPMI_PERIPH7_2OWNER_TABLE_REG_ADDR A:0xfc4ca71c
y.create.l HWIO_PMIC_ARB_SPMI_PERIPH8_2OWNER_TABLE_REG_ADDR A:0xfc4ca720
y.create.l HWIO_PMIC_ARB_SPMI_PERIPH9_2OWNER_TABLE_REG_ADDR A:0xfc4ca724
y.create.l HWIO_PMIC_ARB_SPMI_MAPPING_TABLE_REG0_ADDR A:0xfc4cab00
y.create.l HWIO_PMIC_ARB_SPMI_MAPPING_TABLE_REG1_ADDR A:0xfc4cab04
y.create.l HWIO_PMIC_ARB_SPMI_MAPPING_TABLE_REG2_ADDR A:0xfc4cab08
y.create.l HWIO_PMIC_ARB_SPMI_MAPPING_TABLE_REG3_ADDR A:0xfc4cab0c
y.create.l HWIO_PMIC_ARB_SPMI_MAPPING_TABLE_REG4_ADDR A:0xfc4cab10
y.create.l HWIO_PMIC_ARB_SPMI_MAPPING_TABLE_REG5_ADDR A:0xfc4cab14
y.create.l HWIO_PMIC_ARB_SPMI_MAPPING_TABLE_REG6_ADDR A:0xfc4cab18
y.create.l HWIO_PMIC_ARB_SPMI_MAPPING_TABLE_REG7_ADDR A:0xfc4cab1c
y.create.l HWIO_PMIC_ARB_SPMI_MAPPING_TABLE_REG8_ADDR A:0xfc4cab20
y.create.l HWIO_PMIC_ARB_SPMI_MAPPING_TABLE_REG9_ADDR A:0xfc4cab24
y.create.l HWIO_PMIC_ARB_SPMI_MID_REG_ADDR A:0xfc4caf00
y.create.l HWIO_PMIC_ARB_SPMI_CFG_REG_ADDR A:0xfc4caf04
y.create.l HWIO_PMIC_ARB_SPMI_SEC_DISABLE_REG_ADDR A:0xfc4caf08
y.create.l HWIO_PMIC_ARB_SPMI_HW_VERSION_ADDR A:0xfc4caf0c
y.create.l HWIO_PMIC_ARB_SPMI_CGC_CTRL_ADDR A:0xfc4caf10
y.create.l HWIO_PMIC_ARB_SPMI_MWB_ENABLE_REG_ADDR A:0xfc4caf14
y.create.l HWIO_PMIC_ARB_SPMI_PROTOCOL_IRQ_STATUS_ADDR A:0xfc4caf20
y.create.l HWIO_PMIC_ARB_SPMI_PROTOCOL_IRQ_ENABLE_ADDR A:0xfc4caf24
y.create.l HWIO_PMIC_ARB_SPMI_PROTOCOL_IRQ_CLEAR_ADDR A:0xfc4caf28
y.create.l HWIO_PMIC_ARB_SPMI_PROTOCOL_IRQ_EN_SET_ADDR A:0xfc4caf2c
y.create.l HWIO_PMIC_ARB_SPMI_PROTOCOL_IRQ_EN_CLEAR_ADDR A:0xfc4caf30
y.create.l HWIO_PMIC_ARB_SPMI_CHAR_CFG_ADDR A:0xfc4caf40
y.create.l HWIO_PMIC_ARB_SPMI_CHAR_DATA_0_ADDR A:0xfc4caf44
y.create.l HWIO_PMIC_ARB_SPMI_CHAR_DATA_1_ADDR A:0xfc4caf48
y.create.l HWIO_PMIC_ARB_SPMI_TEST_BUS_CTRL_ADDR A:0xfc4caf4c
y.create.l HWIO_PMIC_ARB_SPMI_HW_SW_EVENTS_CTRL_ADDR A:0xfc4caf50
y.create.l HWIO_PMIC_ARB_SPMI_CMPR_EN_REG_ADDR A:0xfc4caf54
y.create.l HWIO_PMIC_ARB_SPMI_HW_SW_EVENTS_BITWISE_REG0_ADDR A:0xfc4caf58
y.create.l HWIO_PMIC_ARB_SPMI_HW_SW_EVENTS_BITWISE_REG1_ADDR A:0xfc4caf5c
y.create.l HWIO_PMIC_ARB_SPMI_HW_SW_EVENTS_BITWISE_REG2_ADDR A:0xfc4caf60
y.create.l HWIO_PMIC_ARB_SPMI_HW_SW_EVENTS_BITWISE_REG3_ADDR A:0xfc4caf64
y.create.l HWIO_PMIC_ARB_SPMI_HW_SW_EVENTS_BITWISE_REG4_ADDR A:0xfc4caf68
y.create.l HWIO_PMIC_ARB_SPMI_HW_SW_EVENTS_BITWISE_REG5_ADDR A:0xfc4caf6c
y.create.l HWIO_PMIC_ARB_SPMI_HW_SW_EVENTS_BITWISE_REG6_ADDR A:0xfc4caf70
y.create.l HWIO_PMIC_ARB_SPMI_HW_SW_EVENTS_BITWISE_REG7_ADDR A:0xfc4caf74
y.create.l HWIO_PMIC_ARB_SPMI_XPU_SCR_ADDR A:0xfc4c0000
y.create.l HWIO_PMIC_ARB_SPMI_XPU_SWDR_ADDR A:0xfc4c0004
y.create.l HWIO_PMIC_ARB_SPMI_XPU_SEAR0_ADDR A:0xfc4c0040
y.create.l HWIO_PMIC_ARB_SPMI_XPU_SESR_ADDR A:0xfc4c0048
y.create.l HWIO_PMIC_ARB_SPMI_XPU_SESRRESTORE_ADDR A:0xfc4c004c
y.create.l HWIO_PMIC_ARB_SPMI_XPU_SESYNR0_ADDR A:0xfc4c0050
y.create.l HWIO_PMIC_ARB_SPMI_XPU_SESYNR1_ADDR A:0xfc4c0054
y.create.l HWIO_PMIC_ARB_SPMI_XPU_SESYNR2_ADDR A:0xfc4c0058
y.create.l HWIO_PMIC_ARB_SPMI_XPU_MCR_ADDR A:0xfc4c0100
y.create.l HWIO_PMIC_ARB_SPMI_XPU_MEAR0_ADDR A:0xfc4c0140
y.create.l HWIO_PMIC_ARB_SPMI_XPU_MESR_ADDR A:0xfc4c0148
y.create.l HWIO_PMIC_ARB_SPMI_XPU_MESRRESTORE_ADDR A:0xfc4c014c
y.create.l HWIO_PMIC_ARB_SPMI_XPU_MESYNR0_ADDR A:0xfc4c0150
y.create.l HWIO_PMIC_ARB_SPMI_XPU_MESYNR1_ADDR A:0xfc4c0154
y.create.l HWIO_PMIC_ARB_SPMI_XPU_MESYNR2_ADDR A:0xfc4c0158
y.create.l HWIO_PMIC_ARB_SPMI_XPU_CR_ADDR A:0xfc4c0080
y.create.l HWIO_PMIC_ARB_SPMI_XPU_RPU_ACR0_ADDR A:0xfc4c00a0
y.create.l HWIO_PMIC_ARB_SPMI_XPU_EAR0_ADDR A:0xfc4c00c0
y.create.l HWIO_PMIC_ARB_SPMI_XPU_ESR_ADDR A:0xfc4c00c8
y.create.l HWIO_PMIC_ARB_SPMI_XPU_ESRRESTORE_ADDR A:0xfc4c00cc
y.create.l HWIO_PMIC_ARB_SPMI_XPU_ESYNR0_ADDR A:0xfc4c00d0
y.create.l HWIO_PMIC_ARB_SPMI_XPU_ESYNR1_ADDR A:0xfc4c00d4
y.create.l HWIO_PMIC_ARB_SPMI_XPU_ESYNR2_ADDR A:0xfc4c00d8
y.create.l HWIO_PMIC_ARB_SPMI_XPU_IDR0_ADDR A:0xfc4c0074
y.create.l HWIO_PMIC_ARB_SPMI_XPU_IDR1_ADDR A:0xfc4c0078
y.create.l HWIO_PMIC_ARB_SPMI_XPU_REV_ADDR A:0xfc4c007c
y.create.l HWIO_PMIC_ARB_SPMI_XPU_RG0_RACR0_ADDR A:0xfc4c0200
y.create.l HWIO_PMIC_ARB_SPMI_XPU_RG1_RACR0_ADDR A:0xfc4c0280
y.create.l HWIO_PMIC_ARB_SPMI_XPU_RG2_RACR0_ADDR A:0xfc4c0300
y.create.l HWIO_PMIC_ARB_SPMI_XPU_RG3_RACR0_ADDR A:0xfc4c0380
y.create.l HWIO_PMIC_ARB_SPMI_XPU_RG4_RACR0_ADDR A:0xfc4c0400
y.create.l HWIO_PMIC_ARB_SPMI_XPU_RG5_RACR0_ADDR A:0xfc4c0480
y.create.l HWIO_PMIC_ARB_SPMI_XPU_RG6_RACR0_ADDR A:0xfc4c0500
y.create.l HWIO_PMIC_ARB_SPMI_XPU_RG7_RACR0_ADDR A:0xfc4c0580
y.create.l HWIO_PMIC_ARB_SPMI_XPU_RG8_RACR0_ADDR A:0xfc4c0600
y.create.l HWIO_PMIC_ARB_SPMI_XPU_RG9_RACR0_ADDR A:0xfc4c0680
y.create.l HWIO_PMIC_ARB_SPMI_XPU_RG0_SCR_ADDR A:0xfc4c0250
y.create.l HWIO_PMIC_ARB_SPMI_XPU_RG1_SCR_ADDR A:0xfc4c02d0
y.create.l HWIO_PMIC_ARB_SPMI_XPU_RG2_SCR_ADDR A:0xfc4c0350
y.create.l HWIO_PMIC_ARB_SPMI_XPU_RG3_SCR_ADDR A:0xfc4c03d0
y.create.l HWIO_PMIC_ARB_SPMI_XPU_RG4_SCR_ADDR A:0xfc4c0450
y.create.l HWIO_PMIC_ARB_SPMI_XPU_RG5_SCR_ADDR A:0xfc4c04d0
y.create.l HWIO_PMIC_ARB_SPMI_XPU_RG6_SCR_ADDR A:0xfc4c0550
y.create.l HWIO_PMIC_ARB_SPMI_XPU_RG7_SCR_ADDR A:0xfc4c05d0
y.create.l HWIO_PMIC_ARB_SPMI_XPU_RG8_SCR_ADDR A:0xfc4c0650
y.create.l HWIO_PMIC_ARB_SPMI_XPU_RG9_SCR_ADDR A:0xfc4c06d0
y.create.l HWIO_PMIC_ARB_SPMI_XPU_RG0_MCR_ADDR A:0xfc4c0254
y.create.l HWIO_PMIC_ARB_SPMI_XPU_RG1_MCR_ADDR A:0xfc4c02d4
y.create.l HWIO_PMIC_ARB_SPMI_XPU_RG2_MCR_ADDR A:0xfc4c0354
y.create.l HWIO_PMIC_ARB_SPMI_XPU_RG3_MCR_ADDR A:0xfc4c03d4
y.create.l HWIO_PMIC_ARB_SPMI_XPU_RG4_MCR_ADDR A:0xfc4c0454
y.create.l HWIO_PMIC_ARB_SPMI_XPU_RG5_MCR_ADDR A:0xfc4c04d4
y.create.l HWIO_PMIC_ARB_SPMI_XPU_RG6_MCR_ADDR A:0xfc4c0554
y.create.l HWIO_PMIC_ARB_SPMI_XPU_RG7_MCR_ADDR A:0xfc4c05d4
y.create.l HWIO_PMIC_ARB_SPMI_XPU_RG8_MCR_ADDR A:0xfc4c0654
y.create.l HWIO_PMIC_ARB_SPMI_XPU_RG9_MCR_ADDR A:0xfc4c06d4
y.create.l HWIO_PMIC_ARB_SPMI_PIC_OWNER0_ACC_STATUS0_ADDR A:0xfc4cb000
y.create.l HWIO_PMIC_ARB_SPMI_PIC_OWNER0_ACC_STATUS1_ADDR A:0xfc4cb004
y.create.l HWIO_PMIC_ARB_SPMI_PIC_OWNER0_ACC_STATUS2_ADDR A:0xfc4cb008
y.create.l HWIO_PMIC_ARB_SPMI_PIC_OWNER0_ACC_STATUS3_ADDR A:0xfc4cb00c
y.create.l HWIO_PMIC_ARB_SPMI_PIC_OWNER1_ACC_STATUS0_ADDR A:0xfc4cb020
y.create.l HWIO_PMIC_ARB_SPMI_PIC_OWNER1_ACC_STATUS1_ADDR A:0xfc4cb024
y.create.l HWIO_PMIC_ARB_SPMI_PIC_OWNER1_ACC_STATUS2_ADDR A:0xfc4cb028
y.create.l HWIO_PMIC_ARB_SPMI_PIC_OWNER1_ACC_STATUS3_ADDR A:0xfc4cb02c
y.create.l HWIO_PMIC_ARB_SPMI_PIC_OWNER2_ACC_STATUS0_ADDR A:0xfc4cb040
y.create.l HWIO_PMIC_ARB_SPMI_PIC_OWNER2_ACC_STATUS1_ADDR A:0xfc4cb044
y.create.l HWIO_PMIC_ARB_SPMI_PIC_OWNER2_ACC_STATUS2_ADDR A:0xfc4cb048
y.create.l HWIO_PMIC_ARB_SPMI_PIC_OWNER2_ACC_STATUS3_ADDR A:0xfc4cb04c
y.create.l HWIO_PMIC_ARB_SPMI_PIC_OWNER3_ACC_STATUS0_ADDR A:0xfc4cb060
y.create.l HWIO_PMIC_ARB_SPMI_PIC_OWNER3_ACC_STATUS1_ADDR A:0xfc4cb064
y.create.l HWIO_PMIC_ARB_SPMI_PIC_OWNER3_ACC_STATUS2_ADDR A:0xfc4cb068
y.create.l HWIO_PMIC_ARB_SPMI_PIC_OWNER3_ACC_STATUS3_ADDR A:0xfc4cb06c
y.create.l HWIO_PMIC_ARB_SPMI_PIC_OWNER4_ACC_STATUS0_ADDR A:0xfc4cb080
y.create.l HWIO_PMIC_ARB_SPMI_PIC_OWNER4_ACC_STATUS1_ADDR A:0xfc4cb084
y.create.l HWIO_PMIC_ARB_SPMI_PIC_OWNER4_ACC_STATUS2_ADDR A:0xfc4cb088
y.create.l HWIO_PMIC_ARB_SPMI_PIC_OWNER4_ACC_STATUS3_ADDR A:0xfc4cb08c
y.create.l HWIO_PMIC_ARB_SPMI_PIC_OWNER5_ACC_STATUS0_ADDR A:0xfc4cb0a0
y.create.l HWIO_PMIC_ARB_SPMI_PIC_OWNER5_ACC_STATUS1_ADDR A:0xfc4cb0a4
y.create.l HWIO_PMIC_ARB_SPMI_PIC_OWNER5_ACC_STATUS2_ADDR A:0xfc4cb0a8
y.create.l HWIO_PMIC_ARB_SPMI_PIC_OWNER5_ACC_STATUS3_ADDR A:0xfc4cb0ac
y.create.l HWIO_PMIC_ARB_SPMI_PIC_ACC_ENABLE0_ADDR A:0xfc4cb200
y.create.l HWIO_PMIC_ARB_SPMI_PIC_ACC_ENABLE1_ADDR A:0xfc4cb204
y.create.l HWIO_PMIC_ARB_SPMI_PIC_ACC_ENABLE2_ADDR A:0xfc4cb208
y.create.l HWIO_PMIC_ARB_SPMI_PIC_ACC_ENABLE3_ADDR A:0xfc4cb20c
y.create.l HWIO_PMIC_ARB_SPMI_PIC_ACC_ENABLE4_ADDR A:0xfc4cb210
y.create.l HWIO_PMIC_ARB_SPMI_PIC_ACC_ENABLE5_ADDR A:0xfc4cb214
y.create.l HWIO_PMIC_ARB_SPMI_PIC_ACC_ENABLE6_ADDR A:0xfc4cb218
y.create.l HWIO_PMIC_ARB_SPMI_PIC_ACC_ENABLE7_ADDR A:0xfc4cb21c
y.create.l HWIO_PMIC_ARB_SPMI_PIC_ACC_ENABLE8_ADDR A:0xfc4cb220
y.create.l HWIO_PMIC_ARB_SPMI_PIC_ACC_ENABLE9_ADDR A:0xfc4cb224
y.create.l HWIO_PMIC_ARB_SPMI_PIC_IRQ_STATUS0_ADDR A:0xfc4cb600
y.create.l HWIO_PMIC_ARB_SPMI_PIC_IRQ_STATUS1_ADDR A:0xfc4cb604
y.create.l HWIO_PMIC_ARB_SPMI_PIC_IRQ_STATUS2_ADDR A:0xfc4cb608
y.create.l HWIO_PMIC_ARB_SPMI_PIC_IRQ_STATUS3_ADDR A:0xfc4cb60c
y.create.l HWIO_PMIC_ARB_SPMI_PIC_IRQ_STATUS4_ADDR A:0xfc4cb610
y.create.l HWIO_PMIC_ARB_SPMI_PIC_IRQ_STATUS5_ADDR A:0xfc4cb614
y.create.l HWIO_PMIC_ARB_SPMI_PIC_IRQ_STATUS6_ADDR A:0xfc4cb618
y.create.l HWIO_PMIC_ARB_SPMI_PIC_IRQ_STATUS7_ADDR A:0xfc4cb61c
y.create.l HWIO_PMIC_ARB_SPMI_PIC_IRQ_STATUS8_ADDR A:0xfc4cb620
y.create.l HWIO_PMIC_ARB_SPMI_PIC_IRQ_STATUS9_ADDR A:0xfc4cb624
y.create.l HWIO_PMIC_ARB_SPMI_PIC_IRQ_CLEAR0_ADDR A:0xfc4cba00
y.create.l HWIO_PMIC_ARB_SPMI_PIC_IRQ_CLEAR1_ADDR A:0xfc4cba04
y.create.l HWIO_PMIC_ARB_SPMI_PIC_IRQ_CLEAR2_ADDR A:0xfc4cba08
y.create.l HWIO_PMIC_ARB_SPMI_PIC_IRQ_CLEAR3_ADDR A:0xfc4cba0c
y.create.l HWIO_PMIC_ARB_SPMI_PIC_IRQ_CLEAR4_ADDR A:0xfc4cba10
y.create.l HWIO_PMIC_ARB_SPMI_PIC_IRQ_CLEAR5_ADDR A:0xfc4cba14
y.create.l HWIO_PMIC_ARB_SPMI_PIC_IRQ_CLEAR6_ADDR A:0xfc4cba18
y.create.l HWIO_PMIC_ARB_SPMI_PIC_IRQ_CLEAR7_ADDR A:0xfc4cba1c
y.create.l HWIO_PMIC_ARB_SPMI_PIC_IRQ_CLEAR8_ADDR A:0xfc4cba20
y.create.l HWIO_PMIC_ARB_SPMI_PIC_IRQ_CLEAR9_ADDR A:0xfc4cba24
y.create.l HWIO_PMIC_ARB_XPU_SCR_ADDR A:0xfc4ce000
y.create.l HWIO_PMIC_ARB_XPU_SWDR_ADDR A:0xfc4ce004
y.create.l HWIO_PMIC_ARB_XPU_SEAR0_ADDR A:0xfc4ce040
y.create.l HWIO_PMIC_ARB_XPU_SESR_ADDR A:0xfc4ce048
y.create.l HWIO_PMIC_ARB_XPU_SESRRESTORE_ADDR A:0xfc4ce04c
y.create.l HWIO_PMIC_ARB_XPU_SESYNR0_ADDR A:0xfc4ce050
y.create.l HWIO_PMIC_ARB_XPU_SESYNR1_ADDR A:0xfc4ce054
y.create.l HWIO_PMIC_ARB_XPU_SESYNR2_ADDR A:0xfc4ce058
y.create.l HWIO_PMIC_ARB_XPU_MCR_ADDR A:0xfc4ce100
y.create.l HWIO_PMIC_ARB_XPU_MEAR0_ADDR A:0xfc4ce140
y.create.l HWIO_PMIC_ARB_XPU_MESR_ADDR A:0xfc4ce148
y.create.l HWIO_PMIC_ARB_XPU_MESRRESTORE_ADDR A:0xfc4ce14c
y.create.l HWIO_PMIC_ARB_XPU_MESYNR0_ADDR A:0xfc4ce150
y.create.l HWIO_PMIC_ARB_XPU_MESYNR1_ADDR A:0xfc4ce154
y.create.l HWIO_PMIC_ARB_XPU_MESYNR2_ADDR A:0xfc4ce158
y.create.l HWIO_PMIC_ARB_XPU_CR_ADDR A:0xfc4ce080
y.create.l HWIO_PMIC_ARB_XPU_RPU_ACR0_ADDR A:0xfc4ce0a0
y.create.l HWIO_PMIC_ARB_XPU_EAR0_ADDR A:0xfc4ce0c0
y.create.l HWIO_PMIC_ARB_XPU_ESR_ADDR A:0xfc4ce0c8
y.create.l HWIO_PMIC_ARB_XPU_ESRRESTORE_ADDR A:0xfc4ce0cc
y.create.l HWIO_PMIC_ARB_XPU_ESYNR0_ADDR A:0xfc4ce0d0
y.create.l HWIO_PMIC_ARB_XPU_ESYNR1_ADDR A:0xfc4ce0d4
y.create.l HWIO_PMIC_ARB_XPU_ESYNR2_ADDR A:0xfc4ce0d8
y.create.l HWIO_PMIC_ARB_XPU_IDR0_ADDR A:0xfc4ce074
y.create.l HWIO_PMIC_ARB_XPU_IDR1_ADDR A:0xfc4ce078
y.create.l HWIO_PMIC_ARB_XPU_REV_ADDR A:0xfc4ce07c
y.create.l HWIO_PMIC_ARB_XPU_RG0_RACR0_ADDR A:0xfc4ce200
y.create.l HWIO_PMIC_ARB_XPU_RG1_RACR0_ADDR A:0xfc4ce280
y.create.l HWIO_PMIC_ARB_XPU_RG2_RACR0_ADDR A:0xfc4ce300
y.create.l HWIO_PMIC_ARB_XPU_RG3_RACR0_ADDR A:0xfc4ce380
y.create.l HWIO_PMIC_ARB_XPU_RG4_RACR0_ADDR A:0xfc4ce400
y.create.l HWIO_PMIC_ARB_XPU_RG5_RACR0_ADDR A:0xfc4ce480
y.create.l HWIO_PMIC_ARB_XPU_RG6_RACR0_ADDR A:0xfc4ce500
y.create.l HWIO_PMIC_ARB_XPU_RG7_RACR0_ADDR A:0xfc4ce580
y.create.l HWIO_PMIC_ARB_XPU_RG0_SCR_ADDR A:0xfc4ce250
y.create.l HWIO_PMIC_ARB_XPU_RG1_SCR_ADDR A:0xfc4ce2d0
y.create.l HWIO_PMIC_ARB_XPU_RG2_SCR_ADDR A:0xfc4ce350
y.create.l HWIO_PMIC_ARB_XPU_RG3_SCR_ADDR A:0xfc4ce3d0
y.create.l HWIO_PMIC_ARB_XPU_RG4_SCR_ADDR A:0xfc4ce450
y.create.l HWIO_PMIC_ARB_XPU_RG5_SCR_ADDR A:0xfc4ce4d0
y.create.l HWIO_PMIC_ARB_XPU_RG6_SCR_ADDR A:0xfc4ce550
y.create.l HWIO_PMIC_ARB_XPU_RG7_SCR_ADDR A:0xfc4ce5d0
y.create.l HWIO_PMIC_ARB_XPU_RG0_MCR_ADDR A:0xfc4ce254
y.create.l HWIO_PMIC_ARB_XPU_RG1_MCR_ADDR A:0xfc4ce2d4
y.create.l HWIO_PMIC_ARB_XPU_RG2_MCR_ADDR A:0xfc4ce354
y.create.l HWIO_PMIC_ARB_XPU_RG3_MCR_ADDR A:0xfc4ce3d4
y.create.l HWIO_PMIC_ARB_XPU_RG4_MCR_ADDR A:0xfc4ce454
y.create.l HWIO_PMIC_ARB_XPU_RG5_MCR_ADDR A:0xfc4ce4d4
y.create.l HWIO_PMIC_ARB_XPU_RG6_MCR_ADDR A:0xfc4ce554
y.create.l HWIO_PMIC_ARB_XPU_RG7_MCR_ADDR A:0xfc4ce5d4
y.create.l HWIO_PMIC_ARB_HW_VERSION_ADDR A:0xfc4cf000
y.create.l HWIO_PMIC_ARB_MISC_CONFIG_ADDR A:0xfc4cf004
y.create.l HWIO_PMIC_ARB_PVC_INTF_CTL_ADDR A:0xfc4cf008
y.create.l HWIO_PMIC_ARB_PVC_INTF_STATUS_ADDR A:0xfc4cf00c
y.create.l HWIO_PMIC_ARB_PRIORITIES0_ADDR A:0xfc4cf100
y.create.l HWIO_PMIC_ARB_PRIORITIES1_ADDR A:0xfc4cf104
y.create.l HWIO_PMIC_ARB_PRIORITIES2_ADDR A:0xfc4cf108
y.create.l HWIO_PMIC_ARB_PRIORITIES3_ADDR A:0xfc4cf10c
y.create.l HWIO_PMIC_ARB_PRIORITIES4_ADDR A:0xfc4cf110
y.create.l HWIO_PMIC_ARB_PRIORITIES5_ADDR A:0xfc4cf114
y.create.l HWIO_PMIC_ARB_PRIORITIES6_ADDR A:0xfc4cf118
y.create.l HWIO_PMIC_ARB_PRIORITIES7_ADDR A:0xfc4cf11c
y.create.l HWIO_PMIC_ARB_PRIORITIES8_ADDR A:0xfc4cf120
y.create.l HWIO_PMIC_ARB_PRIORITIES9_ADDR A:0xfc4cf124
y.create.l HWIO_PMIC_ARB_PVC_PORT0_CTL_ADDR A:0xfc4cf200
y.create.l HWIO_PMIC_ARB_PVC_PORT1_CTL_ADDR A:0xfc4cf204
y.create.l HWIO_PMIC_ARB_PVC_PORT2_CTL_ADDR A:0xfc4cf208
y.create.l HWIO_PMIC_ARB_PVC_PORT3_CTL_ADDR A:0xfc4cf20c
y.create.l HWIO_PMIC_ARB_PVC_PORT4_CTL_ADDR A:0xfc4cf210
y.create.l HWIO_PMIC_ARB_PVC_PORT5_CTL_ADDR A:0xfc4cf214
y.create.l HWIO_PMIC_ARB_PVC_PORT6_CTL_ADDR A:0xfc4cf218
y.create.l HWIO_PMIC_ARB_PVC_PORT7_CTL_ADDR A:0xfc4cf21c
y.create.l HWIO_PMIC_ARB_PVC_PORT8_CTL_ADDR A:0xfc4cf220
y.create.l HWIO_PMIC_ARB_PVC_PORT9_CTL_ADDR A:0xfc4cf224
y.create.l HWIO_PMIC_ARB_PVC_PORT0_STATUS_ADDR A:0xfc4cf280
y.create.l HWIO_PMIC_ARB_PVC_PORT1_STATUS_ADDR A:0xfc4cf284
y.create.l HWIO_PMIC_ARB_PVC_PORT2_STATUS_ADDR A:0xfc4cf288
y.create.l HWIO_PMIC_ARB_PVC_PORT3_STATUS_ADDR A:0xfc4cf28c
y.create.l HWIO_PMIC_ARB_PVC_PORT4_STATUS_ADDR A:0xfc4cf290
y.create.l HWIO_PMIC_ARB_PVC_PORT5_STATUS_ADDR A:0xfc4cf294
y.create.l HWIO_PMIC_ARB_PVC_PORT6_STATUS_ADDR A:0xfc4cf298
y.create.l HWIO_PMIC_ARB_PVC_PORT7_STATUS_ADDR A:0xfc4cf29c
y.create.l HWIO_PMIC_ARB_PVC_PORT8_STATUS_ADDR A:0xfc4cf2a0
y.create.l HWIO_PMIC_ARB_PVC_PORT9_STATUS_ADDR A:0xfc4cf2a4
y.create.l HWIO_PMIC_ARB_PVC0_ADDR0_ADDR A:0xfc4cf400
y.create.l HWIO_PMIC_ARB_PVC0_ADDR1_ADDR A:0xfc4cf404
y.create.l HWIO_PMIC_ARB_PVC0_ADDR2_ADDR A:0xfc4cf408
y.create.l HWIO_PMIC_ARB_PVC0_ADDR3_ADDR A:0xfc4cf40c
y.create.l HWIO_PMIC_ARB_PVC1_ADDR0_ADDR A:0xfc4cf420
y.create.l HWIO_PMIC_ARB_PVC1_ADDR1_ADDR A:0xfc4cf424
y.create.l HWIO_PMIC_ARB_PVC1_ADDR2_ADDR A:0xfc4cf428
y.create.l HWIO_PMIC_ARB_PVC1_ADDR3_ADDR A:0xfc4cf42c
y.create.l HWIO_PMIC_ARB_PVC2_ADDR0_ADDR A:0xfc4cf440
y.create.l HWIO_PMIC_ARB_PVC2_ADDR1_ADDR A:0xfc4cf444
y.create.l HWIO_PMIC_ARB_PVC2_ADDR2_ADDR A:0xfc4cf448
y.create.l HWIO_PMIC_ARB_PVC2_ADDR3_ADDR A:0xfc4cf44c
y.create.l HWIO_PMIC_ARB_PVC3_ADDR0_ADDR A:0xfc4cf460
y.create.l HWIO_PMIC_ARB_PVC3_ADDR1_ADDR A:0xfc4cf464
y.create.l HWIO_PMIC_ARB_PVC3_ADDR2_ADDR A:0xfc4cf468
y.create.l HWIO_PMIC_ARB_PVC3_ADDR3_ADDR A:0xfc4cf46c
y.create.l HWIO_PMIC_ARB_PVC4_ADDR0_ADDR A:0xfc4cf480
y.create.l HWIO_PMIC_ARB_PVC4_ADDR1_ADDR A:0xfc4cf484
y.create.l HWIO_PMIC_ARB_PVC4_ADDR2_ADDR A:0xfc4cf488
y.create.l HWIO_PMIC_ARB_PVC4_ADDR3_ADDR A:0xfc4cf48c
y.create.l HWIO_PMIC_ARB_PVC5_ADDR0_ADDR A:0xfc4cf4a0
y.create.l HWIO_PMIC_ARB_PVC5_ADDR1_ADDR A:0xfc4cf4a4
y.create.l HWIO_PMIC_ARB_PVC5_ADDR2_ADDR A:0xfc4cf4a8
y.create.l HWIO_PMIC_ARB_PVC5_ADDR3_ADDR A:0xfc4cf4ac
y.create.l HWIO_PMIC_ARB_PVC6_ADDR0_ADDR A:0xfc4cf4c0
y.create.l HWIO_PMIC_ARB_PVC6_ADDR1_ADDR A:0xfc4cf4c4
y.create.l HWIO_PMIC_ARB_PVC6_ADDR2_ADDR A:0xfc4cf4c8
y.create.l HWIO_PMIC_ARB_PVC6_ADDR3_ADDR A:0xfc4cf4cc
y.create.l HWIO_PMIC_ARB_PVC7_ADDR0_ADDR A:0xfc4cf4e0
y.create.l HWIO_PMIC_ARB_PVC7_ADDR1_ADDR A:0xfc4cf4e4
y.create.l HWIO_PMIC_ARB_PVC7_ADDR2_ADDR A:0xfc4cf4e8
y.create.l HWIO_PMIC_ARB_PVC7_ADDR3_ADDR A:0xfc4cf4ec
y.create.l HWIO_PMIC_ARB_PVC8_ADDR0_ADDR A:0xfc4cf500
y.create.l HWIO_PMIC_ARB_PVC8_ADDR1_ADDR A:0xfc4cf504
y.create.l HWIO_PMIC_ARB_PVC8_ADDR2_ADDR A:0xfc4cf508
y.create.l HWIO_PMIC_ARB_PVC8_ADDR3_ADDR A:0xfc4cf50c
y.create.l HWIO_PMIC_ARB_PVC9_ADDR0_ADDR A:0xfc4cf520
y.create.l HWIO_PMIC_ARB_PVC9_ADDR1_ADDR A:0xfc4cf524
y.create.l HWIO_PMIC_ARB_PVC9_ADDR2_ADDR A:0xfc4cf528
y.create.l HWIO_PMIC_ARB_PVC9_ADDR3_ADDR A:0xfc4cf52c
y.create.l HWIO_PMIC_ARB_CHNL0_CMD_ADDR A:0xfc4cf800
y.create.l HWIO_PMIC_ARB_CHNL1_CMD_ADDR A:0xfc4cf880
y.create.l HWIO_PMIC_ARB_CHNL2_CMD_ADDR A:0xfc4cf900
y.create.l HWIO_PMIC_ARB_CHNL3_CMD_ADDR A:0xfc4cf980
y.create.l HWIO_PMIC_ARB_CHNL4_CMD_ADDR A:0xfc4cfa00
y.create.l HWIO_PMIC_ARB_CHNL5_CMD_ADDR A:0xfc4cfa80
y.create.l HWIO_PMIC_ARB_CHNL0_CONFIG_ADDR A:0xfc4cf804
y.create.l HWIO_PMIC_ARB_CHNL1_CONFIG_ADDR A:0xfc4cf884
y.create.l HWIO_PMIC_ARB_CHNL2_CONFIG_ADDR A:0xfc4cf904
y.create.l HWIO_PMIC_ARB_CHNL3_CONFIG_ADDR A:0xfc4cf984
y.create.l HWIO_PMIC_ARB_CHNL4_CONFIG_ADDR A:0xfc4cfa04
y.create.l HWIO_PMIC_ARB_CHNL5_CONFIG_ADDR A:0xfc4cfa84
y.create.l HWIO_PMIC_ARB_CHNL0_STATUS_ADDR A:0xfc4cf808
y.create.l HWIO_PMIC_ARB_CHNL1_STATUS_ADDR A:0xfc4cf888
y.create.l HWIO_PMIC_ARB_CHNL2_STATUS_ADDR A:0xfc4cf908
y.create.l HWIO_PMIC_ARB_CHNL3_STATUS_ADDR A:0xfc4cf988
y.create.l HWIO_PMIC_ARB_CHNL4_STATUS_ADDR A:0xfc4cfa08
y.create.l HWIO_PMIC_ARB_CHNL5_STATUS_ADDR A:0xfc4cfa88
y.create.l HWIO_PMIC_ARB_CHNL0_WDATA0_ADDR A:0xfc4cf810
y.create.l HWIO_PMIC_ARB_CHNL1_WDATA0_ADDR A:0xfc4cf890
y.create.l HWIO_PMIC_ARB_CHNL2_WDATA0_ADDR A:0xfc4cf910
y.create.l HWIO_PMIC_ARB_CHNL3_WDATA0_ADDR A:0xfc4cf990
y.create.l HWIO_PMIC_ARB_CHNL4_WDATA0_ADDR A:0xfc4cfa10
y.create.l HWIO_PMIC_ARB_CHNL5_WDATA0_ADDR A:0xfc4cfa90
y.create.l HWIO_PMIC_ARB_CHNL0_WDATA1_ADDR A:0xfc4cf814
y.create.l HWIO_PMIC_ARB_CHNL1_WDATA1_ADDR A:0xfc4cf894
y.create.l HWIO_PMIC_ARB_CHNL2_WDATA1_ADDR A:0xfc4cf914
y.create.l HWIO_PMIC_ARB_CHNL3_WDATA1_ADDR A:0xfc4cf994
y.create.l HWIO_PMIC_ARB_CHNL4_WDATA1_ADDR A:0xfc4cfa14
y.create.l HWIO_PMIC_ARB_CHNL5_WDATA1_ADDR A:0xfc4cfa94
y.create.l HWIO_PMIC_ARB_CHNL0_RDATA0_ADDR A:0xfc4cf818
y.create.l HWIO_PMIC_ARB_CHNL1_RDATA0_ADDR A:0xfc4cf898
y.create.l HWIO_PMIC_ARB_CHNL2_RDATA0_ADDR A:0xfc4cf918
y.create.l HWIO_PMIC_ARB_CHNL3_RDATA0_ADDR A:0xfc4cf998
y.create.l HWIO_PMIC_ARB_CHNL4_RDATA0_ADDR A:0xfc4cfa18
y.create.l HWIO_PMIC_ARB_CHNL5_RDATA0_ADDR A:0xfc4cfa98
y.create.l HWIO_PMIC_ARB_CHNL0_RDATA1_ADDR A:0xfc4cf81c
y.create.l HWIO_PMIC_ARB_CHNL1_RDATA1_ADDR A:0xfc4cf89c
y.create.l HWIO_PMIC_ARB_CHNL2_RDATA1_ADDR A:0xfc4cf91c
y.create.l HWIO_PMIC_ARB_CHNL3_RDATA1_ADDR A:0xfc4cf99c
y.create.l HWIO_PMIC_ARB_CHNL4_RDATA1_ADDR A:0xfc4cfa1c
y.create.l HWIO_PMIC_ARB_CHNL5_RDATA1_ADDR A:0xfc4cfa9c
y.create.l HWIO_PMIC_ARB_CHNL0_RDATA2_ADDR A:0xfc4cf820
y.create.l HWIO_PMIC_ARB_CHNL1_RDATA2_ADDR A:0xfc4cf8a0
y.create.l HWIO_PMIC_ARB_CHNL2_RDATA2_ADDR A:0xfc4cf920
y.create.l HWIO_PMIC_ARB_CHNL3_RDATA2_ADDR A:0xfc4cf9a0
y.create.l HWIO_PMIC_ARB_CHNL4_RDATA2_ADDR A:0xfc4cfa20
y.create.l HWIO_PMIC_ARB_CHNL5_RDATA2_ADDR A:0xfc4cfaa0
y.create.l HWIO_QDSS_CORESIGHT_CSR_ROM_WORD_ADDR A:0xfc300000
y.create.l HWIO_QDSS_STM_ROM_WORD_ADDR A:0xfc300004
y.create.l HWIO_QDSS_CTI0_ROM_WORD_ADDR A:0xfc300008
y.create.l HWIO_QDSS_CTI1_ROM_WORD_ADDR A:0xfc30000c
y.create.l HWIO_QDSS_CTI2_ROM_WORD_ADDR A:0xfc300010
y.create.l HWIO_QDSS_CTI3_ROM_WORD_ADDR A:0xfc300014
y.create.l HWIO_QDSS_CTI4_ROM_WORD_ADDR A:0xfc300018
y.create.l HWIO_QDSS_CTI5_ROM_WORD_ADDR A:0xfc30001c
y.create.l HWIO_QDSS_CTI6_ROM_WORD_ADDR A:0xfc300020
y.create.l HWIO_QDSS_CTI7_ROM_WORD_ADDR A:0xfc300024
y.create.l HWIO_QDSS_CTI8_ROM_WORD_ADDR A:0xfc300028
y.create.l HWIO_QDSS_TPIU_ROM_WORD_ADDR A:0xfc30002c
y.create.l HWIO_QDSS_TFUN0_ROM_WORD_ADDR A:0xfc300030
y.create.l HWIO_QDSS_TFUN1_ROM_WORD_ADDR A:0xfc300034
y.create.l HWIO_QDSS_TFUN2_ROM_WORD_ADDR A:0xfc300038
y.create.l HWIO_QDSS_TREPL_ROM_WORD_ADDR A:0xfc30003c
y.create.l HWIO_QDSS_ETBETF_ROM_WORD_ADDR A:0xfc300040
y.create.l HWIO_QDSS_ETR_ROM_WORD_ADDR A:0xfc300044
y.create.l HWIO_QDSS_MSS_Q6_CTI_ROM_WORD_ADDR A:0xfc300048
y.create.l HWIO_QDSS_LPA_Q6_CTI_ROM_WORD_ADDR A:0xfc30004c
y.create.l HWIO_QDSS_A7SS_CP14_ROM_WORD_ADDR A:0xfc300050
y.create.l HWIO_QDSS_A7SS_CP15_ROM_WORD_ADDR A:0xfc300054
y.create.l HWIO_QDSS_A7SS_ETM_ROM_WORD_ADDR A:0xfc300058
y.create.l HWIO_QDSS_A7SS_CTI_ROM_WORD_ADDR A:0xfc30005c
y.create.l HWIO_QDSS_RPM_CM3_CTI_ROM_WORD_ADDR A:0xfc300060
y.create.l HWIO_QDSS_DAPROM_PERIPHERAL_ID4_ADDR A:0xfc300fd0
y.create.l HWIO_QDSS_DAPROM_PERIPHERAL_ID5_ADDR A:0xfc300fd4
y.create.l HWIO_QDSS_DAPROM_PERIPHERAL_ID6_ADDR A:0xfc300fd8
y.create.l HWIO_QDSS_DAPROM_PERIPHERAL_ID7_ADDR A:0xfc300fdc
y.create.l HWIO_QDSS_DAPROM_PERIPHERAL_ID0_ADDR A:0xfc300fe0
y.create.l HWIO_QDSS_DAPROM_PERIPHERAL_ID1_ADDR A:0xfc300fe4
y.create.l HWIO_QDSS_DAPROM_PERIPHERAL_ID2_ADDR A:0xfc300fe8
y.create.l HWIO_QDSS_DAPROM_PERIPHERAL_ID3_ADDR A:0xfc300fec
y.create.l HWIO_QDSS_DAPROM_COMPONENT_ID0_ADDR A:0xfc300ff0
y.create.l HWIO_QDSS_DAPROM_COMPONENT_ID1_ADDR A:0xfc300ff4
y.create.l HWIO_QDSS_DAPROM_COMPONENT_ID2_ADDR A:0xfc300ff8
y.create.l HWIO_QDSS_DAPROM_COMPONENT_ID3_ADDR A:0xfc300ffc
y.create.l HWIO_QDSS_CS_QDSSCSR_SWDBGPWRCTRL_ADDR A:0xfc301000
y.create.l HWIO_QDSS_CS_QDSSCSR_SWDBGPWRACK_ADDR A:0xfc301004
y.create.l HWIO_QDSS_CS_QDSSCSR_SWSPADREG0_ADDR A:0xfc301008
y.create.l HWIO_QDSS_CS_QDSSCSR_SWSPADREG1_ADDR A:0xfc30100c
y.create.l HWIO_QDSS_CS_QDSSCSR_STMTRANSCTRL_ADDR A:0xfc301010
y.create.l HWIO_QDSS_CS_QDSSCSR_STMAWIDCTRL_ADDR A:0xfc301014
y.create.l HWIO_QDSS_CS_QDSSCSR_STMCHNOFST0_ADDR A:0xfc301018
y.create.l HWIO_QDSS_CS_QDSSCSR_STMCHNOFST1_ADDR A:0xfc30101c
y.create.l HWIO_QDSS_CS_QDSSCSR_STMEXTHWCTRL0_ADDR A:0xfc301020
y.create.l HWIO_QDSS_CS_QDSSCSR_STMEXTHWCTRL1_ADDR A:0xfc301024
y.create.l HWIO_QDSS_CS_QDSSCSR_STMEXTHWCTRL2_ADDR A:0xfc301028
y.create.l HWIO_QDSS_CS_QDSSCSR_STMEXTHWCTRL3_ADDR A:0xfc30102c
y.create.l HWIO_QDSS_CS_QDSSCSR_USBBAMCTRL_ADDR A:0xfc301030
y.create.l HWIO_QDSS_CS_QDSSCSR_USBFLSHCTRL_ADDR A:0xfc301034
y.create.l HWIO_QDSS_CS_QDSSCSR_TIMESTAMPCTRL_ADDR A:0xfc301038
y.create.l HWIO_QDSS_CS_QDSSCSR_AOTIMEVAL0_ADDR A:0xfc30103c
y.create.l HWIO_QDSS_CS_QDSSCSR_AOTIMEVAL1_ADDR A:0xfc301040
y.create.l HWIO_QDSS_CS_QDSSCSR_QDSSTIMEVAL0_ADDR A:0xfc301044
y.create.l HWIO_QDSS_CS_QDSSCSR_QDSSTIMEVAL1_ADDR A:0xfc301048
y.create.l HWIO_QDSS_CS_QDSSCSR_QDSSTIMELOAD0_ADDR A:0xfc30104c
y.create.l HWIO_QDSS_CS_QDSSCSR_QDSSTIMELOAD1_ADDR A:0xfc301050
y.create.l HWIO_QDSS_CS_QDSSCSR_DAPMSAVAL_ADDR A:0xfc301054
y.create.l HWIO_QDSS_CS_QDSSCSR_QDSSCLKVOTE_ADDR A:0xfc301058
y.create.l HWIO_QDSS_CS_QDSSCSR_QDSSCLKIPI_ADDR A:0xfc30105c
y.create.l HWIO_QDSS_CS_QDSSCSR_QDSSPWRREQIGNORE_ADDR A:0xfc301060
y.create.l HWIO_QDSS_CS_QDSSCSR_QDSSSPARE_ADDR A:0xfc301064
y.create.l HWIO_QDSS_CS_QDSSCSR_IPCAT_ADDR A:0xfc301068
y.create.l HWIO_QDSS_CS_QDSSCSR_ETRIRQCTRL_ADDR A:0xfc30106c
y.create.l HWIO_QDSS_CS_QDSSCSR_ITCTL_ADDR A:0xfc301f00
y.create.l HWIO_QDSS_CS_QDSSCSR_CLAIMSET_ADDR A:0xfc301fa0
y.create.l HWIO_QDSS_CS_QDSSCSR_CLAIMCLR_ADDR A:0xfc301fa4
y.create.l HWIO_QDSS_CS_QDSSCSR_LOCKACCESS_ADDR A:0xfc301fb0
y.create.l HWIO_QDSS_CS_QDSSCSR_LOCKSTATUS_ADDR A:0xfc301fb4
y.create.l HWIO_QDSS_CS_QDSSCSR_AUTHSTATUS_ADDR A:0xfc301fb8
y.create.l HWIO_QDSS_CS_QDSSCSR_DEVICEID_ADDR A:0xfc301fc8
y.create.l HWIO_QDSS_CS_QDSSCSR_DEVICETYPE_ADDR A:0xfc301fcc
y.create.l HWIO_QDSS_CS_QDSSCSR_PERIPHID4_ADDR A:0xfc301fd0
y.create.l HWIO_QDSS_CS_QDSSCSR_PERIPHID5_ADDR A:0xfc301fd4
y.create.l HWIO_QDSS_CS_QDSSCSR_PERIPHID6_ADDR A:0xfc301fd8
y.create.l HWIO_QDSS_CS_QDSSCSR_PERIPHID7_ADDR A:0xfc301fdc
y.create.l HWIO_QDSS_CS_QDSSCSR_PERIPHID0_ADDR A:0xfc301fe0
y.create.l HWIO_QDSS_CS_QDSSCSR_PERIPHID1_ADDR A:0xfc301fe4
y.create.l HWIO_QDSS_CS_QDSSCSR_PERIPHID2_ADDR A:0xfc301fe8
y.create.l HWIO_QDSS_CS_QDSSCSR_PERIPHID3_ADDR A:0xfc301fec
y.create.l HWIO_QDSS_CS_QDSSCSR_COMPID0_ADDR A:0xfc301ff0
y.create.l HWIO_QDSS_CS_QDSSCSR_COMPID1_ADDR A:0xfc301ff4
y.create.l HWIO_QDSS_CS_QDSSCSR_COMPID2_ADDR A:0xfc301ff8
y.create.l HWIO_QDSS_CS_QDSSCSR_COMPID3_ADDR A:0xfc301ffc
y.create.l HWIO_QDSS_STMDMASTARTR_ADDR A:0xfc302c04
y.create.l HWIO_QDSS_STMDMASTOPR_ADDR A:0xfc302c08
y.create.l HWIO_QDSS_STMDMASTATR_ADDR A:0xfc302c0c
y.create.l HWIO_QDSS_STMDMACTLR_ADDR A:0xfc302c10
y.create.l HWIO_QDSS_STMDMAIDR_ADDR A:0xfc302cfc
y.create.l HWIO_QDSS_STMHEER_ADDR A:0xfc302d00
y.create.l HWIO_QDSS_STMHETER_ADDR A:0xfc302d20
y.create.l HWIO_QDSS_STMHEMCR_ADDR A:0xfc302d64
y.create.l HWIO_QDSS_STMHEMASTR_ADDR A:0xfc302df4
y.create.l HWIO_QDSS_STMHEFEAT1R_ADDR A:0xfc302df8
y.create.l HWIO_QDSS_STMHEIDR_ADDR A:0xfc302dfc
y.create.l HWIO_QDSS_STMSPER_ADDR A:0xfc302e00
y.create.l HWIO_QDSS_STMSPTER_ADDR A:0xfc302e20
y.create.l HWIO_QDSS_STMSPSCR_ADDR A:0xfc302e60
y.create.l HWIO_QDSS_STMSPMSCR_ADDR A:0xfc302e64
y.create.l HWIO_QDSS_STMSPOVERRIDER_ADDR A:0xfc302e68
y.create.l HWIO_QDSS_STMSPMOVERRIDER_ADDR A:0xfc302e6c
y.create.l HWIO_QDSS_STMSPTRIGCSR_ADDR A:0xfc302e70
y.create.l HWIO_QDSS_STMTCSR_ADDR A:0xfc302e80
y.create.l HWIO_QDSS_STMTSSTIMR_ADDR A:0xfc302e84
y.create.l HWIO_QDSS_STMTSFREQR_ADDR A:0xfc302e8c
y.create.l HWIO_QDSS_STMSYNCR_ADDR A:0xfc302e90
y.create.l HWIO_QDSS_STMAUXCR_ADDR A:0xfc302e94
y.create.l HWIO_QDSS_STMSPFEAT1R_ADDR A:0xfc302ea0
y.create.l HWIO_QDSS_STMSPFEAT2R_ADDR A:0xfc302ea4
y.create.l HWIO_QDSS_STMSPFEAT3R_ADDR A:0xfc302ea8
y.create.l HWIO_QDSS_STMITTRIGGER_ADDR A:0xfc302ee8
y.create.l HWIO_QDSS_STMITATBDATA0_ADDR A:0xfc302eec
y.create.l HWIO_QDSS_STMITATBCTR2_ADDR A:0xfc302ef0
y.create.l HWIO_QDSS_STMITATBID_ADDR A:0xfc302ef4
y.create.l HWIO_QDSS_STMITATBCTR0_ADDR A:0xfc302ef8
y.create.l HWIO_QDSS_STMITCTRL_ADDR A:0xfc302f00
y.create.l HWIO_QDSS_STMCLAIMSET_ADDR A:0xfc302fa0
y.create.l HWIO_QDSS_STMCLAIMCLR_ADDR A:0xfc302fa4
y.create.l HWIO_QDSS_STMLAR_ADDR A:0xfc302fb0
y.create.l HWIO_QDSS_STMLSR_ADDR A:0xfc302fb4
y.create.l HWIO_QDSS_STMAUTHSTATUS_ADDR A:0xfc302fb8
y.create.l HWIO_QDSS_STMDEVID_ADDR A:0xfc302fc8
y.create.l HWIO_QDSS_STMDEVTYPE_ADDR A:0xfc302fcc
y.create.l HWIO_QDSS_STMPIDR0_ADDR A:0xfc302fe0
y.create.l HWIO_QDSS_STMPIDR1_ADDR A:0xfc302fe4
y.create.l HWIO_QDSS_STMPIDR2_ADDR A:0xfc302fe8
y.create.l HWIO_QDSS_STMPIDR3_ADDR A:0xfc302fec
y.create.l HWIO_QDSS_STMPIDR4_ADDR A:0xfc302fd0
y.create.l HWIO_QDSS_STMPIDR5_ADDR A:0xfc302fd4
y.create.l HWIO_QDSS_STMPIDR6_ADDR A:0xfc302fd8
y.create.l HWIO_QDSS_STMPIDR7_ADDR A:0xfc302fdc
y.create.l HWIO_QDSS_STMCIDR0_ADDR A:0xfc302ff0
y.create.l HWIO_QDSS_STMCIDR1_ADDR A:0xfc302ff4
y.create.l HWIO_QDSS_STMCIDR2_ADDR A:0xfc302ff8
y.create.l HWIO_QDSS_STMCIDR3_ADDR A:0xfc302ffc
y.create.l HWIO_QDSS_CTI0_CTICONTROL_ADDR A:0xfc310000
y.create.l HWIO_QDSS_CTI0_CTIINTACK_ADDR A:0xfc310010
y.create.l HWIO_QDSS_CTI0_CTIAPPSET_ADDR A:0xfc310014
y.create.l HWIO_QDSS_CTI0_CTIAPPCLEAR_ADDR A:0xfc310018
y.create.l HWIO_QDSS_CTI0_CTIAPPPULSE_ADDR A:0xfc31001c
y.create.l HWIO_QDSS_CTI0_CTIINEN0_ADDR A:0xfc310020
y.create.l HWIO_QDSS_CTI0_CTIINEN1_ADDR A:0xfc310024
y.create.l HWIO_QDSS_CTI0_CTIINEN2_ADDR A:0xfc310028
y.create.l HWIO_QDSS_CTI0_CTIINEN3_ADDR A:0xfc31002c
y.create.l HWIO_QDSS_CTI0_CTIINEN4_ADDR A:0xfc310030
y.create.l HWIO_QDSS_CTI0_CTIINEN5_ADDR A:0xfc310034
y.create.l HWIO_QDSS_CTI0_CTIINEN6_ADDR A:0xfc310038
y.create.l HWIO_QDSS_CTI0_CTIINEN7_ADDR A:0xfc31003c
y.create.l HWIO_QDSS_CTI0_CTIOUTEN0_ADDR A:0xfc3100a0
y.create.l HWIO_QDSS_CTI0_CTIOUTEN1_ADDR A:0xfc3100a4
y.create.l HWIO_QDSS_CTI0_CTIOUTEN2_ADDR A:0xfc3100a8
y.create.l HWIO_QDSS_CTI0_CTIOUTEN3_ADDR A:0xfc3100ac
y.create.l HWIO_QDSS_CTI0_CTIOUTEN4_ADDR A:0xfc3100b0
y.create.l HWIO_QDSS_CTI0_CTIOUTEN5_ADDR A:0xfc3100b4
y.create.l HWIO_QDSS_CTI0_CTIOUTEN6_ADDR A:0xfc3100b8
y.create.l HWIO_QDSS_CTI0_CTIOUTEN7_ADDR A:0xfc3100bc
y.create.l HWIO_QDSS_CTI0_CTITRIGINSTATUS_ADDR A:0xfc310130
y.create.l HWIO_QDSS_CTI0_CTITRIGOUTSTATUS_ADDR A:0xfc310134
y.create.l HWIO_QDSS_CTI0_CTICHINSTATUS_ADDR A:0xfc310138
y.create.l HWIO_QDSS_CTI0_CTICHOUTSTATUS_ADDR A:0xfc31013c
y.create.l HWIO_QDSS_CTI0_CTIGATE_ADDR A:0xfc310140
y.create.l HWIO_QDSS_CTI0_ASICCTL_ADDR A:0xfc310144
y.create.l HWIO_QDSS_CTI0_ITCHINACK_ADDR A:0xfc310edc
y.create.l HWIO_QDSS_CTI0_ITTRIGINACK_ADDR A:0xfc310ee0
y.create.l HWIO_QDSS_CTI0_ITCHOUT_ADDR A:0xfc310ee4
y.create.l HWIO_QDSS_CTI0_ITTRIGOUT_ADDR A:0xfc310ee8
y.create.l HWIO_QDSS_CTI0_ITCHOUTACK_ADDR A:0xfc310eec
y.create.l HWIO_QDSS_CTI0_ITTRIGOUTACK_ADDR A:0xfc310ef0
y.create.l HWIO_QDSS_CTI0_ITCHIN_ADDR A:0xfc310ef4
y.create.l HWIO_QDSS_CTI0_ITTRIGIN_ADDR A:0xfc310ef8
y.create.l HWIO_QDSS_CTI0_ITCTRL_ADDR A:0xfc310f00
y.create.l HWIO_QDSS_CTI0_CLAIMSET_ADDR A:0xfc310fa0
y.create.l HWIO_QDSS_CTI0_CLAIMCLR_ADDR A:0xfc310fa4
y.create.l HWIO_QDSS_CTI0_LAR_ADDR A:0xfc310fb0
y.create.l HWIO_QDSS_CTI0_LSR_ADDR A:0xfc310fb4
y.create.l HWIO_QDSS_CTI0_AUTHSTATUS_ADDR A:0xfc310fb8
y.create.l HWIO_QDSS_CTI0_DEVID_ADDR A:0xfc310fc8
y.create.l HWIO_QDSS_CTI0_DEVTYPE_ADDR A:0xfc310fcc
y.create.l HWIO_QDSS_CTI0_PERIPHID0_ADDR A:0xfc310fe0
y.create.l HWIO_QDSS_CTI0_PERIPHID1_ADDR A:0xfc310fe4
y.create.l HWIO_QDSS_CTI0_PERIPHID2_ADDR A:0xfc310fe8
y.create.l HWIO_QDSS_CTI0_PERIPHID3_ADDR A:0xfc310fec
y.create.l HWIO_QDSS_CTI0_PERIPHID4_ADDR A:0xfc310fd0
y.create.l HWIO_QDSS_CTI0_PERIPHID5_ADDR A:0xfc310fd4
y.create.l HWIO_QDSS_CTI0_PERIPHID6_ADDR A:0xfc310fd8
y.create.l HWIO_QDSS_CTI0_PERIPHID7_ADDR A:0xfc310fdc
y.create.l HWIO_QDSS_CTI0_COMPID0_ADDR A:0xfc310ff0
y.create.l HWIO_QDSS_CTI0_COMPID1_ADDR A:0xfc310ff4
y.create.l HWIO_QDSS_CTI0_COMPID2_ADDR A:0xfc310ff8
y.create.l HWIO_QDSS_CTI0_COMPID3_ADDR A:0xfc310ffc
y.create.l HWIO_QDSS_CTI1_CTICONTROL_ADDR A:0xfc311000
y.create.l HWIO_QDSS_CTI1_CTIINTACK_ADDR A:0xfc311010
y.create.l HWIO_QDSS_CTI1_CTIAPPSET_ADDR A:0xfc311014
y.create.l HWIO_QDSS_CTI1_CTIAPPCLEAR_ADDR A:0xfc311018
y.create.l HWIO_QDSS_CTI1_CTIAPPPULSE_ADDR A:0xfc31101c
y.create.l HWIO_QDSS_CTI1_CTIINEN0_ADDR A:0xfc311020
y.create.l HWIO_QDSS_CTI1_CTIINEN1_ADDR A:0xfc311024
y.create.l HWIO_QDSS_CTI1_CTIINEN2_ADDR A:0xfc311028
y.create.l HWIO_QDSS_CTI1_CTIINEN3_ADDR A:0xfc31102c
y.create.l HWIO_QDSS_CTI1_CTIINEN4_ADDR A:0xfc311030
y.create.l HWIO_QDSS_CTI1_CTIINEN5_ADDR A:0xfc311034
y.create.l HWIO_QDSS_CTI1_CTIINEN6_ADDR A:0xfc311038
y.create.l HWIO_QDSS_CTI1_CTIINEN7_ADDR A:0xfc31103c
y.create.l HWIO_QDSS_CTI1_CTIOUTEN0_ADDR A:0xfc3110a0
y.create.l HWIO_QDSS_CTI1_CTIOUTEN1_ADDR A:0xfc3110a4
y.create.l HWIO_QDSS_CTI1_CTIOUTEN2_ADDR A:0xfc3110a8
y.create.l HWIO_QDSS_CTI1_CTIOUTEN3_ADDR A:0xfc3110ac
y.create.l HWIO_QDSS_CTI1_CTIOUTEN4_ADDR A:0xfc3110b0
y.create.l HWIO_QDSS_CTI1_CTIOUTEN5_ADDR A:0xfc3110b4
y.create.l HWIO_QDSS_CTI1_CTIOUTEN6_ADDR A:0xfc3110b8
y.create.l HWIO_QDSS_CTI1_CTIOUTEN7_ADDR A:0xfc3110bc
y.create.l HWIO_QDSS_CTI1_CTITRIGINSTATUS_ADDR A:0xfc311130
y.create.l HWIO_QDSS_CTI1_CTITRIGOUTSTATUS_ADDR A:0xfc311134
y.create.l HWIO_QDSS_CTI1_CTICHINSTATUS_ADDR A:0xfc311138
y.create.l HWIO_QDSS_CTI1_CTICHOUTSTATUS_ADDR A:0xfc31113c
y.create.l HWIO_QDSS_CTI1_CTIGATE_ADDR A:0xfc311140
y.create.l HWIO_QDSS_CTI1_ASICCTL_ADDR A:0xfc311144
y.create.l HWIO_QDSS_CTI1_ITCHINACK_ADDR A:0xfc311edc
y.create.l HWIO_QDSS_CTI1_ITTRIGINACK_ADDR A:0xfc311ee0
y.create.l HWIO_QDSS_CTI1_ITCHOUT_ADDR A:0xfc311ee4
y.create.l HWIO_QDSS_CTI1_ITTRIGOUT_ADDR A:0xfc311ee8
y.create.l HWIO_QDSS_CTI1_ITCHOUTACK_ADDR A:0xfc311eec
y.create.l HWIO_QDSS_CTI1_ITTRIGOUTACK_ADDR A:0xfc311ef0
y.create.l HWIO_QDSS_CTI1_ITCHIN_ADDR A:0xfc311ef4
y.create.l HWIO_QDSS_CTI1_ITTRIGIN_ADDR A:0xfc311ef8
y.create.l HWIO_QDSS_CTI1_ITCTRL_ADDR A:0xfc311f00
y.create.l HWIO_QDSS_CTI1_CLAIMSET_ADDR A:0xfc311fa0
y.create.l HWIO_QDSS_CTI1_CLAIMCLR_ADDR A:0xfc311fa4
y.create.l HWIO_QDSS_CTI1_LAR_ADDR A:0xfc311fb0
y.create.l HWIO_QDSS_CTI1_LSR_ADDR A:0xfc311fb4
y.create.l HWIO_QDSS_CTI1_AUTHSTATUS_ADDR A:0xfc311fb8
y.create.l HWIO_QDSS_CTI1_DEVID_ADDR A:0xfc311fc8
y.create.l HWIO_QDSS_CTI1_DEVTYPE_ADDR A:0xfc311fcc
y.create.l HWIO_QDSS_CTI1_PERIPHID0_ADDR A:0xfc311fe0
y.create.l HWIO_QDSS_CTI1_PERIPHID1_ADDR A:0xfc311fe4
y.create.l HWIO_QDSS_CTI1_PERIPHID2_ADDR A:0xfc311fe8
y.create.l HWIO_QDSS_CTI1_PERIPHID3_ADDR A:0xfc311fec
y.create.l HWIO_QDSS_CTI1_PERIPHID4_ADDR A:0xfc311fd0
y.create.l HWIO_QDSS_CTI1_PERIPHID5_ADDR A:0xfc311fd4
y.create.l HWIO_QDSS_CTI1_PERIPHID6_ADDR A:0xfc311fd8
y.create.l HWIO_QDSS_CTI1_PERIPHID7_ADDR A:0xfc311fdc
y.create.l HWIO_QDSS_CTI1_COMPID0_ADDR A:0xfc311ff0
y.create.l HWIO_QDSS_CTI1_COMPID1_ADDR A:0xfc311ff4
y.create.l HWIO_QDSS_CTI1_COMPID2_ADDR A:0xfc311ff8
y.create.l HWIO_QDSS_CTI1_COMPID3_ADDR A:0xfc311ffc
y.create.l HWIO_QDSS_CTI2_CTICONTROL_ADDR A:0xfc312000
y.create.l HWIO_QDSS_CTI2_CTIINTACK_ADDR A:0xfc312010
y.create.l HWIO_QDSS_CTI2_CTIAPPSET_ADDR A:0xfc312014
y.create.l HWIO_QDSS_CTI2_CTIAPPCLEAR_ADDR A:0xfc312018
y.create.l HWIO_QDSS_CTI2_CTIAPPPULSE_ADDR A:0xfc31201c
y.create.l HWIO_QDSS_CTI2_CTIINEN0_ADDR A:0xfc312020
y.create.l HWIO_QDSS_CTI2_CTIINEN1_ADDR A:0xfc312024
y.create.l HWIO_QDSS_CTI2_CTIINEN2_ADDR A:0xfc312028
y.create.l HWIO_QDSS_CTI2_CTIINEN3_ADDR A:0xfc31202c
y.create.l HWIO_QDSS_CTI2_CTIINEN4_ADDR A:0xfc312030
y.create.l HWIO_QDSS_CTI2_CTIINEN5_ADDR A:0xfc312034
y.create.l HWIO_QDSS_CTI2_CTIINEN6_ADDR A:0xfc312038
y.create.l HWIO_QDSS_CTI2_CTIINEN7_ADDR A:0xfc31203c
y.create.l HWIO_QDSS_CTI2_CTIOUTEN0_ADDR A:0xfc3120a0
y.create.l HWIO_QDSS_CTI2_CTIOUTEN1_ADDR A:0xfc3120a4
y.create.l HWIO_QDSS_CTI2_CTIOUTEN2_ADDR A:0xfc3120a8
y.create.l HWIO_QDSS_CTI2_CTIOUTEN3_ADDR A:0xfc3120ac
y.create.l HWIO_QDSS_CTI2_CTIOUTEN4_ADDR A:0xfc3120b0
y.create.l HWIO_QDSS_CTI2_CTIOUTEN5_ADDR A:0xfc3120b4
y.create.l HWIO_QDSS_CTI2_CTIOUTEN6_ADDR A:0xfc3120b8
y.create.l HWIO_QDSS_CTI2_CTIOUTEN7_ADDR A:0xfc3120bc
y.create.l HWIO_QDSS_CTI2_CTITRIGINSTATUS_ADDR A:0xfc312130
y.create.l HWIO_QDSS_CTI2_CTITRIGOUTSTATUS_ADDR A:0xfc312134
y.create.l HWIO_QDSS_CTI2_CTICHINSTATUS_ADDR A:0xfc312138
y.create.l HWIO_QDSS_CTI2_CTICHOUTSTATUS_ADDR A:0xfc31213c
y.create.l HWIO_QDSS_CTI2_CTIGATE_ADDR A:0xfc312140
y.create.l HWIO_QDSS_CTI2_ASICCTL_ADDR A:0xfc312144
y.create.l HWIO_QDSS_CTI2_ITCHINACK_ADDR A:0xfc312edc
y.create.l HWIO_QDSS_CTI2_ITTRIGINACK_ADDR A:0xfc312ee0
y.create.l HWIO_QDSS_CTI2_ITCHOUT_ADDR A:0xfc312ee4
y.create.l HWIO_QDSS_CTI2_ITTRIGOUT_ADDR A:0xfc312ee8
y.create.l HWIO_QDSS_CTI2_ITCHOUTACK_ADDR A:0xfc312eec
y.create.l HWIO_QDSS_CTI2_ITTRIGOUTACK_ADDR A:0xfc312ef0
y.create.l HWIO_QDSS_CTI2_ITCHIN_ADDR A:0xfc312ef4
y.create.l HWIO_QDSS_CTI2_ITTRIGIN_ADDR A:0xfc312ef8
y.create.l HWIO_QDSS_CTI2_ITCTRL_ADDR A:0xfc312f00
y.create.l HWIO_QDSS_CTI2_CLAIMSET_ADDR A:0xfc312fa0
y.create.l HWIO_QDSS_CTI2_CLAIMCLR_ADDR A:0xfc312fa4
y.create.l HWIO_QDSS_CTI2_LAR_ADDR A:0xfc312fb0
y.create.l HWIO_QDSS_CTI2_LSR_ADDR A:0xfc312fb4
y.create.l HWIO_QDSS_CTI2_AUTHSTATUS_ADDR A:0xfc312fb8
y.create.l HWIO_QDSS_CTI2_DEVID_ADDR A:0xfc312fc8
y.create.l HWIO_QDSS_CTI2_DEVTYPE_ADDR A:0xfc312fcc
y.create.l HWIO_QDSS_CTI2_PERIPHID0_ADDR A:0xfc312fe0
y.create.l HWIO_QDSS_CTI2_PERIPHID1_ADDR A:0xfc312fe4
y.create.l HWIO_QDSS_CTI2_PERIPHID2_ADDR A:0xfc312fe8
y.create.l HWIO_QDSS_CTI2_PERIPHID3_ADDR A:0xfc312fec
y.create.l HWIO_QDSS_CTI2_PERIPHID4_ADDR A:0xfc312fd0
y.create.l HWIO_QDSS_CTI2_PERIPHID5_ADDR A:0xfc312fd4
y.create.l HWIO_QDSS_CTI2_PERIPHID6_ADDR A:0xfc312fd8
y.create.l HWIO_QDSS_CTI2_PERIPHID7_ADDR A:0xfc312fdc
y.create.l HWIO_QDSS_CTI2_COMPID0_ADDR A:0xfc312ff0
y.create.l HWIO_QDSS_CTI2_COMPID1_ADDR A:0xfc312ff4
y.create.l HWIO_QDSS_CTI2_COMPID2_ADDR A:0xfc312ff8
y.create.l HWIO_QDSS_CTI2_COMPID3_ADDR A:0xfc312ffc
y.create.l HWIO_QDSS_CTI3_CTICONTROL_ADDR A:0xfc313000
y.create.l HWIO_QDSS_CTI3_CTIINTACK_ADDR A:0xfc313010
y.create.l HWIO_QDSS_CTI3_CTIAPPSET_ADDR A:0xfc313014
y.create.l HWIO_QDSS_CTI3_CTIAPPCLEAR_ADDR A:0xfc313018
y.create.l HWIO_QDSS_CTI3_CTIAPPPULSE_ADDR A:0xfc31301c
y.create.l HWIO_QDSS_CTI3_CTIINEN0_ADDR A:0xfc313020
y.create.l HWIO_QDSS_CTI3_CTIINEN1_ADDR A:0xfc313024
y.create.l HWIO_QDSS_CTI3_CTIINEN2_ADDR A:0xfc313028
y.create.l HWIO_QDSS_CTI3_CTIINEN3_ADDR A:0xfc31302c
y.create.l HWIO_QDSS_CTI3_CTIINEN4_ADDR A:0xfc313030
y.create.l HWIO_QDSS_CTI3_CTIINEN5_ADDR A:0xfc313034
y.create.l HWIO_QDSS_CTI3_CTIINEN6_ADDR A:0xfc313038
y.create.l HWIO_QDSS_CTI3_CTIINEN7_ADDR A:0xfc31303c
y.create.l HWIO_QDSS_CTI3_CTIOUTEN0_ADDR A:0xfc3130a0
y.create.l HWIO_QDSS_CTI3_CTIOUTEN1_ADDR A:0xfc3130a4
y.create.l HWIO_QDSS_CTI3_CTIOUTEN2_ADDR A:0xfc3130a8
y.create.l HWIO_QDSS_CTI3_CTIOUTEN3_ADDR A:0xfc3130ac
y.create.l HWIO_QDSS_CTI3_CTIOUTEN4_ADDR A:0xfc3130b0
y.create.l HWIO_QDSS_CTI3_CTIOUTEN5_ADDR A:0xfc3130b4
y.create.l HWIO_QDSS_CTI3_CTIOUTEN6_ADDR A:0xfc3130b8
y.create.l HWIO_QDSS_CTI3_CTIOUTEN7_ADDR A:0xfc3130bc
y.create.l HWIO_QDSS_CTI3_CTITRIGINSTATUS_ADDR A:0xfc313130
y.create.l HWIO_QDSS_CTI3_CTITRIGOUTSTATUS_ADDR A:0xfc313134
y.create.l HWIO_QDSS_CTI3_CTICHINSTATUS_ADDR A:0xfc313138
y.create.l HWIO_QDSS_CTI3_CTICHOUTSTATUS_ADDR A:0xfc31313c
y.create.l HWIO_QDSS_CTI3_CTIGATE_ADDR A:0xfc313140
y.create.l HWIO_QDSS_CTI3_ASICCTL_ADDR A:0xfc313144
y.create.l HWIO_QDSS_CTI3_ITCHINACK_ADDR A:0xfc313edc
y.create.l HWIO_QDSS_CTI3_ITTRIGINACK_ADDR A:0xfc313ee0
y.create.l HWIO_QDSS_CTI3_ITCHOUT_ADDR A:0xfc313ee4
y.create.l HWIO_QDSS_CTI3_ITTRIGOUT_ADDR A:0xfc313ee8
y.create.l HWIO_QDSS_CTI3_ITCHOUTACK_ADDR A:0xfc313eec
y.create.l HWIO_QDSS_CTI3_ITTRIGOUTACK_ADDR A:0xfc313ef0
y.create.l HWIO_QDSS_CTI3_ITCHIN_ADDR A:0xfc313ef4
y.create.l HWIO_QDSS_CTI3_ITTRIGIN_ADDR A:0xfc313ef8
y.create.l HWIO_QDSS_CTI3_ITCTRL_ADDR A:0xfc313f00
y.create.l HWIO_QDSS_CTI3_CLAIMSET_ADDR A:0xfc313fa0
y.create.l HWIO_QDSS_CTI3_CLAIMCLR_ADDR A:0xfc313fa4
y.create.l HWIO_QDSS_CTI3_LAR_ADDR A:0xfc313fb0
y.create.l HWIO_QDSS_CTI3_LSR_ADDR A:0xfc313fb4
y.create.l HWIO_QDSS_CTI3_AUTHSTATUS_ADDR A:0xfc313fb8
y.create.l HWIO_QDSS_CTI3_DEVID_ADDR A:0xfc313fc8
y.create.l HWIO_QDSS_CTI3_DEVTYPE_ADDR A:0xfc313fcc
y.create.l HWIO_QDSS_CTI3_PERIPHID0_ADDR A:0xfc313fe0
y.create.l HWIO_QDSS_CTI3_PERIPHID1_ADDR A:0xfc313fe4
y.create.l HWIO_QDSS_CTI3_PERIPHID2_ADDR A:0xfc313fe8
y.create.l HWIO_QDSS_CTI3_PERIPHID3_ADDR A:0xfc313fec
y.create.l HWIO_QDSS_CTI3_PERIPHID4_ADDR A:0xfc313fd0
y.create.l HWIO_QDSS_CTI3_PERIPHID5_ADDR A:0xfc313fd4
y.create.l HWIO_QDSS_CTI3_PERIPHID6_ADDR A:0xfc313fd8
y.create.l HWIO_QDSS_CTI3_PERIPHID7_ADDR A:0xfc313fdc
y.create.l HWIO_QDSS_CTI3_COMPID0_ADDR A:0xfc313ff0
y.create.l HWIO_QDSS_CTI3_COMPID1_ADDR A:0xfc313ff4
y.create.l HWIO_QDSS_CTI3_COMPID2_ADDR A:0xfc313ff8
y.create.l HWIO_QDSS_CTI3_COMPID3_ADDR A:0xfc313ffc
y.create.l HWIO_QDSS_CTI4_CTICONTROL_ADDR A:0xfc314000
y.create.l HWIO_QDSS_CTI4_CTIINTACK_ADDR A:0xfc314010
y.create.l HWIO_QDSS_CTI4_CTIAPPSET_ADDR A:0xfc314014
y.create.l HWIO_QDSS_CTI4_CTIAPPCLEAR_ADDR A:0xfc314018
y.create.l HWIO_QDSS_CTI4_CTIAPPPULSE_ADDR A:0xfc31401c
y.create.l HWIO_QDSS_CTI4_CTIINEN0_ADDR A:0xfc314020
y.create.l HWIO_QDSS_CTI4_CTIINEN1_ADDR A:0xfc314024
y.create.l HWIO_QDSS_CTI4_CTIINEN2_ADDR A:0xfc314028
y.create.l HWIO_QDSS_CTI4_CTIINEN3_ADDR A:0xfc31402c
y.create.l HWIO_QDSS_CTI4_CTIINEN4_ADDR A:0xfc314030
y.create.l HWIO_QDSS_CTI4_CTIINEN5_ADDR A:0xfc314034
y.create.l HWIO_QDSS_CTI4_CTIINEN6_ADDR A:0xfc314038
y.create.l HWIO_QDSS_CTI4_CTIINEN7_ADDR A:0xfc31403c
y.create.l HWIO_QDSS_CTI4_CTIOUTEN0_ADDR A:0xfc3140a0
y.create.l HWIO_QDSS_CTI4_CTIOUTEN1_ADDR A:0xfc3140a4
y.create.l HWIO_QDSS_CTI4_CTIOUTEN2_ADDR A:0xfc3140a8
y.create.l HWIO_QDSS_CTI4_CTIOUTEN3_ADDR A:0xfc3140ac
y.create.l HWIO_QDSS_CTI4_CTIOUTEN4_ADDR A:0xfc3140b0
y.create.l HWIO_QDSS_CTI4_CTIOUTEN5_ADDR A:0xfc3140b4
y.create.l HWIO_QDSS_CTI4_CTIOUTEN6_ADDR A:0xfc3140b8
y.create.l HWIO_QDSS_CTI4_CTIOUTEN7_ADDR A:0xfc3140bc
y.create.l HWIO_QDSS_CTI4_CTITRIGINSTATUS_ADDR A:0xfc314130
y.create.l HWIO_QDSS_CTI4_CTITRIGOUTSTATUS_ADDR A:0xfc314134
y.create.l HWIO_QDSS_CTI4_CTICHINSTATUS_ADDR A:0xfc314138
y.create.l HWIO_QDSS_CTI4_CTICHOUTSTATUS_ADDR A:0xfc31413c
y.create.l HWIO_QDSS_CTI4_CTIGATE_ADDR A:0xfc314140
y.create.l HWIO_QDSS_CTI4_ASICCTL_ADDR A:0xfc314144
y.create.l HWIO_QDSS_CTI4_ITCHINACK_ADDR A:0xfc314edc
y.create.l HWIO_QDSS_CTI4_ITTRIGINACK_ADDR A:0xfc314ee0
y.create.l HWIO_QDSS_CTI4_ITCHOUT_ADDR A:0xfc314ee4
y.create.l HWIO_QDSS_CTI4_ITTRIGOUT_ADDR A:0xfc314ee8
y.create.l HWIO_QDSS_CTI4_ITCHOUTACK_ADDR A:0xfc314eec
y.create.l HWIO_QDSS_CTI4_ITTRIGOUTACK_ADDR A:0xfc314ef0
y.create.l HWIO_QDSS_CTI4_ITCHIN_ADDR A:0xfc314ef4
y.create.l HWIO_QDSS_CTI4_ITTRIGIN_ADDR A:0xfc314ef8
y.create.l HWIO_QDSS_CTI4_ITCTRL_ADDR A:0xfc314f00
y.create.l HWIO_QDSS_CTI4_CLAIMSET_ADDR A:0xfc314fa0
y.create.l HWIO_QDSS_CTI4_CLAIMCLR_ADDR A:0xfc314fa4
y.create.l HWIO_QDSS_CTI4_LAR_ADDR A:0xfc314fb0
y.create.l HWIO_QDSS_CTI4_LSR_ADDR A:0xfc314fb4
y.create.l HWIO_QDSS_CTI4_AUTHSTATUS_ADDR A:0xfc314fb8
y.create.l HWIO_QDSS_CTI4_DEVID_ADDR A:0xfc314fc8
y.create.l HWIO_QDSS_CTI4_DEVTYPE_ADDR A:0xfc314fcc
y.create.l HWIO_QDSS_CTI4_PERIPHID0_ADDR A:0xfc314fe0
y.create.l HWIO_QDSS_CTI4_PERIPHID1_ADDR A:0xfc314fe4
y.create.l HWIO_QDSS_CTI4_PERIPHID2_ADDR A:0xfc314fe8
y.create.l HWIO_QDSS_CTI4_PERIPHID3_ADDR A:0xfc314fec
y.create.l HWIO_QDSS_CTI4_PERIPHID4_ADDR A:0xfc314fd0
y.create.l HWIO_QDSS_CTI4_PERIPHID5_ADDR A:0xfc314fd4
y.create.l HWIO_QDSS_CTI4_PERIPHID6_ADDR A:0xfc314fd8
y.create.l HWIO_QDSS_CTI4_PERIPHID7_ADDR A:0xfc314fdc
y.create.l HWIO_QDSS_CTI4_COMPID0_ADDR A:0xfc314ff0
y.create.l HWIO_QDSS_CTI4_COMPID1_ADDR A:0xfc314ff4
y.create.l HWIO_QDSS_CTI4_COMPID2_ADDR A:0xfc314ff8
y.create.l HWIO_QDSS_CTI4_COMPID3_ADDR A:0xfc314ffc
y.create.l HWIO_QDSS_CTI5_CTICONTROL_ADDR A:0xfc315000
y.create.l HWIO_QDSS_CTI5_CTIINTACK_ADDR A:0xfc315010
y.create.l HWIO_QDSS_CTI5_CTIAPPSET_ADDR A:0xfc315014
y.create.l HWIO_QDSS_CTI5_CTIAPPCLEAR_ADDR A:0xfc315018
y.create.l HWIO_QDSS_CTI5_CTIAPPPULSE_ADDR A:0xfc31501c
y.create.l HWIO_QDSS_CTI5_CTIINEN0_ADDR A:0xfc315020
y.create.l HWIO_QDSS_CTI5_CTIINEN1_ADDR A:0xfc315024
y.create.l HWIO_QDSS_CTI5_CTIINEN2_ADDR A:0xfc315028
y.create.l HWIO_QDSS_CTI5_CTIINEN3_ADDR A:0xfc31502c
y.create.l HWIO_QDSS_CTI5_CTIINEN4_ADDR A:0xfc315030
y.create.l HWIO_QDSS_CTI5_CTIINEN5_ADDR A:0xfc315034
y.create.l HWIO_QDSS_CTI5_CTIINEN6_ADDR A:0xfc315038
y.create.l HWIO_QDSS_CTI5_CTIINEN7_ADDR A:0xfc31503c
y.create.l HWIO_QDSS_CTI5_CTIOUTEN0_ADDR A:0xfc3150a0
y.create.l HWIO_QDSS_CTI5_CTIOUTEN1_ADDR A:0xfc3150a4
y.create.l HWIO_QDSS_CTI5_CTIOUTEN2_ADDR A:0xfc3150a8
y.create.l HWIO_QDSS_CTI5_CTIOUTEN3_ADDR A:0xfc3150ac
y.create.l HWIO_QDSS_CTI5_CTIOUTEN4_ADDR A:0xfc3150b0
y.create.l HWIO_QDSS_CTI5_CTIOUTEN5_ADDR A:0xfc3150b4
y.create.l HWIO_QDSS_CTI5_CTIOUTEN6_ADDR A:0xfc3150b8
y.create.l HWIO_QDSS_CTI5_CTIOUTEN7_ADDR A:0xfc3150bc
y.create.l HWIO_QDSS_CTI5_CTITRIGINSTATUS_ADDR A:0xfc315130
y.create.l HWIO_QDSS_CTI5_CTITRIGOUTSTATUS_ADDR A:0xfc315134
y.create.l HWIO_QDSS_CTI5_CTICHINSTATUS_ADDR A:0xfc315138
y.create.l HWIO_QDSS_CTI5_CTICHOUTSTATUS_ADDR A:0xfc31513c
y.create.l HWIO_QDSS_CTI5_CTIGATE_ADDR A:0xfc315140
y.create.l HWIO_QDSS_CTI5_ASICCTL_ADDR A:0xfc315144
y.create.l HWIO_QDSS_CTI5_ITCHINACK_ADDR A:0xfc315edc
y.create.l HWIO_QDSS_CTI5_ITTRIGINACK_ADDR A:0xfc315ee0
y.create.l HWIO_QDSS_CTI5_ITCHOUT_ADDR A:0xfc315ee4
y.create.l HWIO_QDSS_CTI5_ITTRIGOUT_ADDR A:0xfc315ee8
y.create.l HWIO_QDSS_CTI5_ITCHOUTACK_ADDR A:0xfc315eec
y.create.l HWIO_QDSS_CTI5_ITTRIGOUTACK_ADDR A:0xfc315ef0
y.create.l HWIO_QDSS_CTI5_ITCHIN_ADDR A:0xfc315ef4
y.create.l HWIO_QDSS_CTI5_ITTRIGIN_ADDR A:0xfc315ef8
y.create.l HWIO_QDSS_CTI5_ITCTRL_ADDR A:0xfc315f00
y.create.l HWIO_QDSS_CTI5_CLAIMSET_ADDR A:0xfc315fa0
y.create.l HWIO_QDSS_CTI5_CLAIMCLR_ADDR A:0xfc315fa4
y.create.l HWIO_QDSS_CTI5_LAR_ADDR A:0xfc315fb0
y.create.l HWIO_QDSS_CTI5_LSR_ADDR A:0xfc315fb4
y.create.l HWIO_QDSS_CTI5_AUTHSTATUS_ADDR A:0xfc315fb8
y.create.l HWIO_QDSS_CTI5_DEVID_ADDR A:0xfc315fc8
y.create.l HWIO_QDSS_CTI5_DEVTYPE_ADDR A:0xfc315fcc
y.create.l HWIO_QDSS_CTI5_PERIPHID0_ADDR A:0xfc315fe0
y.create.l HWIO_QDSS_CTI5_PERIPHID1_ADDR A:0xfc315fe4
y.create.l HWIO_QDSS_CTI5_PERIPHID2_ADDR A:0xfc315fe8
y.create.l HWIO_QDSS_CTI5_PERIPHID3_ADDR A:0xfc315fec
y.create.l HWIO_QDSS_CTI5_PERIPHID4_ADDR A:0xfc315fd0
y.create.l HWIO_QDSS_CTI5_PERIPHID5_ADDR A:0xfc315fd4
y.create.l HWIO_QDSS_CTI5_PERIPHID6_ADDR A:0xfc315fd8
y.create.l HWIO_QDSS_CTI5_PERIPHID7_ADDR A:0xfc315fdc
y.create.l HWIO_QDSS_CTI5_COMPID0_ADDR A:0xfc315ff0
y.create.l HWIO_QDSS_CTI5_COMPID1_ADDR A:0xfc315ff4
y.create.l HWIO_QDSS_CTI5_COMPID2_ADDR A:0xfc315ff8
y.create.l HWIO_QDSS_CTI5_COMPID3_ADDR A:0xfc315ffc
y.create.l HWIO_QDSS_CTI6_CTICONTROL_ADDR A:0xfc316000
y.create.l HWIO_QDSS_CTI6_CTIINTACK_ADDR A:0xfc316010
y.create.l HWIO_QDSS_CTI6_CTIAPPSET_ADDR A:0xfc316014
y.create.l HWIO_QDSS_CTI6_CTIAPPCLEAR_ADDR A:0xfc316018
y.create.l HWIO_QDSS_CTI6_CTIAPPPULSE_ADDR A:0xfc31601c
y.create.l HWIO_QDSS_CTI6_CTIINEN0_ADDR A:0xfc316020
y.create.l HWIO_QDSS_CTI6_CTIINEN1_ADDR A:0xfc316024
y.create.l HWIO_QDSS_CTI6_CTIINEN2_ADDR A:0xfc316028
y.create.l HWIO_QDSS_CTI6_CTIINEN3_ADDR A:0xfc31602c
y.create.l HWIO_QDSS_CTI6_CTIINEN4_ADDR A:0xfc316030
y.create.l HWIO_QDSS_CTI6_CTIINEN5_ADDR A:0xfc316034
y.create.l HWIO_QDSS_CTI6_CTIINEN6_ADDR A:0xfc316038
y.create.l HWIO_QDSS_CTI6_CTIINEN7_ADDR A:0xfc31603c
y.create.l HWIO_QDSS_CTI6_CTIOUTEN0_ADDR A:0xfc3160a0
y.create.l HWIO_QDSS_CTI6_CTIOUTEN1_ADDR A:0xfc3160a4
y.create.l HWIO_QDSS_CTI6_CTIOUTEN2_ADDR A:0xfc3160a8
y.create.l HWIO_QDSS_CTI6_CTIOUTEN3_ADDR A:0xfc3160ac
y.create.l HWIO_QDSS_CTI6_CTIOUTEN4_ADDR A:0xfc3160b0
y.create.l HWIO_QDSS_CTI6_CTIOUTEN5_ADDR A:0xfc3160b4
y.create.l HWIO_QDSS_CTI6_CTIOUTEN6_ADDR A:0xfc3160b8
y.create.l HWIO_QDSS_CTI6_CTIOUTEN7_ADDR A:0xfc3160bc
y.create.l HWIO_QDSS_CTI6_CTITRIGINSTATUS_ADDR A:0xfc316130
y.create.l HWIO_QDSS_CTI6_CTITRIGOUTSTATUS_ADDR A:0xfc316134
y.create.l HWIO_QDSS_CTI6_CTICHINSTATUS_ADDR A:0xfc316138
y.create.l HWIO_QDSS_CTI6_CTICHOUTSTATUS_ADDR A:0xfc31613c
y.create.l HWIO_QDSS_CTI6_CTIGATE_ADDR A:0xfc316140
y.create.l HWIO_QDSS_CTI6_ASICCTL_ADDR A:0xfc316144
y.create.l HWIO_QDSS_CTI6_ITCHINACK_ADDR A:0xfc316edc
y.create.l HWIO_QDSS_CTI6_ITTRIGINACK_ADDR A:0xfc316ee0
y.create.l HWIO_QDSS_CTI6_ITCHOUT_ADDR A:0xfc316ee4
y.create.l HWIO_QDSS_CTI6_ITTRIGOUT_ADDR A:0xfc316ee8
y.create.l HWIO_QDSS_CTI6_ITCHOUTACK_ADDR A:0xfc316eec
y.create.l HWIO_QDSS_CTI6_ITTRIGOUTACK_ADDR A:0xfc316ef0
y.create.l HWIO_QDSS_CTI6_ITCHIN_ADDR A:0xfc316ef4
y.create.l HWIO_QDSS_CTI6_ITTRIGIN_ADDR A:0xfc316ef8
y.create.l HWIO_QDSS_CTI6_ITCTRL_ADDR A:0xfc316f00
y.create.l HWIO_QDSS_CTI6_CLAIMSET_ADDR A:0xfc316fa0
y.create.l HWIO_QDSS_CTI6_CLAIMCLR_ADDR A:0xfc316fa4
y.create.l HWIO_QDSS_CTI6_LAR_ADDR A:0xfc316fb0
y.create.l HWIO_QDSS_CTI6_LSR_ADDR A:0xfc316fb4
y.create.l HWIO_QDSS_CTI6_AUTHSTATUS_ADDR A:0xfc316fb8
y.create.l HWIO_QDSS_CTI6_DEVID_ADDR A:0xfc316fc8
y.create.l HWIO_QDSS_CTI6_DEVTYPE_ADDR A:0xfc316fcc
y.create.l HWIO_QDSS_CTI6_PERIPHID0_ADDR A:0xfc316fe0
y.create.l HWIO_QDSS_CTI6_PERIPHID1_ADDR A:0xfc316fe4
y.create.l HWIO_QDSS_CTI6_PERIPHID2_ADDR A:0xfc316fe8
y.create.l HWIO_QDSS_CTI6_PERIPHID3_ADDR A:0xfc316fec
y.create.l HWIO_QDSS_CTI6_PERIPHID4_ADDR A:0xfc316fd0
y.create.l HWIO_QDSS_CTI6_PERIPHID5_ADDR A:0xfc316fd4
y.create.l HWIO_QDSS_CTI6_PERIPHID6_ADDR A:0xfc316fd8
y.create.l HWIO_QDSS_CTI6_PERIPHID7_ADDR A:0xfc316fdc
y.create.l HWIO_QDSS_CTI6_COMPID0_ADDR A:0xfc316ff0
y.create.l HWIO_QDSS_CTI6_COMPID1_ADDR A:0xfc316ff4
y.create.l HWIO_QDSS_CTI6_COMPID2_ADDR A:0xfc316ff8
y.create.l HWIO_QDSS_CTI6_COMPID3_ADDR A:0xfc316ffc
y.create.l HWIO_QDSS_CTI7_CTICONTROL_ADDR A:0xfc317000
y.create.l HWIO_QDSS_CTI7_CTIINTACK_ADDR A:0xfc317010
y.create.l HWIO_QDSS_CTI7_CTIAPPSET_ADDR A:0xfc317014
y.create.l HWIO_QDSS_CTI7_CTIAPPCLEAR_ADDR A:0xfc317018
y.create.l HWIO_QDSS_CTI7_CTIAPPPULSE_ADDR A:0xfc31701c
y.create.l HWIO_QDSS_CTI7_CTIINEN0_ADDR A:0xfc317020
y.create.l HWIO_QDSS_CTI7_CTIINEN1_ADDR A:0xfc317024
y.create.l HWIO_QDSS_CTI7_CTIINEN2_ADDR A:0xfc317028
y.create.l HWIO_QDSS_CTI7_CTIINEN3_ADDR A:0xfc31702c
y.create.l HWIO_QDSS_CTI7_CTIINEN4_ADDR A:0xfc317030
y.create.l HWIO_QDSS_CTI7_CTIINEN5_ADDR A:0xfc317034
y.create.l HWIO_QDSS_CTI7_CTIINEN6_ADDR A:0xfc317038
y.create.l HWIO_QDSS_CTI7_CTIINEN7_ADDR A:0xfc31703c
y.create.l HWIO_QDSS_CTI7_CTIOUTEN0_ADDR A:0xfc3170a0
y.create.l HWIO_QDSS_CTI7_CTIOUTEN1_ADDR A:0xfc3170a4
y.create.l HWIO_QDSS_CTI7_CTIOUTEN2_ADDR A:0xfc3170a8
y.create.l HWIO_QDSS_CTI7_CTIOUTEN3_ADDR A:0xfc3170ac
y.create.l HWIO_QDSS_CTI7_CTIOUTEN4_ADDR A:0xfc3170b0
y.create.l HWIO_QDSS_CTI7_CTIOUTEN5_ADDR A:0xfc3170b4
y.create.l HWIO_QDSS_CTI7_CTIOUTEN6_ADDR A:0xfc3170b8
y.create.l HWIO_QDSS_CTI7_CTIOUTEN7_ADDR A:0xfc3170bc
y.create.l HWIO_QDSS_CTI7_CTITRIGINSTATUS_ADDR A:0xfc317130
y.create.l HWIO_QDSS_CTI7_CTITRIGOUTSTATUS_ADDR A:0xfc317134
y.create.l HWIO_QDSS_CTI7_CTICHINSTATUS_ADDR A:0xfc317138
y.create.l HWIO_QDSS_CTI7_CTICHOUTSTATUS_ADDR A:0xfc31713c
y.create.l HWIO_QDSS_CTI7_CTIGATE_ADDR A:0xfc317140
y.create.l HWIO_QDSS_CTI7_ASICCTL_ADDR A:0xfc317144
y.create.l HWIO_QDSS_CTI7_ITCHINACK_ADDR A:0xfc317edc
y.create.l HWIO_QDSS_CTI7_ITTRIGINACK_ADDR A:0xfc317ee0
y.create.l HWIO_QDSS_CTI7_ITCHOUT_ADDR A:0xfc317ee4
y.create.l HWIO_QDSS_CTI7_ITTRIGOUT_ADDR A:0xfc317ee8
y.create.l HWIO_QDSS_CTI7_ITCHOUTACK_ADDR A:0xfc317eec
y.create.l HWIO_QDSS_CTI7_ITTRIGOUTACK_ADDR A:0xfc317ef0
y.create.l HWIO_QDSS_CTI7_ITCHIN_ADDR A:0xfc317ef4
y.create.l HWIO_QDSS_CTI7_ITTRIGIN_ADDR A:0xfc317ef8
y.create.l HWIO_QDSS_CTI7_ITCTRL_ADDR A:0xfc317f00
y.create.l HWIO_QDSS_CTI7_CLAIMSET_ADDR A:0xfc317fa0
y.create.l HWIO_QDSS_CTI7_CLAIMCLR_ADDR A:0xfc317fa4
y.create.l HWIO_QDSS_CTI7_LAR_ADDR A:0xfc317fb0
y.create.l HWIO_QDSS_CTI7_LSR_ADDR A:0xfc317fb4
y.create.l HWIO_QDSS_CTI7_AUTHSTATUS_ADDR A:0xfc317fb8
y.create.l HWIO_QDSS_CTI7_DEVID_ADDR A:0xfc317fc8
y.create.l HWIO_QDSS_CTI7_DEVTYPE_ADDR A:0xfc317fcc
y.create.l HWIO_QDSS_CTI7_PERIPHID0_ADDR A:0xfc317fe0
y.create.l HWIO_QDSS_CTI7_PERIPHID1_ADDR A:0xfc317fe4
y.create.l HWIO_QDSS_CTI7_PERIPHID2_ADDR A:0xfc317fe8
y.create.l HWIO_QDSS_CTI7_PERIPHID3_ADDR A:0xfc317fec
y.create.l HWIO_QDSS_CTI7_PERIPHID4_ADDR A:0xfc317fd0
y.create.l HWIO_QDSS_CTI7_PERIPHID5_ADDR A:0xfc317fd4
y.create.l HWIO_QDSS_CTI7_PERIPHID6_ADDR A:0xfc317fd8
y.create.l HWIO_QDSS_CTI7_PERIPHID7_ADDR A:0xfc317fdc
y.create.l HWIO_QDSS_CTI7_COMPID0_ADDR A:0xfc317ff0
y.create.l HWIO_QDSS_CTI7_COMPID1_ADDR A:0xfc317ff4
y.create.l HWIO_QDSS_CTI7_COMPID2_ADDR A:0xfc317ff8
y.create.l HWIO_QDSS_CTI7_COMPID3_ADDR A:0xfc317ffc
y.create.l HWIO_QDSS_CTI8_CTICONTROL_ADDR A:0xfc318000
y.create.l HWIO_QDSS_CTI8_CTIINTACK_ADDR A:0xfc318010
y.create.l HWIO_QDSS_CTI8_CTIAPPSET_ADDR A:0xfc318014
y.create.l HWIO_QDSS_CTI8_CTIAPPCLEAR_ADDR A:0xfc318018
y.create.l HWIO_QDSS_CTI8_CTIAPPPULSE_ADDR A:0xfc31801c
y.create.l HWIO_QDSS_CTI8_CTIINEN0_ADDR A:0xfc318020
y.create.l HWIO_QDSS_CTI8_CTIINEN1_ADDR A:0xfc318024
y.create.l HWIO_QDSS_CTI8_CTIINEN2_ADDR A:0xfc318028
y.create.l HWIO_QDSS_CTI8_CTIINEN3_ADDR A:0xfc31802c
y.create.l HWIO_QDSS_CTI8_CTIINEN4_ADDR A:0xfc318030
y.create.l HWIO_QDSS_CTI8_CTIINEN5_ADDR A:0xfc318034
y.create.l HWIO_QDSS_CTI8_CTIINEN6_ADDR A:0xfc318038
y.create.l HWIO_QDSS_CTI8_CTIINEN7_ADDR A:0xfc31803c
y.create.l HWIO_QDSS_CTI8_CTIOUTEN0_ADDR A:0xfc3180a0
y.create.l HWIO_QDSS_CTI8_CTIOUTEN1_ADDR A:0xfc3180a4
y.create.l HWIO_QDSS_CTI8_CTIOUTEN2_ADDR A:0xfc3180a8
y.create.l HWIO_QDSS_CTI8_CTIOUTEN3_ADDR A:0xfc3180ac
y.create.l HWIO_QDSS_CTI8_CTIOUTEN4_ADDR A:0xfc3180b0
y.create.l HWIO_QDSS_CTI8_CTIOUTEN5_ADDR A:0xfc3180b4
y.create.l HWIO_QDSS_CTI8_CTIOUTEN6_ADDR A:0xfc3180b8
y.create.l HWIO_QDSS_CTI8_CTIOUTEN7_ADDR A:0xfc3180bc
y.create.l HWIO_QDSS_CTI8_CTITRIGINSTATUS_ADDR A:0xfc318130
y.create.l HWIO_QDSS_CTI8_CTITRIGOUTSTATUS_ADDR A:0xfc318134
y.create.l HWIO_QDSS_CTI8_CTICHINSTATUS_ADDR A:0xfc318138
y.create.l HWIO_QDSS_CTI8_CTICHOUTSTATUS_ADDR A:0xfc31813c
y.create.l HWIO_QDSS_CTI8_CTIGATE_ADDR A:0xfc318140
y.create.l HWIO_QDSS_CTI8_ASICCTL_ADDR A:0xfc318144
y.create.l HWIO_QDSS_CTI8_ITCHINACK_ADDR A:0xfc318edc
y.create.l HWIO_QDSS_CTI8_ITTRIGINACK_ADDR A:0xfc318ee0
y.create.l HWIO_QDSS_CTI8_ITCHOUT_ADDR A:0xfc318ee4
y.create.l HWIO_QDSS_CTI8_ITTRIGOUT_ADDR A:0xfc318ee8
y.create.l HWIO_QDSS_CTI8_ITCHOUTACK_ADDR A:0xfc318eec
y.create.l HWIO_QDSS_CTI8_ITTRIGOUTACK_ADDR A:0xfc318ef0
y.create.l HWIO_QDSS_CTI8_ITCHIN_ADDR A:0xfc318ef4
y.create.l HWIO_QDSS_CTI8_ITTRIGIN_ADDR A:0xfc318ef8
y.create.l HWIO_QDSS_CTI8_ITCTRL_ADDR A:0xfc318f00
y.create.l HWIO_QDSS_CTI8_CLAIMSET_ADDR A:0xfc318fa0
y.create.l HWIO_QDSS_CTI8_CLAIMCLR_ADDR A:0xfc318fa4
y.create.l HWIO_QDSS_CTI8_LAR_ADDR A:0xfc318fb0
y.create.l HWIO_QDSS_CTI8_LSR_ADDR A:0xfc318fb4
y.create.l HWIO_QDSS_CTI8_AUTHSTATUS_ADDR A:0xfc318fb8
y.create.l HWIO_QDSS_CTI8_DEVID_ADDR A:0xfc318fc8
y.create.l HWIO_QDSS_CTI8_DEVTYPE_ADDR A:0xfc318fcc
y.create.l HWIO_QDSS_CTI8_PERIPHID0_ADDR A:0xfc318fe0
y.create.l HWIO_QDSS_CTI8_PERIPHID1_ADDR A:0xfc318fe4
y.create.l HWIO_QDSS_CTI8_PERIPHID2_ADDR A:0xfc318fe8
y.create.l HWIO_QDSS_CTI8_PERIPHID3_ADDR A:0xfc318fec
y.create.l HWIO_QDSS_CTI8_PERIPHID4_ADDR A:0xfc318fd0
y.create.l HWIO_QDSS_CTI8_PERIPHID5_ADDR A:0xfc318fd4
y.create.l HWIO_QDSS_CTI8_PERIPHID6_ADDR A:0xfc318fd8
y.create.l HWIO_QDSS_CTI8_PERIPHID7_ADDR A:0xfc318fdc
y.create.l HWIO_QDSS_CTI8_COMPID0_ADDR A:0xfc318ff0
y.create.l HWIO_QDSS_CTI8_COMPID1_ADDR A:0xfc318ff4
y.create.l HWIO_QDSS_CTI8_COMPID2_ADDR A:0xfc318ff8
y.create.l HWIO_QDSS_CTI8_COMPID3_ADDR A:0xfc318ffc
y.create.l HWIO_QDSS_CSTPIU_SUPPORTED_PORT_SIZES_ADDR A:0xfc320000
y.create.l HWIO_QDSS_CSTPIU_CURRENT_PORT_SIZE_ADDR A:0xfc320004
y.create.l HWIO_QDSS_CSTPIU_SUPPORTED_TRIGGER_MODES_ADDR A:0xfc320100
y.create.l HWIO_QDSS_CSTPIU_TRIGGER_COUNTER_VALUE_ADDR A:0xfc320104
y.create.l HWIO_QDSS_CSTPIU_TRIGGER_MULTIPLIER_ADDR A:0xfc320108
y.create.l HWIO_QDSS_CSTPIU_SUPPORTED_TEST_PATTERN_MODES_ADDR A:0xfc320200
y.create.l HWIO_QDSS_CSTPIU_CURRENT_TEST_PATTERN_MODE_ADDR A:0xfc320204
y.create.l HWIO_QDSS_CSTPIU_TPRCR_ADDR A:0xfc320208
y.create.l HWIO_QDSS_CSTPIU_FFSR_ADDR A:0xfc320300
y.create.l HWIO_QDSS_CSTPIU_FFCR_ADDR A:0xfc320304
y.create.l HWIO_QDSS_CSTPIU_FSCR_ADDR A:0xfc320308
y.create.l HWIO_QDSS_CSTPIU_EXTCTL_IN_PORT_ADDR A:0xfc320400
y.create.l HWIO_QDSS_CSTPIU_EXTCTL_OUT_PORT_ADDR A:0xfc320404
y.create.l HWIO_QDSS_CSTPIU_ITTRFLINACK_ADDR A:0xfc320ee4
y.create.l HWIO_QDSS_CSTPIU_ITTRFLIN_ADDR A:0xfc320ee8
y.create.l HWIO_QDSS_CSTPIU_ITATBDATA0_ADDR A:0xfc320eec
y.create.l HWIO_QDSS_CSTPIU_ITATBCTR2_ADDR A:0xfc320ef0
y.create.l HWIO_QDSS_CSTPIU_ITATBCTR1_ADDR A:0xfc320ef4
y.create.l HWIO_QDSS_CSTPIU_ITATBCTR0_ADDR A:0xfc320ef8
y.create.l HWIO_QDSS_CSTPIU_ITCTRL_ADDR A:0xfc320f00
y.create.l HWIO_QDSS_CSTPIU_CLAIMSET_ADDR A:0xfc320fa0
y.create.l HWIO_QDSS_CSTPIU_CLAIMCLR_ADDR A:0xfc320fa4
y.create.l HWIO_QDSS_CSTPIU_LAR_ADDR A:0xfc320fb0
y.create.l HWIO_QDSS_CSTPIU_LSR_ADDR A:0xfc320fb4
y.create.l HWIO_QDSS_CSTPIU_AUTHSTATUS_ADDR A:0xfc320fb8
y.create.l HWIO_QDSS_CSTPIU_DEVID_ADDR A:0xfc320fc8
y.create.l HWIO_QDSS_CSTPIU_DEVTYPE_ADDR A:0xfc320fcc
y.create.l HWIO_QDSS_CSTPIU_PERIPHID0_ADDR A:0xfc320fe0
y.create.l HWIO_QDSS_CSTPIU_PERIPHID1_ADDR A:0xfc320fe4
y.create.l HWIO_QDSS_CSTPIU_PERIPHID2_ADDR A:0xfc320fe8
y.create.l HWIO_QDSS_CSTPIU_PERIPHID3_ADDR A:0xfc320fec
y.create.l HWIO_QDSS_CSTPIU_PERIPHID4_ADDR A:0xfc320fd0
y.create.l HWIO_QDSS_CSTPIU_PERIPHID5_ADDR A:0xfc320fd4
y.create.l HWIO_QDSS_CSTPIU_PERIPHID6_ADDR A:0xfc320fd8
y.create.l HWIO_QDSS_CSTPIU_PERIPHID7_ADDR A:0xfc320fdc
y.create.l HWIO_QDSS_CSTPIU_COMPID0_ADDR A:0xfc320ff0
y.create.l HWIO_QDSS_CSTPIU_COMPID1_ADDR A:0xfc320ff4
y.create.l HWIO_QDSS_CSTPIU_COMPID2_ADDR A:0xfc320ff8
y.create.l HWIO_QDSS_CSTPIU_COMPID3_ADDR A:0xfc320ffc
y.create.l HWIO_QDSS_IN_FUN0_CTRL_REG_ADDR A:0xfc321000
y.create.l HWIO_QDSS_IN_FUN0_PRIORITY_CTRL_REG_ADDR A:0xfc321004
y.create.l HWIO_QDSS_IN_FUN0_ITATBDATA0_ADDR A:0xfc321eec
y.create.l HWIO_QDSS_IN_FUN0_ITATBCTR2_ADDR A:0xfc321ef0
y.create.l HWIO_QDSS_IN_FUN0_ITATBCTR1_ADDR A:0xfc321ef4
y.create.l HWIO_QDSS_IN_FUN0_ITATBCTR0_ADDR A:0xfc321ef8
y.create.l HWIO_QDSS_IN_FUN0_ITCTRL_ADDR A:0xfc321f00
y.create.l HWIO_QDSS_IN_FUN0_CLAIMSET_ADDR A:0xfc321fa0
y.create.l HWIO_QDSS_IN_FUN0_CLAIMCLR_ADDR A:0xfc321fa4
y.create.l HWIO_QDSS_IN_FUN0_LOCKACCESS_ADDR A:0xfc321fb0
y.create.l HWIO_QDSS_IN_FUN0_LOCKSTATUS_ADDR A:0xfc321fb4
y.create.l HWIO_QDSS_IN_FUN0_AUTHSTATUS_ADDR A:0xfc321fb8
y.create.l HWIO_QDSS_IN_FUN0_DEVID_ADDR A:0xfc321fc8
y.create.l HWIO_QDSS_IN_FUN0_DEVTYPE_ADDR A:0xfc321fcc
y.create.l HWIO_QDSS_IN_FUN0_PERIPHID0_ADDR A:0xfc321fe0
y.create.l HWIO_QDSS_IN_FUN0_PERIPHID1_ADDR A:0xfc321fe4
y.create.l HWIO_QDSS_IN_FUN0_PERIPHID2_ADDR A:0xfc321fe8
y.create.l HWIO_QDSS_IN_FUN0_PERIPHID3_ADDR A:0xfc321fec
y.create.l HWIO_QDSS_IN_FUN0_PERIPHID4_ADDR A:0xfc321fd0
y.create.l HWIO_QDSS_IN_FUN0_PERIPHID5_ADDR A:0xfc321fd4
y.create.l HWIO_QDSS_IN_FUN0_PERIPHID6_ADDR A:0xfc321fd8
y.create.l HWIO_QDSS_IN_FUN0_PERIPHID7_ADDR A:0xfc321fdc
y.create.l HWIO_QDSS_IN_FUN0_COMPID0_ADDR A:0xfc321ff0
y.create.l HWIO_QDSS_IN_FUN0_COMPID1_ADDR A:0xfc321ff4
y.create.l HWIO_QDSS_IN_FUN0_COMPID2_ADDR A:0xfc321ff8
y.create.l HWIO_QDSS_IN_FUN0_COMPID3_ADDR A:0xfc321ffc
y.create.l HWIO_QDSS_IN_FUN1_CTRL_REG_ADDR A:0xfc322000
y.create.l HWIO_QDSS_IN_FUN1_PRIORITY_CTRL_REG_ADDR A:0xfc322004
y.create.l HWIO_QDSS_IN_FUN1_ITATBDATA0_ADDR A:0xfc322eec
y.create.l HWIO_QDSS_IN_FUN1_ITATBCTR2_ADDR A:0xfc322ef0
y.create.l HWIO_QDSS_IN_FUN1_ITATBCTR1_ADDR A:0xfc322ef4
y.create.l HWIO_QDSS_IN_FUN1_ITATBCTR0_ADDR A:0xfc322ef8
y.create.l HWIO_QDSS_IN_FUN1_ITCTRL_ADDR A:0xfc322f00
y.create.l HWIO_QDSS_IN_FUN1_CLAIMSET_ADDR A:0xfc322fa0
y.create.l HWIO_QDSS_IN_FUN1_CLAIMCLR_ADDR A:0xfc322fa4
y.create.l HWIO_QDSS_IN_FUN1_LOCKACCESS_ADDR A:0xfc322fb0
y.create.l HWIO_QDSS_IN_FUN1_LOCKSTATUS_ADDR A:0xfc322fb4
y.create.l HWIO_QDSS_IN_FUN1_AUTHSTATUS_ADDR A:0xfc322fb8
y.create.l HWIO_QDSS_IN_FUN1_DEVID_ADDR A:0xfc322fc8
y.create.l HWIO_QDSS_IN_FUN1_DEVTYPE_ADDR A:0xfc322fcc
y.create.l HWIO_QDSS_IN_FUN1_PERIPHID0_ADDR A:0xfc322fe0
y.create.l HWIO_QDSS_IN_FUN1_PERIPHID1_ADDR A:0xfc322fe4
y.create.l HWIO_QDSS_IN_FUN1_PERIPHID2_ADDR A:0xfc322fe8
y.create.l HWIO_QDSS_IN_FUN1_PERIPHID3_ADDR A:0xfc322fec
y.create.l HWIO_QDSS_IN_FUN1_PERIPHID4_ADDR A:0xfc322fd0
y.create.l HWIO_QDSS_IN_FUN1_PERIPHID5_ADDR A:0xfc322fd4
y.create.l HWIO_QDSS_IN_FUN1_PERIPHID6_ADDR A:0xfc322fd8
y.create.l HWIO_QDSS_IN_FUN1_PERIPHID7_ADDR A:0xfc322fdc
y.create.l HWIO_QDSS_IN_FUN1_COMPID0_ADDR A:0xfc322ff0
y.create.l HWIO_QDSS_IN_FUN1_COMPID1_ADDR A:0xfc322ff4
y.create.l HWIO_QDSS_IN_FUN1_COMPID2_ADDR A:0xfc322ff8
y.create.l HWIO_QDSS_IN_FUN1_COMPID3_ADDR A:0xfc322ffc
y.create.l HWIO_QDSS_MERG_FUN_CTRL_REG_ADDR A:0xfc323000
y.create.l HWIO_QDSS_MERG_FUN_PRIORITY_CTRL_REG_ADDR A:0xfc323004
y.create.l HWIO_QDSS_MERG_FUN_ITATBDATA0_ADDR A:0xfc323eec
y.create.l HWIO_QDSS_MERG_FUN_ITATBCTR2_ADDR A:0xfc323ef0
y.create.l HWIO_QDSS_MERG_FUN_ITATBCTR1_ADDR A:0xfc323ef4
y.create.l HWIO_QDSS_MERG_FUN_ITATBCTR0_ADDR A:0xfc323ef8
y.create.l HWIO_QDSS_MERG_FUN_ITCTRL_ADDR A:0xfc323f00
y.create.l HWIO_QDSS_MERG_FUN_CLAIMSET_ADDR A:0xfc323fa0
y.create.l HWIO_QDSS_MERG_FUN_CLAIMCLR_ADDR A:0xfc323fa4
y.create.l HWIO_QDSS_MERG_FUN_LOCKACCESS_ADDR A:0xfc323fb0
y.create.l HWIO_QDSS_MERG_FUN_LOCKSTATUS_ADDR A:0xfc323fb4
y.create.l HWIO_QDSS_MERG_FUN_AUTHSTATUS_ADDR A:0xfc323fb8
y.create.l HWIO_QDSS_MERG_FUN_DEVID_ADDR A:0xfc323fc8
y.create.l HWIO_QDSS_MERG_FUN_DEVTYPE_ADDR A:0xfc323fcc
y.create.l HWIO_QDSS_MERG_FUN_PERIPHID0_ADDR A:0xfc323fe0
y.create.l HWIO_QDSS_MERG_FUN_PERIPHID1_ADDR A:0xfc323fe4
y.create.l HWIO_QDSS_MERG_FUN_PERIPHID2_ADDR A:0xfc323fe8
y.create.l HWIO_QDSS_MERG_FUN_PERIPHID3_ADDR A:0xfc323fec
y.create.l HWIO_QDSS_MERG_FUN_PERIPHID4_ADDR A:0xfc323fd0
y.create.l HWIO_QDSS_MERG_FUN_PERIPHID5_ADDR A:0xfc323fd4
y.create.l HWIO_QDSS_MERG_FUN_PERIPHID6_ADDR A:0xfc323fd8
y.create.l HWIO_QDSS_MERG_FUN_PERIPHID7_ADDR A:0xfc323fdc
y.create.l HWIO_QDSS_MERG_FUN_COMPID0_ADDR A:0xfc323ff0
y.create.l HWIO_QDSS_MERG_FUN_COMPID1_ADDR A:0xfc323ff4
y.create.l HWIO_QDSS_MERG_FUN_COMPID2_ADDR A:0xfc323ff8
y.create.l HWIO_QDSS_MERG_FUN_COMPID3_ADDR A:0xfc323ffc
y.create.l HWIO_QDSS_REPL64_IDFILTER0_ADDR A:0xfc324000
y.create.l HWIO_QDSS_REPL64_IDFILTER1_ADDR A:0xfc324004
y.create.l HWIO_QDSS_REPL64_ITATBCTR0_ADDR A:0xfc324efc
y.create.l HWIO_QDSS_REPL64_ITATBCTR1_ADDR A:0xfc324ef8
y.create.l HWIO_QDSS_REPL64_ITCTRL_ADDR A:0xfc324f00
y.create.l HWIO_QDSS_REPL64_CLAIMSET_ADDR A:0xfc324fa0
y.create.l HWIO_QDSS_REPL64_CLAIMCLR_ADDR A:0xfc324fa4
y.create.l HWIO_QDSS_REPL64_LAR_ADDR A:0xfc324fb0
y.create.l HWIO_QDSS_REPL64_LSR_ADDR A:0xfc324fb4
y.create.l HWIO_QDSS_REPL64_AUTHSTATUS_ADDR A:0xfc324fb8
y.create.l HWIO_QDSS_REPL64_DEVID_ADDR A:0xfc324fc8
y.create.l HWIO_QDSS_REPL64_DEVTYPE_ADDR A:0xfc324fcc
y.create.l HWIO_QDSS_REPL64_PIDR0_ADDR A:0xfc324fe0
y.create.l HWIO_QDSS_REPL64_PIDR1_ADDR A:0xfc324fe4
y.create.l HWIO_QDSS_REPL64_PIDR2_ADDR A:0xfc324fe8
y.create.l HWIO_QDSS_REPL64_PIDR3_ADDR A:0xfc324fec
y.create.l HWIO_QDSS_REPL64_PIDR4_ADDR A:0xfc324fd0
y.create.l HWIO_QDSS_REPL64_PIDR5_ADDR A:0xfc324fd4
y.create.l HWIO_QDSS_REPL64_PIDR6_ADDR A:0xfc324fd8
y.create.l HWIO_QDSS_REPL64_PIDR7_ADDR A:0xfc324fdc
y.create.l HWIO_QDSS_REPL64_CIDR0_ADDR A:0xfc324ff0
y.create.l HWIO_QDSS_REPL64_CIDR1_ADDR A:0xfc324ff4
y.create.l HWIO_QDSS_REPL64_CIDR2_ADDR A:0xfc324ff8
y.create.l HWIO_QDSS_REPL64_CIDR3_ADDR A:0xfc324ffc
y.create.l HWIO_QDSS_ETFETB_RSZ_ADDR A:0xfc325004
y.create.l HWIO_QDSS_ETFETB_STS_ADDR A:0xfc32500c
y.create.l HWIO_QDSS_ETFETB_RRD_ADDR A:0xfc325010
y.create.l HWIO_QDSS_ETFETB_RRP_ADDR A:0xfc325014
y.create.l HWIO_QDSS_ETFETB_RWP_ADDR A:0xfc325018
y.create.l HWIO_QDSS_ETFETB_TRG_ADDR A:0xfc32501c
y.create.l HWIO_QDSS_ETFETB_CTL_ADDR A:0xfc325020
y.create.l HWIO_QDSS_ETFETB_RWD_ADDR A:0xfc325024
y.create.l HWIO_QDSS_ETFETB_MODE_ADDR A:0xfc325028
y.create.l HWIO_QDSS_ETFETB_LBUFLEVEL_ADDR A:0xfc32502c
y.create.l HWIO_QDSS_ETFETB_CBUFLEVEL_ADDR A:0xfc325030
y.create.l HWIO_QDSS_ETFETB_BUFWM_ADDR A:0xfc325034
y.create.l HWIO_QDSS_ETFETB_FFSR_ADDR A:0xfc325300
y.create.l HWIO_QDSS_ETFETB_FFCR_ADDR A:0xfc325304
y.create.l HWIO_QDSS_ETFETB_PSCR_ADDR A:0xfc325308
y.create.l HWIO_QDSS_ETFETB_ITATBMDATA0_ADDR A:0xfc325ed0
y.create.l HWIO_QDSS_ETFETB_ITATBMCTR2_ADDR A:0xfc325ed4
y.create.l HWIO_QDSS_ETFETB_ITATBMCTR1_ADDR A:0xfc325ed8
y.create.l HWIO_QDSS_ETFETB_ITATBMCTR0_ADDR A:0xfc325edc
y.create.l HWIO_QDSS_ETFETB_ITMISCOP0_ADDR A:0xfc325ee0
y.create.l HWIO_QDSS_ETFETB_ITTRFLIN_ADDR A:0xfc325ee8
y.create.l HWIO_QDSS_ETFETB_ITATBDATA0_ADDR A:0xfc325eec
y.create.l HWIO_QDSS_ETFETB_ITATBCTR2_ADDR A:0xfc325ef0
y.create.l HWIO_QDSS_ETFETB_ITATBCTR1_ADDR A:0xfc325ef4
y.create.l HWIO_QDSS_ETFETB_ITATBCTR0_ADDR A:0xfc325ef8
y.create.l HWIO_QDSS_ETFETB_ITCTRL_ADDR A:0xfc325f00
y.create.l HWIO_QDSS_ETFETB_CLAIMSET_ADDR A:0xfc325fa0
y.create.l HWIO_QDSS_ETFETB_CLAIMCLR_ADDR A:0xfc325fa4
y.create.l HWIO_QDSS_ETFETB_LAR_ADDR A:0xfc325fb0
y.create.l HWIO_QDSS_ETFETB_LSR_ADDR A:0xfc325fb4
y.create.l HWIO_QDSS_ETFETB_AUTHSTATUS_ADDR A:0xfc325fb8
y.create.l HWIO_QDSS_ETFETB_DEVID_ADDR A:0xfc325fc8
y.create.l HWIO_QDSS_ETFETB_DEVTYPE_ADDR A:0xfc325fcc
y.create.l HWIO_QDSS_ETFETB_PERIPHID0_ADDR A:0xfc325fe0
y.create.l HWIO_QDSS_ETFETB_PERIPHID1_ADDR A:0xfc325fe4
y.create.l HWIO_QDSS_ETFETB_PERIPHID2_ADDR A:0xfc325fe8
y.create.l HWIO_QDSS_ETFETB_PERIPHID3_ADDR A:0xfc325fec
y.create.l HWIO_QDSS_ETFETB_PERIPHID4_ADDR A:0xfc325fd0
y.create.l HWIO_QDSS_ETFETB_PERIPHID5_ADDR A:0xfc325fd4
y.create.l HWIO_QDSS_ETFETB_PERIPHID6_ADDR A:0xfc325fd8
y.create.l HWIO_QDSS_ETFETB_PERIPHID7_ADDR A:0xfc325fdc
y.create.l HWIO_QDSS_ETFETB_COMPID0_ADDR A:0xfc325ff0
y.create.l HWIO_QDSS_ETFETB_COMPID1_ADDR A:0xfc325ff4
y.create.l HWIO_QDSS_ETFETB_COMPID2_ADDR A:0xfc325ff8
y.create.l HWIO_QDSS_ETFETB_COMPID3_ADDR A:0xfc325ffc
y.create.l HWIO_QDSS_ETR_RSZ_ADDR A:0xfc326004
y.create.l HWIO_QDSS_ETR_STS_ADDR A:0xfc32600c
y.create.l HWIO_QDSS_ETR_RRD_ADDR A:0xfc326010
y.create.l HWIO_QDSS_ETR_RRP_ADDR A:0xfc326014
y.create.l HWIO_QDSS_ETR_RWP_ADDR A:0xfc326018
y.create.l HWIO_QDSS_ETR_TRG_ADDR A:0xfc32601c
y.create.l HWIO_QDSS_ETR_CTL_ADDR A:0xfc326020
y.create.l HWIO_QDSS_ETR_RWD_ADDR A:0xfc326024
y.create.l HWIO_QDSS_ETR_MODE_ADDR A:0xfc326028
y.create.l HWIO_QDSS_ETR_LBUFLEVEL_ADDR A:0xfc32602c
y.create.l HWIO_QDSS_ETR_CBUFLEVEL_ADDR A:0xfc326030
y.create.l HWIO_QDSS_ETR_BUFWM_ADDR A:0xfc326034
y.create.l HWIO_QDSS_ETR_RRPHI_ADDR A:0xfc326038
y.create.l HWIO_QDSS_ETR_RWPHI_ADDR A:0xfc32603c
y.create.l HWIO_QDSS_ETR_AXICTL_ADDR A:0xfc326110
y.create.l HWIO_QDSS_ETR_DBALO_ADDR A:0xfc326118
y.create.l HWIO_QDSS_ETR_DBAHI_ADDR A:0xfc32611c
y.create.l HWIO_QDSS_ETR_FFSR_ADDR A:0xfc326300
y.create.l HWIO_QDSS_ETR_FFCR_ADDR A:0xfc326304
y.create.l HWIO_QDSS_ETR_PSCR_ADDR A:0xfc326308
y.create.l HWIO_QDSS_ETR_ITMISCOP0_ADDR A:0xfc326ee0
y.create.l HWIO_QDSS_ETR_ITTRFLIN_ADDR A:0xfc326ee8
y.create.l HWIO_QDSS_ETR_ITATBDATA0_ADDR A:0xfc326eec
y.create.l HWIO_QDSS_ETR_ITATBCTR2_ADDR A:0xfc326ef0
y.create.l HWIO_QDSS_ETR_ITATBCTR1_ADDR A:0xfc326ef4
y.create.l HWIO_QDSS_ETR_ITATBCTR0_ADDR A:0xfc326ef8
y.create.l HWIO_QDSS_ETR_ITCTRL_ADDR A:0xfc326f00
y.create.l HWIO_QDSS_ETR_CLAIMSET_ADDR A:0xfc326fa0
y.create.l HWIO_QDSS_ETR_CLAIMCLR_ADDR A:0xfc326fa4
y.create.l HWIO_QDSS_ETR_LAR_ADDR A:0xfc326fb0
y.create.l HWIO_QDSS_ETR_LSR_ADDR A:0xfc326fb4
y.create.l HWIO_QDSS_ETR_AUTHSTATUS_ADDR A:0xfc326fb8
y.create.l HWIO_QDSS_ETR_DEVID_ADDR A:0xfc326fc8
y.create.l HWIO_QDSS_ETR_DEVTYPE_ADDR A:0xfc326fcc
y.create.l HWIO_QDSS_ETR_PERIPHID0_ADDR A:0xfc326fe0
y.create.l HWIO_QDSS_ETR_PERIPHID1_ADDR A:0xfc326fe4
y.create.l HWIO_QDSS_ETR_PERIPHID2_ADDR A:0xfc326fe8
y.create.l HWIO_QDSS_ETR_PERIPHID3_ADDR A:0xfc326fec
y.create.l HWIO_QDSS_ETR_PERIPHID4_ADDR A:0xfc326fd0
y.create.l HWIO_QDSS_ETR_PERIPHID5_ADDR A:0xfc326fd4
y.create.l HWIO_QDSS_ETR_PERIPHID6_ADDR A:0xfc326fd8
y.create.l HWIO_QDSS_ETR_PERIPHID7_ADDR A:0xfc326fdc
y.create.l HWIO_QDSS_ETR_COMPID0_ADDR A:0xfc326ff0
y.create.l HWIO_QDSS_ETR_COMPID1_ADDR A:0xfc326ff4
y.create.l HWIO_QDSS_ETR_COMPID2_ADDR A:0xfc326ff8
y.create.l HWIO_QDSS_ETR_COMPID3_ADDR A:0xfc326ffc
y.create.l HWIO_QDSS_VMIDDAP_VMIDMT_SCR0_ADDR A:0xfc376000
y.create.l HWIO_QDSS_VMIDDAP_VMIDMT_SCR1_ADDR A:0xfc376004
y.create.l HWIO_QDSS_VMIDDAP_VMIDMT_SCR2_ADDR A:0xfc376008
y.create.l HWIO_QDSS_VMIDDAP_VMIDMT_SACR_ADDR A:0xfc376010
y.create.l HWIO_QDSS_VMIDDAP_VMIDMT_SIDR0_ADDR A:0xfc376020
y.create.l HWIO_QDSS_VMIDDAP_VMIDMT_SIDR1_ADDR A:0xfc376024
y.create.l HWIO_QDSS_VMIDDAP_VMIDMT_SIDR2_ADDR A:0xfc376028
y.create.l HWIO_QDSS_VMIDDAP_VMIDMT_SIDR4_ADDR A:0xfc376030
y.create.l HWIO_QDSS_VMIDDAP_VMIDMT_SIDR5_ADDR A:0xfc376034
y.create.l HWIO_QDSS_VMIDDAP_VMIDMT_SIDR7_ADDR A:0xfc37603c
y.create.l HWIO_QDSS_VMIDDAP_VMIDMT_SGFAR0_ADDR A:0xfc376040
y.create.l HWIO_QDSS_VMIDDAP_VMIDMT_SGFSR_ADDR A:0xfc376048
y.create.l HWIO_QDSS_VMIDDAP_VMIDMT_SGFSRRESTORE_ADDR A:0xfc37604c
y.create.l HWIO_QDSS_VMIDDAP_VMIDMT_SGFSYNDR0_ADDR A:0xfc376050
y.create.l HWIO_QDSS_VMIDDAP_VMIDMT_SGFSYNDR1_ADDR A:0xfc376054
y.create.l HWIO_QDSS_VMIDDAP_VMIDMT_SGFSYNDR2_ADDR A:0xfc376058
y.create.l HWIO_QDSS_VMIDDAP_VMIDMT_VMIDMTSCR0_ADDR A:0xfc376090
y.create.l HWIO_QDSS_VMIDDAP_VMIDMT_CR0_ADDR A:0xfc376000
y.create.l HWIO_QDSS_VMIDDAP_VMIDMT_CR2_ADDR A:0xfc376008
y.create.l HWIO_QDSS_VMIDDAP_VMIDMT_ACR_ADDR A:0xfc376010
y.create.l HWIO_QDSS_VMIDDAP_VMIDMT_IDR0_ADDR A:0xfc376020
y.create.l HWIO_QDSS_VMIDDAP_VMIDMT_IDR1_ADDR A:0xfc376024
y.create.l HWIO_QDSS_VMIDDAP_VMIDMT_IDR2_ADDR A:0xfc376028
y.create.l HWIO_QDSS_VMIDDAP_VMIDMT_IDR4_ADDR A:0xfc376030
y.create.l HWIO_QDSS_VMIDDAP_VMIDMT_IDR5_ADDR A:0xfc376034
y.create.l HWIO_QDSS_VMIDDAP_VMIDMT_IDR7_ADDR A:0xfc37603c
y.create.l HWIO_QDSS_VMIDDAP_VMIDMT_GFAR0_ADDR A:0xfc376040
y.create.l HWIO_QDSS_VMIDDAP_VMIDMT_GFSR_ADDR A:0xfc376048
y.create.l HWIO_QDSS_VMIDDAP_VMIDMT_GFSRRESTORE_ADDR A:0xfc37604c
y.create.l HWIO_QDSS_VMIDDAP_VMIDMT_GFSYNDR0_ADDR A:0xfc376050
y.create.l HWIO_QDSS_VMIDDAP_VMIDMT_GFSYNDR1_ADDR A:0xfc376054
y.create.l HWIO_QDSS_VMIDDAP_VMIDMT_GFSYNDR2_ADDR A:0xfc376058
y.create.l HWIO_QDSS_VMIDDAP_VMIDMT_VMIDMTCR0_ADDR A:0xfc376090
y.create.l HWIO_QDSS_VMIDDAP_VMIDMT_VMIDMTACR_ADDR A:0xfc37609c
y.create.l HWIO_QDSS_VMIDDAP_VMIDMT_NSCR0_ADDR A:0xfc376400
y.create.l HWIO_QDSS_VMIDDAP_VMIDMT_NSCR2_ADDR A:0xfc376408
y.create.l HWIO_QDSS_VMIDDAP_VMIDMT_NSACR_ADDR A:0xfc376410
y.create.l HWIO_QDSS_VMIDDAP_VMIDMT_NSGFAR0_ADDR A:0xfc376440
y.create.l HWIO_QDSS_VMIDDAP_VMIDMT_NSGFSR_ADDR A:0xfc376448
y.create.l HWIO_QDSS_VMIDDAP_VMIDMT_NSGFSRRESTORE_ADDR A:0xfc37644c
y.create.l HWIO_QDSS_VMIDDAP_VMIDMT_NSGFSYNDR0_ADDR A:0xfc376450
y.create.l HWIO_QDSS_VMIDDAP_VMIDMT_NSGFSYNDR1_ADDR A:0xfc376454
y.create.l HWIO_QDSS_VMIDDAP_VMIDMT_NSGFSYNDR2_ADDR A:0xfc376458
y.create.l HWIO_QDSS_VMIDDAP_VMIDMT_NSVMIDMTCR0_ADDR A:0xfc376490
y.create.l HWIO_QDSS_VMIDDAP_VMIDMT_SSDR0_ADDR A:0xfc376080
y.create.l HWIO_QDSS_VMIDDAP_VMIDMT_S2VR0_ADDR A:0xfc376c00
y.create.l HWIO_QDSS_VMIDDAP_VMIDMT_S2VR1_ADDR A:0xfc376c04
y.create.l HWIO_QDSS_VMIDDAP_VMIDMT_AS2VR0_ADDR A:0xfc376e00
y.create.l HWIO_QDSS_VMIDDAP_VMIDMT_AS2VR1_ADDR A:0xfc376e04
y.create.l HWIO_QDSS_VMIDETR_VMIDMT_SCR0_ADDR A:0xfc377000
y.create.l HWIO_QDSS_VMIDETR_VMIDMT_SCR1_ADDR A:0xfc377004
y.create.l HWIO_QDSS_VMIDETR_VMIDMT_SCR2_ADDR A:0xfc377008
y.create.l HWIO_QDSS_VMIDETR_VMIDMT_SACR_ADDR A:0xfc377010
y.create.l HWIO_QDSS_VMIDETR_VMIDMT_SIDR0_ADDR A:0xfc377020
y.create.l HWIO_QDSS_VMIDETR_VMIDMT_SIDR1_ADDR A:0xfc377024
y.create.l HWIO_QDSS_VMIDETR_VMIDMT_SIDR2_ADDR A:0xfc377028
y.create.l HWIO_QDSS_VMIDETR_VMIDMT_SIDR4_ADDR A:0xfc377030
y.create.l HWIO_QDSS_VMIDETR_VMIDMT_SIDR5_ADDR A:0xfc377034
y.create.l HWIO_QDSS_VMIDETR_VMIDMT_SIDR7_ADDR A:0xfc37703c
y.create.l HWIO_QDSS_VMIDETR_VMIDMT_SGFAR0_ADDR A:0xfc377040
y.create.l HWIO_QDSS_VMIDETR_VMIDMT_SGFSR_ADDR A:0xfc377048
y.create.l HWIO_QDSS_VMIDETR_VMIDMT_SGFSRRESTORE_ADDR A:0xfc37704c
y.create.l HWIO_QDSS_VMIDETR_VMIDMT_SGFSYNDR0_ADDR A:0xfc377050
y.create.l HWIO_QDSS_VMIDETR_VMIDMT_SGFSYNDR1_ADDR A:0xfc377054
y.create.l HWIO_QDSS_VMIDETR_VMIDMT_SGFSYNDR2_ADDR A:0xfc377058
y.create.l HWIO_QDSS_VMIDETR_VMIDMT_VMIDMTSCR0_ADDR A:0xfc377090
y.create.l HWIO_QDSS_VMIDETR_VMIDMT_CR0_ADDR A:0xfc377000
y.create.l HWIO_QDSS_VMIDETR_VMIDMT_CR2_ADDR A:0xfc377008
y.create.l HWIO_QDSS_VMIDETR_VMIDMT_ACR_ADDR A:0xfc377010
y.create.l HWIO_QDSS_VMIDETR_VMIDMT_IDR0_ADDR A:0xfc377020
y.create.l HWIO_QDSS_VMIDETR_VMIDMT_IDR1_ADDR A:0xfc377024
y.create.l HWIO_QDSS_VMIDETR_VMIDMT_IDR2_ADDR A:0xfc377028
y.create.l HWIO_QDSS_VMIDETR_VMIDMT_IDR4_ADDR A:0xfc377030
y.create.l HWIO_QDSS_VMIDETR_VMIDMT_IDR5_ADDR A:0xfc377034
y.create.l HWIO_QDSS_VMIDETR_VMIDMT_IDR7_ADDR A:0xfc37703c
y.create.l HWIO_QDSS_VMIDETR_VMIDMT_GFAR0_ADDR A:0xfc377040
y.create.l HWIO_QDSS_VMIDETR_VMIDMT_GFSR_ADDR A:0xfc377048
y.create.l HWIO_QDSS_VMIDETR_VMIDMT_GFSRRESTORE_ADDR A:0xfc37704c
y.create.l HWIO_QDSS_VMIDETR_VMIDMT_GFSYNDR0_ADDR A:0xfc377050
y.create.l HWIO_QDSS_VMIDETR_VMIDMT_GFSYNDR1_ADDR A:0xfc377054
y.create.l HWIO_QDSS_VMIDETR_VMIDMT_GFSYNDR2_ADDR A:0xfc377058
y.create.l HWIO_QDSS_VMIDETR_VMIDMT_VMIDMTCR0_ADDR A:0xfc377090
y.create.l HWIO_QDSS_VMIDETR_VMIDMT_VMIDMTACR_ADDR A:0xfc37709c
y.create.l HWIO_QDSS_VMIDETR_VMIDMT_NSCR0_ADDR A:0xfc377400
y.create.l HWIO_QDSS_VMIDETR_VMIDMT_NSCR2_ADDR A:0xfc377408
y.create.l HWIO_QDSS_VMIDETR_VMIDMT_NSACR_ADDR A:0xfc377410
y.create.l HWIO_QDSS_VMIDETR_VMIDMT_NSGFAR0_ADDR A:0xfc377440
y.create.l HWIO_QDSS_VMIDETR_VMIDMT_NSGFSR_ADDR A:0xfc377448
y.create.l HWIO_QDSS_VMIDETR_VMIDMT_NSGFSRRESTORE_ADDR A:0xfc37744c
y.create.l HWIO_QDSS_VMIDETR_VMIDMT_NSGFSYNDR0_ADDR A:0xfc377450
y.create.l HWIO_QDSS_VMIDETR_VMIDMT_NSGFSYNDR1_ADDR A:0xfc377454
y.create.l HWIO_QDSS_VMIDETR_VMIDMT_NSGFSYNDR2_ADDR A:0xfc377458
y.create.l HWIO_QDSS_VMIDETR_VMIDMT_NSVMIDMTCR0_ADDR A:0xfc377490
y.create.l HWIO_QDSS_VMIDETR_VMIDMT_SSDR0_ADDR A:0xfc377080
y.create.l HWIO_QDSS_VMIDETR_VMIDMT_S2VR0_ADDR A:0xfc377c00
y.create.l HWIO_QDSS_VMIDETR_VMIDMT_S2VR1_ADDR A:0xfc377c04
y.create.l HWIO_QDSS_VMIDETR_VMIDMT_AS2VR0_ADDR A:0xfc377e00
y.create.l HWIO_QDSS_VMIDETR_VMIDMT_AS2VR1_ADDR A:0xfc377e04
y.create.l HWIO_QDSS_NDPBAM_BAM_CTRL_ADDR A:0xfc37c000
y.create.l HWIO_QDSS_NDPBAM_BAM_REVISION_ADDR A:0xfc37c004
y.create.l HWIO_QDSS_NDPBAM_BAM_SW_VERSION_ADDR A:0xfc37c080
y.create.l HWIO_QDSS_NDPBAM_BAM_NUM_PIPES_ADDR A:0xfc37c03c
y.create.l HWIO_QDSS_NDPBAM_BAM_TIMER_ADDR A:0xfc37c040
y.create.l HWIO_QDSS_NDPBAM_BAM_TIMER_CTRL_ADDR A:0xfc37c044
y.create.l HWIO_QDSS_NDPBAM_BAM_DESC_CNT_TRSHLD_ADDR A:0xfc37c008
y.create.l HWIO_QDSS_NDPBAM_BAM_IRQ_SRCS_ADDR A:0xfc37c00c
y.create.l HWIO_QDSS_NDPBAM_BAM_IRQ_SRCS_MSK_ADDR A:0xfc37c010
y.create.l HWIO_QDSS_NDPBAM_BAM_IRQ_SRCS_UNMASKED_ADDR A:0xfc37c030
y.create.l HWIO_QDSS_NDPBAM_BAM_IRQ_STTS_ADDR A:0xfc37c014
y.create.l HWIO_QDSS_NDPBAM_BAM_IRQ_CLR_ADDR A:0xfc37c018
y.create.l HWIO_QDSS_NDPBAM_BAM_IRQ_EN_ADDR A:0xfc37c01c
y.create.l HWIO_QDSS_NDPBAM_BAM_AHB_MASTER_ERR_CTRLS_ADDR A:0xfc37c024
y.create.l HWIO_QDSS_NDPBAM_BAM_AHB_MASTER_ERR_ADDR_ADDR A:0xfc37c028
y.create.l HWIO_QDSS_NDPBAM_BAM_AHB_MASTER_ERR_ADDR_LSB_ADDR A:0xfc37c100
y.create.l HWIO_QDSS_NDPBAM_BAM_AHB_MASTER_ERR_ADDR_MSB_ADDR A:0xfc37c104
y.create.l HWIO_QDSS_NDPBAM_BAM_AHB_MASTER_ERR_DATA_ADDR A:0xfc37c02c
y.create.l HWIO_QDSS_NDPBAM_BAM_TRUST_REG_ADDR A:0xfc37c070
y.create.l HWIO_QDSS_NDPBAM_BAM_TEST_BUS_SEL_ADDR A:0xfc37c074
y.create.l HWIO_QDSS_NDPBAM_BAM_TEST_BUS_REG_ADDR A:0xfc37c078
y.create.l HWIO_QDSS_NDPBAM_BAM_CNFG_BITS_ADDR A:0xfc37c07c
y.create.l HWIO_QDSS_NDPBAM_BAM_IRQ_SRCS_EE0_ADDR A:0xfc37c800
y.create.l HWIO_QDSS_NDPBAM_BAM_IRQ_SRCS_EE1_ADDR A:0xfc37c880
y.create.l HWIO_QDSS_NDPBAM_BAM_IRQ_SRCS_EE2_ADDR A:0xfc37c900
y.create.l HWIO_QDSS_NDPBAM_BAM_IRQ_SRCS_EE3_ADDR A:0xfc37c980
y.create.l HWIO_QDSS_NDPBAM_BAM_IRQ_SRCS_EE4_ADDR A:0xfc37ca00
y.create.l HWIO_QDSS_NDPBAM_BAM_IRQ_SRCS_EE5_ADDR A:0xfc37ca80
y.create.l HWIO_QDSS_NDPBAM_BAM_IRQ_SRCS_EE6_ADDR A:0xfc37cb00
y.create.l HWIO_QDSS_NDPBAM_BAM_IRQ_SRCS_EE7_ADDR A:0xfc37cb80
y.create.l HWIO_QDSS_NDPBAM_BAM_IRQ_SRCS_MSK_EE0_ADDR A:0xfc37c804
y.create.l HWIO_QDSS_NDPBAM_BAM_IRQ_SRCS_MSK_EE1_ADDR A:0xfc37c884
y.create.l HWIO_QDSS_NDPBAM_BAM_IRQ_SRCS_MSK_EE2_ADDR A:0xfc37c904
y.create.l HWIO_QDSS_NDPBAM_BAM_IRQ_SRCS_MSK_EE3_ADDR A:0xfc37c984
y.create.l HWIO_QDSS_NDPBAM_BAM_IRQ_SRCS_MSK_EE4_ADDR A:0xfc37ca04
y.create.l HWIO_QDSS_NDPBAM_BAM_IRQ_SRCS_MSK_EE5_ADDR A:0xfc37ca84
y.create.l HWIO_QDSS_NDPBAM_BAM_IRQ_SRCS_MSK_EE6_ADDR A:0xfc37cb04
y.create.l HWIO_QDSS_NDPBAM_BAM_IRQ_SRCS_MSK_EE7_ADDR A:0xfc37cb84
y.create.l HWIO_QDSS_NDPBAM_BAM_IRQ_SRCS_UNMASKED_EE0_ADDR A:0xfc37c808
y.create.l HWIO_QDSS_NDPBAM_BAM_IRQ_SRCS_UNMASKED_EE1_ADDR A:0xfc37c888
y.create.l HWIO_QDSS_NDPBAM_BAM_IRQ_SRCS_UNMASKED_EE2_ADDR A:0xfc37c908
y.create.l HWIO_QDSS_NDPBAM_BAM_IRQ_SRCS_UNMASKED_EE3_ADDR A:0xfc37c988
y.create.l HWIO_QDSS_NDPBAM_BAM_IRQ_SRCS_UNMASKED_EE4_ADDR A:0xfc37ca08
y.create.l HWIO_QDSS_NDPBAM_BAM_IRQ_SRCS_UNMASKED_EE5_ADDR A:0xfc37ca88
y.create.l HWIO_QDSS_NDPBAM_BAM_IRQ_SRCS_UNMASKED_EE6_ADDR A:0xfc37cb08
y.create.l HWIO_QDSS_NDPBAM_BAM_IRQ_SRCS_UNMASKED_EE7_ADDR A:0xfc37cb88
y.create.l HWIO_QDSS_NDPBAM_BAM_PIPE_ATTR_EE0_ADDR A:0xfc37c80c
y.create.l HWIO_QDSS_NDPBAM_BAM_PIPE_ATTR_EE1_ADDR A:0xfc37c88c
y.create.l HWIO_QDSS_NDPBAM_BAM_PIPE_ATTR_EE2_ADDR A:0xfc37c90c
y.create.l HWIO_QDSS_NDPBAM_BAM_PIPE_ATTR_EE3_ADDR A:0xfc37c98c
y.create.l HWIO_QDSS_NDPBAM_BAM_PIPE_ATTR_EE4_ADDR A:0xfc37ca0c
y.create.l HWIO_QDSS_NDPBAM_BAM_PIPE_ATTR_EE5_ADDR A:0xfc37ca8c
y.create.l HWIO_QDSS_NDPBAM_BAM_PIPE_ATTR_EE6_ADDR A:0xfc37cb0c
y.create.l HWIO_QDSS_NDPBAM_BAM_PIPE_ATTR_EE7_ADDR A:0xfc37cb8c
y.create.l HWIO_QDSS_NDPBAM_BAM_P_CTRL0_ADDR A:0xfc37d000
y.create.l HWIO_QDSS_NDPBAM_BAM_P_CTRL1_ADDR A:0xfc37e000
y.create.l HWIO_QDSS_NDPBAM_BAM_P_RST0_ADDR A:0xfc37d004
y.create.l HWIO_QDSS_NDPBAM_BAM_P_RST1_ADDR A:0xfc37e004
y.create.l HWIO_QDSS_NDPBAM_BAM_P_HALT0_ADDR A:0xfc37d008
y.create.l HWIO_QDSS_NDPBAM_BAM_P_HALT1_ADDR A:0xfc37e008
y.create.l HWIO_QDSS_NDPBAM_BAM_P_TRUST_REG0_ADDR A:0xfc37d030
y.create.l HWIO_QDSS_NDPBAM_BAM_P_TRUST_REG1_ADDR A:0xfc37e030
y.create.l HWIO_QDSS_NDPBAM_BAM_P_IRQ_STTS0_ADDR A:0xfc37d010
y.create.l HWIO_QDSS_NDPBAM_BAM_P_IRQ_STTS1_ADDR A:0xfc37e010
y.create.l HWIO_QDSS_NDPBAM_BAM_P_IRQ_CLR0_ADDR A:0xfc37d014
y.create.l HWIO_QDSS_NDPBAM_BAM_P_IRQ_CLR1_ADDR A:0xfc37e014
y.create.l HWIO_QDSS_NDPBAM_BAM_P_IRQ_EN0_ADDR A:0xfc37d018
y.create.l HWIO_QDSS_NDPBAM_BAM_P_IRQ_EN1_ADDR A:0xfc37e018
y.create.l HWIO_QDSS_NDPBAM_BAM_P_TIMER0_ADDR A:0xfc37d01c
y.create.l HWIO_QDSS_NDPBAM_BAM_P_TIMER1_ADDR A:0xfc37e01c
y.create.l HWIO_QDSS_NDPBAM_BAM_P_TIMER_CTRL0_ADDR A:0xfc37d020
y.create.l HWIO_QDSS_NDPBAM_BAM_P_TIMER_CTRL1_ADDR A:0xfc37e020
y.create.l HWIO_QDSS_NDPBAM_BAM_P_PRDCR_SDBND0_ADDR A:0xfc37d024
y.create.l HWIO_QDSS_NDPBAM_BAM_P_PRDCR_SDBND1_ADDR A:0xfc37e024
y.create.l HWIO_QDSS_NDPBAM_BAM_P_CNSMR_SDBND0_ADDR A:0xfc37d028
y.create.l HWIO_QDSS_NDPBAM_BAM_P_CNSMR_SDBND1_ADDR A:0xfc37e028
y.create.l HWIO_QDSS_NDPBAM_BAM_P_EVNT_DEST_ADDR0_ADDR A:0xfc37d82c
y.create.l HWIO_QDSS_NDPBAM_BAM_P_EVNT_DEST_ADDR1_ADDR A:0xfc37e82c
y.create.l HWIO_QDSS_NDPBAM_BAM_P_EVNT_DEST_ADDR_LSB0_ADDR A:0xfc37d930
y.create.l HWIO_QDSS_NDPBAM_BAM_P_EVNT_DEST_ADDR_LSB1_ADDR A:0xfc37e930
y.create.l HWIO_QDSS_NDPBAM_BAM_P_EVNT_DEST_ADDR_MSB0_ADDR A:0xfc37d934
y.create.l HWIO_QDSS_NDPBAM_BAM_P_EVNT_DEST_ADDR_MSB1_ADDR A:0xfc37e934
y.create.l HWIO_QDSS_NDPBAM_BAM_P_EVNT_REG0_ADDR A:0xfc37d818
y.create.l HWIO_QDSS_NDPBAM_BAM_P_EVNT_REG1_ADDR A:0xfc37e818
y.create.l HWIO_QDSS_NDPBAM_BAM_P_SW_OFSTS0_ADDR A:0xfc37d800
y.create.l HWIO_QDSS_NDPBAM_BAM_P_SW_OFSTS1_ADDR A:0xfc37e800
y.create.l HWIO_QDSS_NDPBAM_BAM_P_DATA_FIFO_ADDR0_ADDR A:0xfc37d824
y.create.l HWIO_QDSS_NDPBAM_BAM_P_DATA_FIFO_ADDR1_ADDR A:0xfc37e824
y.create.l HWIO_QDSS_NDPBAM_BAM_P_DATA_FIFO_ADDR_LSB0_ADDR A:0xfc37d920
y.create.l HWIO_QDSS_NDPBAM_BAM_P_DATA_FIFO_ADDR_LSB1_ADDR A:0xfc37e920
y.create.l HWIO_QDSS_NDPBAM_BAM_P_DATA_FIFO_ADDR_MSB0_ADDR A:0xfc37d924
y.create.l HWIO_QDSS_NDPBAM_BAM_P_DATA_FIFO_ADDR_MSB1_ADDR A:0xfc37e924
y.create.l HWIO_QDSS_NDPBAM_BAM_P_DESC_FIFO_ADDR0_ADDR A:0xfc37d81c
y.create.l HWIO_QDSS_NDPBAM_BAM_P_DESC_FIFO_ADDR1_ADDR A:0xfc37e81c
y.create.l HWIO_QDSS_NDPBAM_BAM_P_DESC_FIFO_ADDR_LSB0_ADDR A:0xfc37d910
y.create.l HWIO_QDSS_NDPBAM_BAM_P_DESC_FIFO_ADDR_LSB1_ADDR A:0xfc37e910
y.create.l HWIO_QDSS_NDPBAM_BAM_P_DESC_FIFO_ADDR_MSB0_ADDR A:0xfc37d914
y.create.l HWIO_QDSS_NDPBAM_BAM_P_DESC_FIFO_ADDR_MSB1_ADDR A:0xfc37e914
y.create.l HWIO_QDSS_NDPBAM_BAM_P_EVNT_GEN_TRSHLD0_ADDR A:0xfc37d828
y.create.l HWIO_QDSS_NDPBAM_BAM_P_EVNT_GEN_TRSHLD1_ADDR A:0xfc37e828
y.create.l HWIO_QDSS_NDPBAM_BAM_P_FIFO_SIZES0_ADDR A:0xfc37d820
y.create.l HWIO_QDSS_NDPBAM_BAM_P_FIFO_SIZES1_ADDR A:0xfc37e820
y.create.l HWIO_QDSS_NDPBAM_BAM_P_RETR_CNTXT_0_ADDR A:0xfc37d834
y.create.l HWIO_QDSS_NDPBAM_BAM_P_RETR_CNTXT_1_ADDR A:0xfc37e834
y.create.l HWIO_QDSS_NDPBAM_BAM_P_SI_CNTXT_0_ADDR A:0xfc37d838
y.create.l HWIO_QDSS_NDPBAM_BAM_P_SI_CNTXT_1_ADDR A:0xfc37e838
y.create.l HWIO_QDSS_NDPBAM_BAM_P_DF_CNTXT_0_ADDR A:0xfc37d830
y.create.l HWIO_QDSS_NDPBAM_BAM_P_DF_CNTXT_1_ADDR A:0xfc37e830
y.create.l HWIO_QDSS_NDPBAM_BAM_P_AU_PSM_CNTXT_1_0_ADDR A:0xfc37d804
y.create.l HWIO_QDSS_NDPBAM_BAM_P_AU_PSM_CNTXT_1_1_ADDR A:0xfc37e804
y.create.l HWIO_QDSS_NDPBAM_BAM_P_PSM_CNTXT_2_0_ADDR A:0xfc37d808
y.create.l HWIO_QDSS_NDPBAM_BAM_P_PSM_CNTXT_2_1_ADDR A:0xfc37e808
y.create.l HWIO_QDSS_NDPBAM_BAM_P_PSM_CNTXT_3_0_ADDR A:0xfc37d80c
y.create.l HWIO_QDSS_NDPBAM_BAM_P_PSM_CNTXT_3_1_ADDR A:0xfc37e80c
y.create.l HWIO_QDSS_NDPBAM_BAM_P_PSM_CNTXT_3_LSB0_ADDR A:0xfc37d900
y.create.l HWIO_QDSS_NDPBAM_BAM_P_PSM_CNTXT_3_LSB1_ADDR A:0xfc37e900
y.create.l HWIO_QDSS_NDPBAM_BAM_P_PSM_CNTXT_3_MSB0_ADDR A:0xfc37d904
y.create.l HWIO_QDSS_NDPBAM_BAM_P_PSM_CNTXT_3_MSB1_ADDR A:0xfc37e904
y.create.l HWIO_QDSS_NDPBAM_BAM_P_PSM_CNTXT_4_0_ADDR A:0xfc37d810
y.create.l HWIO_QDSS_NDPBAM_BAM_P_PSM_CNTXT_4_1_ADDR A:0xfc37e810
y.create.l HWIO_QDSS_NDPBAM_BAM_P_PSM_CNTXT_5_0_ADDR A:0xfc37d814
y.create.l HWIO_QDSS_NDPBAM_BAM_P_PSM_CNTXT_5_1_ADDR A:0xfc37e814
y.create.l HWIO_RBCPR_VERSION_ADDR A:0xfc44f000
y.create.l HWIO_RBCPR_SENSOR_MASK0_ADDR A:0xfc44f020
y.create.l HWIO_RBCPR_SENSOR_MASK1_ADDR A:0xfc44f024
y.create.l HWIO_RBCPR_SENSOR_MASK2_ADDR A:0xfc44f028
y.create.l HWIO_RBCPR_SENSOR_MASK3_ADDR A:0xfc44f02c
y.create.l HWIO_RBCPR_SENSOR_BYPASS0_ADDR A:0xfc44f030
y.create.l HWIO_RBCPR_SENSOR_BYPASS1_ADDR A:0xfc44f034
y.create.l HWIO_RBCPR_SENSOR_BYPASS2_ADDR A:0xfc44f038
y.create.l HWIO_RBCPR_SENSOR_BYPASS3_ADDR A:0xfc44f03c
y.create.l HWIO_RBIF_PMIC_ADDR_ADDR A:0xfc44f040
y.create.l HWIO_RBCPR_TIMER_INTERVAL_ADDR A:0xfc44f044
y.create.l HWIO_RBIF_LIMIT_ADDR A:0xfc44f048
y.create.l HWIO_RBIF_TIMER_ADJUST_ADDR A:0xfc44f04c
y.create.l HWIO_RBCPR_GCNT_TARGET0_ADDR A:0xfc44f060
y.create.l HWIO_RBCPR_GCNT_TARGET1_ADDR A:0xfc44f064
y.create.l HWIO_RBCPR_GCNT_TARGET2_ADDR A:0xfc44f068
y.create.l HWIO_RBCPR_GCNT_TARGET3_ADDR A:0xfc44f06c
y.create.l HWIO_RBCPR_GCNT_TARGET4_ADDR A:0xfc44f070
y.create.l HWIO_RBCPR_GCNT_TARGET5_ADDR A:0xfc44f074
y.create.l HWIO_RBCPR_GCNT_TARGET6_ADDR A:0xfc44f078
y.create.l HWIO_RBCPR_GCNT_TARGET7_ADDR A:0xfc44f07c
y.create.l HWIO_RBCPR_STEP_QUOT_ADDR A:0xfc44f080
y.create.l HWIO_RBCPR_CTL_ADDR A:0xfc44f090
y.create.l HWIO_RBIF_SW_VLEVEL_ADDR A:0xfc44f094
y.create.l HWIO_RBIF_CONT_ACK_CMD_ADDR A:0xfc44f098
y.create.l HWIO_RBIF_CONT_NACK_CMD_ADDR A:0xfc44f09c
y.create.l HWIO_RBCPR_RESULT_0_ADDR A:0xfc44f0a0
y.create.l HWIO_RBCPR_RESULT_1_ADDR A:0xfc44f0a4
y.create.l HWIO_RBIF_IRQ_EN_0_ADDR A:0xfc44f100
y.create.l HWIO_RBIF_IRQ_EN_1_ADDR A:0xfc44f104
y.create.l HWIO_RBIF_IRQ_EN_2_ADDR A:0xfc44f108
y.create.l HWIO_RBIF_IRQ_CLEAR_ADDR A:0xfc44f110
y.create.l HWIO_RBIF_IRQ_STATUS_ADDR A:0xfc44f114
y.create.l HWIO_RBCPR_QUOT_AVG_ADDR A:0xfc44f118
y.create.l HWIO_RBCPR_DEBUG0_ADDR A:0xfc44f11c
y.create.l HWIO_RBCPR_DEBUG1_ADDR A:0xfc44f120
y.create.l HWIO_RBCPR_DEBUG2_ADDR A:0xfc44f124
y.create.l HWIO_RBCPR_BIST_MINMAX_ADDR A:0xfc44f128
y.create.l HWIO_RBCPR_BIST_RESULT_ADDR A:0xfc44f12c
y.create.l HWIO_RBCPR_BIST_FAIL_MAP0_ADDR A:0xfc44f130
y.create.l HWIO_RBCPR_BIST_FAIL_MAP1_ADDR A:0xfc44f134
y.create.l HWIO_RBCPR_BIST_FAIL_MAP2_ADDR A:0xfc44f138
y.create.l HWIO_RBCPR_BIST_FAIL_MAP3_ADDR A:0xfc44f13c
y.create.l HWIO_RBCPR_LOG_0_ADDR A:0xfc44f140
y.create.l HWIO_RBCPR_LOG_1_ADDR A:0xfc44f144
y.create.l HWIO_RBCPR_LOG_2_ADDR A:0xfc44f148
y.create.l HWIO_RBCPR_LOG_3_ADDR A:0xfc44f14c
y.create.l HWIO_RBCPR_LOG_4_ADDR A:0xfc44f150
y.create.l HWIO_RBCPR_LOG_5_ADDR A:0xfc44f154
y.create.l HWIO_RBCPR_LOG_6_ADDR A:0xfc44f158
y.create.l HWIO_RBCPR_LOG_7_ADDR A:0xfc44f15c
y.create.l HWIO_RBCPR_HTOL_AGE_ADDR A:0xfc44f160
y.create.l HWIO_RPM_HW_VERSION_ADDR A:0xfc180000
y.create.l HWIO_RPM_WFI_CONFIG_ADDR A:0xfc180004
y.create.l HWIO_RPM_TIMERS_CLK_OFF_CTL_ADDR A:0xfc180008
y.create.l HWIO_RPM_IPC_ADDR A:0xfc18000c
y.create.l HWIO_RPM_GPO_WDATA_ADDR A:0xfc180010
y.create.l HWIO_RPM_GPO_WDSET_ADDR A:0xfc180014
y.create.l HWIO_RPM_GPO_WDCLR_ADDR A:0xfc180018
y.create.l HWIO_RPM_SLAVES_CLK_GATING_ADDR A:0xfc18001c
y.create.l HWIO_RPM_BOOTROM_REMAP_ADDR_ADDR A:0xfc180020
y.create.l HWIO_RPM_SYSIF_REMAP_ADDR0_ADDR A:0xfc180024
y.create.l HWIO_RPM_SYSIF_REMAP_ADDR1_ADDR A:0xfc180028
y.create.l HWIO_RPM_SYSIF_REMAP_ADDR2_ADDR A:0xfc18002c
y.create.l HWIO_RPM_INTR_POLARITY_0_ADDR A:0xfc180030
y.create.l HWIO_RPM_INTR_POLARITY_1_ADDR A:0xfc180034
y.create.l HWIO_RPM_INTR_EDG_LVL_0_ADDR A:0xfc180038
y.create.l HWIO_RPM_INTR_EDG_LVL_1_ADDR A:0xfc18003c
y.create.l HWIO_RPM_WDOG_RESET_ADDR A:0xfc180040
y.create.l HWIO_RPM_WDOG_CTRL_ADDR A:0xfc180044
y.create.l HWIO_RPM_WDOG_STATUS_ADDR A:0xfc180048
y.create.l HWIO_RPM_WDOG_BARK_TIME_ADDR A:0xfc18004c
y.create.l HWIO_RPM_WDOG_BITE_TIME_ADDR A:0xfc180050
y.create.l HWIO_RPM_WDOG_TEST_LOAD_ADDR A:0xfc180054
y.create.l HWIO_RPM_WDOG_TEST_ADDR A:0xfc180058
y.create.l HWIO_RPM_TEST_BUS_SEL_ADDR A:0xfc18005c
y.create.l HWIO_RPM_SPARE_REG0_ADDR A:0xfc180060
y.create.l HWIO_RPM_SPARE_REG1_ADDR A:0xfc180064
y.create.l HWIO_RPM_SPARE_REG2_ADDR A:0xfc180068
y.create.l HWIO_RPM_SPARE_REG3_ADDR A:0xfc18006c
y.create.l HWIO_RPM_QTMR_AC_CNTFRQ_ADDR A:0xfc182000
y.create.l HWIO_RPM_QTMR_AC_CNTSR_ADDR A:0xfc182004
y.create.l HWIO_RPM_QTMR_AC_CNTTID_ADDR A:0xfc182008
y.create.l HWIO_RPM_QTMR_AC_CNTACR_0_ADDR A:0xfc182040
y.create.l HWIO_RPM_QTMR_AC_CNTACR_1_ADDR A:0xfc182044
y.create.l HWIO_RPM_QTMR_AC_CNTVOFF_LO_0_ADDR A:0xfc182080
y.create.l HWIO_RPM_QTMR_AC_CNTVOFF_LO_1_ADDR A:0xfc182088
y.create.l HWIO_RPM_QTMR_AC_CNTVOFF_HI_0_ADDR A:0xfc182084
y.create.l HWIO_RPM_QTMR_AC_CNTVOFF_HI_1_ADDR A:0xfc18208c
y.create.l HWIO_RPM_QTMR_AC_CFG_ADDR A:0xfc182fc0
y.create.l HWIO_RPM_QTMR_AC_VERSION_ADDR A:0xfc182fd0
y.create.l HWIO_RPM_F0_QTMR_V1_CNTPCT_LO_ADDR A:0xfc183000
y.create.l HWIO_RPM_F0_QTMR_V1_CNTPCT_HI_ADDR A:0xfc183004
y.create.l HWIO_RPM_F0_QTMR_V1_CNTVCT_LO_ADDR A:0xfc183008
y.create.l HWIO_RPM_F0_QTMR_V1_CNTVCT_HI_ADDR A:0xfc18300c
y.create.l HWIO_RPM_F0_QTMR_V1_CNTFRQ_ADDR A:0xfc183010
y.create.l HWIO_RPM_F0_QTMR_V1_CNTPL0ACR_ADDR A:0xfc183014
y.create.l HWIO_RPM_F0_QTMR_V1_CNTVOFF_LO_ADDR A:0xfc183018
y.create.l HWIO_RPM_F0_QTMR_V1_CNTVOFF_HI_ADDR A:0xfc18301c
y.create.l HWIO_RPM_F0_QTMR_V1_CNTP_CVAL_LO_ADDR A:0xfc183020
y.create.l HWIO_RPM_F0_QTMR_V1_CNTP_CVAL_HI_ADDR A:0xfc183024
y.create.l HWIO_RPM_F0_QTMR_V1_CNTP_TVAL_ADDR A:0xfc183028
y.create.l HWIO_RPM_F0_QTMR_V1_CNTP_CTL_ADDR A:0xfc18302c
y.create.l HWIO_RPM_F0_QTMR_V1_CNTV_CVAL_LO_ADDR A:0xfc183030
y.create.l HWIO_RPM_F0_QTMR_V1_CNTV_CVAL_HI_ADDR A:0xfc183034
y.create.l HWIO_RPM_F0_QTMR_V1_CNTV_TVAL_ADDR A:0xfc183038
y.create.l HWIO_RPM_F0_QTMR_V1_CNTV_CTL_ADDR A:0xfc18303c
y.create.l HWIO_RPM_F0_QTMR_V1_VERSION_ADDR A:0xfc183fd0
y.create.l HWIO_RPM_F1_QTMR_V1_CNTPCT_LO_ADDR A:0xfc184000
y.create.l HWIO_RPM_F1_QTMR_V1_CNTPCT_HI_ADDR A:0xfc184004
y.create.l HWIO_RPM_F1_QTMR_V1_CNTVCT_LO_ADDR A:0xfc184008
y.create.l HWIO_RPM_F1_QTMR_V1_CNTVCT_HI_ADDR A:0xfc18400c
y.create.l HWIO_RPM_F1_QTMR_V1_CNTFRQ_ADDR A:0xfc184010
y.create.l HWIO_RPM_F1_QTMR_V1_CNTPL0ACR_ADDR A:0xfc184014
y.create.l HWIO_RPM_F1_QTMR_V1_CNTVOFF_LO_ADDR A:0xfc184018
y.create.l HWIO_RPM_F1_QTMR_V1_CNTVOFF_HI_ADDR A:0xfc18401c
y.create.l HWIO_RPM_F1_QTMR_V1_CNTP_CVAL_LO_ADDR A:0xfc184020
y.create.l HWIO_RPM_F1_QTMR_V1_CNTP_CVAL_HI_ADDR A:0xfc184024
y.create.l HWIO_RPM_F1_QTMR_V1_CNTP_TVAL_ADDR A:0xfc184028
y.create.l HWIO_RPM_F1_QTMR_V1_CNTP_CTL_ADDR A:0xfc18402c
y.create.l HWIO_RPM_F1_QTMR_V1_CNTV_CVAL_LO_ADDR A:0xfc184030
y.create.l HWIO_RPM_F1_QTMR_V1_CNTV_CVAL_HI_ADDR A:0xfc184034
y.create.l HWIO_RPM_F1_QTMR_V1_CNTV_TVAL_ADDR A:0xfc184038
y.create.l HWIO_RPM_F1_QTMR_V1_CNTV_CTL_ADDR A:0xfc18403c
y.create.l HWIO_RPM_F1_QTMR_V1_VERSION_ADDR A:0xfc184fd0
y.create.l HWIO_RPM_MPU_XPU_SCR_ADDR A:0xfc186000
y.create.l HWIO_RPM_MPU_XPU_SWDR_ADDR A:0xfc186004
y.create.l HWIO_RPM_MPU_XPU_PRTN_RACR_SSHADOW_ADDR A:0xfc186008
y.create.l HWIO_RPM_MPU_XPU_PRTN_START_SSHADOW0_ADDR A:0xfc186010
y.create.l HWIO_RPM_MPU_XPU_PRTN_END_SSHADOW0_ADDR A:0xfc186018
y.create.l HWIO_RPM_MPU_XPU_SEAR0_ADDR A:0xfc186040
y.create.l HWIO_RPM_MPU_XPU_SESR_ADDR A:0xfc186048
y.create.l HWIO_RPM_MPU_XPU_SESRRESTORE_ADDR A:0xfc18604c
y.create.l HWIO_RPM_MPU_XPU_SESYNR0_ADDR A:0xfc186050
y.create.l HWIO_RPM_MPU_XPU_SESYNR1_ADDR A:0xfc186054
y.create.l HWIO_RPM_MPU_XPU_SESYNR2_ADDR A:0xfc186058
y.create.l HWIO_RPM_MPU_XPU_MCR_ADDR A:0xfc186100
y.create.l HWIO_RPM_MPU_XPU_MEAR0_ADDR A:0xfc186140
y.create.l HWIO_RPM_MPU_XPU_MESR_ADDR A:0xfc186148
y.create.l HWIO_RPM_MPU_XPU_MESRRESTORE_ADDR A:0xfc18614c
y.create.l HWIO_RPM_MPU_XPU_MESYNR0_ADDR A:0xfc186150
y.create.l HWIO_RPM_MPU_XPU_MESYNR1_ADDR A:0xfc186154
y.create.l HWIO_RPM_MPU_XPU_MESYNR2_ADDR A:0xfc186158
y.create.l HWIO_RPM_MPU_XPU_CR_ADDR A:0xfc186080
y.create.l HWIO_RPM_MPU_XPU_PRTN_RACR_SHADOW_ADDR A:0xfc186088
y.create.l HWIO_RPM_MPU_XPU_PRTN_START_SHADOW0_ADDR A:0xfc186090
y.create.l HWIO_RPM_MPU_XPU_PRTN_END_SHADOW0_ADDR A:0xfc186098
y.create.l HWIO_RPM_MPU_XPU_RPU_ACR0_ADDR A:0xfc1860a0
y.create.l HWIO_RPM_MPU_XPU_EAR0_ADDR A:0xfc1860c0
y.create.l HWIO_RPM_MPU_XPU_ESR_ADDR A:0xfc1860c8
y.create.l HWIO_RPM_MPU_XPU_ESRRESTORE_ADDR A:0xfc1860cc
y.create.l HWIO_RPM_MPU_XPU_ESYNR0_ADDR A:0xfc1860d0
y.create.l HWIO_RPM_MPU_XPU_ESYNR1_ADDR A:0xfc1860d4
y.create.l HWIO_RPM_MPU_XPU_ESYNR2_ADDR A:0xfc1860d8
y.create.l HWIO_RPM_MPU_XPU_UMR_RACR_ADDR A:0xfc1860e0
y.create.l HWIO_RPM_MPU_XPU_UMR_WACR_ADDR A:0xfc1860e4
y.create.l HWIO_RPM_MPU_XPU_IDR0_ADDR A:0xfc186074
y.create.l HWIO_RPM_MPU_XPU_IDR1_ADDR A:0xfc186078
y.create.l HWIO_RPM_MPU_XPU_REV_ADDR A:0xfc18607c
y.create.l HWIO_RPM_MPU_XPU_PRT0_RACR0_ADDR A:0xfc186200
y.create.l HWIO_RPM_MPU_XPU_PRT1_RACR0_ADDR A:0xfc186280
y.create.l HWIO_RPM_MPU_XPU_PRT2_RACR0_ADDR A:0xfc186300
y.create.l HWIO_RPM_MPU_XPU_PRT3_RACR0_ADDR A:0xfc186380
y.create.l HWIO_RPM_MPU_XPU_PRT4_RACR0_ADDR A:0xfc186400
y.create.l HWIO_RPM_MPU_XPU_PRT5_RACR0_ADDR A:0xfc186480
y.create.l HWIO_RPM_MPU_XPU_PRT0_START0_ADDR A:0xfc186240
y.create.l HWIO_RPM_MPU_XPU_PRT1_START0_ADDR A:0xfc1862c0
y.create.l HWIO_RPM_MPU_XPU_PRT2_START0_ADDR A:0xfc186340
y.create.l HWIO_RPM_MPU_XPU_PRT3_START0_ADDR A:0xfc1863c0
y.create.l HWIO_RPM_MPU_XPU_PRT4_START0_ADDR A:0xfc186440
y.create.l HWIO_RPM_MPU_XPU_PRT5_START0_ADDR A:0xfc1864c0
y.create.l HWIO_RPM_MPU_XPU_PRT0_END0_ADDR A:0xfc186248
y.create.l HWIO_RPM_MPU_XPU_PRT1_END0_ADDR A:0xfc1862c8
y.create.l HWIO_RPM_MPU_XPU_PRT2_END0_ADDR A:0xfc186348
y.create.l HWIO_RPM_MPU_XPU_PRT3_END0_ADDR A:0xfc1863c8
y.create.l HWIO_RPM_MPU_XPU_PRT4_END0_ADDR A:0xfc186448
y.create.l HWIO_RPM_MPU_XPU_PRT5_END0_ADDR A:0xfc1864c8
y.create.l HWIO_RPM_MPU_XPU_PRT0_SCR_ADDR A:0xfc186250
y.create.l HWIO_RPM_MPU_XPU_PRT1_SCR_ADDR A:0xfc1862d0
y.create.l HWIO_RPM_MPU_XPU_PRT2_SCR_ADDR A:0xfc186350
y.create.l HWIO_RPM_MPU_XPU_PRT3_SCR_ADDR A:0xfc1863d0
y.create.l HWIO_RPM_MPU_XPU_PRT4_SCR_ADDR A:0xfc186450
y.create.l HWIO_RPM_MPU_XPU_PRT5_SCR_ADDR A:0xfc1864d0
y.create.l HWIO_RPM_MPU_XPU_PRT0_MCR_ADDR A:0xfc186254
y.create.l HWIO_RPM_MPU_XPU_PRT1_MCR_ADDR A:0xfc1862d4
y.create.l HWIO_RPM_MPU_XPU_PRT2_MCR_ADDR A:0xfc186354
y.create.l HWIO_RPM_MPU_XPU_PRT3_MCR_ADDR A:0xfc1863d4
y.create.l HWIO_RPM_MPU_XPU_PRT4_MCR_ADDR A:0xfc186454
y.create.l HWIO_RPM_MPU_XPU_PRT5_MCR_ADDR A:0xfc1864d4
y.create.l HWIO_RPM_MPU_XPU_PRT0_CNTL0_ADDR A:0xfc186258
y.create.l HWIO_RPM_MPU_XPU_PRT1_CNTL0_ADDR A:0xfc1862d8
y.create.l HWIO_RPM_MPU_XPU_PRT2_CNTL0_ADDR A:0xfc186358
y.create.l HWIO_RPM_MPU_XPU_PRT3_CNTL0_ADDR A:0xfc1863d8
y.create.l HWIO_RPM_MPU_XPU_PRT4_CNTL0_ADDR A:0xfc186458
y.create.l HWIO_RPM_MPU_XPU_PRT5_CNTL0_ADDR A:0xfc1864d8
y.create.l HWIO_RPM_MPU_XPU_PRT0_CNTL1_ADDR A:0xfc18625c
y.create.l HWIO_RPM_MPU_XPU_PRT1_CNTL1_ADDR A:0xfc1862dc
y.create.l HWIO_RPM_MPU_XPU_PRT2_CNTL1_ADDR A:0xfc18635c
y.create.l HWIO_RPM_MPU_XPU_PRT3_CNTL1_ADDR A:0xfc1863dc
y.create.l HWIO_RPM_MPU_XPU_PRT4_CNTL1_ADDR A:0xfc18645c
y.create.l HWIO_RPM_MPU_XPU_PRT5_CNTL1_ADDR A:0xfc1864dc
y.create.l HWIO_RPM_APU_XPU_SCR_ADDR A:0xfc187000
y.create.l HWIO_RPM_APU_XPU_SWDR_ADDR A:0xfc187004
y.create.l HWIO_RPM_APU_XPU_SEAR0_ADDR A:0xfc187040
y.create.l HWIO_RPM_APU_XPU_SESR_ADDR A:0xfc187048
y.create.l HWIO_RPM_APU_XPU_SESRRESTORE_ADDR A:0xfc18704c
y.create.l HWIO_RPM_APU_XPU_SESYNR0_ADDR A:0xfc187050
y.create.l HWIO_RPM_APU_XPU_SESYNR1_ADDR A:0xfc187054
y.create.l HWIO_RPM_APU_XPU_SESYNR2_ADDR A:0xfc187058
y.create.l HWIO_RPM_APU_XPU_MCR_ADDR A:0xfc187100
y.create.l HWIO_RPM_APU_XPU_MEAR0_ADDR A:0xfc187140
y.create.l HWIO_RPM_APU_XPU_MESR_ADDR A:0xfc187148
y.create.l HWIO_RPM_APU_XPU_MESRRESTORE_ADDR A:0xfc18714c
y.create.l HWIO_RPM_APU_XPU_MESYNR0_ADDR A:0xfc187150
y.create.l HWIO_RPM_APU_XPU_MESYNR1_ADDR A:0xfc187154
y.create.l HWIO_RPM_APU_XPU_MESYNR2_ADDR A:0xfc187158
y.create.l HWIO_RPM_APU_XPU_CR_ADDR A:0xfc187080
y.create.l HWIO_RPM_APU_XPU_RPU_ACR0_ADDR A:0xfc1870a0
y.create.l HWIO_RPM_APU_XPU_EAR0_ADDR A:0xfc1870c0
y.create.l HWIO_RPM_APU_XPU_ESR_ADDR A:0xfc1870c8
y.create.l HWIO_RPM_APU_XPU_ESRRESTORE_ADDR A:0xfc1870cc
y.create.l HWIO_RPM_APU_XPU_ESYNR0_ADDR A:0xfc1870d0
y.create.l HWIO_RPM_APU_XPU_ESYNR1_ADDR A:0xfc1870d4
y.create.l HWIO_RPM_APU_XPU_ESYNR2_ADDR A:0xfc1870d8
y.create.l HWIO_RPM_APU_XPU_IDR0_ADDR A:0xfc187074
y.create.l HWIO_RPM_APU_XPU_IDR1_ADDR A:0xfc187078
y.create.l HWIO_RPM_APU_XPU_REV_ADDR A:0xfc18707c
y.create.l HWIO_RPM_APU_XPU_RG0_RACR0_ADDR A:0xfc187200
y.create.l HWIO_RPM_APU_XPU_RG0_WACR0_ADDR A:0xfc187220
y.create.l HWIO_RPM_APU_XPU_RG0_SCR_ADDR A:0xfc187250
y.create.l HWIO_RPM_APU_XPU_RG0_MCR_ADDR A:0xfc187254
y.create.l HWIO_RPM_VMIDMT_SCR0_ADDR A:0xfc188000
y.create.l HWIO_RPM_VMIDMT_SCR1_ADDR A:0xfc188004
y.create.l HWIO_RPM_VMIDMT_SCR2_ADDR A:0xfc188008
y.create.l HWIO_RPM_VMIDMT_SACR_ADDR A:0xfc188010
y.create.l HWIO_RPM_VMIDMT_SIDR0_ADDR A:0xfc188020
y.create.l HWIO_RPM_VMIDMT_SIDR1_ADDR A:0xfc188024
y.create.l HWIO_RPM_VMIDMT_SIDR2_ADDR A:0xfc188028
y.create.l HWIO_RPM_VMIDMT_SIDR4_ADDR A:0xfc188030
y.create.l HWIO_RPM_VMIDMT_SIDR5_ADDR A:0xfc188034
y.create.l HWIO_RPM_VMIDMT_SIDR7_ADDR A:0xfc18803c
y.create.l HWIO_RPM_VMIDMT_SGFAR0_ADDR A:0xfc188040
y.create.l HWIO_RPM_VMIDMT_SGFSR_ADDR A:0xfc188048
y.create.l HWIO_RPM_VMIDMT_SGFSRRESTORE_ADDR A:0xfc18804c
y.create.l HWIO_RPM_VMIDMT_SGFSYNDR0_ADDR A:0xfc188050
y.create.l HWIO_RPM_VMIDMT_SGFSYNDR1_ADDR A:0xfc188054
y.create.l HWIO_RPM_VMIDMT_SGFSYNDR2_ADDR A:0xfc188058
y.create.l HWIO_RPM_VMIDMT_VMIDMTSCR0_ADDR A:0xfc188090
y.create.l HWIO_RPM_VMIDMT_CR0_ADDR A:0xfc188000
y.create.l HWIO_RPM_VMIDMT_CR2_ADDR A:0xfc188008
y.create.l HWIO_RPM_VMIDMT_ACR_ADDR A:0xfc188010
y.create.l HWIO_RPM_VMIDMT_IDR0_ADDR A:0xfc188020
y.create.l HWIO_RPM_VMIDMT_IDR1_ADDR A:0xfc188024
y.create.l HWIO_RPM_VMIDMT_IDR2_ADDR A:0xfc188028
y.create.l HWIO_RPM_VMIDMT_IDR4_ADDR A:0xfc188030
y.create.l HWIO_RPM_VMIDMT_IDR5_ADDR A:0xfc188034
y.create.l HWIO_RPM_VMIDMT_IDR7_ADDR A:0xfc18803c
y.create.l HWIO_RPM_VMIDMT_GFAR0_ADDR A:0xfc188040
y.create.l HWIO_RPM_VMIDMT_GFSR_ADDR A:0xfc188048
y.create.l HWIO_RPM_VMIDMT_GFSRRESTORE_ADDR A:0xfc18804c
y.create.l HWIO_RPM_VMIDMT_GFSYNDR0_ADDR A:0xfc188050
y.create.l HWIO_RPM_VMIDMT_GFSYNDR1_ADDR A:0xfc188054
y.create.l HWIO_RPM_VMIDMT_GFSYNDR2_ADDR A:0xfc188058
y.create.l HWIO_RPM_VMIDMT_VMIDMTCR0_ADDR A:0xfc188090
y.create.l HWIO_RPM_VMIDMT_VMIDMTACR_ADDR A:0xfc18809c
y.create.l HWIO_RPM_VMIDMT_NSCR0_ADDR A:0xfc188400
y.create.l HWIO_RPM_VMIDMT_NSCR2_ADDR A:0xfc188408
y.create.l HWIO_RPM_VMIDMT_NSACR_ADDR A:0xfc188410
y.create.l HWIO_RPM_VMIDMT_NSGFAR0_ADDR A:0xfc188440
y.create.l HWIO_RPM_VMIDMT_NSGFSR_ADDR A:0xfc188448
y.create.l HWIO_RPM_VMIDMT_NSGFSRRESTORE_ADDR A:0xfc18844c
y.create.l HWIO_RPM_VMIDMT_NSGFSYNDR0_ADDR A:0xfc188450
y.create.l HWIO_RPM_VMIDMT_NSGFSYNDR1_ADDR A:0xfc188454
y.create.l HWIO_RPM_VMIDMT_NSGFSYNDR2_ADDR A:0xfc188458
y.create.l HWIO_RPM_VMIDMT_NSVMIDMTCR0_ADDR A:0xfc188490
y.create.l HWIO_RPM_VMIDMT_SSDR0_ADDR A:0xfc188080
y.create.l HWIO_RPM_VMIDMT_MSDR0_ADDR A:0xfc188480
y.create.l HWIO_RPM_VMIDMT_MCR_ADDR A:0xfc188494
y.create.l HWIO_RPM_VMIDMT_S2VR0_ADDR A:0xfc188c00
y.create.l HWIO_RPM_VMIDMT_AS2VR0_ADDR A:0xfc188e00
y.create.l HWIO_RPM_MSG_RAM_XPU_SCR_ADDR A:0xfc420000
y.create.l HWIO_RPM_MSG_RAM_XPU_SWDR_ADDR A:0xfc420004
y.create.l HWIO_RPM_MSG_RAM_XPU_SEAR0_ADDR A:0xfc420040
y.create.l HWIO_RPM_MSG_RAM_XPU_SESR_ADDR A:0xfc420048
y.create.l HWIO_RPM_MSG_RAM_XPU_SESRRESTORE_ADDR A:0xfc42004c
y.create.l HWIO_RPM_MSG_RAM_XPU_SESYNR0_ADDR A:0xfc420050
y.create.l HWIO_RPM_MSG_RAM_XPU_SESYNR1_ADDR A:0xfc420054
y.create.l HWIO_RPM_MSG_RAM_XPU_SESYNR2_ADDR A:0xfc420058
y.create.l HWIO_RPM_MSG_RAM_XPU_MCR_ADDR A:0xfc420100
y.create.l HWIO_RPM_MSG_RAM_XPU_MEAR0_ADDR A:0xfc420140
y.create.l HWIO_RPM_MSG_RAM_XPU_MESR_ADDR A:0xfc420148
y.create.l HWIO_RPM_MSG_RAM_XPU_MESRRESTORE_ADDR A:0xfc42014c
y.create.l HWIO_RPM_MSG_RAM_XPU_MESYNR0_ADDR A:0xfc420150
y.create.l HWIO_RPM_MSG_RAM_XPU_MESYNR1_ADDR A:0xfc420154
y.create.l HWIO_RPM_MSG_RAM_XPU_MESYNR2_ADDR A:0xfc420158
y.create.l HWIO_RPM_MSG_RAM_XPU_CR_ADDR A:0xfc420080
y.create.l HWIO_RPM_MSG_RAM_XPU_RPU_ACR0_ADDR A:0xfc4200a0
y.create.l HWIO_RPM_MSG_RAM_XPU_EAR0_ADDR A:0xfc4200c0
y.create.l HWIO_RPM_MSG_RAM_XPU_ESR_ADDR A:0xfc4200c8
y.create.l HWIO_RPM_MSG_RAM_XPU_ESRRESTORE_ADDR A:0xfc4200cc
y.create.l HWIO_RPM_MSG_RAM_XPU_ESYNR0_ADDR A:0xfc4200d0
y.create.l HWIO_RPM_MSG_RAM_XPU_ESYNR1_ADDR A:0xfc4200d4
y.create.l HWIO_RPM_MSG_RAM_XPU_ESYNR2_ADDR A:0xfc4200d8
y.create.l HWIO_RPM_MSG_RAM_XPU_IDR0_ADDR A:0xfc420074
y.create.l HWIO_RPM_MSG_RAM_XPU_IDR1_ADDR A:0xfc420078
y.create.l HWIO_RPM_MSG_RAM_XPU_REV_ADDR A:0xfc42007c
y.create.l HWIO_RPM_MSG_RAM_XPU_RG0_RACR0_ADDR A:0xfc420200
y.create.l HWIO_RPM_MSG_RAM_XPU_RG1_RACR0_ADDR A:0xfc420280
y.create.l HWIO_RPM_MSG_RAM_XPU_RG2_RACR0_ADDR A:0xfc420300
y.create.l HWIO_RPM_MSG_RAM_XPU_RG3_RACR0_ADDR A:0xfc420380
y.create.l HWIO_RPM_MSG_RAM_XPU_RG4_RACR0_ADDR A:0xfc420400
y.create.l HWIO_RPM_MSG_RAM_XPU_RG5_RACR0_ADDR A:0xfc420480
y.create.l HWIO_RPM_MSG_RAM_XPU_RG6_RACR0_ADDR A:0xfc420500
y.create.l HWIO_RPM_MSG_RAM_XPU_RG7_RACR0_ADDR A:0xfc420580
y.create.l HWIO_RPM_MSG_RAM_XPU_RG8_RACR0_ADDR A:0xfc420600
y.create.l HWIO_RPM_MSG_RAM_XPU_RG9_RACR0_ADDR A:0xfc420680
y.create.l HWIO_RPM_MSG_RAM_XPU_RG0_SCR_ADDR A:0xfc420250
y.create.l HWIO_RPM_MSG_RAM_XPU_RG1_SCR_ADDR A:0xfc4202d0
y.create.l HWIO_RPM_MSG_RAM_XPU_RG2_SCR_ADDR A:0xfc420350
y.create.l HWIO_RPM_MSG_RAM_XPU_RG3_SCR_ADDR A:0xfc4203d0
y.create.l HWIO_RPM_MSG_RAM_XPU_RG4_SCR_ADDR A:0xfc420450
y.create.l HWIO_RPM_MSG_RAM_XPU_RG5_SCR_ADDR A:0xfc4204d0
y.create.l HWIO_RPM_MSG_RAM_XPU_RG6_SCR_ADDR A:0xfc420550
y.create.l HWIO_RPM_MSG_RAM_XPU_RG7_SCR_ADDR A:0xfc4205d0
y.create.l HWIO_RPM_MSG_RAM_XPU_RG8_SCR_ADDR A:0xfc420650
y.create.l HWIO_RPM_MSG_RAM_XPU_RG9_SCR_ADDR A:0xfc4206d0
y.create.l HWIO_RPM_MSG_RAM_XPU_RG0_MCR_ADDR A:0xfc420254
y.create.l HWIO_RPM_MSG_RAM_XPU_RG1_MCR_ADDR A:0xfc4202d4
y.create.l HWIO_RPM_MSG_RAM_XPU_RG2_MCR_ADDR A:0xfc420354
y.create.l HWIO_RPM_MSG_RAM_XPU_RG3_MCR_ADDR A:0xfc4203d4
y.create.l HWIO_RPM_MSG_RAM_XPU_RG4_MCR_ADDR A:0xfc420454
y.create.l HWIO_RPM_MSG_RAM_XPU_RG5_MCR_ADDR A:0xfc4204d4
y.create.l HWIO_RPM_MSG_RAM_XPU_RG6_MCR_ADDR A:0xfc420554
y.create.l HWIO_RPM_MSG_RAM_XPU_RG7_MCR_ADDR A:0xfc4205d4
y.create.l HWIO_RPM_MSG_RAM_XPU_RG8_MCR_ADDR A:0xfc420654
y.create.l HWIO_RPM_MSG_RAM_XPU_RG9_MCR_ADDR A:0xfc4206d4
y.create.l HWIO_QFPROM_RAW_ACC_PRIVATE0_ADDR A:0xfc4b8000
y.create.l HWIO_QFPROM_RAW_ACC_PRIVATE1_ADDR A:0xfc4b8004
y.create.l HWIO_QFPROM_RAW_ACC_PRIVATE2_ADDR A:0xfc4b8008
y.create.l HWIO_QFPROM_RAW_ACC_PRIVATE3_ADDR A:0xfc4b800c
y.create.l HWIO_QFPROM_RAW_ACC_PRIVATE4_ADDR A:0xfc4b8010
y.create.l HWIO_QFPROM_RAW_ACC_PRIVATE5_ADDR A:0xfc4b8014
y.create.l HWIO_QFPROM_RAW_ACC_PRIVATE6_ADDR A:0xfc4b8018
y.create.l HWIO_QFPROM_RAW_ACC_PRIVATE7_ADDR A:0xfc4b801c
y.create.l HWIO_QFPROM_RAW_ACC_PRIVATE8_ADDR A:0xfc4b8020
y.create.l HWIO_QFPROM_RAW_ACC_PRIVATE9_ADDR A:0xfc4b8024
y.create.l HWIO_QFPROM_RAW_JTAG_ID_LSB_ADDR A:0xfc4b80a0
y.create.l HWIO_QFPROM_RAW_JTAG_ID_MSB_ADDR A:0xfc4b80a4
y.create.l HWIO_QFPROM_RAW_RD_WR_PERM_LSB_ADDR A:0xfc4b80a8
y.create.l HWIO_QFPROM_RAW_RD_WR_PERM_MSB_ADDR A:0xfc4b80ac
y.create.l HWIO_QFPROM_RAW_PTE_LSB_ADDR A:0xfc4b80b0
y.create.l HWIO_QFPROM_RAW_PTE_MSB_ADDR A:0xfc4b80b4
y.create.l HWIO_QFPROM_RAW_AP_ANTI_ROLLBACK_ROW0_LSB_ADDR A:0xfc4b80b8
y.create.l HWIO_QFPROM_RAW_AP_ANTI_ROLLBACK_ROW0_MSB_ADDR A:0xfc4b80bc
y.create.l HWIO_QFPROM_RAW_AP_ANTI_ROLLBACK_ROW1_LSB_ADDR A:0xfc4b80c0
y.create.l HWIO_QFPROM_RAW_AP_ANTI_ROLLBACK_ROW1_MSB_ADDR A:0xfc4b80c4
y.create.l HWIO_QFPROM_RAW_MSA_ANTI_ROLLBACK_LSB_ADDR A:0xfc4b80c8
y.create.l HWIO_QFPROM_RAW_MSA_ANTI_ROLLBACK_MSB_ADDR A:0xfc4b80cc
y.create.l HWIO_QFPROM_RAW_IMEI_ESN0_LSB_ADDR A:0xfc4b80d0
y.create.l HWIO_QFPROM_RAW_IMEI_ESN0_MSB_ADDR A:0xfc4b80d4
y.create.l HWIO_QFPROM_RAW_IMEI_ESN1_LSB_ADDR A:0xfc4b80d8
y.create.l HWIO_QFPROM_RAW_IMEI_ESN1_MSB_ADDR A:0xfc4b80dc
y.create.l HWIO_QFPROM_RAW_IMEI_ESN2_LSB_ADDR A:0xfc4b80e0
y.create.l HWIO_QFPROM_RAW_IMEI_ESN2_MSB_ADDR A:0xfc4b80e4
y.create.l HWIO_QFPROM_RAW_OEM_CONFIG_ROW0_LSB_ADDR A:0xfc4b80e8
y.create.l HWIO_QFPROM_RAW_OEM_CONFIG_ROW0_MSB_ADDR A:0xfc4b80ec
y.create.l HWIO_QFPROM_RAW_OEM_CONFIG_ROW1_LSB_ADDR A:0xfc4b80f0
y.create.l HWIO_QFPROM_RAW_OEM_CONFIG_ROW1_MSB_ADDR A:0xfc4b80f4
y.create.l HWIO_QFPROM_RAW_FEAT_CONFIG_ROW0_LSB_ADDR A:0xfc4b80f8
y.create.l HWIO_QFPROM_RAW_FEAT_CONFIG_ROW0_MSB_ADDR A:0xfc4b80fc
y.create.l HWIO_QFPROM_RAW_FEAT_CONFIG_ROW1_LSB_ADDR A:0xfc4b8100
y.create.l HWIO_QFPROM_RAW_FEAT_CONFIG_ROW1_MSB_ADDR A:0xfc4b8104
y.create.l HWIO_QFPROM_RAW_FEAT_CONFIG_ROW2_LSB_ADDR A:0xfc4b8108
y.create.l HWIO_QFPROM_RAW_FEAT_CONFIG_ROW2_MSB_ADDR A:0xfc4b810c
y.create.l HWIO_QFPROM_RAW_FEAT_CONFIG_ROW3_LSB_ADDR A:0xfc4b8110
y.create.l HWIO_QFPROM_RAW_FEAT_CONFIG_ROW3_MSB_ADDR A:0xfc4b8114
y.create.l HWIO_QFPROM_RAW_MEM_REDUN0_ADDR A:0xfc4b8118
y.create.l HWIO_QFPROM_RAW_MEM_REDUN1_ADDR A:0xfc4b811c
y.create.l HWIO_QFPROM_RAW_MEM_REDUN2_ADDR A:0xfc4b8120
y.create.l HWIO_QFPROM_RAW_MEM_REDUN3_ADDR A:0xfc4b8124
y.create.l HWIO_QFPROM_RAW_MEM_REDUN4_ADDR A:0xfc4b8128
y.create.l HWIO_QFPROM_RAW_MEM_REDUN5_ADDR A:0xfc4b812c
y.create.l HWIO_QFPROM_RAW_MEM_REDUN6_ADDR A:0xfc4b8130
y.create.l HWIO_QFPROM_RAW_MEM_REDUN7_ADDR A:0xfc4b8134
y.create.l HWIO_QFPROM_RAW_MEM_REDUN8_ADDR A:0xfc4b8138
y.create.l HWIO_QFPROM_RAW_MEM_REDUN9_ADDR A:0xfc4b813c
y.create.l HWIO_QFPROM_RAW_DEBUG_KEY_LSB_ADDR A:0xfc4b81a8
y.create.l HWIO_QFPROM_RAW_DEBUG_KEY_MSB_ADDR A:0xfc4b81ac
y.create.l HWIO_QFPROM_RAW_MEM_ACCEL_ROW0_LSB_ADDR A:0xfc4b81b0
y.create.l HWIO_QFPROM_RAW_MEM_ACCEL_ROW0_MSB_ADDR A:0xfc4b81b4
y.create.l HWIO_QFPROM_RAW_MEM_ACCEL_ROW1_LSB_ADDR A:0xfc4b81b8
y.create.l HWIO_QFPROM_RAW_MEM_ACCEL_ROW1_MSB_ADDR A:0xfc4b81bc
y.create.l HWIO_QFPROM_RAW_CALIB_ROW0_LSB_ADDR A:0xfc4b81c0
y.create.l HWIO_QFPROM_RAW_CALIB_ROW0_MSB_ADDR A:0xfc4b81c4
y.create.l HWIO_QFPROM_RAW_CALIB_ROW1_LSB_ADDR A:0xfc4b81c8
y.create.l HWIO_QFPROM_RAW_CALIB_ROW1_MSB_ADDR A:0xfc4b81cc
y.create.l HWIO_QFPROM_RAW_FEC_EN_LSB_ADDR A:0xfc4b81d0
y.create.l HWIO_QFPROM_RAW_FEC_EN_MSB_ADDR A:0xfc4b81d4
y.create.l HWIO_QFPROM_RAW_INTAGLIO_GLUEBIT_LSB_ADDR A:0xfc4b81d8
y.create.l HWIO_QFPROM_RAW_INTAGLIO_GLUEBIT_MSB_ADDR A:0xfc4b81dc
y.create.l HWIO_QFPROM_RAW_CUST_KEY_ROW0_LSB_ADDR A:0xfc4b81e0
y.create.l HWIO_QFPROM_RAW_CUST_KEY_ROW1_LSB_ADDR A:0xfc4b81e8
y.create.l HWIO_QFPROM_RAW_CUST_KEY_ROW0_MSB_ADDR A:0xfc4b81e4
y.create.l HWIO_QFPROM_RAW_CUST_KEY_ROW1_MSB_ADDR A:0xfc4b81ec
y.create.l HWIO_QFPROM_RAW_SERIAL_NUM_LSB_ADDR A:0xfc4b81f0
y.create.l HWIO_QFPROM_RAW_SERIAL_NUM_MSB_ADDR A:0xfc4b81f4
y.create.l HWIO_QFPROM_RAW_SPARE_REG19_LSB_ADDR A:0xfc4b81f8
y.create.l HWIO_QFPROM_RAW_SPARE_REG19_MSB_ADDR A:0xfc4b81fc
y.create.l HWIO_QFPROM_RAW_ROM_PATCH_ROW0_LSB_ADDR A:0xfc4b8200
y.create.l HWIO_QFPROM_RAW_ROM_PATCH_ROW1_LSB_ADDR A:0xfc4b8208
y.create.l HWIO_QFPROM_RAW_ROM_PATCH_ROW2_LSB_ADDR A:0xfc4b8210
y.create.l HWIO_QFPROM_RAW_ROM_PATCH_ROW3_LSB_ADDR A:0xfc4b8218
y.create.l HWIO_QFPROM_RAW_ROM_PATCH_ROW4_LSB_ADDR A:0xfc4b8220
y.create.l HWIO_QFPROM_RAW_ROM_PATCH_ROW5_LSB_ADDR A:0xfc4b8228
y.create.l HWIO_QFPROM_RAW_ROM_PATCH_ROW6_LSB_ADDR A:0xfc4b8230
y.create.l HWIO_QFPROM_RAW_ROM_PATCH_ROW7_LSB_ADDR A:0xfc4b8238
y.create.l HWIO_QFPROM_RAW_ROM_PATCH_ROW8_LSB_ADDR A:0xfc4b8240
y.create.l HWIO_QFPROM_RAW_ROM_PATCH_ROW9_LSB_ADDR A:0xfc4b8248
y.create.l HWIO_QFPROM_RAW_ROM_PATCH_ROW0_MSB_ADDR A:0xfc4b8204
y.create.l HWIO_QFPROM_RAW_ROM_PATCH_ROW1_MSB_ADDR A:0xfc4b820c
y.create.l HWIO_QFPROM_RAW_ROM_PATCH_ROW2_MSB_ADDR A:0xfc4b8214
y.create.l HWIO_QFPROM_RAW_ROM_PATCH_ROW3_MSB_ADDR A:0xfc4b821c
y.create.l HWIO_QFPROM_RAW_ROM_PATCH_ROW4_MSB_ADDR A:0xfc4b8224
y.create.l HWIO_QFPROM_RAW_ROM_PATCH_ROW5_MSB_ADDR A:0xfc4b822c
y.create.l HWIO_QFPROM_RAW_ROM_PATCH_ROW6_MSB_ADDR A:0xfc4b8234
y.create.l HWIO_QFPROM_RAW_ROM_PATCH_ROW7_MSB_ADDR A:0xfc4b823c
y.create.l HWIO_QFPROM_RAW_ROM_PATCH_ROW8_MSB_ADDR A:0xfc4b8244
y.create.l HWIO_QFPROM_RAW_ROM_PATCH_ROW9_MSB_ADDR A:0xfc4b824c
y.create.l HWIO_QFPROM_RAW_PRI_KEY_DERIVATION_KEY_ROW0_LSB_ADDR A:0xfc4b8380
y.create.l HWIO_QFPROM_RAW_PRI_KEY_DERIVATION_KEY_ROW1_LSB_ADDR A:0xfc4b8388
y.create.l HWIO_QFPROM_RAW_PRI_KEY_DERIVATION_KEY_ROW2_LSB_ADDR A:0xfc4b8390
y.create.l HWIO_QFPROM_RAW_PRI_KEY_DERIVATION_KEY_ROW3_LSB_ADDR A:0xfc4b8398
y.create.l HWIO_QFPROM_RAW_PRI_KEY_DERIVATION_KEY_ROW0_MSB_ADDR A:0xfc4b8384
y.create.l HWIO_QFPROM_RAW_PRI_KEY_DERIVATION_KEY_ROW1_MSB_ADDR A:0xfc4b838c
y.create.l HWIO_QFPROM_RAW_PRI_KEY_DERIVATION_KEY_ROW2_MSB_ADDR A:0xfc4b8394
y.create.l HWIO_QFPROM_RAW_PRI_KEY_DERIVATION_KEY_ROW3_MSB_ADDR A:0xfc4b839c
y.create.l HWIO_QFPROM_RAW_PRI_KEY_DERIVATION_KEY_ROW4_LSB_ADDR A:0xfc4b83a0
y.create.l HWIO_QFPROM_RAW_PRI_KEY_DERIVATION_KEY_ROW4_MSB_ADDR A:0xfc4b83a4
y.create.l HWIO_QFPROM_RAW_SEC_KEY_DERIVATION_KEY_ROW0_LSB_ADDR A:0xfc4b83a8
y.create.l HWIO_QFPROM_RAW_SEC_KEY_DERIVATION_KEY_ROW1_LSB_ADDR A:0xfc4b83b0
y.create.l HWIO_QFPROM_RAW_SEC_KEY_DERIVATION_KEY_ROW2_LSB_ADDR A:0xfc4b83b8
y.create.l HWIO_QFPROM_RAW_SEC_KEY_DERIVATION_KEY_ROW3_LSB_ADDR A:0xfc4b83c0
y.create.l HWIO_QFPROM_RAW_SEC_KEY_DERIVATION_KEY_ROW0_MSB_ADDR A:0xfc4b83ac
y.create.l HWIO_QFPROM_RAW_SEC_KEY_DERIVATION_KEY_ROW1_MSB_ADDR A:0xfc4b83b4
y.create.l HWIO_QFPROM_RAW_SEC_KEY_DERIVATION_KEY_ROW2_MSB_ADDR A:0xfc4b83bc
y.create.l HWIO_QFPROM_RAW_SEC_KEY_DERIVATION_KEY_ROW3_MSB_ADDR A:0xfc4b83c4
y.create.l HWIO_QFPROM_RAW_SEC_KEY_DERIVATION_KEY_ROW4_LSB_ADDR A:0xfc4b83c8
y.create.l HWIO_QFPROM_RAW_SEC_KEY_DERIVATION_KEY_ROW4_MSB_ADDR A:0xfc4b83cc
y.create.l HWIO_QFPROM_RAW_OEM_PK_HASH_ROW0_LSB_ADDR A:0xfc4b83d0
y.create.l HWIO_QFPROM_RAW_OEM_PK_HASH_ROW1_LSB_ADDR A:0xfc4b83d8
y.create.l HWIO_QFPROM_RAW_OEM_PK_HASH_ROW2_LSB_ADDR A:0xfc4b83e0
y.create.l HWIO_QFPROM_RAW_OEM_PK_HASH_ROW3_LSB_ADDR A:0xfc4b83e8
y.create.l HWIO_QFPROM_RAW_OEM_PK_HASH_ROW0_MSB_ADDR A:0xfc4b83d4
y.create.l HWIO_QFPROM_RAW_OEM_PK_HASH_ROW1_MSB_ADDR A:0xfc4b83dc
y.create.l HWIO_QFPROM_RAW_OEM_PK_HASH_ROW2_MSB_ADDR A:0xfc4b83e4
y.create.l HWIO_QFPROM_RAW_OEM_PK_HASH_ROW3_MSB_ADDR A:0xfc4b83ec
y.create.l HWIO_QFPROM_RAW_OEM_PK_HASH_ROW4_LSB_ADDR A:0xfc4b83f0
y.create.l HWIO_QFPROM_RAW_OEM_PK_HASH_ROW4_MSB_ADDR A:0xfc4b83f4
y.create.l HWIO_QFPROM_RAW_OEM_SEC_BOOT_ROW0_LSB_ADDR A:0xfc4b83f8
y.create.l HWIO_QFPROM_RAW_OEM_SEC_BOOT_ROW1_LSB_ADDR A:0xfc4b8400
y.create.l HWIO_QFPROM_RAW_OEM_SEC_BOOT_ROW2_LSB_ADDR A:0xfc4b8408
y.create.l HWIO_QFPROM_RAW_OEM_SEC_BOOT_ROW3_LSB_ADDR A:0xfc4b8410
y.create.l HWIO_QFPROM_RAW_OEM_SEC_BOOT_ROW0_MSB_ADDR A:0xfc4b83fc
y.create.l HWIO_QFPROM_RAW_OEM_SEC_BOOT_ROW1_MSB_ADDR A:0xfc4b8404
y.create.l HWIO_QFPROM_RAW_OEM_SEC_BOOT_ROW2_MSB_ADDR A:0xfc4b840c
y.create.l HWIO_QFPROM_RAW_OEM_SEC_BOOT_ROW3_MSB_ADDR A:0xfc4b8414
y.create.l HWIO_QFPROM_RAW_QC_SEC_BOOT_ROW0_LSB_ADDR A:0xfc4b8418
y.create.l HWIO_QFPROM_RAW_QC_SEC_BOOT_ROW1_LSB_ADDR A:0xfc4b8420
y.create.l HWIO_QFPROM_RAW_QC_SEC_BOOT_ROW2_LSB_ADDR A:0xfc4b8428
y.create.l HWIO_QFPROM_RAW_QC_SEC_BOOT_ROW3_LSB_ADDR A:0xfc4b8430
y.create.l HWIO_QFPROM_RAW_QC_SEC_BOOT_ROW0_MSB_ADDR A:0xfc4b841c
y.create.l HWIO_QFPROM_RAW_QC_SEC_BOOT_ROW1_MSB_ADDR A:0xfc4b8424
y.create.l HWIO_QFPROM_RAW_QC_SEC_BOOT_ROW2_MSB_ADDR A:0xfc4b842c
y.create.l HWIO_QFPROM_RAW_QC_SEC_BOOT_ROW3_MSB_ADDR A:0xfc4b8434
y.create.l HWIO_QFPROM_RAW_USB_VID_PID_LSB_ADDR A:0xfc4b8438
y.create.l HWIO_QFPROM_RAW_USB_VID_PID_MSB_ADDR A:0xfc4b843c
y.create.l HWIO_QFPROM_RAW_SPARE_REG27_ROW0_LSB_ADDR A:0xfc4b8440
y.create.l HWIO_QFPROM_RAW_SPARE_REG27_ROW0_MSB_ADDR A:0xfc4b8444
y.create.l HWIO_QFPROM_RAW_SPARE_REG27_ROW1_LSB_ADDR A:0xfc4b8448
y.create.l HWIO_QFPROM_RAW_SPARE_REG27_ROW1_MSB_ADDR A:0xfc4b844c
y.create.l HWIO_QFPROM_RAW_SPARE_REG28_ROW0_LSB_ADDR A:0xfc4b8450
y.create.l HWIO_QFPROM_RAW_SPARE_REG28_ROW0_MSB_ADDR A:0xfc4b8454
y.create.l HWIO_QFPROM_RAW_SPARE_REG28_ROW1_LSB_ADDR A:0xfc4b8458
y.create.l HWIO_QFPROM_RAW_SPARE_REG28_ROW1_MSB_ADDR A:0xfc4b845c
y.create.l HWIO_QFPROM_RAW_SPARE_REG28_ROW2_LSB_ADDR A:0xfc4b8460
y.create.l HWIO_QFPROM_RAW_SPARE_REG28_ROW2_MSB_ADDR A:0xfc4b8464
y.create.l HWIO_QFPROM_RAW_HDCP_KSV_LSB_ADDR A:0xfc4b8468
y.create.l HWIO_QFPROM_RAW_HDCP_KSV_MSB_ADDR A:0xfc4b846c
y.create.l HWIO_QFPROM_RAW_HDCP_KEY_ROW1_LSB_ADDR A:0xfc4b8470
y.create.l HWIO_QFPROM_RAW_HDCP_KEY_ROW2_LSB_ADDR A:0xfc4b8478
y.create.l HWIO_QFPROM_RAW_HDCP_KEY_ROW3_LSB_ADDR A:0xfc4b8480
y.create.l HWIO_QFPROM_RAW_HDCP_KEY_ROW4_LSB_ADDR A:0xfc4b8488
y.create.l HWIO_QFPROM_RAW_HDCP_KEY_ROW5_LSB_ADDR A:0xfc4b8490
y.create.l HWIO_QFPROM_RAW_HDCP_KEY_ROW6_LSB_ADDR A:0xfc4b8498
y.create.l HWIO_QFPROM_RAW_HDCP_KEY_ROW7_LSB_ADDR A:0xfc4b84a0
y.create.l HWIO_QFPROM_RAW_HDCP_KEY_ROW8_LSB_ADDR A:0xfc4b84a8
y.create.l HWIO_QFPROM_RAW_HDCP_KEY_ROW9_LSB_ADDR A:0xfc4b84b0
y.create.l HWIO_QFPROM_RAW_HDCP_KEY_ROW10_LSB_ADDR A:0xfc4b84b8
y.create.l HWIO_QFPROM_RAW_HDCP_KEY_ROW1_MSB_ADDR A:0xfc4b8474
y.create.l HWIO_QFPROM_RAW_HDCP_KEY_ROW2_MSB_ADDR A:0xfc4b847c
y.create.l HWIO_QFPROM_RAW_HDCP_KEY_ROW3_MSB_ADDR A:0xfc4b8484
y.create.l HWIO_QFPROM_RAW_HDCP_KEY_ROW4_MSB_ADDR A:0xfc4b848c
y.create.l HWIO_QFPROM_RAW_HDCP_KEY_ROW5_MSB_ADDR A:0xfc4b8494
y.create.l HWIO_QFPROM_RAW_HDCP_KEY_ROW6_MSB_ADDR A:0xfc4b849c
y.create.l HWIO_QFPROM_RAW_HDCP_KEY_ROW7_MSB_ADDR A:0xfc4b84a4
y.create.l HWIO_QFPROM_RAW_HDCP_KEY_ROW8_MSB_ADDR A:0xfc4b84ac
y.create.l HWIO_QFPROM_RAW_HDCP_KEY_ROW9_MSB_ADDR A:0xfc4b84b4
y.create.l HWIO_QFPROM_RAW_HDCP_KEY_ROW10_MSB_ADDR A:0xfc4b84bc
y.create.l HWIO_QFPROM_RAW_CUST_PRIV_KEY0_ROW0_LSB_ADDR A:0xfc4b85b0
y.create.l HWIO_QFPROM_RAW_CUST_PRIV_KEY0_ROW1_LSB_ADDR A:0xfc4b85b8
y.create.l HWIO_QFPROM_RAW_CUST_PRIV_KEY0_ROW2_LSB_ADDR A:0xfc4b85c0
y.create.l HWIO_QFPROM_RAW_CUST_PRIV_KEY0_ROW3_LSB_ADDR A:0xfc4b85c8
y.create.l HWIO_QFPROM_RAW_CUST_PRIV_KEY0_ROW4_LSB_ADDR A:0xfc4b85d0
y.create.l HWIO_QFPROM_RAW_CUST_PRIV_KEY0_ROW5_LSB_ADDR A:0xfc4b85d8
y.create.l HWIO_QFPROM_RAW_CUST_PRIV_KEY0_ROW6_LSB_ADDR A:0xfc4b85e0
y.create.l HWIO_QFPROM_RAW_CUST_PRIV_KEY0_ROW7_LSB_ADDR A:0xfc4b85e8
y.create.l HWIO_QFPROM_RAW_CUST_PRIV_KEY0_ROW8_LSB_ADDR A:0xfc4b85f0
y.create.l HWIO_QFPROM_RAW_CUST_PRIV_KEY0_ROW9_LSB_ADDR A:0xfc4b85f8
y.create.l HWIO_QFPROM_RAW_CUST_PRIV_KEY0_ROW0_MSB_ADDR A:0xfc4b85b4
y.create.l HWIO_QFPROM_RAW_CUST_PRIV_KEY0_ROW1_MSB_ADDR A:0xfc4b85bc
y.create.l HWIO_QFPROM_RAW_CUST_PRIV_KEY0_ROW2_MSB_ADDR A:0xfc4b85c4
y.create.l HWIO_QFPROM_RAW_CUST_PRIV_KEY0_ROW3_MSB_ADDR A:0xfc4b85cc
y.create.l HWIO_QFPROM_RAW_CUST_PRIV_KEY0_ROW4_MSB_ADDR A:0xfc4b85d4
y.create.l HWIO_QFPROM_RAW_CUST_PRIV_KEY0_ROW5_MSB_ADDR A:0xfc4b85dc
y.create.l HWIO_QFPROM_RAW_CUST_PRIV_KEY0_ROW6_MSB_ADDR A:0xfc4b85e4
y.create.l HWIO_QFPROM_RAW_CUST_PRIV_KEY0_ROW7_MSB_ADDR A:0xfc4b85ec
y.create.l HWIO_QFPROM_RAW_CUST_PRIV_KEY0_ROW8_MSB_ADDR A:0xfc4b85f4
y.create.l HWIO_QFPROM_RAW_CUST_PRIV_KEY0_ROW9_MSB_ADDR A:0xfc4b85fc
y.create.l HWIO_QFPROM_RAW_CUST_PRIV_KEY1_ROW0_LSB_ADDR A:0xfc4b86d8
y.create.l HWIO_QFPROM_RAW_CUST_PRIV_KEY1_ROW1_LSB_ADDR A:0xfc4b86e0
y.create.l HWIO_QFPROM_RAW_CUST_PRIV_KEY1_ROW2_LSB_ADDR A:0xfc4b86e8
y.create.l HWIO_QFPROM_RAW_CUST_PRIV_KEY1_ROW3_LSB_ADDR A:0xfc4b86f0
y.create.l HWIO_QFPROM_RAW_CUST_PRIV_KEY1_ROW4_LSB_ADDR A:0xfc4b86f8
y.create.l HWIO_QFPROM_RAW_CUST_PRIV_KEY1_ROW5_LSB_ADDR A:0xfc4b8700
y.create.l HWIO_QFPROM_RAW_CUST_PRIV_KEY1_ROW6_LSB_ADDR A:0xfc4b8708
y.create.l HWIO_QFPROM_RAW_CUST_PRIV_KEY1_ROW7_LSB_ADDR A:0xfc4b8710
y.create.l HWIO_QFPROM_RAW_CUST_PRIV_KEY1_ROW8_LSB_ADDR A:0xfc4b8718
y.create.l HWIO_QFPROM_RAW_CUST_PRIV_KEY1_ROW9_LSB_ADDR A:0xfc4b8720
y.create.l HWIO_QFPROM_RAW_CUST_PRIV_KEY1_ROW0_MSB_ADDR A:0xfc4b86dc
y.create.l HWIO_QFPROM_RAW_CUST_PRIV_KEY1_ROW1_MSB_ADDR A:0xfc4b86e4
y.create.l HWIO_QFPROM_RAW_CUST_PRIV_KEY1_ROW2_MSB_ADDR A:0xfc4b86ec
y.create.l HWIO_QFPROM_RAW_CUST_PRIV_KEY1_ROW3_MSB_ADDR A:0xfc4b86f4
y.create.l HWIO_QFPROM_RAW_CUST_PRIV_KEY1_ROW4_MSB_ADDR A:0xfc4b86fc
y.create.l HWIO_QFPROM_RAW_CUST_PRIV_KEY1_ROW5_MSB_ADDR A:0xfc4b8704
y.create.l HWIO_QFPROM_RAW_CUST_PRIV_KEY1_ROW6_MSB_ADDR A:0xfc4b870c
y.create.l HWIO_QFPROM_RAW_CUST_PRIV_KEY1_ROW7_MSB_ADDR A:0xfc4b8714
y.create.l HWIO_QFPROM_RAW_CUST_PRIV_KEY1_ROW8_MSB_ADDR A:0xfc4b871c
y.create.l HWIO_QFPROM_RAW_CUST_PRIV_KEY1_ROW9_MSB_ADDR A:0xfc4b8724
y.create.l HWIO_ACC_IR_ADDR A:0xfc4ba000
y.create.l HWIO_ACC_DR_ADDR A:0xfc4ba004
y.create.l HWIO_ACC_VERID_ADDR A:0xfc4ba008
y.create.l HWIO_ACC_FEATSET0_ADDR A:0xfc4ba010
y.create.l HWIO_ACC_FEATSET1_ADDR A:0xfc4ba014
y.create.l HWIO_ACC_FEATSET2_ADDR A:0xfc4ba018
y.create.l HWIO_ACC_FEATSET3_ADDR A:0xfc4ba01c
y.create.l HWIO_ACC_FEATSET4_ADDR A:0xfc4ba020
y.create.l HWIO_ACC_FEATSET5_ADDR A:0xfc4ba024
y.create.l HWIO_ACC_FEATSET6_ADDR A:0xfc4ba028
y.create.l HWIO_ACC_FEATSET7_ADDR A:0xfc4ba02c
y.create.l HWIO_QFPROM_BLOW_TIMER_ADDR A:0xfc4ba038
y.create.l HWIO_QFPROM_TEST_CTRL_ADDR A:0xfc4ba03c
y.create.l HWIO_QFPROM_ACCEL_ADDR A:0xfc4ba040
y.create.l HWIO_ACC_STATE_ADDR A:0xfc4ba044
y.create.l HWIO_QFPROM_BLOW_STATUS_ADDR A:0xfc4ba048
y.create.l HWIO_HW_KEY_STATUS_ADDR A:0xfc4ba04c
y.create.l HWIO_QFPROM_BIST_CTRL_ADDR A:0xfc4ba050
y.create.l HWIO_QFPROM_BIST_ERROR_ADDR A:0xfc4ba054
y.create.l HWIO_QFPROM_HASH_SIGNATURE0_ADDR A:0xfc4ba060
y.create.l HWIO_QFPROM_HASH_SIGNATURE1_ADDR A:0xfc4ba064
y.create.l HWIO_QFPROM_HASH_SIGNATURE2_ADDR A:0xfc4ba068
y.create.l HWIO_QFPROM_HASH_SIGNATURE3_ADDR A:0xfc4ba06c
y.create.l HWIO_QFPROM_HASH_SIGNATURE4_ADDR A:0xfc4ba070
y.create.l HWIO_QFPROM_HASH_SIGNATURE5_ADDR A:0xfc4ba074
y.create.l HWIO_QFPROM_HASH_SIGNATURE6_ADDR A:0xfc4ba078
y.create.l HWIO_QFPROM_HASH_SIGNATURE7_ADDR A:0xfc4ba07c
y.create.l HWIO_FEC_ESR_ADDR A:0xfc4ba080
y.create.l HWIO_FEC_EAR_ADDR A:0xfc4ba084
y.create.l HWIO_RESET_JDR_STATUS_ADDR A:0xfc4ba088
y.create.l HWIO_QFPROM_ROM_ERROR_ADDR A:0xfc4ba090
y.create.l HWIO_QFPROM0_MATCH_STATUS_ADDR A:0xfc4ba094
y.create.l HWIO_QFPROM1_MATCH_STATUS_ADDR A:0xfc4ba098
y.create.l HWIO_QFPROM_CORR_ACC_PRIVATE0_ADDR A:0xfc4bc000
y.create.l HWIO_QFPROM_CORR_ACC_PRIVATE1_ADDR A:0xfc4bc004
y.create.l HWIO_QFPROM_CORR_ACC_PRIVATE2_ADDR A:0xfc4bc008
y.create.l HWIO_QFPROM_CORR_ACC_PRIVATE3_ADDR A:0xfc4bc00c
y.create.l HWIO_QFPROM_CORR_ACC_PRIVATE4_ADDR A:0xfc4bc010
y.create.l HWIO_QFPROM_CORR_ACC_PRIVATE5_ADDR A:0xfc4bc014
y.create.l HWIO_QFPROM_CORR_ACC_PRIVATE6_ADDR A:0xfc4bc018
y.create.l HWIO_QFPROM_CORR_ACC_PRIVATE7_ADDR A:0xfc4bc01c
y.create.l HWIO_QFPROM_CORR_ACC_PRIVATE8_ADDR A:0xfc4bc020
y.create.l HWIO_QFPROM_CORR_ACC_PRIVATE9_ADDR A:0xfc4bc024
y.create.l HWIO_QFPROM_CORR_JTAG_ID_LSB_ADDR A:0xfc4bc0a0
y.create.l HWIO_QFPROM_CORR_JTAG_ID_MSB_ADDR A:0xfc4bc0a4
y.create.l HWIO_QFPROM_CORR_RD_WR_PERM_LSB_ADDR A:0xfc4bc0a8
y.create.l HWIO_QFPROM_CORR_RD_WR_PERM_MSB_ADDR A:0xfc4bc0ac
y.create.l HWIO_QFPROM_CORR_PTE_LSB_ADDR A:0xfc4bc0b0
y.create.l HWIO_QFPROM_CORR_PTE_MSB_ADDR A:0xfc4bc0b4
y.create.l HWIO_QFPROM_CORR_AP_ANTI_ROLLBACK_ROW0_LSB_ADDR A:0xfc4bc0b8
y.create.l HWIO_QFPROM_CORR_AP_ANTI_ROLLBACK_ROW0_MSB_ADDR A:0xfc4bc0bc
y.create.l HWIO_QFPROM_CORR_AP_ANTI_ROLLBACK_ROW1_LSB_ADDR A:0xfc4bc0c0
y.create.l HWIO_QFPROM_CORR_AP_ANTI_ROLLBACK_ROW1_MSB_ADDR A:0xfc4bc0c4
y.create.l HWIO_QFPROM_CORR_MSA_ANTI_ROLLBACK_LSB_ADDR A:0xfc4bc0c8
y.create.l HWIO_QFPROM_CORR_MSA_ANTI_ROLLBACK_MSB_ADDR A:0xfc4bc0cc
y.create.l HWIO_QFPROM_CORR_IMEI_ESN0_LSB_ADDR A:0xfc4bc0d0
y.create.l HWIO_QFPROM_CORR_IMEI_ESN0_MSB_ADDR A:0xfc4bc0d4
y.create.l HWIO_QFPROM_CORR_IMEI_ESN1_LSB_ADDR A:0xfc4bc0d8
y.create.l HWIO_QFPROM_CORR_IMEI_ESN1_MSB_ADDR A:0xfc4bc0dc
y.create.l HWIO_QFPROM_CORR_IMEI_ESN2_LSB_ADDR A:0xfc4bc0e0
y.create.l HWIO_QFPROM_CORR_IMEI_ESN2_MSB_ADDR A:0xfc4bc0e4
y.create.l HWIO_QFPROM_CORR_OEM_CONFIG_ROW0_LSB_ADDR A:0xfc4bc0e8
y.create.l HWIO_QFPROM_CORR_OEM_CONFIG_ROW0_MSB_ADDR A:0xfc4bc0ec
y.create.l HWIO_QFPROM_CORR_OEM_CONFIG_ROW1_LSB_ADDR A:0xfc4bc0f0
y.create.l HWIO_QFPROM_CORR_OEM_CONFIG_ROW1_MSB_ADDR A:0xfc4bc0f4
y.create.l HWIO_QFPROM_CORR_FEAT_CONFIG_ROW0_LSB_ADDR A:0xfc4bc0f8
y.create.l HWIO_QFPROM_CORR_FEAT_CONFIG_ROW0_MSB_ADDR A:0xfc4bc0fc
y.create.l HWIO_QFPROM_CORR_FEAT_CONFIG_ROW1_LSB_ADDR A:0xfc4bc100
y.create.l HWIO_QFPROM_CORR_FEAT_CONFIG_ROW1_MSB_ADDR A:0xfc4bc104
y.create.l HWIO_QFPROM_CORR_FEAT_CONFIG_ROW2_LSB_ADDR A:0xfc4bc108
y.create.l HWIO_QFPROM_CORR_FEAT_CONFIG_ROW2_MSB_ADDR A:0xfc4bc10c
y.create.l HWIO_QFPROM_CORR_FEAT_CONFIG_ROW3_LSB_ADDR A:0xfc4bc110
y.create.l HWIO_QFPROM_CORR_FEAT_CONFIG_ROW3_MSB_ADDR A:0xfc4bc114
y.create.l HWIO_QFPROM_CORR_MEM_REDUN0_ADDR A:0xfc4bc118
y.create.l HWIO_QFPROM_CORR_MEM_REDUN1_ADDR A:0xfc4bc11c
y.create.l HWIO_QFPROM_CORR_MEM_REDUN2_ADDR A:0xfc4bc120
y.create.l HWIO_QFPROM_CORR_MEM_REDUN3_ADDR A:0xfc4bc124
y.create.l HWIO_QFPROM_CORR_MEM_REDUN4_ADDR A:0xfc4bc128
y.create.l HWIO_QFPROM_CORR_MEM_REDUN5_ADDR A:0xfc4bc12c
y.create.l HWIO_QFPROM_CORR_MEM_REDUN6_ADDR A:0xfc4bc130
y.create.l HWIO_QFPROM_CORR_MEM_REDUN7_ADDR A:0xfc4bc134
y.create.l HWIO_QFPROM_CORR_MEM_REDUN8_ADDR A:0xfc4bc138
y.create.l HWIO_QFPROM_CORR_MEM_REDUN9_ADDR A:0xfc4bc13c
y.create.l HWIO_QFPROM_CORR_DEBUG_KEY_LSB_ADDR A:0xfc4bc1a8
y.create.l HWIO_QFPROM_CORR_DEBUG_KEY_MSB_ADDR A:0xfc4bc1ac
y.create.l HWIO_QFPROM_CORR_MEM_ACCEL_ROW0_LSB_ADDR A:0xfc4bc1b0
y.create.l HWIO_QFPROM_CORR_MEM_ACCEL_ROW0_MSB_ADDR A:0xfc4bc1b4
y.create.l HWIO_QFPROM_CORR_MEM_ACCEL_ROW1_LSB_ADDR A:0xfc4bc1b8
y.create.l HWIO_QFPROM_CORR_MEM_ACCEL_ROW1_MSB_ADDR A:0xfc4bc1bc
y.create.l HWIO_QFPROM_CORR_CALIB_ROW0_LSB_ADDR A:0xfc4bc1c0
y.create.l HWIO_QFPROM_CORR_CALIB_ROW0_MSB_ADDR A:0xfc4bc1c4
y.create.l HWIO_QFPROM_CORR_CALIB_ROW1_LSB_ADDR A:0xfc4bc1c8
y.create.l HWIO_QFPROM_CORR_CALIB_ROW1_MSB_ADDR A:0xfc4bc1cc
y.create.l HWIO_QFPROM_CORR_FEC_EN_LSB_ADDR A:0xfc4bc1d0
y.create.l HWIO_QFPROM_CORR_FEC_EN_MSB_ADDR A:0xfc4bc1d4
y.create.l HWIO_QFPROM_CORR_INTAGLIO_GLUEBIT_LSB_ADDR A:0xfc4bc1d8
y.create.l HWIO_QFPROM_CORR_INTAGLIO_GLUEBIT_MSB_ADDR A:0xfc4bc1dc
y.create.l HWIO_QFPROM_CORR_CUST_KEY_ROW0_LSB_ADDR A:0xfc4bc1e0
y.create.l HWIO_QFPROM_CORR_CUST_KEY_ROW1_LSB_ADDR A:0xfc4bc1e8
y.create.l HWIO_QFPROM_CORR_CUST_KEY_ROW0_MSB_ADDR A:0xfc4bc1e4
y.create.l HWIO_QFPROM_CORR_CUST_KEY_ROW1_MSB_ADDR A:0xfc4bc1ec
y.create.l HWIO_QFPROM_CORR_SERIAL_NUM_LSB_ADDR A:0xfc4bc1f0
y.create.l HWIO_QFPROM_CORR_SERIAL_NUM_MSB_ADDR A:0xfc4bc1f4
y.create.l HWIO_QFPROM_CORR_SPARE_REG19_LSB_ADDR A:0xfc4bc1f8
y.create.l HWIO_QFPROM_CORR_SPARE_REG19_MSB_ADDR A:0xfc4bc1fc
y.create.l HWIO_QFPROM_CORR_ROM_PATCH_ROW0_LSB_ADDR A:0xfc4bc200
y.create.l HWIO_QFPROM_CORR_ROM_PATCH_ROW1_LSB_ADDR A:0xfc4bc208
y.create.l HWIO_QFPROM_CORR_ROM_PATCH_ROW2_LSB_ADDR A:0xfc4bc210
y.create.l HWIO_QFPROM_CORR_ROM_PATCH_ROW3_LSB_ADDR A:0xfc4bc218
y.create.l HWIO_QFPROM_CORR_ROM_PATCH_ROW4_LSB_ADDR A:0xfc4bc220
y.create.l HWIO_QFPROM_CORR_ROM_PATCH_ROW5_LSB_ADDR A:0xfc4bc228
y.create.l HWIO_QFPROM_CORR_ROM_PATCH_ROW6_LSB_ADDR A:0xfc4bc230
y.create.l HWIO_QFPROM_CORR_ROM_PATCH_ROW7_LSB_ADDR A:0xfc4bc238
y.create.l HWIO_QFPROM_CORR_ROM_PATCH_ROW8_LSB_ADDR A:0xfc4bc240
y.create.l HWIO_QFPROM_CORR_ROM_PATCH_ROW9_LSB_ADDR A:0xfc4bc248
y.create.l HWIO_QFPROM_CORR_ROM_PATCH_ROW0_MSB_ADDR A:0xfc4bc204
y.create.l HWIO_QFPROM_CORR_ROM_PATCH_ROW1_MSB_ADDR A:0xfc4bc20c
y.create.l HWIO_QFPROM_CORR_ROM_PATCH_ROW2_MSB_ADDR A:0xfc4bc214
y.create.l HWIO_QFPROM_CORR_ROM_PATCH_ROW3_MSB_ADDR A:0xfc4bc21c
y.create.l HWIO_QFPROM_CORR_ROM_PATCH_ROW4_MSB_ADDR A:0xfc4bc224
y.create.l HWIO_QFPROM_CORR_ROM_PATCH_ROW5_MSB_ADDR A:0xfc4bc22c
y.create.l HWIO_QFPROM_CORR_ROM_PATCH_ROW6_MSB_ADDR A:0xfc4bc234
y.create.l HWIO_QFPROM_CORR_ROM_PATCH_ROW7_MSB_ADDR A:0xfc4bc23c
y.create.l HWIO_QFPROM_CORR_ROM_PATCH_ROW8_MSB_ADDR A:0xfc4bc244
y.create.l HWIO_QFPROM_CORR_ROM_PATCH_ROW9_MSB_ADDR A:0xfc4bc24c
y.create.l HWIO_QFPROM_CORR_PRI_KEY_DERIVATION_KEY_ROW0_LSB_ADDR A:0xfc4bc380
y.create.l HWIO_QFPROM_CORR_PRI_KEY_DERIVATION_KEY_ROW1_LSB_ADDR A:0xfc4bc388
y.create.l HWIO_QFPROM_CORR_PRI_KEY_DERIVATION_KEY_ROW2_LSB_ADDR A:0xfc4bc390
y.create.l HWIO_QFPROM_CORR_PRI_KEY_DERIVATION_KEY_ROW3_LSB_ADDR A:0xfc4bc398
y.create.l HWIO_QFPROM_CORR_PRI_KEY_DERIVATION_KEY_ROW0_MSB_ADDR A:0xfc4bc384
y.create.l HWIO_QFPROM_CORR_PRI_KEY_DERIVATION_KEY_ROW1_MSB_ADDR A:0xfc4bc38c
y.create.l HWIO_QFPROM_CORR_PRI_KEY_DERIVATION_KEY_ROW2_MSB_ADDR A:0xfc4bc394
y.create.l HWIO_QFPROM_CORR_PRI_KEY_DERIVATION_KEY_ROW3_MSB_ADDR A:0xfc4bc39c
y.create.l HWIO_QFPROM_CORR_PRI_KEY_DERIVATION_KEY_ROW4_LSB_ADDR A:0xfc4bc3a0
y.create.l HWIO_QFPROM_CORR_PRI_KEY_DERIVATION_KEY_ROW4_MSB_ADDR A:0xfc4bc3a4
y.create.l HWIO_QFPROM_CORR_SEC_KEY_DERIVATION_KEY_ROW0_LSB_ADDR A:0xfc4bc3a8
y.create.l HWIO_QFPROM_CORR_SEC_KEY_DERIVATION_KEY_ROW1_LSB_ADDR A:0xfc4bc3b0
y.create.l HWIO_QFPROM_CORR_SEC_KEY_DERIVATION_KEY_ROW2_LSB_ADDR A:0xfc4bc3b8
y.create.l HWIO_QFPROM_CORR_SEC_KEY_DERIVATION_KEY_ROW3_LSB_ADDR A:0xfc4bc3c0
y.create.l HWIO_QFPROM_CORR_SEC_KEY_DERIVATION_KEY_ROW0_MSB_ADDR A:0xfc4bc3ac
y.create.l HWIO_QFPROM_CORR_SEC_KEY_DERIVATION_KEY_ROW1_MSB_ADDR A:0xfc4bc3b4
y.create.l HWIO_QFPROM_CORR_SEC_KEY_DERIVATION_KEY_ROW2_MSB_ADDR A:0xfc4bc3bc
y.create.l HWIO_QFPROM_CORR_SEC_KEY_DERIVATION_KEY_ROW3_MSB_ADDR A:0xfc4bc3c4
y.create.l HWIO_QFPROM_CORR_SEC_KEY_DERIVATION_KEY_ROW4_LSB_ADDR A:0xfc4bc3c8
y.create.l HWIO_QFPROM_CORR_SEC_KEY_DERIVATION_KEY_ROW4_MSB_ADDR A:0xfc4bc3cc
y.create.l HWIO_QFPROM_CORR_OEM_PK_HASH_ROW0_LSB_ADDR A:0xfc4bc3d0
y.create.l HWIO_QFPROM_CORR_OEM_PK_HASH_ROW1_LSB_ADDR A:0xfc4bc3d8
y.create.l HWIO_QFPROM_CORR_OEM_PK_HASH_ROW2_LSB_ADDR A:0xfc4bc3e0
y.create.l HWIO_QFPROM_CORR_OEM_PK_HASH_ROW3_LSB_ADDR A:0xfc4bc3e8
y.create.l HWIO_QFPROM_CORR_OEM_PK_HASH_ROW0_MSB_ADDR A:0xfc4bc3d4
y.create.l HWIO_QFPROM_CORR_OEM_PK_HASH_ROW1_MSB_ADDR A:0xfc4bc3dc
y.create.l HWIO_QFPROM_CORR_OEM_PK_HASH_ROW2_MSB_ADDR A:0xfc4bc3e4
y.create.l HWIO_QFPROM_CORR_OEM_PK_HASH_ROW3_MSB_ADDR A:0xfc4bc3ec
y.create.l HWIO_QFPROM_CORR_OEM_PK_HASH_ROW4_LSB_ADDR A:0xfc4bc3f0
y.create.l HWIO_QFPROM_CORR_OEM_PK_HASH_ROW4_MSB_ADDR A:0xfc4bc3f4
y.create.l HWIO_QFPROM_CORR_OEM_SEC_BOOT_ROW0_LSB_ADDR A:0xfc4bc3f8
y.create.l HWIO_QFPROM_CORR_OEM_SEC_BOOT_ROW1_LSB_ADDR A:0xfc4bc400
y.create.l HWIO_QFPROM_CORR_OEM_SEC_BOOT_ROW2_LSB_ADDR A:0xfc4bc408
y.create.l HWIO_QFPROM_CORR_OEM_SEC_BOOT_ROW3_LSB_ADDR A:0xfc4bc410
y.create.l HWIO_QFPROM_CORR_OEM_SEC_BOOT_ROW0_MSB_ADDR A:0xfc4bc3fc
y.create.l HWIO_QFPROM_CORR_OEM_SEC_BOOT_ROW1_MSB_ADDR A:0xfc4bc404
y.create.l HWIO_QFPROM_CORR_OEM_SEC_BOOT_ROW2_MSB_ADDR A:0xfc4bc40c
y.create.l HWIO_QFPROM_CORR_OEM_SEC_BOOT_ROW3_MSB_ADDR A:0xfc4bc414
y.create.l HWIO_QFPROM_CORR_QC_SEC_BOOT_ROW0_LSB_ADDR A:0xfc4bc418
y.create.l HWIO_QFPROM_CORR_QC_SEC_BOOT_ROW1_LSB_ADDR A:0xfc4bc420
y.create.l HWIO_QFPROM_CORR_QC_SEC_BOOT_ROW2_LSB_ADDR A:0xfc4bc428
y.create.l HWIO_QFPROM_CORR_QC_SEC_BOOT_ROW3_LSB_ADDR A:0xfc4bc430
y.create.l HWIO_QFPROM_CORR_QC_SEC_BOOT_ROW0_MSB_ADDR A:0xfc4bc41c
y.create.l HWIO_QFPROM_CORR_QC_SEC_BOOT_ROW1_MSB_ADDR A:0xfc4bc424
y.create.l HWIO_QFPROM_CORR_QC_SEC_BOOT_ROW2_MSB_ADDR A:0xfc4bc42c
y.create.l HWIO_QFPROM_CORR_QC_SEC_BOOT_ROW3_MSB_ADDR A:0xfc4bc434
y.create.l HWIO_QFPROM_CORR_USB_VID_PID_LSB_ADDR A:0xfc4bc438
y.create.l HWIO_QFPROM_CORR_USB_VID_PID_MSB_ADDR A:0xfc4bc43c
y.create.l HWIO_QFPROM_CORR_SPARE_REG27_ROW0_LSB_ADDR A:0xfc4bc440
y.create.l HWIO_QFPROM_CORR_SPARE_REG27_ROW0_MSB_ADDR A:0xfc4bc444
y.create.l HWIO_QFPROM_CORR_SPARE_REG27_ROW1_LSB_ADDR A:0xfc4bc448
y.create.l HWIO_QFPROM_CORR_SPARE_REG27_ROW1_MSB_ADDR A:0xfc4bc44c
y.create.l HWIO_QFPROM_CORR_SPARE_REG28_ROW0_LSB_ADDR A:0xfc4bc450
y.create.l HWIO_QFPROM_CORR_SPARE_REG28_ROW0_MSB_ADDR A:0xfc4bc454
y.create.l HWIO_QFPROM_CORR_SPARE_REG28_ROW1_LSB_ADDR A:0xfc4bc458
y.create.l HWIO_QFPROM_CORR_SPARE_REG28_ROW1_MSB_ADDR A:0xfc4bc45c
y.create.l HWIO_QFPROM_CORR_SPARE_REG28_ROW2_LSB_ADDR A:0xfc4bc460
y.create.l HWIO_QFPROM_CORR_SPARE_REG28_ROW2_MSB_ADDR A:0xfc4bc464
y.create.l HWIO_QFPROM_CORR_HDCP_KSV_LSB_ADDR A:0xfc4bc468
y.create.l HWIO_QFPROM_CORR_HDCP_KSV_MSB_ADDR A:0xfc4bc46c
y.create.l HWIO_QFPROM_CORR_HDCP_KEY_ROW1_LSB_ADDR A:0xfc4bc470
y.create.l HWIO_QFPROM_CORR_HDCP_KEY_ROW2_LSB_ADDR A:0xfc4bc478
y.create.l HWIO_QFPROM_CORR_HDCP_KEY_ROW3_LSB_ADDR A:0xfc4bc480
y.create.l HWIO_QFPROM_CORR_HDCP_KEY_ROW4_LSB_ADDR A:0xfc4bc488
y.create.l HWIO_QFPROM_CORR_HDCP_KEY_ROW5_LSB_ADDR A:0xfc4bc490
y.create.l HWIO_QFPROM_CORR_HDCP_KEY_ROW6_LSB_ADDR A:0xfc4bc498
y.create.l HWIO_QFPROM_CORR_HDCP_KEY_ROW7_LSB_ADDR A:0xfc4bc4a0
y.create.l HWIO_QFPROM_CORR_HDCP_KEY_ROW8_LSB_ADDR A:0xfc4bc4a8
y.create.l HWIO_QFPROM_CORR_HDCP_KEY_ROW9_LSB_ADDR A:0xfc4bc4b0
y.create.l HWIO_QFPROM_CORR_HDCP_KEY_ROW10_LSB_ADDR A:0xfc4bc4b8
y.create.l HWIO_QFPROM_CORR_HDCP_KEY_ROW1_MSB_ADDR A:0xfc4bc474
y.create.l HWIO_QFPROM_CORR_HDCP_KEY_ROW2_MSB_ADDR A:0xfc4bc47c
y.create.l HWIO_QFPROM_CORR_HDCP_KEY_ROW3_MSB_ADDR A:0xfc4bc484
y.create.l HWIO_QFPROM_CORR_HDCP_KEY_ROW4_MSB_ADDR A:0xfc4bc48c
y.create.l HWIO_QFPROM_CORR_HDCP_KEY_ROW5_MSB_ADDR A:0xfc4bc494
y.create.l HWIO_QFPROM_CORR_HDCP_KEY_ROW6_MSB_ADDR A:0xfc4bc49c
y.create.l HWIO_QFPROM_CORR_HDCP_KEY_ROW7_MSB_ADDR A:0xfc4bc4a4
y.create.l HWIO_QFPROM_CORR_HDCP_KEY_ROW8_MSB_ADDR A:0xfc4bc4ac
y.create.l HWIO_QFPROM_CORR_HDCP_KEY_ROW9_MSB_ADDR A:0xfc4bc4b4
y.create.l HWIO_QFPROM_CORR_HDCP_KEY_ROW10_MSB_ADDR A:0xfc4bc4bc
y.create.l HWIO_QFPROM_CORR_CUST_PRIV_KEY0_ROW0_LSB_ADDR A:0xfc4bc5b0
y.create.l HWIO_QFPROM_CORR_CUST_PRIV_KEY0_ROW1_LSB_ADDR A:0xfc4bc5b8
y.create.l HWIO_QFPROM_CORR_CUST_PRIV_KEY0_ROW2_LSB_ADDR A:0xfc4bc5c0
y.create.l HWIO_QFPROM_CORR_CUST_PRIV_KEY0_ROW3_LSB_ADDR A:0xfc4bc5c8
y.create.l HWIO_QFPROM_CORR_CUST_PRIV_KEY0_ROW4_LSB_ADDR A:0xfc4bc5d0
y.create.l HWIO_QFPROM_CORR_CUST_PRIV_KEY0_ROW5_LSB_ADDR A:0xfc4bc5d8
y.create.l HWIO_QFPROM_CORR_CUST_PRIV_KEY0_ROW6_LSB_ADDR A:0xfc4bc5e0
y.create.l HWIO_QFPROM_CORR_CUST_PRIV_KEY0_ROW7_LSB_ADDR A:0xfc4bc5e8
y.create.l HWIO_QFPROM_CORR_CUST_PRIV_KEY0_ROW8_LSB_ADDR A:0xfc4bc5f0
y.create.l HWIO_QFPROM_CORR_CUST_PRIV_KEY0_ROW9_LSB_ADDR A:0xfc4bc5f8
y.create.l HWIO_QFPROM_CORR_CUST_PRIV_KEY0_ROW0_MSB_ADDR A:0xfc4bc5b4
y.create.l HWIO_QFPROM_CORR_CUST_PRIV_KEY0_ROW1_MSB_ADDR A:0xfc4bc5bc
y.create.l HWIO_QFPROM_CORR_CUST_PRIV_KEY0_ROW2_MSB_ADDR A:0xfc4bc5c4
y.create.l HWIO_QFPROM_CORR_CUST_PRIV_KEY0_ROW3_MSB_ADDR A:0xfc4bc5cc
y.create.l HWIO_QFPROM_CORR_CUST_PRIV_KEY0_ROW4_MSB_ADDR A:0xfc4bc5d4
y.create.l HWIO_QFPROM_CORR_CUST_PRIV_KEY0_ROW5_MSB_ADDR A:0xfc4bc5dc
y.create.l HWIO_QFPROM_CORR_CUST_PRIV_KEY0_ROW6_MSB_ADDR A:0xfc4bc5e4
y.create.l HWIO_QFPROM_CORR_CUST_PRIV_KEY0_ROW7_MSB_ADDR A:0xfc4bc5ec
y.create.l HWIO_QFPROM_CORR_CUST_PRIV_KEY0_ROW8_MSB_ADDR A:0xfc4bc5f4
y.create.l HWIO_QFPROM_CORR_CUST_PRIV_KEY0_ROW9_MSB_ADDR A:0xfc4bc5fc
y.create.l HWIO_QFPROM_CORR_CUST_PRIV_KEY1_ROW0_LSB_ADDR A:0xfc4bc6d8
y.create.l HWIO_QFPROM_CORR_CUST_PRIV_KEY1_ROW1_LSB_ADDR A:0xfc4bc6e0
y.create.l HWIO_QFPROM_CORR_CUST_PRIV_KEY1_ROW2_LSB_ADDR A:0xfc4bc6e8
y.create.l HWIO_QFPROM_CORR_CUST_PRIV_KEY1_ROW3_LSB_ADDR A:0xfc4bc6f0
y.create.l HWIO_QFPROM_CORR_CUST_PRIV_KEY1_ROW4_LSB_ADDR A:0xfc4bc6f8
y.create.l HWIO_QFPROM_CORR_CUST_PRIV_KEY1_ROW5_LSB_ADDR A:0xfc4bc700
y.create.l HWIO_QFPROM_CORR_CUST_PRIV_KEY1_ROW6_LSB_ADDR A:0xfc4bc708
y.create.l HWIO_QFPROM_CORR_CUST_PRIV_KEY1_ROW7_LSB_ADDR A:0xfc4bc710
y.create.l HWIO_QFPROM_CORR_CUST_PRIV_KEY1_ROW8_LSB_ADDR A:0xfc4bc718
y.create.l HWIO_QFPROM_CORR_CUST_PRIV_KEY1_ROW9_LSB_ADDR A:0xfc4bc720
y.create.l HWIO_QFPROM_CORR_CUST_PRIV_KEY1_ROW0_MSB_ADDR A:0xfc4bc6dc
y.create.l HWIO_QFPROM_CORR_CUST_PRIV_KEY1_ROW1_MSB_ADDR A:0xfc4bc6e4
y.create.l HWIO_QFPROM_CORR_CUST_PRIV_KEY1_ROW2_MSB_ADDR A:0xfc4bc6ec
y.create.l HWIO_QFPROM_CORR_CUST_PRIV_KEY1_ROW3_MSB_ADDR A:0xfc4bc6f4
y.create.l HWIO_QFPROM_CORR_CUST_PRIV_KEY1_ROW4_MSB_ADDR A:0xfc4bc6fc
y.create.l HWIO_QFPROM_CORR_CUST_PRIV_KEY1_ROW5_MSB_ADDR A:0xfc4bc704
y.create.l HWIO_QFPROM_CORR_CUST_PRIV_KEY1_ROW6_MSB_ADDR A:0xfc4bc70c
y.create.l HWIO_QFPROM_CORR_CUST_PRIV_KEY1_ROW7_MSB_ADDR A:0xfc4bc714
y.create.l HWIO_QFPROM_CORR_CUST_PRIV_KEY1_ROW8_MSB_ADDR A:0xfc4bc71c
y.create.l HWIO_QFPROM_CORR_CUST_PRIV_KEY1_ROW9_MSB_ADDR A:0xfc4bc724
y.create.l HWIO_SEC_CTRL_HW_VERSION_ADDR A:0xfc4be000
y.create.l HWIO_FEATURE_CONFIG0_ADDR A:0xfc4be004
y.create.l HWIO_FEATURE_CONFIG1_ADDR A:0xfc4be008
y.create.l HWIO_FEATURE_CONFIG2_ADDR A:0xfc4be00c
y.create.l HWIO_FEATURE_CONFIG3_ADDR A:0xfc4be010
y.create.l HWIO_FEATURE_CONFIG4_ADDR A:0xfc4be014
y.create.l HWIO_FEATURE_CONFIG5_ADDR A:0xfc4be018
y.create.l HWIO_FEATURE_CONFIG6_ADDR A:0xfc4be01c
y.create.l HWIO_FEATURE_CONFIG7_ADDR A:0xfc4be020
y.create.l HWIO_OEM_CONFIG0_ADDR A:0xfc4be024
y.create.l HWIO_OEM_CONFIG1_ADDR A:0xfc4be028
y.create.l HWIO_OEM_CONFIG2_ADDR A:0xfc4be02c
y.create.l HWIO_OEM_CONFIG3_ADDR A:0xfc4be030
y.create.l HWIO_BOOT_CONFIG_ADDR A:0xfc4be034
y.create.l HWIO_SECURE_BOOT1_ADDR A:0xfc4be03c
y.create.l HWIO_SECURE_BOOT2_ADDR A:0xfc4be040
y.create.l HWIO_SECURE_BOOT3_ADDR A:0xfc4be044
y.create.l HWIO_SECURE_BOOT4_ADDR A:0xfc4be048
y.create.l HWIO_SECURE_BOOT5_ADDR A:0xfc4be04c
y.create.l HWIO_SECURE_BOOT6_ADDR A:0xfc4be050
y.create.l HWIO_SECURE_BOOT7_ADDR A:0xfc4be054
y.create.l HWIO_SECURE_BOOT8_ADDR A:0xfc4be058
y.create.l HWIO_SECURE_BOOT9_ADDR A:0xfc4be05c
y.create.l HWIO_SECURE_BOOT10_ADDR A:0xfc4be060
y.create.l HWIO_OVERRIDE_0_ADDR A:0xfc4be0b0
y.create.l HWIO_OVERRIDE_1_ADDR A:0xfc4be0b4
y.create.l HWIO_OVERRIDE_2_ADDR A:0xfc4be0b8
y.create.l HWIO_OVERRIDE_3_ADDR A:0xfc4be0bc
y.create.l HWIO_OVERRIDE_4_ADDR A:0xfc4be0c0
y.create.l HWIO_CAPT_SEC_GPIO_ADDR A:0xfc4be0c4
y.create.l HWIO_APP_PROC_CFG_ADDR A:0xfc4be0c8
y.create.l HWIO_MSS_PROC_CFG_ADDR A:0xfc4be0cc
y.create.l HWIO_KDF_CFG_ADDR A:0xfc4be0d0
y.create.l HWIO_QFPROM_CLK_CTL_ADDR A:0xfc4be0d4
y.create.l HWIO_HDCP_KSV_LSB_ADDR A:0xfc4be0d8
y.create.l HWIO_HDCP_KSV_MSB_ADDR A:0xfc4be0dc
y.create.l HWIO_JTAG_ID_ADDR A:0xfc4be0e0
y.create.l HWIO_OEM_ID_ADDR A:0xfc4be0e4
y.create.l HWIO_TEST_BUS_SEL_ADDR A:0xfc4be0e8
y.create.l HWIO_SPDM_DYN_SECURE_MODE_ADDR A:0xfc4be0ec
y.create.l HWIO_BOOT_PARTITION_SELECT_ADDR A:0xfc4be0f0
y.create.l HWIO_SEC_CTRL_APU_XPU_SCR_ADDR A:0xfc4bf000
y.create.l HWIO_SEC_CTRL_APU_XPU_SWDR_ADDR A:0xfc4bf004
y.create.l HWIO_SEC_CTRL_APU_XPU_SEAR0_ADDR A:0xfc4bf040
y.create.l HWIO_SEC_CTRL_APU_XPU_SESR_ADDR A:0xfc4bf048
y.create.l HWIO_SEC_CTRL_APU_XPU_SESRRESTORE_ADDR A:0xfc4bf04c
y.create.l HWIO_SEC_CTRL_APU_XPU_SESYNR0_ADDR A:0xfc4bf050
y.create.l HWIO_SEC_CTRL_APU_XPU_SESYNR1_ADDR A:0xfc4bf054
y.create.l HWIO_SEC_CTRL_APU_XPU_SESYNR2_ADDR A:0xfc4bf058
y.create.l HWIO_SEC_CTRL_APU_XPU_MCR_ADDR A:0xfc4bf100
y.create.l HWIO_SEC_CTRL_APU_XPU_MEAR0_ADDR A:0xfc4bf140
y.create.l HWIO_SEC_CTRL_APU_XPU_MESR_ADDR A:0xfc4bf148
y.create.l HWIO_SEC_CTRL_APU_XPU_MESRRESTORE_ADDR A:0xfc4bf14c
y.create.l HWIO_SEC_CTRL_APU_XPU_MESYNR0_ADDR A:0xfc4bf150
y.create.l HWIO_SEC_CTRL_APU_XPU_MESYNR1_ADDR A:0xfc4bf154
y.create.l HWIO_SEC_CTRL_APU_XPU_MESYNR2_ADDR A:0xfc4bf158
y.create.l HWIO_SEC_CTRL_APU_XPU_CR_ADDR A:0xfc4bf080
y.create.l HWIO_SEC_CTRL_APU_XPU_RPU_ACR0_ADDR A:0xfc4bf0a0
y.create.l HWIO_SEC_CTRL_APU_XPU_EAR0_ADDR A:0xfc4bf0c0
y.create.l HWIO_SEC_CTRL_APU_XPU_ESR_ADDR A:0xfc4bf0c8
y.create.l HWIO_SEC_CTRL_APU_XPU_ESRRESTORE_ADDR A:0xfc4bf0cc
y.create.l HWIO_SEC_CTRL_APU_XPU_ESYNR0_ADDR A:0xfc4bf0d0
y.create.l HWIO_SEC_CTRL_APU_XPU_ESYNR1_ADDR A:0xfc4bf0d4
y.create.l HWIO_SEC_CTRL_APU_XPU_ESYNR2_ADDR A:0xfc4bf0d8
y.create.l HWIO_SEC_CTRL_APU_XPU_IDR0_ADDR A:0xfc4bf074
y.create.l HWIO_SEC_CTRL_APU_XPU_IDR1_ADDR A:0xfc4bf078
y.create.l HWIO_SEC_CTRL_APU_XPU_REV_ADDR A:0xfc4bf07c
y.create.l HWIO_SEC_CTRL_APU_XPU_RG0_RACR0_ADDR A:0xfc4bf200
y.create.l HWIO_SEC_CTRL_APU_XPU_RG1_RACR0_ADDR A:0xfc4bf280
y.create.l HWIO_SEC_CTRL_APU_XPU_RG2_RACR0_ADDR A:0xfc4bf300
y.create.l HWIO_SEC_CTRL_APU_XPU_RG0_WACR0_ADDR A:0xfc4bf220
y.create.l HWIO_SEC_CTRL_APU_XPU_RG1_WACR0_ADDR A:0xfc4bf2a0
y.create.l HWIO_SEC_CTRL_APU_XPU_RG2_WACR0_ADDR A:0xfc4bf320
y.create.l HWIO_SEC_CTRL_APU_XPU_RG0_SCR_ADDR A:0xfc4bf250
y.create.l HWIO_SEC_CTRL_APU_XPU_RG1_SCR_ADDR A:0xfc4bf2d0
y.create.l HWIO_SEC_CTRL_APU_XPU_RG2_SCR_ADDR A:0xfc4bf350
y.create.l HWIO_SEC_CTRL_APU_XPU_RG0_MCR_ADDR A:0xfc4bf254
y.create.l HWIO_SEC_CTRL_APU_XPU_RG1_MCR_ADDR A:0xfc4bf2d4
y.create.l HWIO_SEC_CTRL_APU_XPU_RG2_MCR_ADDR A:0xfc4bf354
y.create.l HWIO_SNOC_0_ABT_HW_VERSION_ADDR A:0xfea00000
y.create.l HWIO_SNOC_0_ABT_INST_ID_ADDR A:0xfea00004
y.create.l HWIO_SNOC_0_ABT_NUM_SLAVES_ADDR A:0xfea00008
y.create.l HWIO_SNOC_0_ABT_TIMER_LOADVAL_ADDR A:0xfea0000c
y.create.l HWIO_SNOC_0_ABT_TIMER_MODE_ADDR A:0xfea00010
y.create.l HWIO_SNOC_0_ABT_INTR_STATUS_ADDR A:0xfea00014
y.create.l HWIO_SNOC_0_ABT_INTR_CLEAR_ADDR A:0xfea00018
y.create.l HWIO_SNOC_0_ABT_INTR_ENABLE_ADDR A:0xfea0001c
y.create.l HWIO_SNOC_0_ABT_SYND_VALID_ADDR A:0xfea00020
y.create.l HWIO_SNOC_0_ABT_SYND_CLEAR_ADDR A:0xfea00024
y.create.l HWIO_SNOC_0_ABT_SYND_ID_ADDR A:0xfea00028
y.create.l HWIO_SNOC_0_ABT_SYND_ADDR0_ADDR A:0xfea0002c
y.create.l HWIO_SNOC_0_ABT_SYND_ADDR1_ADDR A:0xfea00030
y.create.l HWIO_SNOC_0_ABT_SYND_HREADY_ADDR A:0xfea00034
y.create.l HWIO_SNOC_1_ABT_HW_VERSION_ADDR A:0xfea01000
y.create.l HWIO_SNOC_1_ABT_INST_ID_ADDR A:0xfea01004
y.create.l HWIO_SNOC_1_ABT_NUM_SLAVES_ADDR A:0xfea01008
y.create.l HWIO_SNOC_1_ABT_TIMER_LOADVAL_ADDR A:0xfea0100c
y.create.l HWIO_SNOC_1_ABT_TIMER_MODE_ADDR A:0xfea01010
y.create.l HWIO_SNOC_1_ABT_INTR_STATUS_ADDR A:0xfea01014
y.create.l HWIO_SNOC_1_ABT_INTR_CLEAR_ADDR A:0xfea01018
y.create.l HWIO_SNOC_1_ABT_INTR_ENABLE_ADDR A:0xfea0101c
y.create.l HWIO_SNOC_1_ABT_SYND_VALID_ADDR A:0xfea01020
y.create.l HWIO_SNOC_1_ABT_SYND_CLEAR_ADDR A:0xfea01024
y.create.l HWIO_SNOC_1_ABT_SYND_ID_ADDR A:0xfea01028
y.create.l HWIO_SNOC_1_ABT_SYND_ADDR0_ADDR A:0xfea0102c
y.create.l HWIO_SNOC_1_ABT_SYND_ADDR1_ADDR A:0xfea01030
y.create.l HWIO_SNOC_1_ABT_SYND_HREADY_ADDR A:0xfea01034
y.create.l HWIO_SPDM_CREG_CFG0_ADDR A:0xfc4b0000
y.create.l HWIO_SPDM_CREG_HW_INFO_ADDR A:0xfc4b0004
y.create.l HWIO_SPDM_CREG_HW_VERSION_ADDR A:0xfc4b0008
y.create.l HWIO_SPDM_CREG_MUTEX_0_ADDR A:0xfc4b0100
y.create.l HWIO_SPDM_OLEM_CFG0_ADDR A:0xfc4b1000
y.create.l HWIO_SPDM_OLEM_CFG1_ADDR A:0xfc4b1004
y.create.l HWIO_SPDM_OLEM_CFG2_ADDR A:0xfc4b1008
y.create.l HWIO_SPDM_OLEM_CFG3_ADDR A:0xfc4b100c
y.create.l HWIO_SPDM_OLEM_CFG4_ADDR A:0xfc4b1010
y.create.l HWIO_SPDM_OLEM_CFG5_ADDR A:0xfc4b1014
y.create.l HWIO_SPDM_OLEM_CFG6_ADDR A:0xfc4b1018
y.create.l HWIO_SPDM_OLEM_CYCLE_C0_OUT_ADDR A:0xfc4b1020
y.create.l HWIO_SPDM_OLEM_CYCLE_C1_OUT_ADDR A:0xfc4b1024
y.create.l HWIO_SPDM_OLEM_CYCLE_C2_OUT_ADDR A:0xfc4b1028
y.create.l HWIO_SPDM_OLEM_CYCLE_C3_OUT_ADDR A:0xfc4b102c
y.create.l HWIO_SPDM_OLEM_CYCLE_C4_OUT_ADDR A:0xfc4b1030
y.create.l HWIO_SPDM_OLEM_CYCLE_C5_OUT_ADDR A:0xfc4b1034
y.create.l HWIO_SPDM_OLEM_CYCLE_C6_OUT_ADDR A:0xfc4b1038
y.create.l HWIO_SPDM_OLEM_CYCLE_C7_OUT_ADDR A:0xfc4b103c
y.create.l HWIO_SPDM_OLEM_CYCLE_C8_OUT_ADDR A:0xfc4b1040
y.create.l HWIO_SPDM_OLEM_CYCLE_C9_OUT_ADDR A:0xfc4b1044
y.create.l HWIO_SPDM_OLEM_EVENT_C0_OUT_ADDR A:0xfc4b10a0
y.create.l HWIO_SPDM_OLEM_EVENT_C1_OUT_ADDR A:0xfc4b10a4
y.create.l HWIO_SPDM_OLEM_EVENT_C2_OUT_ADDR A:0xfc4b10a8
y.create.l HWIO_SPDM_OLEM_EVENT_C3_OUT_ADDR A:0xfc4b10ac
y.create.l HWIO_SPDM_OLEM_EVENT_C4_OUT_ADDR A:0xfc4b10b0
y.create.l HWIO_SPDM_OLEM_EVENT_C5_OUT_ADDR A:0xfc4b10b4
y.create.l HWIO_SPDM_OLEM_EVENT_C6_OUT_ADDR A:0xfc4b10b8
y.create.l HWIO_SPDM_OLEM_EVENT_C7_OUT_ADDR A:0xfc4b10bc
y.create.l HWIO_SPDM_OLEM_EVENT_C8_OUT_ADDR A:0xfc4b10c0
y.create.l HWIO_SPDM_OLEM_EVENT_C9_OUT_ADDR A:0xfc4b10c4
y.create.l HWIO_SPDM_OLEM_MULTIBIT_C0_OUT_ADDR A:0xfc4b1120
y.create.l HWIO_SPDM_OLEM_MULTIBIT_C1_OUT_ADDR A:0xfc4b1124
y.create.l HWIO_SPDM_OLEM_MULTIBIT_C2_OUT_ADDR A:0xfc4b1128
y.create.l HWIO_SPDM_OLEM_MULTIBIT_C3_OUT_ADDR A:0xfc4b112c
y.create.l HWIO_SPDM_OLEM_MULTIBIT_C4_OUT_ADDR A:0xfc4b1130
y.create.l HWIO_SPDM_OLEM_MULTIBIT_C5_OUT_ADDR A:0xfc4b1134
y.create.l HWIO_SPDM_OLEM_MULTIBIT_C6_OUT_ADDR A:0xfc4b1138
y.create.l HWIO_SPDM_OLEM_MULTIBIT_C7_OUT_ADDR A:0xfc4b113c
y.create.l HWIO_SPDM_RT_LOW_THRESH_STATUS_ADDR A:0xfc4b2000
y.create.l HWIO_SPDM_RT_HIGH_THRESH_STATUS_ADDR A:0xfc4b2004
y.create.l HWIO_SPDM_RT_LOW_IRQ_EN_0_ADDR A:0xfc4b2010
y.create.l HWIO_SPDM_RT_LOW_IRQ_EN_1_ADDR A:0xfc4b2014
y.create.l HWIO_SPDM_RT_LOW_IRQ_EN_2_ADDR A:0xfc4b2018
y.create.l HWIO_SPDM_RT_LOW_IRQ_EN_3_ADDR A:0xfc4b201c
y.create.l HWIO_SPDM_RT_HIGH_IRQ_EN_0_ADDR A:0xfc4b2020
y.create.l HWIO_SPDM_RT_HIGH_IRQ_EN_1_ADDR A:0xfc4b2024
y.create.l HWIO_SPDM_RT_HIGH_IRQ_EN_2_ADDR A:0xfc4b2028
y.create.l HWIO_SPDM_RT_HIGH_IRQ_EN_3_ADDR A:0xfc4b202c
y.create.l HWIO_SPDM_RT_IRQ_TIMER_0_ADDR A:0xfc4b2030
y.create.l HWIO_SPDM_RT_IRQ_TIMER_1_ADDR A:0xfc4b2034
y.create.l HWIO_SPDM_RT_IRQ_TIMER_2_ADDR A:0xfc4b2038
y.create.l HWIO_SPDM_RT_IRQ_TIMER_3_ADDR A:0xfc4b203c
y.create.l HWIO_SPDM_RT_DIAG_MUX_SEL_ADDR A:0xfc4b2040
y.create.l HWIO_SPDM_RT_MON_EN_ADDR A:0xfc4b2050
y.create.l HWIO_SPDM_RT_MON_EN_SET_ADDR A:0xfc4b2054
y.create.l HWIO_SPDM_RT_MON_EN_CLEAR_ADDR A:0xfc4b2058
y.create.l HWIO_SPDM_RT_MON_RST_ADDR A:0xfc4b2060
y.create.l HWIO_SPDM_RT_MON_RST_SET_ADDR A:0xfc4b2064
y.create.l HWIO_SPDM_RT_MON_RST_CLEAR_ADDR A:0xfc4b2068
y.create.l HWIO_SPDM_RT_MON_CFG_0_ADDR A:0xfc4b2100
y.create.l HWIO_SPDM_RT_MON_CFG_1_ADDR A:0xfc4b2110
y.create.l HWIO_SPDM_RT_MON_CFG_2_ADDR A:0xfc4b2120
y.create.l HWIO_SPDM_RT_MON_CFG_3_ADDR A:0xfc4b2130
y.create.l HWIO_SPDM_RT_MON_CFG_4_ADDR A:0xfc4b2140
y.create.l HWIO_SPDM_RT_MON_CFG_5_ADDR A:0xfc4b2150
y.create.l HWIO_SPDM_RT_MON_CFG_6_ADDR A:0xfc4b2160
y.create.l HWIO_SPDM_RT_MON_CFG_7_ADDR A:0xfc4b2170
y.create.l HWIO_SPDM_RT_MON_CFG_8_ADDR A:0xfc4b2180
y.create.l HWIO_SPDM_RT_MON_CFG_9_ADDR A:0xfc4b2190
y.create.l HWIO_SPDM_RT_THRESH_CFG_0_ADDR A:0xfc4b2104
y.create.l HWIO_SPDM_RT_THRESH_CFG_1_ADDR A:0xfc4b2114
y.create.l HWIO_SPDM_RT_THRESH_CFG_2_ADDR A:0xfc4b2124
y.create.l HWIO_SPDM_RT_THRESH_CFG_3_ADDR A:0xfc4b2134
y.create.l HWIO_SPDM_RT_THRESH_CFG_4_ADDR A:0xfc4b2144
y.create.l HWIO_SPDM_RT_THRESH_CFG_5_ADDR A:0xfc4b2154
y.create.l HWIO_SPDM_RT_THRESH_CFG_6_ADDR A:0xfc4b2164
y.create.l HWIO_SPDM_RT_THRESH_CFG_7_ADDR A:0xfc4b2174
y.create.l HWIO_SPDM_RT_THRESH_CFG_8_ADDR A:0xfc4b2184
y.create.l HWIO_SPDM_RT_THRESH_CFG_9_ADDR A:0xfc4b2194
y.create.l HWIO_SPDM_RT_MON_STATUS_0_ADDR A:0xfc4b2108
y.create.l HWIO_SPDM_RT_MON_STATUS_1_ADDR A:0xfc4b2118
y.create.l HWIO_SPDM_RT_MON_STATUS_2_ADDR A:0xfc4b2128
y.create.l HWIO_SPDM_RT_MON_STATUS_3_ADDR A:0xfc4b2138
y.create.l HWIO_SPDM_RT_MON_STATUS_4_ADDR A:0xfc4b2148
y.create.l HWIO_SPDM_RT_MON_STATUS_5_ADDR A:0xfc4b2158
y.create.l HWIO_SPDM_RT_MON_STATUS_6_ADDR A:0xfc4b2168
y.create.l HWIO_SPDM_RT_MON_STATUS_7_ADDR A:0xfc4b2178
y.create.l HWIO_SPDM_RT_MON_STATUS_8_ADDR A:0xfc4b2188
y.create.l HWIO_SPDM_RT_MON_STATUS_9_ADDR A:0xfc4b2198
y.create.l HWIO_SPDM_XPU_SCR_ADDR A:0xfc4b3000
y.create.l HWIO_SPDM_XPU_SWDR_ADDR A:0xfc4b3004
y.create.l HWIO_SPDM_XPU_SEAR0_ADDR A:0xfc4b3040
y.create.l HWIO_SPDM_XPU_SESR_ADDR A:0xfc4b3048
y.create.l HWIO_SPDM_XPU_SESRRESTORE_ADDR A:0xfc4b304c
y.create.l HWIO_SPDM_XPU_SESYNR0_ADDR A:0xfc4b3050
y.create.l HWIO_SPDM_XPU_SESYNR1_ADDR A:0xfc4b3054
y.create.l HWIO_SPDM_XPU_SESYNR2_ADDR A:0xfc4b3058
y.create.l HWIO_SPDM_XPU_MCR_ADDR A:0xfc4b3100
y.create.l HWIO_SPDM_XPU_MEAR0_ADDR A:0xfc4b3140
y.create.l HWIO_SPDM_XPU_MESR_ADDR A:0xfc4b3148
y.create.l HWIO_SPDM_XPU_MESRRESTORE_ADDR A:0xfc4b314c
y.create.l HWIO_SPDM_XPU_MESYNR0_ADDR A:0xfc4b3150
y.create.l HWIO_SPDM_XPU_MESYNR1_ADDR A:0xfc4b3154
y.create.l HWIO_SPDM_XPU_MESYNR2_ADDR A:0xfc4b3158
y.create.l HWIO_SPDM_XPU_CR_ADDR A:0xfc4b3080
y.create.l HWIO_SPDM_XPU_RPU_ACR0_ADDR A:0xfc4b30a0
y.create.l HWIO_SPDM_XPU_EAR0_ADDR A:0xfc4b30c0
y.create.l HWIO_SPDM_XPU_ESR_ADDR A:0xfc4b30c8
y.create.l HWIO_SPDM_XPU_ESRRESTORE_ADDR A:0xfc4b30cc
y.create.l HWIO_SPDM_XPU_ESYNR0_ADDR A:0xfc4b30d0
y.create.l HWIO_SPDM_XPU_ESYNR1_ADDR A:0xfc4b30d4
y.create.l HWIO_SPDM_XPU_ESYNR2_ADDR A:0xfc4b30d8
y.create.l HWIO_SPDM_XPU_IDR0_ADDR A:0xfc4b3074
y.create.l HWIO_SPDM_XPU_IDR1_ADDR A:0xfc4b3078
y.create.l HWIO_SPDM_XPU_REV_ADDR A:0xfc4b307c
y.create.l HWIO_SPDM_XPU_RG0_RACR0_ADDR A:0xfc4b3200
y.create.l HWIO_SPDM_XPU_RG0_SCR_ADDR A:0xfc4b3250
y.create.l HWIO_SPDM_XPU_RG0_MCR_ADDR A:0xfc4b3254
y.create.l HWIO_SPDM_SREG_CFG0_ADDR A:0xfc4b4000
y.create.l HWIO_SPDM_SREG_CFG1_ADDR A:0xfc4b4004
y.create.l HWIO_SPDM_SREG_MUTEX_0_ADDR A:0xfc4b4100
y.create.l HWIO_SPDM_VMIDMT_SCR0_ADDR A:0xfc4b5000
y.create.l HWIO_SPDM_VMIDMT_SCR1_ADDR A:0xfc4b5004
y.create.l HWIO_SPDM_VMIDMT_SCR2_ADDR A:0xfc4b5008
y.create.l HWIO_SPDM_VMIDMT_SACR_ADDR A:0xfc4b5010
y.create.l HWIO_SPDM_VMIDMT_SIDR0_ADDR A:0xfc4b5020
y.create.l HWIO_SPDM_VMIDMT_SIDR1_ADDR A:0xfc4b5024
y.create.l HWIO_SPDM_VMIDMT_SIDR2_ADDR A:0xfc4b5028
y.create.l HWIO_SPDM_VMIDMT_SIDR4_ADDR A:0xfc4b5030
y.create.l HWIO_SPDM_VMIDMT_SIDR5_ADDR A:0xfc4b5034
y.create.l HWIO_SPDM_VMIDMT_SIDR7_ADDR A:0xfc4b503c
y.create.l HWIO_SPDM_VMIDMT_SGFAR0_ADDR A:0xfc4b5040
y.create.l HWIO_SPDM_VMIDMT_SGFSR_ADDR A:0xfc4b5048
y.create.l HWIO_SPDM_VMIDMT_SGFSRRESTORE_ADDR A:0xfc4b504c
y.create.l HWIO_SPDM_VMIDMT_SGFSYNDR0_ADDR A:0xfc4b5050
y.create.l HWIO_SPDM_VMIDMT_SGFSYNDR1_ADDR A:0xfc4b5054
y.create.l HWIO_SPDM_VMIDMT_SGFSYNDR2_ADDR A:0xfc4b5058
y.create.l HWIO_SPDM_VMIDMT_VMIDMTSCR0_ADDR A:0xfc4b5090
y.create.l HWIO_SPDM_VMIDMT_CR0_ADDR A:0xfc4b5000
y.create.l HWIO_SPDM_VMIDMT_CR2_ADDR A:0xfc4b5008
y.create.l HWIO_SPDM_VMIDMT_ACR_ADDR A:0xfc4b5010
y.create.l HWIO_SPDM_VMIDMT_IDR0_ADDR A:0xfc4b5020
y.create.l HWIO_SPDM_VMIDMT_IDR1_ADDR A:0xfc4b5024
y.create.l HWIO_SPDM_VMIDMT_IDR2_ADDR A:0xfc4b5028
y.create.l HWIO_SPDM_VMIDMT_IDR4_ADDR A:0xfc4b5030
y.create.l HWIO_SPDM_VMIDMT_IDR5_ADDR A:0xfc4b5034
y.create.l HWIO_SPDM_VMIDMT_IDR7_ADDR A:0xfc4b503c
y.create.l HWIO_SPDM_VMIDMT_GFAR0_ADDR A:0xfc4b5040
y.create.l HWIO_SPDM_VMIDMT_GFSR_ADDR A:0xfc4b5048
y.create.l HWIO_SPDM_VMIDMT_GFSRRESTORE_ADDR A:0xfc4b504c
y.create.l HWIO_SPDM_VMIDMT_GFSYNDR0_ADDR A:0xfc4b5050
y.create.l HWIO_SPDM_VMIDMT_GFSYNDR1_ADDR A:0xfc4b5054
y.create.l HWIO_SPDM_VMIDMT_GFSYNDR2_ADDR A:0xfc4b5058
y.create.l HWIO_SPDM_VMIDMT_VMIDMTCR0_ADDR A:0xfc4b5090
y.create.l HWIO_SPDM_VMIDMT_VMIDMTACR_ADDR A:0xfc4b509c
y.create.l HWIO_SPDM_VMIDMT_NSCR0_ADDR A:0xfc4b5400
y.create.l HWIO_SPDM_VMIDMT_NSCR2_ADDR A:0xfc4b5408
y.create.l HWIO_SPDM_VMIDMT_NSACR_ADDR A:0xfc4b5410
y.create.l HWIO_SPDM_VMIDMT_NSGFAR0_ADDR A:0xfc4b5440
y.create.l HWIO_SPDM_VMIDMT_NSGFSR_ADDR A:0xfc4b5448
y.create.l HWIO_SPDM_VMIDMT_NSGFSRRESTORE_ADDR A:0xfc4b544c
y.create.l HWIO_SPDM_VMIDMT_NSGFSYNDR0_ADDR A:0xfc4b5450
y.create.l HWIO_SPDM_VMIDMT_NSGFSYNDR1_ADDR A:0xfc4b5454
y.create.l HWIO_SPDM_VMIDMT_NSGFSYNDR2_ADDR A:0xfc4b5458
y.create.l HWIO_SPDM_VMIDMT_NSVMIDMTCR0_ADDR A:0xfc4b5490
y.create.l HWIO_SPDM_VMIDMT_SSDR0_ADDR A:0xfc4b5080
y.create.l HWIO_SPDM_VMIDMT_S2VR0_ADDR A:0xfc4b5c00
y.create.l HWIO_SPDM_VMIDMT_AS2VR0_ADDR A:0xfc4b5e00
y.create.l HWIO_SNOC_OBS_ID_COREID_ADDR A:0xfc460000
y.create.l HWIO_SNOC_OBS_ID_REVISIONID_ADDR A:0xfc460004
y.create.l HWIO_SNOC_OBS_FAULTEN_ADDR A:0xfc460008
y.create.l HWIO_SNOC_OBS_ERRVLD_ADDR A:0xfc46000c
y.create.l HWIO_SNOC_OBS_ERRCLR_ADDR A:0xfc460010
y.create.l HWIO_SNOC_OBS_ERRLOG0_ADDR A:0xfc460014
y.create.l HWIO_SNOC_OBS_ERRLOG1_ADDR A:0xfc460018
y.create.l HWIO_SNOC_OBS_ERRLOG3_ADDR A:0xfc460020
y.create.l HWIO_SNOC_OBS_ERRLOG4_ADDR A:0xfc460024
y.create.l HWIO_SNOC_OBS_ERRLOG5_ADDR A:0xfc460028
y.create.l HWIO_SNOC_OBS_DBG_ID_COREID_ADDR A:0xfc460080
y.create.l HWIO_SNOC_OBS_DBG_ID_REVISIONID_ADDR A:0xfc460084
y.create.l HWIO_SNOC_OBS_DBG_ATBID_ADDR A:0xfc460088
y.create.l HWIO_SNOC_OBS_DBG_ATBEN_ADDR A:0xfc46008c
y.create.l HWIO_SNOC_OBS_DBG_SYNCPERIOD_ADDR A:0xfc460090
y.create.l HWIO_SNOC_QXM_LPASS_CORE_TFILT_ID_COREID_ADDR A:0xfc461000
y.create.l HWIO_SNOC_QXM_LPASS_CORE_TFILT_ID_REVISIONID_ADDR A:0xfc461004
y.create.l HWIO_SNOC_QXM_LPASS_CORE_TFILT_MODE_ADDR A:0xfc461008
y.create.l HWIO_SNOC_QXM_LPASS_CORE_TFILT_ADDRBASE_LOW_ADDR A:0xfc46100c
y.create.l HWIO_SNOC_QXM_LPASS_CORE_TFILT_ADDRBASE_HIGH_ADDR A:0xfc461010
y.create.l HWIO_SNOC_QXM_LPASS_CORE_TFILT_ADDRWINDOWSIZE_ADDR A:0xfc461014
y.create.l HWIO_SNOC_QXM_LPASS_CORE_TFILT_SRCIDBASE_ADDR A:0xfc461018
y.create.l HWIO_SNOC_QXM_LPASS_CORE_TFILT_SRCIDMASK_ADDR A:0xfc46101c
y.create.l HWIO_SNOC_QXM_LPASS_CORE_TFILT_OPCODE_ADDR A:0xfc461020
y.create.l HWIO_SNOC_QXM_LPASS_CORE_TFILT_USERBASE_ADDR A:0xfc461024
y.create.l HWIO_SNOC_QXM_LPASS_CORE_TFILT_USERMASK_ADDR A:0xfc461028
y.create.l HWIO_SNOC_QDSS_BAM_TFILT_ID_COREID_ADDR A:0xfc461080
y.create.l HWIO_SNOC_QDSS_BAM_TFILT_ID_REVISIONID_ADDR A:0xfc461084
y.create.l HWIO_SNOC_QDSS_BAM_TFILT_MODE_ADDR A:0xfc461088
y.create.l HWIO_SNOC_QDSS_BAM_TFILT_ADDRBASE_LOW_ADDR A:0xfc46108c
y.create.l HWIO_SNOC_QDSS_BAM_TFILT_ADDRWINDOWSIZE_ADDR A:0xfc461094
y.create.l HWIO_SNOC_QDSS_BAM_TFILT_SRCIDBASE_ADDR A:0xfc461098
y.create.l HWIO_SNOC_QDSS_BAM_TFILT_SRCIDMASK_ADDR A:0xfc46109c
y.create.l HWIO_SNOC_QDSS_BAM_TFILT_OPCODE_ADDR A:0xfc4610a0
y.create.l HWIO_SNOC_QDSS_BAM_TFILT_USERBASE_ADDR A:0xfc4610a4
y.create.l HWIO_SNOC_QDSS_BAM_TFILT_USERMASK_ADDR A:0xfc4610a8
y.create.l HWIO_SNOC_CRYPTO0_TFILT_ID_COREID_ADDR A:0xfc461100
y.create.l HWIO_SNOC_CRYPTO0_TFILT_ID_REVISIONID_ADDR A:0xfc461104
y.create.l HWIO_SNOC_CRYPTO0_TFILT_MODE_ADDR A:0xfc461108
y.create.l HWIO_SNOC_CRYPTO0_TFILT_ADDRBASE_LOW_ADDR A:0xfc46110c
y.create.l HWIO_SNOC_CRYPTO0_TFILT_ADDRBASE_HIGH_ADDR A:0xfc461110
y.create.l HWIO_SNOC_CRYPTO0_TFILT_ADDRWINDOWSIZE_ADDR A:0xfc461114
y.create.l HWIO_SNOC_CRYPTO0_TFILT_SRCIDBASE_ADDR A:0xfc461118
y.create.l HWIO_SNOC_CRYPTO0_TFILT_SRCIDMASK_ADDR A:0xfc46111c
y.create.l HWIO_SNOC_CRYPTO0_TFILT_OPCODE_ADDR A:0xfc461120
y.create.l HWIO_SNOC_CRYPTO0_TFILT_USERBASE_ADDR A:0xfc461124
y.create.l HWIO_SNOC_CRYPTO0_TFILT_USERMASK_ADDR A:0xfc461128
y.create.l HWIO_SNOC_QXM_LPASS_Q6_TFILT_ID_COREID_ADDR A:0xfc461200
y.create.l HWIO_SNOC_QXM_LPASS_Q6_TFILT_ID_REVISIONID_ADDR A:0xfc461204
y.create.l HWIO_SNOC_QXM_LPASS_Q6_TFILT_MODE_ADDR A:0xfc461208
y.create.l HWIO_SNOC_QXM_LPASS_Q6_TFILT_ADDRBASE_LOW_ADDR A:0xfc46120c
y.create.l HWIO_SNOC_QXM_LPASS_Q6_TFILT_ADDRBASE_HIGH_ADDR A:0xfc461210
y.create.l HWIO_SNOC_QXM_LPASS_Q6_TFILT_ADDRWINDOWSIZE_ADDR A:0xfc461214
y.create.l HWIO_SNOC_QXM_LPASS_Q6_TFILT_SRCIDBASE_ADDR A:0xfc461218
y.create.l HWIO_SNOC_QXM_LPASS_Q6_TFILT_SRCIDMASK_ADDR A:0xfc46121c
y.create.l HWIO_SNOC_QXM_LPASS_Q6_TFILT_OPCODE_ADDR A:0xfc461220
y.create.l HWIO_SNOC_QXM_LPASS_Q6_TFILT_USERBASE_ADDR A:0xfc461224
y.create.l HWIO_SNOC_QXM_LPASS_Q6_TFILT_USERMASK_ADDR A:0xfc461228
y.create.l HWIO_SNOC_MSS_TFILT_ID_COREID_ADDR A:0xfc461280
y.create.l HWIO_SNOC_MSS_TFILT_ID_REVISIONID_ADDR A:0xfc461284
y.create.l HWIO_SNOC_MSS_TFILT_MODE_ADDR A:0xfc461288
y.create.l HWIO_SNOC_MSS_TFILT_ADDRBASE_LOW_ADDR A:0xfc46128c
y.create.l HWIO_SNOC_MSS_TFILT_ADDRBASE_HIGH_ADDR A:0xfc461290
y.create.l HWIO_SNOC_MSS_TFILT_ADDRWINDOWSIZE_ADDR A:0xfc461294
y.create.l HWIO_SNOC_MSS_TFILT_SRCIDBASE_ADDR A:0xfc461298
y.create.l HWIO_SNOC_MSS_TFILT_SRCIDMASK_ADDR A:0xfc46129c
y.create.l HWIO_SNOC_MSS_TFILT_OPCODE_ADDR A:0xfc4612a0
y.create.l HWIO_SNOC_MSS_TFILT_USERBASE_ADDR A:0xfc4612a4
y.create.l HWIO_SNOC_MSS_TFILT_USERMASK_ADDR A:0xfc4612a8
y.create.l HWIO_SNOC_MSS_NAV_TFILT_ID_COREID_ADDR A:0xfc461300
y.create.l HWIO_SNOC_MSS_NAV_TFILT_ID_REVISIONID_ADDR A:0xfc461304
y.create.l HWIO_SNOC_MSS_NAV_TFILT_MODE_ADDR A:0xfc461308
y.create.l HWIO_SNOC_MSS_NAV_TFILT_ADDRBASE_LOW_ADDR A:0xfc46130c
y.create.l HWIO_SNOC_MSS_NAV_TFILT_ADDRBASE_HIGH_ADDR A:0xfc461310
y.create.l HWIO_SNOC_MSS_NAV_TFILT_ADDRWINDOWSIZE_ADDR A:0xfc461314
y.create.l HWIO_SNOC_MSS_NAV_TFILT_SRCIDBASE_ADDR A:0xfc461318
y.create.l HWIO_SNOC_MSS_NAV_TFILT_SRCIDMASK_ADDR A:0xfc46131c
y.create.l HWIO_SNOC_MSS_NAV_TFILT_OPCODE_ADDR A:0xfc461320
y.create.l HWIO_SNOC_MSS_NAV_TFILT_USERBASE_ADDR A:0xfc461324
y.create.l HWIO_SNOC_MSS_NAV_TFILT_USERMASK_ADDR A:0xfc461328
y.create.l HWIO_SNOC_QXM_IPA_TFILT_ID_COREID_ADDR A:0xfc461380
y.create.l HWIO_SNOC_QXM_IPA_TFILT_ID_REVISIONID_ADDR A:0xfc461384
y.create.l HWIO_SNOC_QXM_IPA_TFILT_MODE_ADDR A:0xfc461388
y.create.l HWIO_SNOC_QXM_IPA_TFILT_ADDRBASE_LOW_ADDR A:0xfc46138c
y.create.l HWIO_SNOC_QXM_IPA_TFILT_ADDRBASE_HIGH_ADDR A:0xfc461390
y.create.l HWIO_SNOC_QXM_IPA_TFILT_ADDRWINDOWSIZE_ADDR A:0xfc461394
y.create.l HWIO_SNOC_QXM_IPA_TFILT_SRCIDBASE_ADDR A:0xfc461398
y.create.l HWIO_SNOC_QXM_IPA_TFILT_SRCIDMASK_ADDR A:0xfc46139c
y.create.l HWIO_SNOC_QXM_IPA_TFILT_OPCODE_ADDR A:0xfc4613a0
y.create.l HWIO_SNOC_QXM_IPA_TFILT_USERBASE_ADDR A:0xfc4613a4
y.create.l HWIO_SNOC_QXM_IPA_TFILT_USERMASK_ADDR A:0xfc4613a8
y.create.l HWIO_SNOC_PNOC_TFILT_ID_COREID_ADDR A:0xfc461400
y.create.l HWIO_SNOC_PNOC_TFILT_ID_REVISIONID_ADDR A:0xfc461404
y.create.l HWIO_SNOC_PNOC_TFILT_MODE_ADDR A:0xfc461408
y.create.l HWIO_SNOC_PNOC_TFILT_ADDRBASE_LOW_ADDR A:0xfc46140c
y.create.l HWIO_SNOC_PNOC_TFILT_ADDRBASE_HIGH_ADDR A:0xfc461410
y.create.l HWIO_SNOC_PNOC_TFILT_ADDRWINDOWSIZE_ADDR A:0xfc461414
y.create.l HWIO_SNOC_PNOC_TFILT_SRCIDBASE_ADDR A:0xfc461418
y.create.l HWIO_SNOC_PNOC_TFILT_SRCIDMASK_ADDR A:0xfc46141c
y.create.l HWIO_SNOC_PNOC_TFILT_OPCODE_ADDR A:0xfc461420
y.create.l HWIO_SNOC_PNOC_TFILT_USERBASE_ADDR A:0xfc461424
y.create.l HWIO_SNOC_PNOC_TFILT_USERMASK_ADDR A:0xfc461428
y.create.l HWIO_SNOC_USB3_TFILT_ID_COREID_ADDR A:0xfc461480
y.create.l HWIO_SNOC_USB3_TFILT_ID_REVISIONID_ADDR A:0xfc461484
y.create.l HWIO_SNOC_USB3_TFILT_MODE_ADDR A:0xfc461488
y.create.l HWIO_SNOC_USB3_TFILT_ADDRBASE_LOW_ADDR A:0xfc46148c
y.create.l HWIO_SNOC_USB3_TFILT_ADDRWINDOWSIZE_ADDR A:0xfc461494
y.create.l HWIO_SNOC_USB3_TFILT_SRCIDBASE_ADDR A:0xfc461498
y.create.l HWIO_SNOC_USB3_TFILT_SRCIDMASK_ADDR A:0xfc46149c
y.create.l HWIO_SNOC_USB3_TFILT_OPCODE_ADDR A:0xfc4614a0
y.create.l HWIO_SNOC_USB3_TFILT_USERBASE_ADDR A:0xfc4614a4
y.create.l HWIO_SNOC_USB3_TFILT_USERMASK_ADDR A:0xfc4614a8
y.create.l HWIO_SNOC_QDSS_ETR_TFILT_ID_COREID_ADDR A:0xfc461500
y.create.l HWIO_SNOC_QDSS_ETR_TFILT_ID_REVISIONID_ADDR A:0xfc461504
y.create.l HWIO_SNOC_QDSS_ETR_TFILT_MODE_ADDR A:0xfc461508
y.create.l HWIO_SNOC_QDSS_ETR_TFILT_ADDRBASE_LOW_ADDR A:0xfc46150c
y.create.l HWIO_SNOC_QDSS_ETR_TFILT_ADDRWINDOWSIZE_ADDR A:0xfc461514
y.create.l HWIO_SNOC_QDSS_ETR_TFILT_SRCIDBASE_ADDR A:0xfc461518
y.create.l HWIO_SNOC_QDSS_ETR_TFILT_SRCIDMASK_ADDR A:0xfc46151c
y.create.l HWIO_SNOC_QDSS_ETR_TFILT_OPCODE_ADDR A:0xfc461520
y.create.l HWIO_SNOC_QDSS_ETR_TFILT_USERBASE_ADDR A:0xfc461524
y.create.l HWIO_SNOC_QDSS_ETR_TFILT_USERMASK_ADDR A:0xfc461528
y.create.l HWIO_SNOC_PCIE_TFILT_ID_COREID_ADDR A:0xfc461580
y.create.l HWIO_SNOC_PCIE_TFILT_ID_REVISIONID_ADDR A:0xfc461584
y.create.l HWIO_SNOC_PCIE_TFILT_MODE_ADDR A:0xfc461588
y.create.l HWIO_SNOC_PCIE_TFILT_ADDRBASE_LOW_ADDR A:0xfc46158c
y.create.l HWIO_SNOC_PCIE_TFILT_ADDRWINDOWSIZE_ADDR A:0xfc461594
y.create.l HWIO_SNOC_PCIE_TFILT_SRCIDBASE_ADDR A:0xfc461598
y.create.l HWIO_SNOC_PCIE_TFILT_SRCIDMASK_ADDR A:0xfc46159c
y.create.l HWIO_SNOC_PCIE_TFILT_OPCODE_ADDR A:0xfc4615a0
y.create.l HWIO_SNOC_PCIE_TFILT_USERBASE_ADDR A:0xfc4615a4
y.create.l HWIO_SNOC_PCIE_TFILT_USERMASK_ADDR A:0xfc4615a8
y.create.l HWIO_SNOC_TPRB0_TPROF_ID_COREID_ADDR A:0xfc461600
y.create.l HWIO_SNOC_TPRB0_TPROF_ID_REVISIONID_ADDR A:0xfc461604
y.create.l HWIO_SNOC_TPRB0_TPROF_EN_ADDR A:0xfc461608
y.create.l HWIO_SNOC_TPRB0_TPROF_MODE_ADDR A:0xfc46160c
y.create.l HWIO_SNOC_TPRB0_TPROF_OBSERVEDSEL_0_ADDR A:0xfc461610
y.create.l HWIO_SNOC_TPRB0_TPROF_OBSERVEDSEL_1_ADDR A:0xfc461614
y.create.l HWIO_SNOC_TPRB0_TPROF_NTENURELINES_0_ADDR A:0xfc461620
y.create.l HWIO_SNOC_TPRB0_TPROF_THRESHOLDS_0_0_ADDR A:0xfc46162c
y.create.l HWIO_SNOC_TPRB0_TPROF_THRESHOLDS_0_1_ADDR A:0xfc461630
y.create.l HWIO_SNOC_TPRB0_TPROF_THRESHOLDS_0_2_ADDR A:0xfc461634
y.create.l HWIO_SNOC_TPRB0_TPROF_THRESHOLDS_1_0_ADDR A:0xfc46163c
y.create.l HWIO_SNOC_TPRB0_TPROF_THRESHOLDS_1_1_ADDR A:0xfc461640
y.create.l HWIO_SNOC_TPRB0_TPROF_THRESHOLDS_1_2_ADDR A:0xfc461644
y.create.l HWIO_SNOC_TPRB0_TPROF_OVERFLOWSTATUS_ADDR A:0xfc46166c
y.create.l HWIO_SNOC_TPRB0_TPROF_OVERFLOWRESET_ADDR A:0xfc461670
y.create.l HWIO_SNOC_TPRB0_TPROF_PENDINGEVENTMODE_ADDR A:0xfc461674
y.create.l HWIO_SNOC_TPRB0_TPROF_PRESCALER_ADDR A:0xfc461678
y.create.l HWIO_SNOC_TPRB1_TPROF_ID_COREID_ADDR A:0xfc461680
y.create.l HWIO_SNOC_TPRB1_TPROF_ID_REVISIONID_ADDR A:0xfc461684
y.create.l HWIO_SNOC_TPRB1_TPROF_EN_ADDR A:0xfc461688
y.create.l HWIO_SNOC_TPRB1_TPROF_MODE_ADDR A:0xfc46168c
y.create.l HWIO_SNOC_TPRB1_TPROF_OBSERVEDSEL_0_ADDR A:0xfc461690
y.create.l HWIO_SNOC_TPRB1_TPROF_OBSERVEDSEL_1_ADDR A:0xfc461694
y.create.l HWIO_SNOC_TPRB1_TPROF_NTENURELINES_0_ADDR A:0xfc4616a0
y.create.l HWIO_SNOC_TPRB1_TPROF_THRESHOLDS_0_0_ADDR A:0xfc4616ac
y.create.l HWIO_SNOC_TPRB1_TPROF_THRESHOLDS_0_1_ADDR A:0xfc4616b0
y.create.l HWIO_SNOC_TPRB1_TPROF_THRESHOLDS_0_2_ADDR A:0xfc4616b4
y.create.l HWIO_SNOC_TPRB1_TPROF_THRESHOLDS_1_0_ADDR A:0xfc4616bc
y.create.l HWIO_SNOC_TPRB1_TPROF_THRESHOLDS_1_1_ADDR A:0xfc4616c0
y.create.l HWIO_SNOC_TPRB1_TPROF_THRESHOLDS_1_2_ADDR A:0xfc4616c4
y.create.l HWIO_SNOC_TPRB1_TPROF_OVERFLOWSTATUS_ADDR A:0xfc4616ec
y.create.l HWIO_SNOC_TPRB1_TPROF_OVERFLOWRESET_ADDR A:0xfc4616f0
y.create.l HWIO_SNOC_TPRB1_TPROF_PENDINGEVENTMODE_ADDR A:0xfc4616f4
y.create.l HWIO_SNOC_TPRB1_TPROF_PRESCALER_ADDR A:0xfc4616f8
y.create.l HWIO_SNOC_TPRB2_TPROF_ID_COREID_ADDR A:0xfc461700
y.create.l HWIO_SNOC_TPRB2_TPROF_ID_REVISIONID_ADDR A:0xfc461704
y.create.l HWIO_SNOC_TPRB2_TPROF_EN_ADDR A:0xfc461708
y.create.l HWIO_SNOC_TPRB2_TPROF_MODE_ADDR A:0xfc46170c
y.create.l HWIO_SNOC_TPRB2_TPROF_OBSERVEDSEL_0_ADDR A:0xfc461710
y.create.l HWIO_SNOC_TPRB2_TPROF_OBSERVEDSEL_1_ADDR A:0xfc461714
y.create.l HWIO_SNOC_TPRB2_TPROF_NTENURELINES_0_ADDR A:0xfc461720
y.create.l HWIO_SNOC_TPRB2_TPROF_THRESHOLDS_0_0_ADDR A:0xfc46172c
y.create.l HWIO_SNOC_TPRB2_TPROF_THRESHOLDS_0_1_ADDR A:0xfc461730
y.create.l HWIO_SNOC_TPRB2_TPROF_THRESHOLDS_0_2_ADDR A:0xfc461734
y.create.l HWIO_SNOC_TPRB2_TPROF_THRESHOLDS_1_0_ADDR A:0xfc46173c
y.create.l HWIO_SNOC_TPRB2_TPROF_THRESHOLDS_1_1_ADDR A:0xfc461740
y.create.l HWIO_SNOC_TPRB2_TPROF_THRESHOLDS_1_2_ADDR A:0xfc461744
y.create.l HWIO_SNOC_TPRB2_TPROF_OVERFLOWSTATUS_ADDR A:0xfc46176c
y.create.l HWIO_SNOC_TPRB2_TPROF_OVERFLOWRESET_ADDR A:0xfc461770
y.create.l HWIO_SNOC_TPRB2_TPROF_PENDINGEVENTMODE_ADDR A:0xfc461774
y.create.l HWIO_SNOC_TPRB2_TPROF_PRESCALER_ADDR A:0xfc461778
y.create.l HWIO_SNOC_TPRB3_TPROF_ID_COREID_ADDR A:0xfc461780
y.create.l HWIO_SNOC_TPRB3_TPROF_ID_REVISIONID_ADDR A:0xfc461784
y.create.l HWIO_SNOC_TPRB3_TPROF_EN_ADDR A:0xfc461788
y.create.l HWIO_SNOC_TPRB3_TPROF_MODE_ADDR A:0xfc46178c
y.create.l HWIO_SNOC_TPRB3_TPROF_OBSERVEDSEL_0_ADDR A:0xfc461790
y.create.l HWIO_SNOC_TPRB3_TPROF_OBSERVEDSEL_1_ADDR A:0xfc461794
y.create.l HWIO_SNOC_TPRB3_TPROF_NTENURELINES_0_ADDR A:0xfc4617a0
y.create.l HWIO_SNOC_TPRB3_TPROF_THRESHOLDS_0_0_ADDR A:0xfc4617ac
y.create.l HWIO_SNOC_TPRB3_TPROF_THRESHOLDS_0_1_ADDR A:0xfc4617b0
y.create.l HWIO_SNOC_TPRB3_TPROF_THRESHOLDS_0_2_ADDR A:0xfc4617b4
y.create.l HWIO_SNOC_TPRB3_TPROF_THRESHOLDS_1_0_ADDR A:0xfc4617bc
y.create.l HWIO_SNOC_TPRB3_TPROF_THRESHOLDS_1_1_ADDR A:0xfc4617c0
y.create.l HWIO_SNOC_TPRB3_TPROF_THRESHOLDS_1_2_ADDR A:0xfc4617c4
y.create.l HWIO_SNOC_TPRB3_TPROF_OVERFLOWSTATUS_ADDR A:0xfc4617ec
y.create.l HWIO_SNOC_TPRB3_TPROF_OVERFLOWRESET_ADDR A:0xfc4617f0
y.create.l HWIO_SNOC_TPRB3_TPROF_PENDINGEVENTMODE_ADDR A:0xfc4617f4
y.create.l HWIO_SNOC_TPRB3_TPROF_PRESCALER_ADDR A:0xfc4617f8
y.create.l HWIO_SNOC_EPRB0_SPROF_ID_COREID_ADDR A:0xfc461800
y.create.l HWIO_SNOC_EPRB0_SPROF_ID_REVISIONID_ADDR A:0xfc461804
y.create.l HWIO_SNOC_EPRB0_SPROF_MAINCTL_ADDR A:0xfc461808
y.create.l HWIO_SNOC_EPRB0_SPROF_CFGCTL_ADDR A:0xfc46180c
y.create.l HWIO_SNOC_EPRB0_SPROF_TRACEPORTSEL_ADDR A:0xfc461810
y.create.l HWIO_SNOC_EPRB0_SPROF_FILTERLUT_ADDR A:0xfc461814
y.create.l HWIO_SNOC_EPRB0_SPROF_TRACEALARMEN_ADDR A:0xfc461818
y.create.l HWIO_SNOC_EPRB0_SPROF_TRACEALARMSTATUS_ADDR A:0xfc46181c
y.create.l HWIO_SNOC_EPRB0_SPROF_TRACEALARMCLR_ADDR A:0xfc461820
y.create.l HWIO_SNOC_EPRB0_SPROF_STATPERIOD_ADDR A:0xfc461824
y.create.l HWIO_SNOC_EPRB0_SPROF_STATGO_ADDR A:0xfc461828
y.create.l HWIO_SNOC_EPRB0_SPROF_STATALARMMIN_ADDR A:0xfc46182c
y.create.l HWIO_SNOC_EPRB0_SPROF_STATALARMMAX_ADDR A:0xfc461830
y.create.l HWIO_SNOC_EPRB0_SPROF_STATALARMSTATUS_ADDR A:0xfc461834
y.create.l HWIO_SNOC_EPRB0_SPROF_STATALARMCLR_ADDR A:0xfc461838
y.create.l HWIO_SNOC_EPRB0_SPROF_FILTERS_0_ROUTEIDBASE_ADDR A:0xfc461844
y.create.l HWIO_SNOC_EPRB0_SPROF_FILTERS_0_ROUTEIDMASK_ADDR A:0xfc461848
y.create.l HWIO_SNOC_EPRB0_SPROF_FILTERS_0_ADDRBASE_LOW_ADDR A:0xfc46184c
y.create.l HWIO_SNOC_EPRB0_SPROF_FILTERS_0_ADDRBASE_HIGH_ADDR A:0xfc461850
y.create.l HWIO_SNOC_EPRB0_SPROF_FILTERS_0_WINDOWSIZE_ADDR A:0xfc461854
y.create.l HWIO_SNOC_EPRB0_SPROF_FILTERS_0_OPCODE_ADDR A:0xfc461860
y.create.l HWIO_SNOC_EPRB0_SPROF_FILTERS_0_STATUS_ADDR A:0xfc461864
y.create.l HWIO_SNOC_EPRB0_SPROF_FILTERS_0_LENGTH_ADDR A:0xfc461868
y.create.l HWIO_SNOC_EPRB0_SPROF_FILTERS_0_URGENCY_ADDR A:0xfc46186c
y.create.l HWIO_SNOC_EPRB0_SPROF_FILTERS_1_ROUTEIDBASE_ADDR A:0xfc461880
y.create.l HWIO_SNOC_EPRB0_SPROF_FILTERS_1_ROUTEIDMASK_ADDR A:0xfc461884
y.create.l HWIO_SNOC_EPRB0_SPROF_FILTERS_1_ADDRBASE_LOW_ADDR A:0xfc461888
y.create.l HWIO_SNOC_EPRB0_SPROF_FILTERS_1_ADDRBASE_HIGH_ADDR A:0xfc46188c
y.create.l HWIO_SNOC_EPRB0_SPROF_FILTERS_1_WINDOWSIZE_ADDR A:0xfc461890
y.create.l HWIO_SNOC_EPRB0_SPROF_FILTERS_1_OPCODE_ADDR A:0xfc46189c
y.create.l HWIO_SNOC_EPRB0_SPROF_FILTERS_1_STATUS_ADDR A:0xfc4618a0
y.create.l HWIO_SNOC_EPRB0_SPROF_FILTERS_1_LENGTH_ADDR A:0xfc4618a4
y.create.l HWIO_SNOC_EPRB0_SPROF_FILTERS_1_URGENCY_ADDR A:0xfc4618a8
y.create.l HWIO_SNOC_EPRB0_SPROF_FILTERS_2_ROUTEIDBASE_ADDR A:0xfc4618bc
y.create.l HWIO_SNOC_EPRB0_SPROF_FILTERS_2_ROUTEIDMASK_ADDR A:0xfc4618c0
y.create.l HWIO_SNOC_EPRB0_SPROF_FILTERS_2_ADDRBASE_LOW_ADDR A:0xfc4618c4
y.create.l HWIO_SNOC_EPRB0_SPROF_FILTERS_2_ADDRBASE_HIGH_ADDR A:0xfc4618c8
y.create.l HWIO_SNOC_EPRB0_SPROF_FILTERS_2_WINDOWSIZE_ADDR A:0xfc4618cc
y.create.l HWIO_SNOC_EPRB0_SPROF_FILTERS_2_OPCODE_ADDR A:0xfc4618d8
y.create.l HWIO_SNOC_EPRB0_SPROF_FILTERS_2_STATUS_ADDR A:0xfc4618dc
y.create.l HWIO_SNOC_EPRB0_SPROF_FILTERS_2_LENGTH_ADDR A:0xfc4618e0
y.create.l HWIO_SNOC_EPRB0_SPROF_FILTERS_2_URGENCY_ADDR A:0xfc4618e4
y.create.l HWIO_SNOC_EPRB0_SPROF_FILTERS_3_ROUTEIDBASE_ADDR A:0xfc4618f8
y.create.l HWIO_SNOC_EPRB0_SPROF_FILTERS_3_ROUTEIDMASK_ADDR A:0xfc4618fc
y.create.l HWIO_SNOC_EPRB0_SPROF_FILTERS_3_ADDRBASE_LOW_ADDR A:0xfc461900
y.create.l HWIO_SNOC_EPRB0_SPROF_FILTERS_3_ADDRBASE_HIGH_ADDR A:0xfc461904
y.create.l HWIO_SNOC_EPRB0_SPROF_FILTERS_3_WINDOWSIZE_ADDR A:0xfc461908
y.create.l HWIO_SNOC_EPRB0_SPROF_FILTERS_3_OPCODE_ADDR A:0xfc461914
y.create.l HWIO_SNOC_EPRB0_SPROF_FILTERS_3_STATUS_ADDR A:0xfc461918
y.create.l HWIO_SNOC_EPRB0_SPROF_FILTERS_3_LENGTH_ADDR A:0xfc46191c
y.create.l HWIO_SNOC_EPRB0_SPROF_FILTERS_3_URGENCY_ADDR A:0xfc461920
y.create.l HWIO_SNOC_EPRB0_SPROF_COUNTERS_0_PORTSEL_ADDR A:0xfc461934
y.create.l HWIO_SNOC_EPRB0_SPROF_COUNTERS_0_SRC_ADDR A:0xfc461938
y.create.l HWIO_SNOC_EPRB0_SPROF_COUNTERS_0_ALARMMODE_ADDR A:0xfc46193c
y.create.l HWIO_SNOC_EPRB0_SPROF_COUNTERS_0_VAL_ADDR A:0xfc461940
y.create.l HWIO_SNOC_EPRB0_SPROF_COUNTERS_1_PORTSEL_ADDR A:0xfc461948
y.create.l HWIO_SNOC_EPRB0_SPROF_COUNTERS_1_SRC_ADDR A:0xfc46194c
y.create.l HWIO_SNOC_EPRB0_SPROF_COUNTERS_1_ALARMMODE_ADDR A:0xfc461950
y.create.l HWIO_SNOC_EPRB0_SPROF_COUNTERS_1_VAL_ADDR A:0xfc461954
y.create.l HWIO_SNOC_EPRB0_SPROF_COUNTERS_2_PORTSEL_ADDR A:0xfc46195c
y.create.l HWIO_SNOC_EPRB0_SPROF_COUNTERS_2_SRC_ADDR A:0xfc461960
y.create.l HWIO_SNOC_EPRB0_SPROF_COUNTERS_2_ALARMMODE_ADDR A:0xfc461964
y.create.l HWIO_SNOC_EPRB0_SPROF_COUNTERS_2_VAL_ADDR A:0xfc461968
y.create.l HWIO_SNOC_EPRB0_SPROF_COUNTERS_3_PORTSEL_ADDR A:0xfc461970
y.create.l HWIO_SNOC_EPRB0_SPROF_COUNTERS_3_SRC_ADDR A:0xfc461974
y.create.l HWIO_SNOC_EPRB0_SPROF_COUNTERS_3_ALARMMODE_ADDR A:0xfc461978
y.create.l HWIO_SNOC_EPRB0_SPROF_COUNTERS_3_VAL_ADDR A:0xfc46197c
y.create.l HWIO_SNOC_EPRB0_SPROF_COUNTERS_4_PORTSEL_ADDR A:0xfc461984
y.create.l HWIO_SNOC_EPRB0_SPROF_COUNTERS_4_SRC_ADDR A:0xfc461988
y.create.l HWIO_SNOC_EPRB0_SPROF_COUNTERS_4_ALARMMODE_ADDR A:0xfc46198c
y.create.l HWIO_SNOC_EPRB0_SPROF_COUNTERS_4_VAL_ADDR A:0xfc461990
y.create.l HWIO_SNOC_EPRB0_SPROF_COUNTERS_5_PORTSEL_ADDR A:0xfc461998
y.create.l HWIO_SNOC_EPRB0_SPROF_COUNTERS_5_SRC_ADDR A:0xfc46199c
y.create.l HWIO_SNOC_EPRB0_SPROF_COUNTERS_5_ALARMMODE_ADDR A:0xfc4619a0
y.create.l HWIO_SNOC_EPRB0_SPROF_COUNTERS_5_VAL_ADDR A:0xfc4619a4
y.create.l HWIO_SNOC_EPRB0_SPROF_COUNTERS_6_PORTSEL_ADDR A:0xfc4619ac
y.create.l HWIO_SNOC_EPRB0_SPROF_COUNTERS_6_SRC_ADDR A:0xfc4619b0
y.create.l HWIO_SNOC_EPRB0_SPROF_COUNTERS_6_ALARMMODE_ADDR A:0xfc4619b4
y.create.l HWIO_SNOC_EPRB0_SPROF_COUNTERS_6_VAL_ADDR A:0xfc4619b8
y.create.l HWIO_SNOC_EPRB0_SPROF_COUNTERS_7_PORTSEL_ADDR A:0xfc4619c0
y.create.l HWIO_SNOC_EPRB0_SPROF_COUNTERS_7_SRC_ADDR A:0xfc4619c4
y.create.l HWIO_SNOC_EPRB0_SPROF_COUNTERS_7_ALARMMODE_ADDR A:0xfc4619c8
y.create.l HWIO_SNOC_EPRB0_SPROF_COUNTERS_7_VAL_ADDR A:0xfc4619cc
y.create.l HWIO_SNOC_EPRB0_SPROF_COUNTERS_8_PORTSEL_ADDR A:0xfc4619d4
y.create.l HWIO_SNOC_EPRB0_SPROF_COUNTERS_8_SRC_ADDR A:0xfc4619d8
y.create.l HWIO_SNOC_EPRB0_SPROF_COUNTERS_8_ALARMMODE_ADDR A:0xfc4619dc
y.create.l HWIO_SNOC_EPRB0_SPROF_COUNTERS_8_VAL_ADDR A:0xfc4619e0
y.create.l HWIO_SNOC_EPRB0_SPROF_COUNTERS_9_PORTSEL_ADDR A:0xfc4619e8
y.create.l HWIO_SNOC_EPRB0_SPROF_COUNTERS_9_SRC_ADDR A:0xfc4619ec
y.create.l HWIO_SNOC_EPRB0_SPROF_COUNTERS_9_ALARMMODE_ADDR A:0xfc4619f0
y.create.l HWIO_SNOC_EPRB0_SPROF_COUNTERS_9_VAL_ADDR A:0xfc4619f4
y.create.l HWIO_SNOC_EPRB1_SPROF_ID_COREID_ADDR A:0xfc461c00
y.create.l HWIO_SNOC_EPRB1_SPROF_ID_REVISIONID_ADDR A:0xfc461c04
y.create.l HWIO_SNOC_EPRB1_SPROF_MAINCTL_ADDR A:0xfc461c08
y.create.l HWIO_SNOC_EPRB1_SPROF_CFGCTL_ADDR A:0xfc461c0c
y.create.l HWIO_SNOC_EPRB1_SPROF_TRACEPORTSEL_ADDR A:0xfc461c10
y.create.l HWIO_SNOC_EPRB1_SPROF_FILTERLUT_ADDR A:0xfc461c14
y.create.l HWIO_SNOC_EPRB1_SPROF_TRACEALARMEN_ADDR A:0xfc461c18
y.create.l HWIO_SNOC_EPRB1_SPROF_TRACEALARMSTATUS_ADDR A:0xfc461c1c
y.create.l HWIO_SNOC_EPRB1_SPROF_TRACEALARMCLR_ADDR A:0xfc461c20
y.create.l HWIO_SNOC_EPRB1_SPROF_STATPERIOD_ADDR A:0xfc461c24
y.create.l HWIO_SNOC_EPRB1_SPROF_STATGO_ADDR A:0xfc461c28
y.create.l HWIO_SNOC_EPRB1_SPROF_STATALARMMIN_ADDR A:0xfc461c2c
y.create.l HWIO_SNOC_EPRB1_SPROF_STATALARMMAX_ADDR A:0xfc461c30
y.create.l HWIO_SNOC_EPRB1_SPROF_STATALARMSTATUS_ADDR A:0xfc461c34
y.create.l HWIO_SNOC_EPRB1_SPROF_STATALARMCLR_ADDR A:0xfc461c38
y.create.l HWIO_SNOC_EPRB1_SPROF_FILTERS_0_ROUTEIDBASE_ADDR A:0xfc461c44
y.create.l HWIO_SNOC_EPRB1_SPROF_FILTERS_0_ROUTEIDMASK_ADDR A:0xfc461c48
y.create.l HWIO_SNOC_EPRB1_SPROF_FILTERS_0_ADDRBASE_LOW_ADDR A:0xfc461c4c
y.create.l HWIO_SNOC_EPRB1_SPROF_FILTERS_0_ADDRBASE_HIGH_ADDR A:0xfc461c50
y.create.l HWIO_SNOC_EPRB1_SPROF_FILTERS_0_WINDOWSIZE_ADDR A:0xfc461c54
y.create.l HWIO_SNOC_EPRB1_SPROF_FILTERS_0_OPCODE_ADDR A:0xfc461c60
y.create.l HWIO_SNOC_EPRB1_SPROF_FILTERS_0_STATUS_ADDR A:0xfc461c64
y.create.l HWIO_SNOC_EPRB1_SPROF_FILTERS_0_LENGTH_ADDR A:0xfc461c68
y.create.l HWIO_SNOC_EPRB1_SPROF_FILTERS_0_URGENCY_ADDR A:0xfc461c6c
y.create.l HWIO_SNOC_EPRB1_SPROF_FILTERS_1_ROUTEIDBASE_ADDR A:0xfc461c80
y.create.l HWIO_SNOC_EPRB1_SPROF_FILTERS_1_ROUTEIDMASK_ADDR A:0xfc461c84
y.create.l HWIO_SNOC_EPRB1_SPROF_FILTERS_1_ADDRBASE_LOW_ADDR A:0xfc461c88
y.create.l HWIO_SNOC_EPRB1_SPROF_FILTERS_1_ADDRBASE_HIGH_ADDR A:0xfc461c8c
y.create.l HWIO_SNOC_EPRB1_SPROF_FILTERS_1_WINDOWSIZE_ADDR A:0xfc461c90
y.create.l HWIO_SNOC_EPRB1_SPROF_FILTERS_1_OPCODE_ADDR A:0xfc461c9c
y.create.l HWIO_SNOC_EPRB1_SPROF_FILTERS_1_STATUS_ADDR A:0xfc461ca0
y.create.l HWIO_SNOC_EPRB1_SPROF_FILTERS_1_LENGTH_ADDR A:0xfc461ca4
y.create.l HWIO_SNOC_EPRB1_SPROF_FILTERS_1_URGENCY_ADDR A:0xfc461ca8
y.create.l HWIO_SNOC_EPRB1_SPROF_FILTERS_2_ROUTEIDBASE_ADDR A:0xfc461cbc
y.create.l HWIO_SNOC_EPRB1_SPROF_FILTERS_2_ROUTEIDMASK_ADDR A:0xfc461cc0
y.create.l HWIO_SNOC_EPRB1_SPROF_FILTERS_2_ADDRBASE_LOW_ADDR A:0xfc461cc4
y.create.l HWIO_SNOC_EPRB1_SPROF_FILTERS_2_ADDRBASE_HIGH_ADDR A:0xfc461cc8
y.create.l HWIO_SNOC_EPRB1_SPROF_FILTERS_2_WINDOWSIZE_ADDR A:0xfc461ccc
y.create.l HWIO_SNOC_EPRB1_SPROF_FILTERS_2_OPCODE_ADDR A:0xfc461cd8
y.create.l HWIO_SNOC_EPRB1_SPROF_FILTERS_2_STATUS_ADDR A:0xfc461cdc
y.create.l HWIO_SNOC_EPRB1_SPROF_FILTERS_2_LENGTH_ADDR A:0xfc461ce0
y.create.l HWIO_SNOC_EPRB1_SPROF_FILTERS_2_URGENCY_ADDR A:0xfc461ce4
y.create.l HWIO_SNOC_EPRB1_SPROF_FILTERS_3_ROUTEIDBASE_ADDR A:0xfc461cf8
y.create.l HWIO_SNOC_EPRB1_SPROF_FILTERS_3_ROUTEIDMASK_ADDR A:0xfc461cfc
y.create.l HWIO_SNOC_EPRB1_SPROF_FILTERS_3_ADDRBASE_LOW_ADDR A:0xfc461d00
y.create.l HWIO_SNOC_EPRB1_SPROF_FILTERS_3_ADDRBASE_HIGH_ADDR A:0xfc461d04
y.create.l HWIO_SNOC_EPRB1_SPROF_FILTERS_3_WINDOWSIZE_ADDR A:0xfc461d08
y.create.l HWIO_SNOC_EPRB1_SPROF_FILTERS_3_OPCODE_ADDR A:0xfc461d14
y.create.l HWIO_SNOC_EPRB1_SPROF_FILTERS_3_STATUS_ADDR A:0xfc461d18
y.create.l HWIO_SNOC_EPRB1_SPROF_FILTERS_3_LENGTH_ADDR A:0xfc461d1c
y.create.l HWIO_SNOC_EPRB1_SPROF_FILTERS_3_URGENCY_ADDR A:0xfc461d20
y.create.l HWIO_SNOC_EPRB1_SPROF_COUNTERS_0_PORTSEL_ADDR A:0xfc461d34
y.create.l HWIO_SNOC_EPRB1_SPROF_COUNTERS_0_SRC_ADDR A:0xfc461d38
y.create.l HWIO_SNOC_EPRB1_SPROF_COUNTERS_0_ALARMMODE_ADDR A:0xfc461d3c
y.create.l HWIO_SNOC_EPRB1_SPROF_COUNTERS_0_VAL_ADDR A:0xfc461d40
y.create.l HWIO_SNOC_EPRB1_SPROF_COUNTERS_1_PORTSEL_ADDR A:0xfc461d48
y.create.l HWIO_SNOC_EPRB1_SPROF_COUNTERS_1_SRC_ADDR A:0xfc461d4c
y.create.l HWIO_SNOC_EPRB1_SPROF_COUNTERS_1_ALARMMODE_ADDR A:0xfc461d50
y.create.l HWIO_SNOC_EPRB1_SPROF_COUNTERS_1_VAL_ADDR A:0xfc461d54
y.create.l HWIO_SNOC_EPRB1_SPROF_COUNTERS_2_PORTSEL_ADDR A:0xfc461d5c
y.create.l HWIO_SNOC_EPRB1_SPROF_COUNTERS_2_SRC_ADDR A:0xfc461d60
y.create.l HWIO_SNOC_EPRB1_SPROF_COUNTERS_2_ALARMMODE_ADDR A:0xfc461d64
y.create.l HWIO_SNOC_EPRB1_SPROF_COUNTERS_2_VAL_ADDR A:0xfc461d68
y.create.l HWIO_SNOC_EPRB1_SPROF_COUNTERS_3_PORTSEL_ADDR A:0xfc461d70
y.create.l HWIO_SNOC_EPRB1_SPROF_COUNTERS_3_SRC_ADDR A:0xfc461d74
y.create.l HWIO_SNOC_EPRB1_SPROF_COUNTERS_3_ALARMMODE_ADDR A:0xfc461d78
y.create.l HWIO_SNOC_EPRB1_SPROF_COUNTERS_3_VAL_ADDR A:0xfc461d7c
y.create.l HWIO_SNOC_EPRB1_SPROF_COUNTERS_4_PORTSEL_ADDR A:0xfc461d84
y.create.l HWIO_SNOC_EPRB1_SPROF_COUNTERS_4_SRC_ADDR A:0xfc461d88
y.create.l HWIO_SNOC_EPRB1_SPROF_COUNTERS_4_ALARMMODE_ADDR A:0xfc461d8c
y.create.l HWIO_SNOC_EPRB1_SPROF_COUNTERS_4_VAL_ADDR A:0xfc461d90
y.create.l HWIO_SNOC_EPRB1_SPROF_COUNTERS_5_PORTSEL_ADDR A:0xfc461d98
y.create.l HWIO_SNOC_EPRB1_SPROF_COUNTERS_5_SRC_ADDR A:0xfc461d9c
y.create.l HWIO_SNOC_EPRB1_SPROF_COUNTERS_5_ALARMMODE_ADDR A:0xfc461da0
y.create.l HWIO_SNOC_EPRB1_SPROF_COUNTERS_5_VAL_ADDR A:0xfc461da4
y.create.l HWIO_SNOC_EPRB1_SPROF_COUNTERS_6_PORTSEL_ADDR A:0xfc461dac
y.create.l HWIO_SNOC_EPRB1_SPROF_COUNTERS_6_SRC_ADDR A:0xfc461db0
y.create.l HWIO_SNOC_EPRB1_SPROF_COUNTERS_6_ALARMMODE_ADDR A:0xfc461db4
y.create.l HWIO_SNOC_EPRB1_SPROF_COUNTERS_6_VAL_ADDR A:0xfc461db8
y.create.l HWIO_SNOC_EPRB1_SPROF_COUNTERS_7_PORTSEL_ADDR A:0xfc461dc0
y.create.l HWIO_SNOC_EPRB1_SPROF_COUNTERS_7_SRC_ADDR A:0xfc461dc4
y.create.l HWIO_SNOC_EPRB1_SPROF_COUNTERS_7_ALARMMODE_ADDR A:0xfc461dc8
y.create.l HWIO_SNOC_EPRB1_SPROF_COUNTERS_7_VAL_ADDR A:0xfc461dcc
y.create.l HWIO_SNOC_EPRB1_SPROF_COUNTERS_8_PORTSEL_ADDR A:0xfc461dd4
y.create.l HWIO_SNOC_EPRB1_SPROF_COUNTERS_8_SRC_ADDR A:0xfc461dd8
y.create.l HWIO_SNOC_EPRB1_SPROF_COUNTERS_8_ALARMMODE_ADDR A:0xfc461ddc
y.create.l HWIO_SNOC_EPRB1_SPROF_COUNTERS_8_VAL_ADDR A:0xfc461de0
y.create.l HWIO_SNOC_EPRB1_SPROF_COUNTERS_9_PORTSEL_ADDR A:0xfc461de8
y.create.l HWIO_SNOC_EPRB1_SPROF_COUNTERS_9_SRC_ADDR A:0xfc461dec
y.create.l HWIO_SNOC_EPRB1_SPROF_COUNTERS_9_ALARMMODE_ADDR A:0xfc461df0
y.create.l HWIO_SNOC_EPRB1_SPROF_COUNTERS_9_VAL_ADDR A:0xfc461df4
y.create.l HWIO_SNOC_TPRB0_SPROF_ID_COREID_ADDR A:0xfc462000
y.create.l HWIO_SNOC_TPRB0_SPROF_ID_REVISIONID_ADDR A:0xfc462004
y.create.l HWIO_SNOC_TPRB0_SPROF_MAINCTL_ADDR A:0xfc462008
y.create.l HWIO_SNOC_TPRB0_SPROF_CFGCTL_ADDR A:0xfc46200c
y.create.l HWIO_SNOC_TPRB0_SPROF_STATPERIOD_ADDR A:0xfc462024
y.create.l HWIO_SNOC_TPRB0_SPROF_STATGO_ADDR A:0xfc462028
y.create.l HWIO_SNOC_TPRB0_SPROF_STATALARMMIN_ADDR A:0xfc46202c
y.create.l HWIO_SNOC_TPRB0_SPROF_STATALARMMAX_ADDR A:0xfc462030
y.create.l HWIO_SNOC_TPRB0_SPROF_STATALARMSTATUS_ADDR A:0xfc462034
y.create.l HWIO_SNOC_TPRB0_SPROF_STATALARMCLR_ADDR A:0xfc462038
y.create.l HWIO_SNOC_TPRB0_SPROF_COUNTERS_0_SRC_ADDR A:0xfc462138
y.create.l HWIO_SNOC_TPRB0_SPROF_COUNTERS_0_ALARMMODE_ADDR A:0xfc46213c
y.create.l HWIO_SNOC_TPRB0_SPROF_COUNTERS_0_VAL_ADDR A:0xfc462140
y.create.l HWIO_SNOC_TPRB0_SPROF_COUNTERS_1_SRC_ADDR A:0xfc46214c
y.create.l HWIO_SNOC_TPRB0_SPROF_COUNTERS_1_ALARMMODE_ADDR A:0xfc462150
y.create.l HWIO_SNOC_TPRB0_SPROF_COUNTERS_1_VAL_ADDR A:0xfc462154
y.create.l HWIO_SNOC_TPRB0_SPROF_COUNTERS_2_SRC_ADDR A:0xfc462160
y.create.l HWIO_SNOC_TPRB0_SPROF_COUNTERS_2_ALARMMODE_ADDR A:0xfc462164
y.create.l HWIO_SNOC_TPRB0_SPROF_COUNTERS_2_VAL_ADDR A:0xfc462168
y.create.l HWIO_SNOC_TPRB0_SPROF_COUNTERS_3_SRC_ADDR A:0xfc462174
y.create.l HWIO_SNOC_TPRB0_SPROF_COUNTERS_3_ALARMMODE_ADDR A:0xfc462178
y.create.l HWIO_SNOC_TPRB0_SPROF_COUNTERS_3_VAL_ADDR A:0xfc46217c
y.create.l HWIO_SNOC_TPRB0_SPROF_COUNTERS_4_SRC_ADDR A:0xfc462188
y.create.l HWIO_SNOC_TPRB0_SPROF_COUNTERS_4_ALARMMODE_ADDR A:0xfc46218c
y.create.l HWIO_SNOC_TPRB0_SPROF_COUNTERS_4_VAL_ADDR A:0xfc462190
y.create.l HWIO_SNOC_TPRB0_SPROF_COUNTERS_5_SRC_ADDR A:0xfc46219c
y.create.l HWIO_SNOC_TPRB0_SPROF_COUNTERS_5_ALARMMODE_ADDR A:0xfc4621a0
y.create.l HWIO_SNOC_TPRB0_SPROF_COUNTERS_5_VAL_ADDR A:0xfc4621a4
y.create.l HWIO_SNOC_TPRB0_SPROF_COUNTERS_6_SRC_ADDR A:0xfc4621b0
y.create.l HWIO_SNOC_TPRB0_SPROF_COUNTERS_6_ALARMMODE_ADDR A:0xfc4621b4
y.create.l HWIO_SNOC_TPRB0_SPROF_COUNTERS_6_VAL_ADDR A:0xfc4621b8
y.create.l HWIO_SNOC_TPRB0_SPROF_COUNTERS_7_SRC_ADDR A:0xfc4621c4
y.create.l HWIO_SNOC_TPRB0_SPROF_COUNTERS_7_ALARMMODE_ADDR A:0xfc4621c8
y.create.l HWIO_SNOC_TPRB0_SPROF_COUNTERS_7_VAL_ADDR A:0xfc4621cc
y.create.l HWIO_SNOC_TPRB0_SPROF_COUNTERS_8_SRC_ADDR A:0xfc4621d8
y.create.l HWIO_SNOC_TPRB0_SPROF_COUNTERS_8_ALARMMODE_ADDR A:0xfc4621dc
y.create.l HWIO_SNOC_TPRB0_SPROF_COUNTERS_8_VAL_ADDR A:0xfc4621e0
y.create.l HWIO_SNOC_TPRB0_SPROF_COUNTERS_9_SRC_ADDR A:0xfc4621ec
y.create.l HWIO_SNOC_TPRB0_SPROF_COUNTERS_9_ALARMMODE_ADDR A:0xfc4621f0
y.create.l HWIO_SNOC_TPRB0_SPROF_COUNTERS_9_VAL_ADDR A:0xfc4621f4
y.create.l HWIO_SNOC_TPRB0_SPROF_COUNTERS_10_SRC_ADDR A:0xfc462200
y.create.l HWIO_SNOC_TPRB0_SPROF_COUNTERS_10_ALARMMODE_ADDR A:0xfc462204
y.create.l HWIO_SNOC_TPRB0_SPROF_COUNTERS_10_VAL_ADDR A:0xfc462208
y.create.l HWIO_SNOC_TPRB0_SPROF_COUNTERS_11_SRC_ADDR A:0xfc462214
y.create.l HWIO_SNOC_TPRB0_SPROF_COUNTERS_11_ALARMMODE_ADDR A:0xfc462218
y.create.l HWIO_SNOC_TPRB0_SPROF_COUNTERS_11_VAL_ADDR A:0xfc46221c
y.create.l HWIO_SNOC_TPRB0_SPROF_COUNTERS_12_SRC_ADDR A:0xfc462228
y.create.l HWIO_SNOC_TPRB0_SPROF_COUNTERS_12_ALARMMODE_ADDR A:0xfc46222c
y.create.l HWIO_SNOC_TPRB0_SPROF_COUNTERS_12_VAL_ADDR A:0xfc462230
y.create.l HWIO_SNOC_TPRB0_SPROF_COUNTERS_13_SRC_ADDR A:0xfc46223c
y.create.l HWIO_SNOC_TPRB0_SPROF_COUNTERS_13_ALARMMODE_ADDR A:0xfc462240
y.create.l HWIO_SNOC_TPRB0_SPROF_COUNTERS_13_VAL_ADDR A:0xfc462244
y.create.l HWIO_SNOC_TPRB0_SPROF_COUNTERS_14_SRC_ADDR A:0xfc462250
y.create.l HWIO_SNOC_TPRB0_SPROF_COUNTERS_14_ALARMMODE_ADDR A:0xfc462254
y.create.l HWIO_SNOC_TPRB0_SPROF_COUNTERS_14_VAL_ADDR A:0xfc462258
y.create.l HWIO_SNOC_TPRB0_SPROF_COUNTERS_15_SRC_ADDR A:0xfc462264
y.create.l HWIO_SNOC_TPRB0_SPROF_COUNTERS_15_ALARMMODE_ADDR A:0xfc462268
y.create.l HWIO_SNOC_TPRB0_SPROF_COUNTERS_15_VAL_ADDR A:0xfc46226c
y.create.l HWIO_SNOC_TPRB1_SPROF_ID_COREID_ADDR A:0xfc462400
y.create.l HWIO_SNOC_TPRB1_SPROF_ID_REVISIONID_ADDR A:0xfc462404
y.create.l HWIO_SNOC_TPRB1_SPROF_MAINCTL_ADDR A:0xfc462408
y.create.l HWIO_SNOC_TPRB1_SPROF_CFGCTL_ADDR A:0xfc46240c
y.create.l HWIO_SNOC_TPRB1_SPROF_STATPERIOD_ADDR A:0xfc462424
y.create.l HWIO_SNOC_TPRB1_SPROF_STATGO_ADDR A:0xfc462428
y.create.l HWIO_SNOC_TPRB1_SPROF_STATALARMMIN_ADDR A:0xfc46242c
y.create.l HWIO_SNOC_TPRB1_SPROF_STATALARMMAX_ADDR A:0xfc462430
y.create.l HWIO_SNOC_TPRB1_SPROF_STATALARMSTATUS_ADDR A:0xfc462434
y.create.l HWIO_SNOC_TPRB1_SPROF_STATALARMCLR_ADDR A:0xfc462438
y.create.l HWIO_SNOC_TPRB1_SPROF_COUNTERS_0_SRC_ADDR A:0xfc462538
y.create.l HWIO_SNOC_TPRB1_SPROF_COUNTERS_0_ALARMMODE_ADDR A:0xfc46253c
y.create.l HWIO_SNOC_TPRB1_SPROF_COUNTERS_0_VAL_ADDR A:0xfc462540
y.create.l HWIO_SNOC_TPRB1_SPROF_COUNTERS_1_SRC_ADDR A:0xfc46254c
y.create.l HWIO_SNOC_TPRB1_SPROF_COUNTERS_1_ALARMMODE_ADDR A:0xfc462550
y.create.l HWIO_SNOC_TPRB1_SPROF_COUNTERS_1_VAL_ADDR A:0xfc462554
y.create.l HWIO_SNOC_TPRB1_SPROF_COUNTERS_2_SRC_ADDR A:0xfc462560
y.create.l HWIO_SNOC_TPRB1_SPROF_COUNTERS_2_ALARMMODE_ADDR A:0xfc462564
y.create.l HWIO_SNOC_TPRB1_SPROF_COUNTERS_2_VAL_ADDR A:0xfc462568
y.create.l HWIO_SNOC_TPRB1_SPROF_COUNTERS_3_SRC_ADDR A:0xfc462574
y.create.l HWIO_SNOC_TPRB1_SPROF_COUNTERS_3_ALARMMODE_ADDR A:0xfc462578
y.create.l HWIO_SNOC_TPRB1_SPROF_COUNTERS_3_VAL_ADDR A:0xfc46257c
y.create.l HWIO_SNOC_TPRB1_SPROF_COUNTERS_4_SRC_ADDR A:0xfc462588
y.create.l HWIO_SNOC_TPRB1_SPROF_COUNTERS_4_ALARMMODE_ADDR A:0xfc46258c
y.create.l HWIO_SNOC_TPRB1_SPROF_COUNTERS_4_VAL_ADDR A:0xfc462590
y.create.l HWIO_SNOC_TPRB1_SPROF_COUNTERS_5_SRC_ADDR A:0xfc46259c
y.create.l HWIO_SNOC_TPRB1_SPROF_COUNTERS_5_ALARMMODE_ADDR A:0xfc4625a0
y.create.l HWIO_SNOC_TPRB1_SPROF_COUNTERS_5_VAL_ADDR A:0xfc4625a4
y.create.l HWIO_SNOC_TPRB1_SPROF_COUNTERS_6_SRC_ADDR A:0xfc4625b0
y.create.l HWIO_SNOC_TPRB1_SPROF_COUNTERS_6_ALARMMODE_ADDR A:0xfc4625b4
y.create.l HWIO_SNOC_TPRB1_SPROF_COUNTERS_6_VAL_ADDR A:0xfc4625b8
y.create.l HWIO_SNOC_TPRB1_SPROF_COUNTERS_7_SRC_ADDR A:0xfc4625c4
y.create.l HWIO_SNOC_TPRB1_SPROF_COUNTERS_7_ALARMMODE_ADDR A:0xfc4625c8
y.create.l HWIO_SNOC_TPRB1_SPROF_COUNTERS_7_VAL_ADDR A:0xfc4625cc
y.create.l HWIO_SNOC_TPRB1_SPROF_COUNTERS_8_SRC_ADDR A:0xfc4625d8
y.create.l HWIO_SNOC_TPRB1_SPROF_COUNTERS_8_ALARMMODE_ADDR A:0xfc4625dc
y.create.l HWIO_SNOC_TPRB1_SPROF_COUNTERS_8_VAL_ADDR A:0xfc4625e0
y.create.l HWIO_SNOC_TPRB1_SPROF_COUNTERS_9_SRC_ADDR A:0xfc4625ec
y.create.l HWIO_SNOC_TPRB1_SPROF_COUNTERS_9_ALARMMODE_ADDR A:0xfc4625f0
y.create.l HWIO_SNOC_TPRB1_SPROF_COUNTERS_9_VAL_ADDR A:0xfc4625f4
y.create.l HWIO_SNOC_TPRB1_SPROF_COUNTERS_10_SRC_ADDR A:0xfc462600
y.create.l HWIO_SNOC_TPRB1_SPROF_COUNTERS_10_ALARMMODE_ADDR A:0xfc462604
y.create.l HWIO_SNOC_TPRB1_SPROF_COUNTERS_10_VAL_ADDR A:0xfc462608
y.create.l HWIO_SNOC_TPRB1_SPROF_COUNTERS_11_SRC_ADDR A:0xfc462614
y.create.l HWIO_SNOC_TPRB1_SPROF_COUNTERS_11_ALARMMODE_ADDR A:0xfc462618
y.create.l HWIO_SNOC_TPRB1_SPROF_COUNTERS_11_VAL_ADDR A:0xfc46261c
y.create.l HWIO_SNOC_TPRB1_SPROF_COUNTERS_12_SRC_ADDR A:0xfc462628
y.create.l HWIO_SNOC_TPRB1_SPROF_COUNTERS_12_ALARMMODE_ADDR A:0xfc46262c
y.create.l HWIO_SNOC_TPRB1_SPROF_COUNTERS_12_VAL_ADDR A:0xfc462630
y.create.l HWIO_SNOC_TPRB1_SPROF_COUNTERS_13_SRC_ADDR A:0xfc46263c
y.create.l HWIO_SNOC_TPRB1_SPROF_COUNTERS_13_ALARMMODE_ADDR A:0xfc462640
y.create.l HWIO_SNOC_TPRB1_SPROF_COUNTERS_13_VAL_ADDR A:0xfc462644
y.create.l HWIO_SNOC_TPRB1_SPROF_COUNTERS_14_SRC_ADDR A:0xfc462650
y.create.l HWIO_SNOC_TPRB1_SPROF_COUNTERS_14_ALARMMODE_ADDR A:0xfc462654
y.create.l HWIO_SNOC_TPRB1_SPROF_COUNTERS_14_VAL_ADDR A:0xfc462658
y.create.l HWIO_SNOC_TPRB1_SPROF_COUNTERS_15_SRC_ADDR A:0xfc462664
y.create.l HWIO_SNOC_TPRB1_SPROF_COUNTERS_15_ALARMMODE_ADDR A:0xfc462668
y.create.l HWIO_SNOC_TPRB1_SPROF_COUNTERS_15_VAL_ADDR A:0xfc46266c
y.create.l HWIO_SNOC_TPRB2_SPROF_ID_COREID_ADDR A:0xfc462800
y.create.l HWIO_SNOC_TPRB2_SPROF_ID_REVISIONID_ADDR A:0xfc462804
y.create.l HWIO_SNOC_TPRB2_SPROF_MAINCTL_ADDR A:0xfc462808
y.create.l HWIO_SNOC_TPRB2_SPROF_CFGCTL_ADDR A:0xfc46280c
y.create.l HWIO_SNOC_TPRB2_SPROF_STATPERIOD_ADDR A:0xfc462824
y.create.l HWIO_SNOC_TPRB2_SPROF_STATGO_ADDR A:0xfc462828
y.create.l HWIO_SNOC_TPRB2_SPROF_STATALARMMIN_ADDR A:0xfc46282c
y.create.l HWIO_SNOC_TPRB2_SPROF_STATALARMMAX_ADDR A:0xfc462830
y.create.l HWIO_SNOC_TPRB2_SPROF_STATALARMSTATUS_ADDR A:0xfc462834
y.create.l HWIO_SNOC_TPRB2_SPROF_STATALARMCLR_ADDR A:0xfc462838
y.create.l HWIO_SNOC_TPRB2_SPROF_COUNTERS_0_SRC_ADDR A:0xfc462938
y.create.l HWIO_SNOC_TPRB2_SPROF_COUNTERS_0_ALARMMODE_ADDR A:0xfc46293c
y.create.l HWIO_SNOC_TPRB2_SPROF_COUNTERS_0_VAL_ADDR A:0xfc462940
y.create.l HWIO_SNOC_TPRB2_SPROF_COUNTERS_1_SRC_ADDR A:0xfc46294c
y.create.l HWIO_SNOC_TPRB2_SPROF_COUNTERS_1_ALARMMODE_ADDR A:0xfc462950
y.create.l HWIO_SNOC_TPRB2_SPROF_COUNTERS_1_VAL_ADDR A:0xfc462954
y.create.l HWIO_SNOC_TPRB2_SPROF_COUNTERS_2_SRC_ADDR A:0xfc462960
y.create.l HWIO_SNOC_TPRB2_SPROF_COUNTERS_2_ALARMMODE_ADDR A:0xfc462964
y.create.l HWIO_SNOC_TPRB2_SPROF_COUNTERS_2_VAL_ADDR A:0xfc462968
y.create.l HWIO_SNOC_TPRB2_SPROF_COUNTERS_3_SRC_ADDR A:0xfc462974
y.create.l HWIO_SNOC_TPRB2_SPROF_COUNTERS_3_ALARMMODE_ADDR A:0xfc462978
y.create.l HWIO_SNOC_TPRB2_SPROF_COUNTERS_3_VAL_ADDR A:0xfc46297c
y.create.l HWIO_SNOC_TPRB2_SPROF_COUNTERS_4_SRC_ADDR A:0xfc462988
y.create.l HWIO_SNOC_TPRB2_SPROF_COUNTERS_4_ALARMMODE_ADDR A:0xfc46298c
y.create.l HWIO_SNOC_TPRB2_SPROF_COUNTERS_4_VAL_ADDR A:0xfc462990
y.create.l HWIO_SNOC_TPRB2_SPROF_COUNTERS_5_SRC_ADDR A:0xfc46299c
y.create.l HWIO_SNOC_TPRB2_SPROF_COUNTERS_5_ALARMMODE_ADDR A:0xfc4629a0
y.create.l HWIO_SNOC_TPRB2_SPROF_COUNTERS_5_VAL_ADDR A:0xfc4629a4
y.create.l HWIO_SNOC_TPRB2_SPROF_COUNTERS_6_SRC_ADDR A:0xfc4629b0
y.create.l HWIO_SNOC_TPRB2_SPROF_COUNTERS_6_ALARMMODE_ADDR A:0xfc4629b4
y.create.l HWIO_SNOC_TPRB2_SPROF_COUNTERS_6_VAL_ADDR A:0xfc4629b8
y.create.l HWIO_SNOC_TPRB2_SPROF_COUNTERS_7_SRC_ADDR A:0xfc4629c4
y.create.l HWIO_SNOC_TPRB2_SPROF_COUNTERS_7_ALARMMODE_ADDR A:0xfc4629c8
y.create.l HWIO_SNOC_TPRB2_SPROF_COUNTERS_7_VAL_ADDR A:0xfc4629cc
y.create.l HWIO_SNOC_TPRB2_SPROF_COUNTERS_8_SRC_ADDR A:0xfc4629d8
y.create.l HWIO_SNOC_TPRB2_SPROF_COUNTERS_8_ALARMMODE_ADDR A:0xfc4629dc
y.create.l HWIO_SNOC_TPRB2_SPROF_COUNTERS_8_VAL_ADDR A:0xfc4629e0
y.create.l HWIO_SNOC_TPRB2_SPROF_COUNTERS_9_SRC_ADDR A:0xfc4629ec
y.create.l HWIO_SNOC_TPRB2_SPROF_COUNTERS_9_ALARMMODE_ADDR A:0xfc4629f0
y.create.l HWIO_SNOC_TPRB2_SPROF_COUNTERS_9_VAL_ADDR A:0xfc4629f4
y.create.l HWIO_SNOC_TPRB2_SPROF_COUNTERS_10_SRC_ADDR A:0xfc462a00
y.create.l HWIO_SNOC_TPRB2_SPROF_COUNTERS_10_ALARMMODE_ADDR A:0xfc462a04
y.create.l HWIO_SNOC_TPRB2_SPROF_COUNTERS_10_VAL_ADDR A:0xfc462a08
y.create.l HWIO_SNOC_TPRB2_SPROF_COUNTERS_11_SRC_ADDR A:0xfc462a14
y.create.l HWIO_SNOC_TPRB2_SPROF_COUNTERS_11_ALARMMODE_ADDR A:0xfc462a18
y.create.l HWIO_SNOC_TPRB2_SPROF_COUNTERS_11_VAL_ADDR A:0xfc462a1c
y.create.l HWIO_SNOC_TPRB2_SPROF_COUNTERS_12_SRC_ADDR A:0xfc462a28
y.create.l HWIO_SNOC_TPRB2_SPROF_COUNTERS_12_ALARMMODE_ADDR A:0xfc462a2c
y.create.l HWIO_SNOC_TPRB2_SPROF_COUNTERS_12_VAL_ADDR A:0xfc462a30
y.create.l HWIO_SNOC_TPRB2_SPROF_COUNTERS_13_SRC_ADDR A:0xfc462a3c
y.create.l HWIO_SNOC_TPRB2_SPROF_COUNTERS_13_ALARMMODE_ADDR A:0xfc462a40
y.create.l HWIO_SNOC_TPRB2_SPROF_COUNTERS_13_VAL_ADDR A:0xfc462a44
y.create.l HWIO_SNOC_TPRB2_SPROF_COUNTERS_14_SRC_ADDR A:0xfc462a50
y.create.l HWIO_SNOC_TPRB2_SPROF_COUNTERS_14_ALARMMODE_ADDR A:0xfc462a54
y.create.l HWIO_SNOC_TPRB2_SPROF_COUNTERS_14_VAL_ADDR A:0xfc462a58
y.create.l HWIO_SNOC_TPRB2_SPROF_COUNTERS_15_SRC_ADDR A:0xfc462a64
y.create.l HWIO_SNOC_TPRB2_SPROF_COUNTERS_15_ALARMMODE_ADDR A:0xfc462a68
y.create.l HWIO_SNOC_TPRB2_SPROF_COUNTERS_15_VAL_ADDR A:0xfc462a6c
y.create.l HWIO_SNOC_TPRB3_SPROF_ID_COREID_ADDR A:0xfc462c00
y.create.l HWIO_SNOC_TPRB3_SPROF_ID_REVISIONID_ADDR A:0xfc462c04
y.create.l HWIO_SNOC_TPRB3_SPROF_MAINCTL_ADDR A:0xfc462c08
y.create.l HWIO_SNOC_TPRB3_SPROF_CFGCTL_ADDR A:0xfc462c0c
y.create.l HWIO_SNOC_TPRB3_SPROF_STATPERIOD_ADDR A:0xfc462c24
y.create.l HWIO_SNOC_TPRB3_SPROF_STATGO_ADDR A:0xfc462c28
y.create.l HWIO_SNOC_TPRB3_SPROF_STATALARMMIN_ADDR A:0xfc462c2c
y.create.l HWIO_SNOC_TPRB3_SPROF_STATALARMMAX_ADDR A:0xfc462c30
y.create.l HWIO_SNOC_TPRB3_SPROF_STATALARMSTATUS_ADDR A:0xfc462c34
y.create.l HWIO_SNOC_TPRB3_SPROF_STATALARMCLR_ADDR A:0xfc462c38
y.create.l HWIO_SNOC_TPRB3_SPROF_COUNTERS_0_SRC_ADDR A:0xfc462d38
y.create.l HWIO_SNOC_TPRB3_SPROF_COUNTERS_0_ALARMMODE_ADDR A:0xfc462d3c
y.create.l HWIO_SNOC_TPRB3_SPROF_COUNTERS_0_VAL_ADDR A:0xfc462d40
y.create.l HWIO_SNOC_TPRB3_SPROF_COUNTERS_1_SRC_ADDR A:0xfc462d4c
y.create.l HWIO_SNOC_TPRB3_SPROF_COUNTERS_1_ALARMMODE_ADDR A:0xfc462d50
y.create.l HWIO_SNOC_TPRB3_SPROF_COUNTERS_1_VAL_ADDR A:0xfc462d54
y.create.l HWIO_SNOC_TPRB3_SPROF_COUNTERS_2_SRC_ADDR A:0xfc462d60
y.create.l HWIO_SNOC_TPRB3_SPROF_COUNTERS_2_ALARMMODE_ADDR A:0xfc462d64
y.create.l HWIO_SNOC_TPRB3_SPROF_COUNTERS_2_VAL_ADDR A:0xfc462d68
y.create.l HWIO_SNOC_TPRB3_SPROF_COUNTERS_3_SRC_ADDR A:0xfc462d74
y.create.l HWIO_SNOC_TPRB3_SPROF_COUNTERS_3_ALARMMODE_ADDR A:0xfc462d78
y.create.l HWIO_SNOC_TPRB3_SPROF_COUNTERS_3_VAL_ADDR A:0xfc462d7c
y.create.l HWIO_SNOC_TPRB3_SPROF_COUNTERS_4_SRC_ADDR A:0xfc462d88
y.create.l HWIO_SNOC_TPRB3_SPROF_COUNTERS_4_ALARMMODE_ADDR A:0xfc462d8c
y.create.l HWIO_SNOC_TPRB3_SPROF_COUNTERS_4_VAL_ADDR A:0xfc462d90
y.create.l HWIO_SNOC_TPRB3_SPROF_COUNTERS_5_SRC_ADDR A:0xfc462d9c
y.create.l HWIO_SNOC_TPRB3_SPROF_COUNTERS_5_ALARMMODE_ADDR A:0xfc462da0
y.create.l HWIO_SNOC_TPRB3_SPROF_COUNTERS_5_VAL_ADDR A:0xfc462da4
y.create.l HWIO_SNOC_TPRB3_SPROF_COUNTERS_6_SRC_ADDR A:0xfc462db0
y.create.l HWIO_SNOC_TPRB3_SPROF_COUNTERS_6_ALARMMODE_ADDR A:0xfc462db4
y.create.l HWIO_SNOC_TPRB3_SPROF_COUNTERS_6_VAL_ADDR A:0xfc462db8
y.create.l HWIO_SNOC_TPRB3_SPROF_COUNTERS_7_SRC_ADDR A:0xfc462dc4
y.create.l HWIO_SNOC_TPRB3_SPROF_COUNTERS_7_ALARMMODE_ADDR A:0xfc462dc8
y.create.l HWIO_SNOC_TPRB3_SPROF_COUNTERS_7_VAL_ADDR A:0xfc462dcc
y.create.l HWIO_SNOC_TPRB3_SPROF_COUNTERS_8_SRC_ADDR A:0xfc462dd8
y.create.l HWIO_SNOC_TPRB3_SPROF_COUNTERS_8_ALARMMODE_ADDR A:0xfc462ddc
y.create.l HWIO_SNOC_TPRB3_SPROF_COUNTERS_8_VAL_ADDR A:0xfc462de0
y.create.l HWIO_SNOC_TPRB3_SPROF_COUNTERS_9_SRC_ADDR A:0xfc462dec
y.create.l HWIO_SNOC_TPRB3_SPROF_COUNTERS_9_ALARMMODE_ADDR A:0xfc462df0
y.create.l HWIO_SNOC_TPRB3_SPROF_COUNTERS_9_VAL_ADDR A:0xfc462df4
y.create.l HWIO_SNOC_TPRB3_SPROF_COUNTERS_10_SRC_ADDR A:0xfc462e00
y.create.l HWIO_SNOC_TPRB3_SPROF_COUNTERS_10_ALARMMODE_ADDR A:0xfc462e04
y.create.l HWIO_SNOC_TPRB3_SPROF_COUNTERS_10_VAL_ADDR A:0xfc462e08
y.create.l HWIO_SNOC_TPRB3_SPROF_COUNTERS_11_SRC_ADDR A:0xfc462e14
y.create.l HWIO_SNOC_TPRB3_SPROF_COUNTERS_11_ALARMMODE_ADDR A:0xfc462e18
y.create.l HWIO_SNOC_TPRB3_SPROF_COUNTERS_11_VAL_ADDR A:0xfc462e1c
y.create.l HWIO_SNOC_TPRB3_SPROF_COUNTERS_12_SRC_ADDR A:0xfc462e28
y.create.l HWIO_SNOC_TPRB3_SPROF_COUNTERS_12_ALARMMODE_ADDR A:0xfc462e2c
y.create.l HWIO_SNOC_TPRB3_SPROF_COUNTERS_12_VAL_ADDR A:0xfc462e30
y.create.l HWIO_SNOC_TPRB3_SPROF_COUNTERS_13_SRC_ADDR A:0xfc462e3c
y.create.l HWIO_SNOC_TPRB3_SPROF_COUNTERS_13_ALARMMODE_ADDR A:0xfc462e40
y.create.l HWIO_SNOC_TPRB3_SPROF_COUNTERS_13_VAL_ADDR A:0xfc462e44
y.create.l HWIO_SNOC_TPRB3_SPROF_COUNTERS_14_SRC_ADDR A:0xfc462e50
y.create.l HWIO_SNOC_TPRB3_SPROF_COUNTERS_14_ALARMMODE_ADDR A:0xfc462e54
y.create.l HWIO_SNOC_TPRB3_SPROF_COUNTERS_14_VAL_ADDR A:0xfc462e58
y.create.l HWIO_SNOC_TPRB3_SPROF_COUNTERS_15_SRC_ADDR A:0xfc462e64
y.create.l HWIO_SNOC_TPRB3_SPROF_COUNTERS_15_ALARMMODE_ADDR A:0xfc462e68
y.create.l HWIO_SNOC_TPRB3_SPROF_COUNTERS_15_VAL_ADDR A:0xfc462e6c
y.create.l HWIO_SNOC_QXM_LPASS_CORE_QOS_ID_COREID_ADDR A:0xfc463000
y.create.l HWIO_SNOC_QXM_LPASS_CORE_QOS_ID_REVISIONID_ADDR A:0xfc463004
y.create.l HWIO_SNOC_QXM_LPASS_CORE_QOS_PRIORITY_ADDR A:0xfc463008
y.create.l HWIO_SNOC_QXM_LPASS_CORE_QOS_MODE_ADDR A:0xfc46300c
y.create.l HWIO_SNOC_QXM_LPASS_CORE_QOS_EXTCONTROL_ADDR A:0xfc463018
y.create.l HWIO_SNOC_QDSS_BAM_QOS_ID_COREID_ADDR A:0xfc463080
y.create.l HWIO_SNOC_QDSS_BAM_QOS_ID_REVISIONID_ADDR A:0xfc463084
y.create.l HWIO_SNOC_QDSS_BAM_QOS_PRIORITY_ADDR A:0xfc463088
y.create.l HWIO_SNOC_QDSS_BAM_QOS_MODE_ADDR A:0xfc46308c
y.create.l HWIO_SNOC_QDSS_BAM_QOS_EXTCONTROL_ADDR A:0xfc463098
y.create.l HWIO_SNOC_CRYPTO0_QOS_ID_COREID_ADDR A:0xfc463100
y.create.l HWIO_SNOC_CRYPTO0_QOS_ID_REVISIONID_ADDR A:0xfc463104
y.create.l HWIO_SNOC_CRYPTO0_QOS_PRIORITY_ADDR A:0xfc463108
y.create.l HWIO_SNOC_CRYPTO0_QOS_MODE_ADDR A:0xfc46310c
y.create.l HWIO_SNOC_CRYPTO0_QOS_EXTCONTROL_ADDR A:0xfc463118
y.create.l HWIO_SNOC_QXM_IPA_QOS_ID_COREID_ADDR A:0xfc463180
y.create.l HWIO_SNOC_QXM_IPA_QOS_ID_REVISIONID_ADDR A:0xfc463184
y.create.l HWIO_SNOC_QXM_IPA_QOS_PRIORITY_ADDR A:0xfc463188
y.create.l HWIO_SNOC_QXM_IPA_QOS_MODE_ADDR A:0xfc46318c
y.create.l HWIO_SNOC_QXM_IPA_QOS_EXTCONTROL_ADDR A:0xfc463198
y.create.l HWIO_SNOC_QXM_LPASS_Q6_QOS_ID_COREID_ADDR A:0xfc463200
y.create.l HWIO_SNOC_QXM_LPASS_Q6_QOS_ID_REVISIONID_ADDR A:0xfc463204
y.create.l HWIO_SNOC_QXM_LPASS_Q6_QOS_PRIORITY_ADDR A:0xfc463208
y.create.l HWIO_SNOC_QXM_LPASS_Q6_QOS_MODE_ADDR A:0xfc46320c
y.create.l HWIO_SNOC_QXM_LPASS_Q6_QOS_EXTCONTROL_ADDR A:0xfc463218
y.create.l HWIO_SNOC_MSS_QOS_ID_COREID_ADDR A:0xfc463280
y.create.l HWIO_SNOC_MSS_QOS_ID_REVISIONID_ADDR A:0xfc463284
y.create.l HWIO_SNOC_MSS_QOS_PRIORITY_ADDR A:0xfc463288
y.create.l HWIO_SNOC_MSS_QOS_MODE_ADDR A:0xfc46328c
y.create.l HWIO_SNOC_MSS_QOS_BANDWIDTH_ADDR A:0xfc463290
y.create.l HWIO_SNOC_MSS_QOS_SATURATION_ADDR A:0xfc463294
y.create.l HWIO_SNOC_MSS_QOS_EXTCONTROL_ADDR A:0xfc463298
y.create.l HWIO_SNOC_MSS_NAV_QOS_ID_COREID_ADDR A:0xfc463300
y.create.l HWIO_SNOC_MSS_NAV_QOS_ID_REVISIONID_ADDR A:0xfc463304
y.create.l HWIO_SNOC_MSS_NAV_QOS_PRIORITY_ADDR A:0xfc463308
y.create.l HWIO_SNOC_MSS_NAV_QOS_MODE_ADDR A:0xfc46330c
y.create.l HWIO_SNOC_MSS_NAV_QOS_EXTCONTROL_ADDR A:0xfc463318
y.create.l HWIO_SNOC_USB3_QOS_ID_COREID_ADDR A:0xfc463380
y.create.l HWIO_SNOC_USB3_QOS_ID_REVISIONID_ADDR A:0xfc463384
y.create.l HWIO_SNOC_USB3_QOS_PRIORITY_ADDR A:0xfc463388
y.create.l HWIO_SNOC_USB3_QOS_MODE_ADDR A:0xfc46338c
y.create.l HWIO_SNOC_USB3_QOS_EXTCONTROL_ADDR A:0xfc463398
y.create.l HWIO_SNOC_PNOC_QOS_ID_COREID_ADDR A:0xfc463400
y.create.l HWIO_SNOC_PNOC_QOS_ID_REVISIONID_ADDR A:0xfc463404
y.create.l HWIO_SNOC_PNOC_QOS_PRIORITY_ADDR A:0xfc463408
y.create.l HWIO_SNOC_PNOC_QOS_MODE_ADDR A:0xfc46340c
y.create.l HWIO_SNOC_PNOC_QOS_EXTCONTROL_ADDR A:0xfc463418
y.create.l HWIO_SNOC_QDSS_ETR_QOS_ID_COREID_ADDR A:0xfc463500
y.create.l HWIO_SNOC_QDSS_ETR_QOS_ID_REVISIONID_ADDR A:0xfc463504
y.create.l HWIO_SNOC_QDSS_ETR_QOS_PRIORITY_ADDR A:0xfc463508
y.create.l HWIO_SNOC_QDSS_ETR_QOS_MODE_ADDR A:0xfc46350c
y.create.l HWIO_SNOC_QDSS_ETR_QOS_EXTCONTROL_ADDR A:0xfc463518
y.create.l HWIO_SNOC_PCIE_QOS_ID_COREID_ADDR A:0xfc463580
y.create.l HWIO_SNOC_PCIE_QOS_ID_REVISIONID_ADDR A:0xfc463584
y.create.l HWIO_SNOC_PCIE_QOS_PRIORITY_ADDR A:0xfc463588
y.create.l HWIO_SNOC_PCIE_QOS_MODE_ADDR A:0xfc46358c
y.create.l HWIO_SNOC_PCIE_QOS_EXTCONTROL_ADDR A:0xfc463598
y.create.l HWIO_TLMM_XPU_SCR_ADDR A:0xfd500000
y.create.l HWIO_TLMM_XPU_SWDR_ADDR A:0xfd500004
y.create.l HWIO_TLMM_XPU_SEAR0_ADDR A:0xfd500040
y.create.l HWIO_TLMM_XPU_SESR_ADDR A:0xfd500048
y.create.l HWIO_TLMM_XPU_SESRRESTORE_ADDR A:0xfd50004c
y.create.l HWIO_TLMM_XPU_SESYNR0_ADDR A:0xfd500050
y.create.l HWIO_TLMM_XPU_SESYNR1_ADDR A:0xfd500054
y.create.l HWIO_TLMM_XPU_SESYNR2_ADDR A:0xfd500058
y.create.l HWIO_TLMM_XPU_MCR_ADDR A:0xfd500100
y.create.l HWIO_TLMM_XPU_MEAR0_ADDR A:0xfd500140
y.create.l HWIO_TLMM_XPU_MESR_ADDR A:0xfd500148
y.create.l HWIO_TLMM_XPU_MESRRESTORE_ADDR A:0xfd50014c
y.create.l HWIO_TLMM_XPU_MESYNR0_ADDR A:0xfd500150
y.create.l HWIO_TLMM_XPU_MESYNR1_ADDR A:0xfd500154
y.create.l HWIO_TLMM_XPU_MESYNR2_ADDR A:0xfd500158
y.create.l HWIO_TLMM_XPU_CR_ADDR A:0xfd500080
y.create.l HWIO_TLMM_XPU_RPU_ACR0_ADDR A:0xfd5000a0
y.create.l HWIO_TLMM_XPU_EAR0_ADDR A:0xfd5000c0
y.create.l HWIO_TLMM_XPU_ESR_ADDR A:0xfd5000c8
y.create.l HWIO_TLMM_XPU_ESRRESTORE_ADDR A:0xfd5000cc
y.create.l HWIO_TLMM_XPU_ESYNR0_ADDR A:0xfd5000d0
y.create.l HWIO_TLMM_XPU_ESYNR1_ADDR A:0xfd5000d4
y.create.l HWIO_TLMM_XPU_ESYNR2_ADDR A:0xfd5000d8
y.create.l HWIO_TLMM_XPU_IDR0_ADDR A:0xfd500074
y.create.l HWIO_TLMM_XPU_IDR1_ADDR A:0xfd500078
y.create.l HWIO_TLMM_XPU_REV_ADDR A:0xfd50007c
y.create.l HWIO_TLMM_XPU_RG0_RACR0_ADDR A:0xfd500200
y.create.l HWIO_TLMM_XPU_RG1_RACR0_ADDR A:0xfd500280
y.create.l HWIO_TLMM_XPU_RG2_RACR0_ADDR A:0xfd500300
y.create.l HWIO_TLMM_XPU_RG3_RACR0_ADDR A:0xfd500380
y.create.l HWIO_TLMM_XPU_RG4_RACR0_ADDR A:0xfd500400
y.create.l HWIO_TLMM_XPU_RG5_RACR0_ADDR A:0xfd500480
y.create.l HWIO_TLMM_XPU_RG6_RACR0_ADDR A:0xfd500500
y.create.l HWIO_TLMM_XPU_RG7_RACR0_ADDR A:0xfd500580
y.create.l HWIO_TLMM_XPU_RG8_RACR0_ADDR A:0xfd500600
y.create.l HWIO_TLMM_XPU_RG9_RACR0_ADDR A:0xfd500680
y.create.l HWIO_TLMM_XPU_RG0_SCR_ADDR A:0xfd500250
y.create.l HWIO_TLMM_XPU_RG1_SCR_ADDR A:0xfd5002d0
y.create.l HWIO_TLMM_XPU_RG2_SCR_ADDR A:0xfd500350
y.create.l HWIO_TLMM_XPU_RG3_SCR_ADDR A:0xfd5003d0
y.create.l HWIO_TLMM_XPU_RG4_SCR_ADDR A:0xfd500450
y.create.l HWIO_TLMM_XPU_RG5_SCR_ADDR A:0xfd5004d0
y.create.l HWIO_TLMM_XPU_RG6_SCR_ADDR A:0xfd500550
y.create.l HWIO_TLMM_XPU_RG7_SCR_ADDR A:0xfd5005d0
y.create.l HWIO_TLMM_XPU_RG8_SCR_ADDR A:0xfd500650
y.create.l HWIO_TLMM_XPU_RG9_SCR_ADDR A:0xfd5006d0
y.create.l HWIO_TLMM_XPU_RG0_MCR_ADDR A:0xfd500254
y.create.l HWIO_TLMM_XPU_RG1_MCR_ADDR A:0xfd5002d4
y.create.l HWIO_TLMM_XPU_RG2_MCR_ADDR A:0xfd500354
y.create.l HWIO_TLMM_XPU_RG3_MCR_ADDR A:0xfd5003d4
y.create.l HWIO_TLMM_XPU_RG4_MCR_ADDR A:0xfd500454
y.create.l HWIO_TLMM_XPU_RG5_MCR_ADDR A:0xfd5004d4
y.create.l HWIO_TLMM_XPU_RG6_MCR_ADDR A:0xfd500554
y.create.l HWIO_TLMM_XPU_RG7_MCR_ADDR A:0xfd5005d4
y.create.l HWIO_TLMM_XPU_RG8_MCR_ADDR A:0xfd500654
y.create.l HWIO_TLMM_XPU_RG9_MCR_ADDR A:0xfd5006d4
y.create.l HWIO_TLMM_GPIO_CFG0_ADDR A:0xfd511000
y.create.l HWIO_TLMM_GPIO_CFG1_ADDR A:0xfd511010
y.create.l HWIO_TLMM_GPIO_CFG2_ADDR A:0xfd511020
y.create.l HWIO_TLMM_GPIO_CFG3_ADDR A:0xfd511030
y.create.l HWIO_TLMM_GPIO_CFG4_ADDR A:0xfd511040
y.create.l HWIO_TLMM_GPIO_CFG5_ADDR A:0xfd511050
y.create.l HWIO_TLMM_GPIO_CFG6_ADDR A:0xfd511060
y.create.l HWIO_TLMM_GPIO_CFG7_ADDR A:0xfd511070
y.create.l HWIO_TLMM_GPIO_CFG8_ADDR A:0xfd511080
y.create.l HWIO_TLMM_GPIO_CFG9_ADDR A:0xfd511090
y.create.l HWIO_TLMM_GPIO_IN_OUT0_ADDR A:0xfd511004
y.create.l HWIO_TLMM_GPIO_IN_OUT1_ADDR A:0xfd511014
y.create.l HWIO_TLMM_GPIO_IN_OUT2_ADDR A:0xfd511024
y.create.l HWIO_TLMM_GPIO_IN_OUT3_ADDR A:0xfd511034
y.create.l HWIO_TLMM_GPIO_IN_OUT4_ADDR A:0xfd511044
y.create.l HWIO_TLMM_GPIO_IN_OUT5_ADDR A:0xfd511054
y.create.l HWIO_TLMM_GPIO_IN_OUT6_ADDR A:0xfd511064
y.create.l HWIO_TLMM_GPIO_IN_OUT7_ADDR A:0xfd511074
y.create.l HWIO_TLMM_GPIO_IN_OUT8_ADDR A:0xfd511084
y.create.l HWIO_TLMM_GPIO_IN_OUT9_ADDR A:0xfd511094
y.create.l HWIO_TLMM_GPIO_INTR_CFG0_ADDR A:0xfd511008
y.create.l HWIO_TLMM_GPIO_INTR_CFG1_ADDR A:0xfd511018
y.create.l HWIO_TLMM_GPIO_INTR_CFG2_ADDR A:0xfd511028
y.create.l HWIO_TLMM_GPIO_INTR_CFG3_ADDR A:0xfd511038
y.create.l HWIO_TLMM_GPIO_INTR_CFG4_ADDR A:0xfd511048
y.create.l HWIO_TLMM_GPIO_INTR_CFG5_ADDR A:0xfd511058
y.create.l HWIO_TLMM_GPIO_INTR_CFG6_ADDR A:0xfd511068
y.create.l HWIO_TLMM_GPIO_INTR_CFG7_ADDR A:0xfd511078
y.create.l HWIO_TLMM_GPIO_INTR_CFG8_ADDR A:0xfd511088
y.create.l HWIO_TLMM_GPIO_INTR_CFG9_ADDR A:0xfd511098
y.create.l HWIO_TLMM_GPIO_INTR_STATUS0_ADDR A:0xfd51100c
y.create.l HWIO_TLMM_GPIO_INTR_STATUS1_ADDR A:0xfd51101c
y.create.l HWIO_TLMM_GPIO_INTR_STATUS2_ADDR A:0xfd51102c
y.create.l HWIO_TLMM_GPIO_INTR_STATUS3_ADDR A:0xfd51103c
y.create.l HWIO_TLMM_GPIO_INTR_STATUS4_ADDR A:0xfd51104c
y.create.l HWIO_TLMM_GPIO_INTR_STATUS5_ADDR A:0xfd51105c
y.create.l HWIO_TLMM_GPIO_INTR_STATUS6_ADDR A:0xfd51106c
y.create.l HWIO_TLMM_GPIO_INTR_STATUS7_ADDR A:0xfd51107c
y.create.l HWIO_TLMM_GPIO_INTR_STATUS8_ADDR A:0xfd51108c
y.create.l HWIO_TLMM_GPIO_INTR_STATUS9_ADDR A:0xfd51109c
y.create.l HWIO_TLMM_CLK_GATE_EN_ADDR A:0xfd512000
y.create.l HWIO_TLMM_IE_CTRL_DISABLE_ADDR A:0xfd512004
y.create.l HWIO_TLMM_MPM_WAKEUP_INT_EN_0_ADDR A:0xfd512008
y.create.l HWIO_TLMM_MPM_WAKEUP_INT_EN_1_ADDR A:0xfd51200c
y.create.l HWIO_TLMM_INT_JTAG_CTL_ADDR A:0xfd512010
y.create.l HWIO_TLMM_ETM_MODE_ADDR A:0xfd512014
y.create.l HWIO_TLMM_DBG_BUS_OUT_SEL_ADDR A:0xfd512018
y.create.l HWIO_TLMM_PERIPH_CHAR_TEST_MODE_ADDR A:0xfd51201c
y.create.l HWIO_TLMM_CHIP_MODE_ADDR A:0xfd512020
y.create.l HWIO_TLMM_HW_REVISION_NUMBER_ADDR A:0xfd512028
y.create.l HWIO_TLMM_SLIMBUS_CTL_ADDR A:0xfd512030
y.create.l HWIO_TLMM_RFFE_CTL_ADDR A:0xfd512034
y.create.l HWIO_TLMM_RESOUT_HDRV_CTL_ADDR A:0xfd512038
y.create.l HWIO_TLMM_JTAG_HDRV_CTL_ADDR A:0xfd51203c
y.create.l HWIO_TLMM_PMIC_HDRV_PULL_CTL_ADDR A:0xfd512040
y.create.l HWIO_TLMM_SDC1_HDRV_PULL_CTL_ADDR A:0xfd512044
y.create.l HWIO_TLMM_SDC2_HDRV_PULL_CTL_ADDR A:0xfd512048
y.create.l HWIO_TLMM_MODE_PULL_CTL_ADDR A:0xfd51204c
y.create.l HWIO_TLMM_GPIO_HSIC_STROBE_PAD_CTL_ADDR A:0xfd512050
y.create.l HWIO_TLMM_GPIO_HSIC_DATA_PAD_CTL_ADDR A:0xfd512054
y.create.l HWIO_TLMM_HSIC_CAL_PAD_CTL_ADDR A:0xfd512058
y.create.l HWIO_TLMM_EBI2_HDRV_PULL_CTL_ADDR A:0xfd51205c
y.create.l HWIO_TLMM_SPARE1_ADDR A:0xfd512060
y.create.l HWIO_TLMM_SPARE2_ADDR A:0xfd512064
y.create.l HWIO_TLMM_SPARE3_ADDR A:0xfd512068
y.create.l HWIO_TLMM_SPARE4_ADDR A:0xfd51206c
y.create.l HWIO_TLMM_DIR_CONN_INTR0_CFG_WCSS_ADDR A:0xfd512100
y.create.l HWIO_TLMM_DIR_CONN_INTR1_CFG_WCSS_ADDR A:0xfd512104
y.create.l HWIO_TLMM_DIR_CONN_INTR0_CFG_SENSORS_ADDR A:0xfd512200
y.create.l HWIO_TLMM_DIR_CONN_INTR1_CFG_SENSORS_ADDR A:0xfd512204
y.create.l HWIO_TLMM_DIR_CONN_INTR2_CFG_SENSORS_ADDR A:0xfd512208
y.create.l HWIO_TLMM_DIR_CONN_INTR3_CFG_SENSORS_ADDR A:0xfd51220c
y.create.l HWIO_TLMM_DIR_CONN_INTR4_CFG_SENSORS_ADDR A:0xfd512210
y.create.l HWIO_TLMM_DIR_CONN_INTR5_CFG_SENSORS_ADDR A:0xfd512214
y.create.l HWIO_TLMM_DIR_CONN_INTR6_CFG_SENSORS_ADDR A:0xfd512218
y.create.l HWIO_TLMM_DIR_CONN_INTR7_CFG_SENSORS_ADDR A:0xfd51221c
y.create.l HWIO_TLMM_DIR_CONN_INTR8_CFG_SENSORS_ADDR A:0xfd512220
y.create.l HWIO_TLMM_DIR_CONN_INTR9_CFG_SENSORS_ADDR A:0xfd512224
y.create.l HWIO_TLMM_DIR_CONN_INTR0_CFG_LPA_DSP_ADDR A:0xfd512500
y.create.l HWIO_TLMM_DIR_CONN_INTR1_CFG_LPA_DSP_ADDR A:0xfd512504
y.create.l HWIO_TLMM_DIR_CONN_INTR2_CFG_LPA_DSP_ADDR A:0xfd512508
y.create.l HWIO_TLMM_DIR_CONN_INTR3_CFG_LPA_DSP_ADDR A:0xfd51250c
y.create.l HWIO_TLMM_DIR_CONN_INTR4_CFG_LPA_DSP_ADDR A:0xfd512510
y.create.l HWIO_TLMM_DIR_CONN_INTR5_CFG_LPA_DSP_ADDR A:0xfd512514
y.create.l HWIO_TLMM_DIR_CONN_INTR0_CFG_RPM_ADDR A:0xfd512700
y.create.l HWIO_TLMM_DIR_CONN_INTR0_CFG_KPSS_ADDR A:0xfd512800
y.create.l HWIO_TLMM_DIR_CONN_INTR1_CFG_KPSS_ADDR A:0xfd512804
y.create.l HWIO_TLMM_DIR_CONN_INTR2_CFG_KPSS_ADDR A:0xfd512808
y.create.l HWIO_TLMM_DIR_CONN_INTR3_CFG_KPSS_ADDR A:0xfd51280c
y.create.l HWIO_TLMM_DIR_CONN_INTR4_CFG_KPSS_ADDR A:0xfd512810
y.create.l HWIO_TLMM_DIR_CONN_INTR5_CFG_KPSS_ADDR A:0xfd512814
y.create.l HWIO_TLMM_DIR_CONN_INTR6_CFG_KPSS_ADDR A:0xfd512818
y.create.l HWIO_TLMM_DIR_CONN_INTR7_CFG_KPSS_ADDR A:0xfd51281c
y.create.l HWIO_TLMM_DIR_CONN_INTR0_CFG_MSS_ADDR A:0xfd512a00
y.create.l HWIO_TLMM_DIR_CONN_INTR1_CFG_MSS_ADDR A:0xfd512a04
y.create.l HWIO_TLMM_GPIO_OUT_0_ADDR A:0xfd513000
y.create.l HWIO_TLMM_GPIO_OUT_1_ADDR A:0xfd513004
y.create.l HWIO_TLMM_GPIO_OUT_2_ADDR A:0xfd513008
y.create.l HWIO_TLMM_GPIO_OUT_CLR_0_ADDR A:0xfd513020
y.create.l HWIO_TLMM_GPIO_OUT_CLR_1_ADDR A:0xfd513024
y.create.l HWIO_TLMM_GPIO_OUT_CLR_2_ADDR A:0xfd513028
y.create.l HWIO_TLMM_GPIO_OUT_SET_0_ADDR A:0xfd513040
y.create.l HWIO_TLMM_GPIO_OUT_SET_1_ADDR A:0xfd513044
y.create.l HWIO_TLMM_GPIO_OUT_SET_2_ADDR A:0xfd513048
y.create.l HWIO_TLMM_GPIO_IN_0_ADDR A:0xfd513060
y.create.l HWIO_TLMM_GPIO_IN_1_ADDR A:0xfd513064
y.create.l HWIO_TLMM_GPIO_IN_2_ADDR A:0xfd513068
y.create.l HWIO_TLMM_GPIO_OE_0_ADDR A:0xfd513080
y.create.l HWIO_TLMM_GPIO_OE_1_ADDR A:0xfd513084
y.create.l HWIO_TLMM_GPIO_OE_2_ADDR A:0xfd513088
y.create.l HWIO_TLMM_GPIO_OE_CLR_0_ADDR A:0xfd513100
y.create.l HWIO_TLMM_GPIO_OE_CLR_1_ADDR A:0xfd513104
y.create.l HWIO_TLMM_GPIO_OE_CLR_2_ADDR A:0xfd513108
y.create.l HWIO_TLMM_GPIO_OE_SET_0_ADDR A:0xfd513120
y.create.l HWIO_TLMM_GPIO_OE_SET_1_ADDR A:0xfd513124
y.create.l HWIO_TLMM_GPIO_OE_SET_2_ADDR A:0xfd513128
y.create.l HWIO_GUSB2PHYCFG_REGS_0_GUSB2PHYCFG_ADDR A:0xf920c200
y.create.l HWIO_GUSB2I2CCTL_REGS_0_GUSB2I2CCTL_ADDR A:0xf920c240
y.create.l HWIO_GUSB2PHYACC_REGS_0_GUSB2PHYACC_ULPI_ADDR A:0xf920c280
y.create.l HWIO_GUSB3PIPECTL_REGS_0_GUSB3PIPECTL_ADDR A:0xf920c2c0
y.create.l HWIO_GTXFIFOSIZ_REGS_0_GTXFIFOSIZ0_ADDR A:0xf920c300
y.create.l HWIO_GTXFIFOSIZ_REGS_0_GTXFIFOSIZ1_ADDR A:0xf920c304
y.create.l HWIO_GTXFIFOSIZ_REGS_0_GTXFIFOSIZ2_ADDR A:0xf920c308
y.create.l HWIO_GTXFIFOSIZ_REGS_0_GTXFIFOSIZ3_ADDR A:0xf920c30c
y.create.l HWIO_GTXFIFOSIZ_REGS_0_GTXFIFOSIZ4_ADDR A:0xf920c310
y.create.l HWIO_GTXFIFOSIZ_REGS_0_GTXFIFOSIZ5_ADDR A:0xf920c314
y.create.l HWIO_GTXFIFOSIZ_REGS_0_GTXFIFOSIZ6_ADDR A:0xf920c318
y.create.l HWIO_GTXFIFOSIZ_REGS_0_GTXFIFOSIZ7_ADDR A:0xf920c31c
y.create.l HWIO_GTXFIFOSIZ_REGS_0_GTXFIFOSIZ8_ADDR A:0xf920c320
y.create.l HWIO_GTXFIFOSIZ_REGS_0_GTXFIFOSIZ9_ADDR A:0xf920c324
y.create.l HWIO_GTXFIFOSIZ_REGS_0_GTXFIFOSIZ10_ADDR A:0xf920c328
y.create.l HWIO_GTXFIFOSIZ_REGS_0_GTXFIFOSIZ11_ADDR A:0xf920c32c
y.create.l HWIO_GTXFIFOSIZ_REGS_0_GTXFIFOSIZ12_ADDR A:0xf920c330
y.create.l HWIO_GTXFIFOSIZ_REGS_0_GTXFIFOSIZ13_ADDR A:0xf920c334
y.create.l HWIO_GTXFIFOSIZ_REGS_0_GTXFIFOSIZ14_ADDR A:0xf920c338
y.create.l HWIO_GTXFIFOSIZ_REGS_0_GTXFIFOSIZ15_ADDR A:0xf920c33c
y.create.l HWIO_GRXFIFOSIZ_REGS_0_GRXFIFOSIZ0_ADDR A:0xf920c380
y.create.l HWIO_GRXFIFOSIZ_REGS_0_GRXFIFOSIZ1_ADDR A:0xf920c384
y.create.l HWIO_GRXFIFOSIZ_REGS_0_GRXFIFOSIZ2_ADDR A:0xf920c388
y.create.l HWIO_GEVNTADRLO_REGS_0_GEVNTADRLO_ADDR A:0xf920c400
y.create.l HWIO_GEVNTADRLO_REGS_1_GEVNTADRLO_ADDR A:0xf920c410
y.create.l HWIO_GEVNTADRLO_REGS_0_GEVNTADRHI_ADDR A:0xf920c404
y.create.l HWIO_GEVNTADRLO_REGS_1_GEVNTADRHI_ADDR A:0xf920c414
y.create.l HWIO_GEVNTADRLO_REGS_0_GEVNTSIZ_ADDR A:0xf920c408
y.create.l HWIO_GEVNTADRLO_REGS_1_GEVNTSIZ_ADDR A:0xf920c418
y.create.l HWIO_GEVNTADRLO_REGS_0_GEVNTCOUNT_ADDR A:0xf920c40c
y.create.l HWIO_GEVNTADRLO_REGS_1_GEVNTCOUNT_ADDR A:0xf920c41c
y.create.l HWIO_GSBUSCFG0_ADDR A:0xf920c100
y.create.l HWIO_GSBUSCFG1_ADDR A:0xf920c104
y.create.l HWIO_GTXTHRCFG_ADDR A:0xf920c108
y.create.l HWIO_GRXTHRCFG_ADDR A:0xf920c10c
y.create.l HWIO_GCTL_ADDR A:0xf920c110
y.create.l HWIO_GPMSTS_ADDR A:0xf920c114
y.create.l HWIO_GSTS_ADDR A:0xf920c118
y.create.l HWIO_GUCTL1_ADDR A:0xf920c11c
y.create.l HWIO_GSNPSID_ADDR A:0xf920c120
y.create.l HWIO_GGPIO_ADDR A:0xf920c124
y.create.l HWIO_GUID_ADDR A:0xf920c128
y.create.l HWIO_GUCTL_ADDR A:0xf920c12c
y.create.l HWIO_GBUSERRADDRLO_ADDR A:0xf920c130
y.create.l HWIO_GBUSERRADDRHI_ADDR A:0xf920c134
y.create.l HWIO_GPRTBIMAPLO_ADDR A:0xf920c138
y.create.l HWIO_GPRTBIMAPHI_ADDR A:0xf920c13c
y.create.l HWIO_GHWPARAMS0_ADDR A:0xf920c140
y.create.l HWIO_GHWPARAMS1_ADDR A:0xf920c144
y.create.l HWIO_GHWPARAMS2_ADDR A:0xf920c148
y.create.l HWIO_GHWPARAMS3_ADDR A:0xf920c14c
y.create.l HWIO_GHWPARAMS4_ADDR A:0xf920c150
y.create.l HWIO_GHWPARAMS5_ADDR A:0xf920c154
y.create.l HWIO_GHWPARAMS6_ADDR A:0xf920c158
y.create.l HWIO_GHWPARAMS7_ADDR A:0xf920c15c
y.create.l HWIO_GDBGFIFOSPACE_ADDR A:0xf920c160
y.create.l HWIO_GDBGLTSSM_ADDR A:0xf920c164
y.create.l HWIO_GDBGLNMCC_ADDR A:0xf920c168
y.create.l HWIO_GDBGBMU_ADDR A:0xf920c16c
y.create.l HWIO_GDBGLSPMUX_HST_ADDR A:0xf920c170
y.create.l HWIO_GDBGLSP_ADDR A:0xf920c174
y.create.l HWIO_GDBGEPINFO0_ADDR A:0xf920c178
y.create.l HWIO_GDBGEPINFO1_ADDR A:0xf920c17c
y.create.l HWIO_GPRTBIMAP_HSLO_ADDR A:0xf920c180
y.create.l HWIO_GPRTBIMAP_HSHI_ADDR A:0xf920c184
y.create.l HWIO_GPRTBIMAP_FSLO_ADDR A:0xf920c188
y.create.l HWIO_GPRTBIMAP_FSHI_ADDR A:0xf920c18c
y.create.l HWIO_GHWPARAMS8_ADDR A:0xf920c600
y.create.l HWIO_GTXFIFOPRIDEV_ADDR A:0xf920c610
y.create.l HWIO_GTXFIFOPRIHST_ADDR A:0xf920c618
y.create.l HWIO_GRXFIFOPRIHST_ADDR A:0xf920c61c
y.create.l HWIO_GDMAHLRATIO_ADDR A:0xf920c624
y.create.l HWIO_GFLADJ_ADDR A:0xf920c630
y.create.l HWIO_RSVD_REGS_0_RSVD_ADDR A:0xf920c780
y.create.l HWIO_RSVD_REGS_1_RSVD_ADDR A:0xf920c784
y.create.l HWIO_RSVD_REGS_2_RSVD_ADDR A:0xf920c788
y.create.l HWIO_RSVD_REGS_3_RSVD_ADDR A:0xf920c78c
y.create.l HWIO_RSVD_REGS_4_RSVD_ADDR A:0xf920c790
y.create.l HWIO_RSVD_REGS_5_RSVD_ADDR A:0xf920c794
y.create.l HWIO_RSVD_REGS_6_RSVD_ADDR A:0xf920c798
y.create.l HWIO_RSVD_REGS_7_RSVD_ADDR A:0xf920c79c
y.create.l HWIO_RSVD_REGS_8_RSVD_ADDR A:0xf920c7a0
y.create.l HWIO_RSVD_REGS_9_RSVD_ADDR A:0xf920c7a4
y.create.l HWIO_DEPCMDPAR2_REGS_0_DEPCMDPAR2_ADDR A:0xf920c800
y.create.l HWIO_DEPCMDPAR2_REGS_1_DEPCMDPAR2_ADDR A:0xf920c810
y.create.l HWIO_DEPCMDPAR2_REGS_2_DEPCMDPAR2_ADDR A:0xf920c820
y.create.l HWIO_DEPCMDPAR2_REGS_3_DEPCMDPAR2_ADDR A:0xf920c830
y.create.l HWIO_DEPCMDPAR2_REGS_4_DEPCMDPAR2_ADDR A:0xf920c840
y.create.l HWIO_DEPCMDPAR2_REGS_5_DEPCMDPAR2_ADDR A:0xf920c850
y.create.l HWIO_DEPCMDPAR2_REGS_6_DEPCMDPAR2_ADDR A:0xf920c860
y.create.l HWIO_DEPCMDPAR2_REGS_7_DEPCMDPAR2_ADDR A:0xf920c870
y.create.l HWIO_DEPCMDPAR2_REGS_8_DEPCMDPAR2_ADDR A:0xf920c880
y.create.l HWIO_DEPCMDPAR2_REGS_9_DEPCMDPAR2_ADDR A:0xf920c890
y.create.l HWIO_DEPCMDPAR2_REGS_0_DEPCMDPAR1_ADDR A:0xf920c804
y.create.l HWIO_DEPCMDPAR2_REGS_1_DEPCMDPAR1_ADDR A:0xf920c814
y.create.l HWIO_DEPCMDPAR2_REGS_2_DEPCMDPAR1_ADDR A:0xf920c824
y.create.l HWIO_DEPCMDPAR2_REGS_3_DEPCMDPAR1_ADDR A:0xf920c834
y.create.l HWIO_DEPCMDPAR2_REGS_4_DEPCMDPAR1_ADDR A:0xf920c844
y.create.l HWIO_DEPCMDPAR2_REGS_5_DEPCMDPAR1_ADDR A:0xf920c854
y.create.l HWIO_DEPCMDPAR2_REGS_6_DEPCMDPAR1_ADDR A:0xf920c864
y.create.l HWIO_DEPCMDPAR2_REGS_7_DEPCMDPAR1_ADDR A:0xf920c874
y.create.l HWIO_DEPCMDPAR2_REGS_8_DEPCMDPAR1_ADDR A:0xf920c884
y.create.l HWIO_DEPCMDPAR2_REGS_9_DEPCMDPAR1_ADDR A:0xf920c894
y.create.l HWIO_DEPCMDPAR2_REGS_0_DEPCMDPAR0_ADDR A:0xf920c808
y.create.l HWIO_DEPCMDPAR2_REGS_1_DEPCMDPAR0_ADDR A:0xf920c818
y.create.l HWIO_DEPCMDPAR2_REGS_2_DEPCMDPAR0_ADDR A:0xf920c828
y.create.l HWIO_DEPCMDPAR2_REGS_3_DEPCMDPAR0_ADDR A:0xf920c838
y.create.l HWIO_DEPCMDPAR2_REGS_4_DEPCMDPAR0_ADDR A:0xf920c848
y.create.l HWIO_DEPCMDPAR2_REGS_5_DEPCMDPAR0_ADDR A:0xf920c858
y.create.l HWIO_DEPCMDPAR2_REGS_6_DEPCMDPAR0_ADDR A:0xf920c868
y.create.l HWIO_DEPCMDPAR2_REGS_7_DEPCMDPAR0_ADDR A:0xf920c878
y.create.l HWIO_DEPCMDPAR2_REGS_8_DEPCMDPAR0_ADDR A:0xf920c888
y.create.l HWIO_DEPCMDPAR2_REGS_9_DEPCMDPAR0_ADDR A:0xf920c898
y.create.l HWIO_DEPCMDPAR2_REGS_0_DEPCMD_ADDR A:0xf920c80c
y.create.l HWIO_DEPCMDPAR2_REGS_1_DEPCMD_ADDR A:0xf920c81c
y.create.l HWIO_DEPCMDPAR2_REGS_2_DEPCMD_ADDR A:0xf920c82c
y.create.l HWIO_DEPCMDPAR2_REGS_3_DEPCMD_ADDR A:0xf920c83c
y.create.l HWIO_DEPCMDPAR2_REGS_4_DEPCMD_ADDR A:0xf920c84c
y.create.l HWIO_DEPCMDPAR2_REGS_5_DEPCMD_ADDR A:0xf920c85c
y.create.l HWIO_DEPCMDPAR2_REGS_6_DEPCMD_ADDR A:0xf920c86c
y.create.l HWIO_DEPCMDPAR2_REGS_7_DEPCMD_ADDR A:0xf920c87c
y.create.l HWIO_DEPCMDPAR2_REGS_8_DEPCMD_ADDR A:0xf920c88c
y.create.l HWIO_DEPCMDPAR2_REGS_9_DEPCMD_ADDR A:0xf920c89c
y.create.l HWIO_DCFG_ADDR A:0xf920c700
y.create.l HWIO_DCTL_ADDR A:0xf920c704
y.create.l HWIO_DEVTEN_ADDR A:0xf920c708
y.create.l HWIO_DSTS_ADDR A:0xf920c70c
y.create.l HWIO_DGCMDPAR_ADDR A:0xf920c710
y.create.l HWIO_DGCMD_ADDR A:0xf920c714
y.create.l HWIO_DALEPENA_ADDR A:0xf920c720
y.create.l HWIO_OCFG_ADDR A:0xf920cc00
y.create.l HWIO_OCTL_ADDR A:0xf920cc04
y.create.l HWIO_OEVT_ADDR A:0xf920cc08
y.create.l HWIO_OEVTEN_ADDR A:0xf920cc0c
y.create.l HWIO_OSTS_ADDR A:0xf920cc10
y.create.l HWIO_ADPEVT_ADDR A:0xf920cc28
y.create.l HWIO_RSVD_HC_REGS_0_RSVD_HC_ADDR A:0xf920001c
y.create.l HWIO_CAPLENGTH_ADDR A:0xf9200000
y.create.l HWIO_HCSPARAMS1_ADDR A:0xf9200004
y.create.l HWIO_HCSPARAMS2_ADDR A:0xf9200008
y.create.l HWIO_HCSPARAMS3_ADDR A:0xf920000c
y.create.l HWIO_HCCPARAMS_ADDR A:0xf9200010
y.create.l HWIO_DBOFF_ADDR A:0xf9200014
y.create.l HWIO_RTSOFF_ADDR A:0xf9200018
y.create.l HWIO_USBCMD_ADDR A:0xf9200020
y.create.l HWIO_USBSTS_ADDR A:0xf9200024
y.create.l HWIO_PAGESIZE_ADDR A:0xf9200028
y.create.l HWIO_DNCTRL_ADDR A:0xf9200034
y.create.l HWIO_CRCR_LO_ADDR A:0xf9200038
y.create.l HWIO_CRCR_HI_ADDR A:0xf920003c
y.create.l HWIO_DCBAAP_LO_ADDR A:0xf9200050
y.create.l HWIO_DCBAAP_HI_ADDR A:0xf9200054
y.create.l HWIO_CONFIG_ADDR A:0xf9200058
y.create.l HWIO_PORTSC_REGS_0_PORTSC_ADDR A:0xf9200420
y.create.l HWIO_PORTSC_REGS_1_PORTSC_ADDR A:0xf9200430
y.create.l HWIO_PORTSC_REGS_0_PORTPMSC_ADDR A:0xf9200424
y.create.l HWIO_PORTSC_REGS_1_PORTPMSC_ADDR A:0xf9200434
y.create.l HWIO_PORTSC_REGS_0_PORTLI_ADDR A:0xf9200428
y.create.l HWIO_PORTSC_REGS_1_PORTLI_ADDR A:0xf9200438
y.create.l HWIO_PORTSC_REGS_0_PORTHLPMC_ADDR A:0xf920042c
y.create.l HWIO_PORTSC_REGS_1_PORTHLPMC_ADDR A:0xf920043c
y.create.l HWIO_MFINDEX_ADDR A:0xf9200440
y.create.l HWIO_RSVDZ_ADDR A:0xf9200444
y.create.l HWIO_IMAN_REGS_0_IMAN_ADDR A:0xf9200460
y.create.l HWIO_IMAN_REGS_1_IMAN_ADDR A:0xf9200480
y.create.l HWIO_IMAN_REGS_0_IMOD_ADDR A:0xf9200464
y.create.l HWIO_IMAN_REGS_1_IMOD_ADDR A:0xf9200484
y.create.l HWIO_IMAN_REGS_0_ERSTSZ_ADDR A:0xf9200468
y.create.l HWIO_IMAN_REGS_1_ERSTSZ_ADDR A:0xf9200488
y.create.l HWIO_IMAN_REGS_0_RSVDP_ADDR A:0xf920046c
y.create.l HWIO_IMAN_REGS_1_RSVDP_ADDR A:0xf920048c
y.create.l HWIO_IMAN_REGS_0_ERSTBA_LO_ADDR A:0xf9200470
y.create.l HWIO_IMAN_REGS_1_ERSTBA_LO_ADDR A:0xf9200490
y.create.l HWIO_IMAN_REGS_0_ERSTBA_HI_ADDR A:0xf9200474
y.create.l HWIO_IMAN_REGS_1_ERSTBA_HI_ADDR A:0xf9200494
y.create.l HWIO_IMAN_REGS_0_ERDP_LO_ADDR A:0xf9200478
y.create.l HWIO_IMAN_REGS_1_ERDP_LO_ADDR A:0xf9200498
y.create.l HWIO_IMAN_REGS_0_ERDP_HI_ADDR A:0xf920047c
y.create.l HWIO_IMAN_REGS_1_ERDP_HI_ADDR A:0xf920049c
y.create.l HWIO_DB_REGS_0_DB_ADDR A:0xf92004a0
y.create.l HWIO_DB_REGS_1_DB_ADDR A:0xf92004a4
y.create.l HWIO_DB_REGS_2_DB_ADDR A:0xf92004a8
y.create.l HWIO_DB_REGS_3_DB_ADDR A:0xf92004ac
y.create.l HWIO_DB_REGS_4_DB_ADDR A:0xf92004b0
y.create.l HWIO_DB_REGS_5_DB_ADDR A:0xf92004b4
y.create.l HWIO_DB_REGS_6_DB_ADDR A:0xf92004b8
y.create.l HWIO_DB_REGS_7_DB_ADDR A:0xf92004bc
y.create.l HWIO_DB_REGS_8_DB_ADDR A:0xf92004c0
y.create.l HWIO_DB_REGS_9_DB_ADDR A:0xf92004c4
y.create.l HWIO_USBLEGSUP_ADDR A:0xf92008a0
y.create.l HWIO_USBLEGCTLSTS_ADDR A:0xf92008a4
y.create.l HWIO_SUPTPRT2_DW0_ADDR A:0xf92008b0
y.create.l HWIO_SUPTPRT2_DW1_ADDR A:0xf92008b4
y.create.l HWIO_SUPTPRT2_DW2_ADDR A:0xf92008b8
y.create.l HWIO_SUPTPRT2_DW3_ADDR A:0xf92008bc
y.create.l HWIO_SUPTPRT3_DW0_ADDR A:0xf92008c0
y.create.l HWIO_SUPTPRT3_DW1_ADDR A:0xf92008c4
y.create.l HWIO_SUPTPRT3_DW2_ADDR A:0xf92008c8
y.create.l HWIO_SUPTPRT3_DW3_ADDR A:0xf92008cc
y.create.l HWIO_GP_REG_0_ADDR A:0xf92f8400
y.create.l HWIO_GP_REG_1_ADDR A:0xf92f8404
y.create.l HWIO_GP_REG_2_ADDR A:0xf92f8408
y.create.l HWIO_GP_REG_3_ADDR A:0xf92f840c
y.create.l HWIO_GP_REG_4_ADDR A:0xf92f8410
y.create.l HWIO_GP_REG_5_ADDR A:0xf92f8414
y.create.l HWIO_GP_REG_6_ADDR A:0xf92f8418
y.create.l HWIO_GP_REG_7_ADDR A:0xf92f841c
y.create.l HWIO_GP_REG_8_ADDR A:0xf92f8420
y.create.l HWIO_GP_REG_9_ADDR A:0xf92f8424
y.create.l HWIO_IPCAT_REG_ADDR A:0xf92f8800
y.create.l HWIO_CTRL_REG_ADDR A:0xf92f8804
y.create.l HWIO_GENERAL_CFG_ADDR A:0xf92f8808
y.create.l HWIO_RAM1_REG_ADDR A:0xf92f880c
y.create.l HWIO_HS_PHY_CTRL_ADDR A:0xf92f8810
y.create.l HWIO_PARAMETER_OVERRIDE_X_ADDR A:0xf92f8814
y.create.l HWIO_CHARGING_DET_CTRL_ADDR A:0xf92f8818
y.create.l HWIO_CHARGING_DET_OUTPUT_ADDR A:0xf92f881c
y.create.l HWIO_ALT_INTERRUPT_EN_ADDR A:0xf92f8820
y.create.l HWIO_HS_PHY_IRQ_STAT_ADDR A:0xf92f8824
y.create.l HWIO_CGCTL_REG_ADDR A:0xf92f8828
y.create.l HWIO_DBG_BUS_REG_ADDR A:0xf92f882c
y.create.l HWIO_SS_PHY_CTRL_ADDR A:0xf92f8830
y.create.l HWIO_SS_PHY_PARAM_CTRL_1_ADDR A:0xf92f8834
y.create.l HWIO_SS_PHY_PARAM_CTRL_2_ADDR A:0xf92f8838
y.create.l HWIO_SS_CR_PROTOCOL_DATA_IN_ADDR A:0xf92f883c
y.create.l HWIO_SS_CR_PROTOCOL_DATA_OUT_ADDR A:0xf92f8840
y.create.l HWIO_SS_CR_PROTOCOL_CAP_ADDR_ADDR A:0xf92f8844
y.create.l HWIO_SS_CR_PROTOCOL_CAP_DATA_ADDR A:0xf92f8848
y.create.l HWIO_SS_CR_PROTOCOL_READ_ADDR A:0xf92f884c
y.create.l HWIO_SS_CR_PROTOCOL_WRITE_ADDR A:0xf92f8850
y.create.l HWIO_SS_STATUS_READ_ONLY_ADDR A:0xf92f8854
y.create.l HWIO_PWR_EVNT_IRQ_STAT_ADDR A:0xf92f8858
y.create.l HWIO_PWR_EVNT_IRQ_MASK_ADDR A:0xf92f885c
y.create.l HWIO_HW_SW_EVT_CTRL_REG_ADDR A:0xf92f8860
y.create.l HWIO_VMIDMT_AMEMTYPE_CTRL_REG_ADDR A:0xf92f8864
y.create.l HWIO_FLADJ_30MHZ_REG_ADDR A:0xf92f8868
y.create.l HWIO_M_AW_USER_REG_ADDR A:0xf92f886c
y.create.l HWIO_M_AR_USER_REG_ADDR A:0xf92f8870
y.create.l HWIO_HS_RX_TESTER_1_REG_ADDR A:0xf92f8874
y.create.l HWIO_HS_PHY_TEST_ADDR A:0xf92f8878
y.create.l HWIO_HS_PHY_CTRL_2_ADDR A:0xf92f887c
y.create.l HWIO_PARAMETER_OVERRIDE_X_2_ADDR A:0xf92f8880
y.create.l HWIO_CHARGING_DET_CTRL_2_ADDR A:0xf92f8884
y.create.l HWIO_CHARGING_DET_OUTPUT_2_ADDR A:0xf92f8888
y.create.l HWIO_ALT_INTERRUPT_EN_2_ADDR A:0xf92f888c
y.create.l HWIO_HS_PHY_IRQ_STAT_2_ADDR A:0xf92f8890
y.create.l HWIO_HS_PHY_TEST_2_ADDR A:0xf92f8894
y.create.l HWIO_HS_PHY_CTRL_3_ADDR A:0xf92f8898
y.create.l HWIO_PARAMETER_OVERRIDE_X_3_ADDR A:0xf92f889c
y.create.l HWIO_CHARGING_DET_CTRL_3_ADDR A:0xf92f88a0
y.create.l HWIO_CHARGING_DET_OUTPUT_3_ADDR A:0xf92f88a4
y.create.l HWIO_ALT_INTERRUPT_EN_3_ADDR A:0xf92f88a8
y.create.l HWIO_HS_PHY_IRQ_STAT_3_ADDR A:0xf92f88ac
y.create.l HWIO_HS_PHY_TEST_3_ADDR A:0xf92f88b0
y.create.l HWIO_QSCRTCH_REG_0_ADDR A:0xf92f88b4
y.create.l HWIO_QSCRTCH_REG_1_ADDR A:0xf92f88b8
y.create.l HWIO_QSCRTCH_REG_2_ADDR A:0xf92f88bc
y.create.l HWIO_QSCRTCH_REG_3_ADDR A:0xf92f88c0
y.create.l HWIO_QSCRTCH_REG_4_ADDR A:0xf92f88c4
y.create.l HWIO_SS_PHY_CTRL_2_ADDR A:0xf92f88c8
y.create.l HWIO_HS_PHY_TEST_OUT_1_ADDR A:0xf92f88cc
y.create.l HWIO_HS_PHY_TEST_OUT_2_ADDR A:0xf92f88d0
y.create.l HWIO_HS_PHY_TEST_OUT_3_ADDR A:0xf92f88d4
y.create.l HWIO_HS_RX_TESTER_2_ADDR A:0xf92f88d8
y.create.l HWIO_HS_RX_TESTER_3_ADDR A:0xf92f88dc
y.create.l HWIO_HS_RX_TESTER_OUT_1_ADDR A:0xf92f88e0
y.create.l HWIO_HS_RX_TESTER_OUT_2_ADDR A:0xf92f88e4
y.create.l HWIO_HS_RX_TESTER_OUT_3_ADDR A:0xf92f88e8
y.create.l HWIO_HS_PHY_CTRL_COMMON_ADDR A:0xf92f88ec
y.create.l HWIO_SS_QMP_PHY_CTRL_ADDR A:0xf92f88f0
y.create.l HWIO_SNPS_CORE_CFG_ADDR A:0xf92f88f4
y.create.l HWIO_DBM_EP_CFG_ADDR0_ADDR A:0xf92f8000
y.create.l HWIO_DBM_EP_CFG_ADDR1_ADDR A:0xf92f8004
y.create.l HWIO_DBM_EP_CFG_ADDR2_ADDR A:0xf92f8008
y.create.l HWIO_DBM_EP_CFG_ADDR3_ADDR A:0xf92f800c
y.create.l HWIO_DBM_EP_CFG_ADDR4_ADDR A:0xf92f8010
y.create.l HWIO_DBM_EP_CFG_ADDR5_ADDR A:0xf92f8014
y.create.l HWIO_DBM_EP_CFG_ADDR6_ADDR A:0xf92f8018
y.create.l HWIO_DBM_EP_CFG_ADDR7_ADDR A:0xf92f801c
y.create.l HWIO_DBM_DATA_SIZE_ADDR0_ADDR A:0xf92f8080
y.create.l HWIO_DBM_DATA_SIZE_ADDR1_ADDR A:0xf92f8084
y.create.l HWIO_DBM_DATA_SIZE_ADDR2_ADDR A:0xf92f8088
y.create.l HWIO_DBM_DATA_SIZE_ADDR3_ADDR A:0xf92f808c
y.create.l HWIO_DBM_DATA_SIZE_ADDR4_ADDR A:0xf92f8090
y.create.l HWIO_DBM_DATA_SIZE_ADDR5_ADDR A:0xf92f8094
y.create.l HWIO_DBM_DATA_SIZE_ADDR6_ADDR A:0xf92f8098
y.create.l HWIO_DBM_DATA_SIZE_ADDR7_ADDR A:0xf92f809c
y.create.l HWIO_DBM_DATA_FIFO_ADDR_LSB0_ADDR A:0xf92f8100
y.create.l HWIO_DBM_DATA_FIFO_ADDR_LSB1_ADDR A:0xf92f8108
y.create.l HWIO_DBM_DATA_FIFO_ADDR_LSB2_ADDR A:0xf92f8110
y.create.l HWIO_DBM_DATA_FIFO_ADDR_LSB3_ADDR A:0xf92f8118
y.create.l HWIO_DBM_DATA_FIFO_ADDR_LSB4_ADDR A:0xf92f8120
y.create.l HWIO_DBM_DATA_FIFO_ADDR_LSB5_ADDR A:0xf92f8128
y.create.l HWIO_DBM_DATA_FIFO_ADDR_LSB6_ADDR A:0xf92f8130
y.create.l HWIO_DBM_DATA_FIFO_ADDR_LSB7_ADDR A:0xf92f8138
y.create.l HWIO_DBM_DATA_FIFO_ADDR_MSB0_ADDR A:0xf92f8104
y.create.l HWIO_DBM_DATA_FIFO_ADDR_MSB1_ADDR A:0xf92f810c
y.create.l HWIO_DBM_DATA_FIFO_ADDR_MSB2_ADDR A:0xf92f8114
y.create.l HWIO_DBM_DATA_FIFO_ADDR_MSB3_ADDR A:0xf92f811c
y.create.l HWIO_DBM_DATA_FIFO_ADDR_MSB4_ADDR A:0xf92f8124
y.create.l HWIO_DBM_DATA_FIFO_ADDR_MSB5_ADDR A:0xf92f812c
y.create.l HWIO_DBM_DATA_FIFO_ADDR_MSB6_ADDR A:0xf92f8134
y.create.l HWIO_DBM_DATA_FIFO_ADDR_MSB7_ADDR A:0xf92f813c
y.create.l HWIO_DBM_DATA_FIFO_ADDR_EN_ADDR A:0xf92f8200
y.create.l HWIO_DBM_DATA_FIFO_SIZE_EN_ADDR A:0xf92f8204
y.create.l HWIO_DBM_DBG_CNFG_ADDR A:0xf92f8208
y.create.l HWIO_DBM_SOFT_RESET_ADDR A:0xf92f820c
y.create.l HWIO_DBM_GEN_CFG_ADDR A:0xf92f8210
y.create.l HWIO_DBM_STATUS_ADDR A:0xf92f8214
y.create.l HWIO_DBM_STATES_ADDR A:0xf92f8218
y.create.l HWIO_DBM_HW_TRB0_EP0_ADDR A:0xf92f8220
y.create.l HWIO_DBM_HW_TRB0_EP1_ADDR A:0xf92f8224
y.create.l HWIO_DBM_HW_TRB0_EP2_ADDR A:0xf92f8228
y.create.l HWIO_DBM_HW_TRB0_EP3_ADDR A:0xf92f822c
y.create.l HWIO_DBM_HW_TRB1_EP0_ADDR A:0xf92f8230
y.create.l HWIO_DBM_HW_TRB1_EP1_ADDR A:0xf92f8234
y.create.l HWIO_DBM_HW_TRB1_EP2_ADDR A:0xf92f8238
y.create.l HWIO_DBM_HW_TRB1_EP3_ADDR A:0xf92f823c
y.create.l HWIO_DBM_HW_TRB2_EP0_ADDR A:0xf92f8240
y.create.l HWIO_DBM_HW_TRB2_EP1_ADDR A:0xf92f8244
y.create.l HWIO_DBM_HW_TRB2_EP2_ADDR A:0xf92f8248
y.create.l HWIO_DBM_HW_TRB2_EP3_ADDR A:0xf92f824c
y.create.l HWIO_DBM_HW_TRB3_EP0_ADDR A:0xf92f8250
y.create.l HWIO_DBM_HW_TRB3_EP1_ADDR A:0xf92f8254
y.create.l HWIO_DBM_HW_TRB3_EP2_ADDR A:0xf92f8258
y.create.l HWIO_DBM_HW_TRB3_EP3_ADDR A:0xf92f825c
y.create.l HWIO_DBM_GEVNTADR_LSB_ADDR A:0xf92f8260
y.create.l HWIO_DBM_GEVNTADR_MSB_ADDR A:0xf92f8264
y.create.l HWIO_DBM_GEVNTSIZ_ADDR A:0xf92f8268
y.create.l HWIO_DBM_DATA_FIFO_EN_ADDR A:0xf92f826c
y.create.l HWIO_DBM_GEVNTADR_ADDR A:0xf92f8270
y.create.l HWIO_DBM_PIPE_CFG_ADDR A:0xf92f8274
y.create.l HWIO_INACTIVITY_TIMER_ADDR A:0xf92f8278
y.create.l HWIO_DBM_DATA_FIFO_ADDR0_ADDR A:0xf92f8280
y.create.l HWIO_DBM_DATA_FIFO_ADDR1_ADDR A:0xf92f8284
y.create.l HWIO_DBM_DATA_FIFO_ADDR2_ADDR A:0xf92f8288
y.create.l HWIO_DBM_DATA_FIFO_ADDR3_ADDR A:0xf92f828c
y.create.l HWIO_DBM_DATA_FIFO_ADDR4_ADDR A:0xf92f8290
y.create.l HWIO_DBM_DATA_FIFO_ADDR5_ADDR A:0xf92f8294
y.create.l HWIO_DBM_DATA_FIFO_ADDR6_ADDR A:0xf92f8298
y.create.l HWIO_DBM_DATA_FIFO_ADDR7_ADDR A:0xf92f829c
y.create.l HWIO_USB30_VMIDMT_SCR0_ADDR A:0xf92f9000
y.create.l HWIO_USB30_VMIDMT_SCR1_ADDR A:0xf92f9004
y.create.l HWIO_USB30_VMIDMT_SCR2_ADDR A:0xf92f9008
y.create.l HWIO_USB30_VMIDMT_SACR_ADDR A:0xf92f9010
y.create.l HWIO_USB30_VMIDMT_SIDR0_ADDR A:0xf92f9020
y.create.l HWIO_USB30_VMIDMT_SIDR1_ADDR A:0xf92f9024
y.create.l HWIO_USB30_VMIDMT_SIDR2_ADDR A:0xf92f9028
y.create.l HWIO_USB30_VMIDMT_SIDR4_ADDR A:0xf92f9030
y.create.l HWIO_USB30_VMIDMT_SIDR5_ADDR A:0xf92f9034
y.create.l HWIO_USB30_VMIDMT_SIDR7_ADDR A:0xf92f903c
y.create.l HWIO_USB30_VMIDMT_SGFAR0_ADDR A:0xf92f9040
y.create.l HWIO_USB30_VMIDMT_SGFSR_ADDR A:0xf92f9048
y.create.l HWIO_USB30_VMIDMT_SGFSRRESTORE_ADDR A:0xf92f904c
y.create.l HWIO_USB30_VMIDMT_SGFSYNDR0_ADDR A:0xf92f9050
y.create.l HWIO_USB30_VMIDMT_SGFSYNDR1_ADDR A:0xf92f9054
y.create.l HWIO_USB30_VMIDMT_SGFSYNDR2_ADDR A:0xf92f9058
y.create.l HWIO_USB30_VMIDMT_VMIDMTSCR0_ADDR A:0xf92f9090
y.create.l HWIO_USB30_VMIDMT_CR0_ADDR A:0xf92f9000
y.create.l HWIO_USB30_VMIDMT_CR2_ADDR A:0xf92f9008
y.create.l HWIO_USB30_VMIDMT_ACR_ADDR A:0xf92f9010
y.create.l HWIO_USB30_VMIDMT_IDR0_ADDR A:0xf92f9020
y.create.l HWIO_USB30_VMIDMT_IDR1_ADDR A:0xf92f9024
y.create.l HWIO_USB30_VMIDMT_IDR2_ADDR A:0xf92f9028
y.create.l HWIO_USB30_VMIDMT_IDR4_ADDR A:0xf92f9030
y.create.l HWIO_USB30_VMIDMT_IDR5_ADDR A:0xf92f9034
y.create.l HWIO_USB30_VMIDMT_IDR7_ADDR A:0xf92f903c
y.create.l HWIO_USB30_VMIDMT_GFAR0_ADDR A:0xf92f9040
y.create.l HWIO_USB30_VMIDMT_GFSR_ADDR A:0xf92f9048
y.create.l HWIO_USB30_VMIDMT_GFSRRESTORE_ADDR A:0xf92f904c
y.create.l HWIO_USB30_VMIDMT_GFSYNDR0_ADDR A:0xf92f9050
y.create.l HWIO_USB30_VMIDMT_GFSYNDR1_ADDR A:0xf92f9054
y.create.l HWIO_USB30_VMIDMT_GFSYNDR2_ADDR A:0xf92f9058
y.create.l HWIO_USB30_VMIDMT_VMIDMTCR0_ADDR A:0xf92f9090
y.create.l HWIO_USB30_VMIDMT_VMIDMTACR_ADDR A:0xf92f909c
y.create.l HWIO_USB30_VMIDMT_NSCR0_ADDR A:0xf92f9400
y.create.l HWIO_USB30_VMIDMT_NSCR2_ADDR A:0xf92f9408
y.create.l HWIO_USB30_VMIDMT_NSACR_ADDR A:0xf92f9410
y.create.l HWIO_USB30_VMIDMT_NSGFAR0_ADDR A:0xf92f9440
y.create.l HWIO_USB30_VMIDMT_NSGFSR_ADDR A:0xf92f9448
y.create.l HWIO_USB30_VMIDMT_NSGFSRRESTORE_ADDR A:0xf92f944c
y.create.l HWIO_USB30_VMIDMT_NSGFSYNDR0_ADDR A:0xf92f9450
y.create.l HWIO_USB30_VMIDMT_NSGFSYNDR1_ADDR A:0xf92f9454
y.create.l HWIO_USB30_VMIDMT_NSGFSYNDR2_ADDR A:0xf92f9458
y.create.l HWIO_USB30_VMIDMT_NSVMIDMTCR0_ADDR A:0xf92f9490
y.create.l HWIO_USB30_VMIDMT_SSDR0_ADDR A:0xf92f9080
y.create.l HWIO_USB30_VMIDMT_MSDR0_ADDR A:0xf92f9480
y.create.l HWIO_USB30_VMIDMT_MCR_ADDR A:0xf92f9494
y.create.l HWIO_USB30_VMIDMT_S2VR0_ADDR A:0xf92f9c00
y.create.l HWIO_USB30_VMIDMT_AS2VR0_ADDR A:0xf92f9e00
y.create.l HWIO_USB30_XPU_SCR_ADDR A:0xf92fa000
y.create.l HWIO_USB30_XPU_SWDR_ADDR A:0xf92fa004
y.create.l HWIO_USB30_XPU_SEAR0_ADDR A:0xf92fa040
y.create.l HWIO_USB30_XPU_SESR_ADDR A:0xf92fa048
y.create.l HWIO_USB30_XPU_SESRRESTORE_ADDR A:0xf92fa04c
y.create.l HWIO_USB30_XPU_SESYNR0_ADDR A:0xf92fa050
y.create.l HWIO_USB30_XPU_SESYNR1_ADDR A:0xf92fa054
y.create.l HWIO_USB30_XPU_SESYNR2_ADDR A:0xf92fa058
y.create.l HWIO_USB30_XPU_MCR_ADDR A:0xf92fa100
y.create.l HWIO_USB30_XPU_MEAR0_ADDR A:0xf92fa140
y.create.l HWIO_USB30_XPU_MESR_ADDR A:0xf92fa148
y.create.l HWIO_USB30_XPU_MESRRESTORE_ADDR A:0xf92fa14c
y.create.l HWIO_USB30_XPU_MESYNR0_ADDR A:0xf92fa150
y.create.l HWIO_USB30_XPU_MESYNR1_ADDR A:0xf92fa154
y.create.l HWIO_USB30_XPU_MESYNR2_ADDR A:0xf92fa158
y.create.l HWIO_USB30_XPU_CR_ADDR A:0xf92fa080
y.create.l HWIO_USB30_XPU_RPU_ACR0_ADDR A:0xf92fa0a0
y.create.l HWIO_USB30_XPU_EAR0_ADDR A:0xf92fa0c0
y.create.l HWIO_USB30_XPU_ESR_ADDR A:0xf92fa0c8
y.create.l HWIO_USB30_XPU_ESRRESTORE_ADDR A:0xf92fa0cc
y.create.l HWIO_USB30_XPU_ESYNR0_ADDR A:0xf92fa0d0
y.create.l HWIO_USB30_XPU_ESYNR1_ADDR A:0xf92fa0d4
y.create.l HWIO_USB30_XPU_ESYNR2_ADDR A:0xf92fa0d8
y.create.l HWIO_USB30_XPU_IDR0_ADDR A:0xf92fa074
y.create.l HWIO_USB30_XPU_IDR1_ADDR A:0xf92fa078
y.create.l HWIO_USB30_XPU_REV_ADDR A:0xf92fa07c
y.create.l HWIO_USB30_XPU_RG0_RACR0_ADDR A:0xf92fa200
y.create.l HWIO_USB30_XPU_RG0_SCR_ADDR A:0xf92fa250
y.create.l HWIO_USB30_XPU_RG0_MCR_ADDR A:0xf92fa254
y.create.l HWIO_USB30_BAM_CTRL_ADDR A:0xf9304000
y.create.l HWIO_USB30_BAM_REVISION_ADDR A:0xf9304004
y.create.l HWIO_USB30_BAM_SW_VERSION_ADDR A:0xf9304080
y.create.l HWIO_USB30_BAM_NUM_PIPES_ADDR A:0xf930403c
y.create.l HWIO_USB30_BAM_TIMER_ADDR A:0xf9304040
y.create.l HWIO_USB30_BAM_TIMER_CTRL_ADDR A:0xf9304044
y.create.l HWIO_USB30_BAM_DESC_CNT_TRSHLD_ADDR A:0xf9304008
y.create.l HWIO_USB30_BAM_IRQ_SRCS_ADDR A:0xf930400c
y.create.l HWIO_USB30_BAM_IRQ_SRCS_MSK_ADDR A:0xf9304010
y.create.l HWIO_USB30_BAM_IRQ_SRCS_UNMASKED_ADDR A:0xf9304030
y.create.l HWIO_USB30_BAM_IRQ_STTS_ADDR A:0xf9304014
y.create.l HWIO_USB30_BAM_IRQ_CLR_ADDR A:0xf9304018
y.create.l HWIO_USB30_BAM_IRQ_EN_ADDR A:0xf930401c
y.create.l HWIO_USB30_BAM_AHB_MASTER_ERR_CTRLS_ADDR A:0xf9304024
y.create.l HWIO_USB30_BAM_AHB_MASTER_ERR_ADDR_ADDR A:0xf9304028
y.create.l HWIO_USB30_BAM_AHB_MASTER_ERR_ADDR_LSB_ADDR A:0xf9304100
y.create.l HWIO_USB30_BAM_AHB_MASTER_ERR_ADDR_MSB_ADDR A:0xf9304104
y.create.l HWIO_USB30_BAM_AHB_MASTER_ERR_DATA_ADDR A:0xf930402c
y.create.l HWIO_USB30_BAM_TRUST_REG_ADDR A:0xf9304070
y.create.l HWIO_USB30_BAM_TEST_BUS_SEL_ADDR A:0xf9304074
y.create.l HWIO_USB30_BAM_TEST_BUS_REG_ADDR A:0xf9304078
y.create.l HWIO_USB30_BAM_CNFG_BITS_ADDR A:0xf930407c
y.create.l HWIO_USB30_BAM_IRQ_SRCS_EE0_ADDR A:0xf9304800
y.create.l HWIO_USB30_BAM_IRQ_SRCS_EE1_ADDR A:0xf9304880
y.create.l HWIO_USB30_BAM_IRQ_SRCS_EE2_ADDR A:0xf9304900
y.create.l HWIO_USB30_BAM_IRQ_SRCS_EE3_ADDR A:0xf9304980
y.create.l HWIO_USB30_BAM_IRQ_SRCS_EE4_ADDR A:0xf9304a00
y.create.l HWIO_USB30_BAM_IRQ_SRCS_EE5_ADDR A:0xf9304a80
y.create.l HWIO_USB30_BAM_IRQ_SRCS_EE6_ADDR A:0xf9304b00
y.create.l HWIO_USB30_BAM_IRQ_SRCS_EE7_ADDR A:0xf9304b80
y.create.l HWIO_USB30_BAM_IRQ_SRCS_MSK_EE0_ADDR A:0xf9304804
y.create.l HWIO_USB30_BAM_IRQ_SRCS_MSK_EE1_ADDR A:0xf9304884
y.create.l HWIO_USB30_BAM_IRQ_SRCS_MSK_EE2_ADDR A:0xf9304904
y.create.l HWIO_USB30_BAM_IRQ_SRCS_MSK_EE3_ADDR A:0xf9304984
y.create.l HWIO_USB30_BAM_IRQ_SRCS_MSK_EE4_ADDR A:0xf9304a04
y.create.l HWIO_USB30_BAM_IRQ_SRCS_MSK_EE5_ADDR A:0xf9304a84
y.create.l HWIO_USB30_BAM_IRQ_SRCS_MSK_EE6_ADDR A:0xf9304b04
y.create.l HWIO_USB30_BAM_IRQ_SRCS_MSK_EE7_ADDR A:0xf9304b84
y.create.l HWIO_USB30_BAM_IRQ_SRCS_UNMASKED_EE0_ADDR A:0xf9304808
y.create.l HWIO_USB30_BAM_IRQ_SRCS_UNMASKED_EE1_ADDR A:0xf9304888
y.create.l HWIO_USB30_BAM_IRQ_SRCS_UNMASKED_EE2_ADDR A:0xf9304908
y.create.l HWIO_USB30_BAM_IRQ_SRCS_UNMASKED_EE3_ADDR A:0xf9304988
y.create.l HWIO_USB30_BAM_IRQ_SRCS_UNMASKED_EE4_ADDR A:0xf9304a08
y.create.l HWIO_USB30_BAM_IRQ_SRCS_UNMASKED_EE5_ADDR A:0xf9304a88
y.create.l HWIO_USB30_BAM_IRQ_SRCS_UNMASKED_EE6_ADDR A:0xf9304b08
y.create.l HWIO_USB30_BAM_IRQ_SRCS_UNMASKED_EE7_ADDR A:0xf9304b88
y.create.l HWIO_USB30_BAM_PIPE_ATTR_EE0_ADDR A:0xf930480c
y.create.l HWIO_USB30_BAM_PIPE_ATTR_EE1_ADDR A:0xf930488c
y.create.l HWIO_USB30_BAM_PIPE_ATTR_EE2_ADDR A:0xf930490c
y.create.l HWIO_USB30_BAM_PIPE_ATTR_EE3_ADDR A:0xf930498c
y.create.l HWIO_USB30_BAM_PIPE_ATTR_EE4_ADDR A:0xf9304a0c
y.create.l HWIO_USB30_BAM_PIPE_ATTR_EE5_ADDR A:0xf9304a8c
y.create.l HWIO_USB30_BAM_PIPE_ATTR_EE6_ADDR A:0xf9304b0c
y.create.l HWIO_USB30_BAM_PIPE_ATTR_EE7_ADDR A:0xf9304b8c
y.create.l HWIO_USB30_BAM_P_CTRL0_ADDR A:0xf9305000
y.create.l HWIO_USB30_BAM_P_CTRL1_ADDR A:0xf9306000
y.create.l HWIO_USB30_BAM_P_CTRL2_ADDR A:0xf9307000
y.create.l HWIO_USB30_BAM_P_CTRL3_ADDR A:0xf9308000
y.create.l HWIO_USB30_BAM_P_CTRL4_ADDR A:0xf9309000
y.create.l HWIO_USB30_BAM_P_CTRL5_ADDR A:0xf930a000
y.create.l HWIO_USB30_BAM_P_CTRL6_ADDR A:0xf930b000
y.create.l HWIO_USB30_BAM_P_CTRL7_ADDR A:0xf930c000
y.create.l HWIO_USB30_BAM_P_RST0_ADDR A:0xf9305004
y.create.l HWIO_USB30_BAM_P_RST1_ADDR A:0xf9306004
y.create.l HWIO_USB30_BAM_P_RST2_ADDR A:0xf9307004
y.create.l HWIO_USB30_BAM_P_RST3_ADDR A:0xf9308004
y.create.l HWIO_USB30_BAM_P_RST4_ADDR A:0xf9309004
y.create.l HWIO_USB30_BAM_P_RST5_ADDR A:0xf930a004
y.create.l HWIO_USB30_BAM_P_RST6_ADDR A:0xf930b004
y.create.l HWIO_USB30_BAM_P_RST7_ADDR A:0xf930c004
y.create.l HWIO_USB30_BAM_P_HALT0_ADDR A:0xf9305008
y.create.l HWIO_USB30_BAM_P_HALT1_ADDR A:0xf9306008
y.create.l HWIO_USB30_BAM_P_HALT2_ADDR A:0xf9307008
y.create.l HWIO_USB30_BAM_P_HALT3_ADDR A:0xf9308008
y.create.l HWIO_USB30_BAM_P_HALT4_ADDR A:0xf9309008
y.create.l HWIO_USB30_BAM_P_HALT5_ADDR A:0xf930a008
y.create.l HWIO_USB30_BAM_P_HALT6_ADDR A:0xf930b008
y.create.l HWIO_USB30_BAM_P_HALT7_ADDR A:0xf930c008
y.create.l HWIO_USB30_BAM_P_TRUST_REG0_ADDR A:0xf9305030
y.create.l HWIO_USB30_BAM_P_TRUST_REG1_ADDR A:0xf9306030
y.create.l HWIO_USB30_BAM_P_TRUST_REG2_ADDR A:0xf9307030
y.create.l HWIO_USB30_BAM_P_TRUST_REG3_ADDR A:0xf9308030
y.create.l HWIO_USB30_BAM_P_TRUST_REG4_ADDR A:0xf9309030
y.create.l HWIO_USB30_BAM_P_TRUST_REG5_ADDR A:0xf930a030
y.create.l HWIO_USB30_BAM_P_TRUST_REG6_ADDR A:0xf930b030
y.create.l HWIO_USB30_BAM_P_TRUST_REG7_ADDR A:0xf930c030
y.create.l HWIO_USB30_BAM_P_IRQ_STTS0_ADDR A:0xf9305010
y.create.l HWIO_USB30_BAM_P_IRQ_STTS1_ADDR A:0xf9306010
y.create.l HWIO_USB30_BAM_P_IRQ_STTS2_ADDR A:0xf9307010
y.create.l HWIO_USB30_BAM_P_IRQ_STTS3_ADDR A:0xf9308010
y.create.l HWIO_USB30_BAM_P_IRQ_STTS4_ADDR A:0xf9309010
y.create.l HWIO_USB30_BAM_P_IRQ_STTS5_ADDR A:0xf930a010
y.create.l HWIO_USB30_BAM_P_IRQ_STTS6_ADDR A:0xf930b010
y.create.l HWIO_USB30_BAM_P_IRQ_STTS7_ADDR A:0xf930c010
y.create.l HWIO_USB30_BAM_P_IRQ_CLR0_ADDR A:0xf9305014
y.create.l HWIO_USB30_BAM_P_IRQ_CLR1_ADDR A:0xf9306014
y.create.l HWIO_USB30_BAM_P_IRQ_CLR2_ADDR A:0xf9307014
y.create.l HWIO_USB30_BAM_P_IRQ_CLR3_ADDR A:0xf9308014
y.create.l HWIO_USB30_BAM_P_IRQ_CLR4_ADDR A:0xf9309014
y.create.l HWIO_USB30_BAM_P_IRQ_CLR5_ADDR A:0xf930a014
y.create.l HWIO_USB30_BAM_P_IRQ_CLR6_ADDR A:0xf930b014
y.create.l HWIO_USB30_BAM_P_IRQ_CLR7_ADDR A:0xf930c014
y.create.l HWIO_USB30_BAM_P_IRQ_EN0_ADDR A:0xf9305018
y.create.l HWIO_USB30_BAM_P_IRQ_EN1_ADDR A:0xf9306018
y.create.l HWIO_USB30_BAM_P_IRQ_EN2_ADDR A:0xf9307018
y.create.l HWIO_USB30_BAM_P_IRQ_EN3_ADDR A:0xf9308018
y.create.l HWIO_USB30_BAM_P_IRQ_EN4_ADDR A:0xf9309018
y.create.l HWIO_USB30_BAM_P_IRQ_EN5_ADDR A:0xf930a018
y.create.l HWIO_USB30_BAM_P_IRQ_EN6_ADDR A:0xf930b018
y.create.l HWIO_USB30_BAM_P_IRQ_EN7_ADDR A:0xf930c018
y.create.l HWIO_USB30_BAM_P_TIMER0_ADDR A:0xf930501c
y.create.l HWIO_USB30_BAM_P_TIMER1_ADDR A:0xf930601c
y.create.l HWIO_USB30_BAM_P_TIMER2_ADDR A:0xf930701c
y.create.l HWIO_USB30_BAM_P_TIMER3_ADDR A:0xf930801c
y.create.l HWIO_USB30_BAM_P_TIMER4_ADDR A:0xf930901c
y.create.l HWIO_USB30_BAM_P_TIMER5_ADDR A:0xf930a01c
y.create.l HWIO_USB30_BAM_P_TIMER6_ADDR A:0xf930b01c
y.create.l HWIO_USB30_BAM_P_TIMER7_ADDR A:0xf930c01c
y.create.l HWIO_USB30_BAM_P_TIMER_CTRL0_ADDR A:0xf9305020
y.create.l HWIO_USB30_BAM_P_TIMER_CTRL1_ADDR A:0xf9306020
y.create.l HWIO_USB30_BAM_P_TIMER_CTRL2_ADDR A:0xf9307020
y.create.l HWIO_USB30_BAM_P_TIMER_CTRL3_ADDR A:0xf9308020
y.create.l HWIO_USB30_BAM_P_TIMER_CTRL4_ADDR A:0xf9309020
y.create.l HWIO_USB30_BAM_P_TIMER_CTRL5_ADDR A:0xf930a020
y.create.l HWIO_USB30_BAM_P_TIMER_CTRL6_ADDR A:0xf930b020
y.create.l HWIO_USB30_BAM_P_TIMER_CTRL7_ADDR A:0xf930c020
y.create.l HWIO_USB30_BAM_P_PRDCR_SDBND0_ADDR A:0xf9305024
y.create.l HWIO_USB30_BAM_P_PRDCR_SDBND1_ADDR A:0xf9306024
y.create.l HWIO_USB30_BAM_P_PRDCR_SDBND2_ADDR A:0xf9307024
y.create.l HWIO_USB30_BAM_P_PRDCR_SDBND3_ADDR A:0xf9308024
y.create.l HWIO_USB30_BAM_P_PRDCR_SDBND4_ADDR A:0xf9309024
y.create.l HWIO_USB30_BAM_P_PRDCR_SDBND5_ADDR A:0xf930a024
y.create.l HWIO_USB30_BAM_P_PRDCR_SDBND6_ADDR A:0xf930b024
y.create.l HWIO_USB30_BAM_P_PRDCR_SDBND7_ADDR A:0xf930c024
y.create.l HWIO_USB30_BAM_P_CNSMR_SDBND0_ADDR A:0xf9305028
y.create.l HWIO_USB30_BAM_P_CNSMR_SDBND1_ADDR A:0xf9306028
y.create.l HWIO_USB30_BAM_P_CNSMR_SDBND2_ADDR A:0xf9307028
y.create.l HWIO_USB30_BAM_P_CNSMR_SDBND3_ADDR A:0xf9308028
y.create.l HWIO_USB30_BAM_P_CNSMR_SDBND4_ADDR A:0xf9309028
y.create.l HWIO_USB30_BAM_P_CNSMR_SDBND5_ADDR A:0xf930a028
y.create.l HWIO_USB30_BAM_P_CNSMR_SDBND6_ADDR A:0xf930b028
y.create.l HWIO_USB30_BAM_P_CNSMR_SDBND7_ADDR A:0xf930c028
y.create.l HWIO_USB30_BAM_P_EVNT_DEST_ADDR0_ADDR A:0xf930582c
y.create.l HWIO_USB30_BAM_P_EVNT_DEST_ADDR1_ADDR A:0xf930682c
y.create.l HWIO_USB30_BAM_P_EVNT_DEST_ADDR2_ADDR A:0xf930782c
y.create.l HWIO_USB30_BAM_P_EVNT_DEST_ADDR3_ADDR A:0xf930882c
y.create.l HWIO_USB30_BAM_P_EVNT_DEST_ADDR4_ADDR A:0xf930982c
y.create.l HWIO_USB30_BAM_P_EVNT_DEST_ADDR5_ADDR A:0xf930a82c
y.create.l HWIO_USB30_BAM_P_EVNT_DEST_ADDR6_ADDR A:0xf930b82c
y.create.l HWIO_USB30_BAM_P_EVNT_DEST_ADDR7_ADDR A:0xf930c82c
y.create.l HWIO_USB30_BAM_P_EVNT_DEST_ADDR_LSB0_ADDR A:0xf9305930
y.create.l HWIO_USB30_BAM_P_EVNT_DEST_ADDR_LSB1_ADDR A:0xf9306930
y.create.l HWIO_USB30_BAM_P_EVNT_DEST_ADDR_LSB2_ADDR A:0xf9307930
y.create.l HWIO_USB30_BAM_P_EVNT_DEST_ADDR_LSB3_ADDR A:0xf9308930
y.create.l HWIO_USB30_BAM_P_EVNT_DEST_ADDR_LSB4_ADDR A:0xf9309930
y.create.l HWIO_USB30_BAM_P_EVNT_DEST_ADDR_LSB5_ADDR A:0xf930a930
y.create.l HWIO_USB30_BAM_P_EVNT_DEST_ADDR_LSB6_ADDR A:0xf930b930
y.create.l HWIO_USB30_BAM_P_EVNT_DEST_ADDR_LSB7_ADDR A:0xf930c930
y.create.l HWIO_USB30_BAM_P_EVNT_DEST_ADDR_MSB0_ADDR A:0xf9305934
y.create.l HWIO_USB30_BAM_P_EVNT_DEST_ADDR_MSB1_ADDR A:0xf9306934
y.create.l HWIO_USB30_BAM_P_EVNT_DEST_ADDR_MSB2_ADDR A:0xf9307934
y.create.l HWIO_USB30_BAM_P_EVNT_DEST_ADDR_MSB3_ADDR A:0xf9308934
y.create.l HWIO_USB30_BAM_P_EVNT_DEST_ADDR_MSB4_ADDR A:0xf9309934
y.create.l HWIO_USB30_BAM_P_EVNT_DEST_ADDR_MSB5_ADDR A:0xf930a934
y.create.l HWIO_USB30_BAM_P_EVNT_DEST_ADDR_MSB6_ADDR A:0xf930b934
y.create.l HWIO_USB30_BAM_P_EVNT_DEST_ADDR_MSB7_ADDR A:0xf930c934
y.create.l HWIO_USB30_BAM_P_EVNT_REG0_ADDR A:0xf9305818
y.create.l HWIO_USB30_BAM_P_EVNT_REG1_ADDR A:0xf9306818
y.create.l HWIO_USB30_BAM_P_EVNT_REG2_ADDR A:0xf9307818
y.create.l HWIO_USB30_BAM_P_EVNT_REG3_ADDR A:0xf9308818
y.create.l HWIO_USB30_BAM_P_EVNT_REG4_ADDR A:0xf9309818
y.create.l HWIO_USB30_BAM_P_EVNT_REG5_ADDR A:0xf930a818
y.create.l HWIO_USB30_BAM_P_EVNT_REG6_ADDR A:0xf930b818
y.create.l HWIO_USB30_BAM_P_EVNT_REG7_ADDR A:0xf930c818
y.create.l HWIO_USB30_BAM_P_SW_OFSTS0_ADDR A:0xf9305800
y.create.l HWIO_USB30_BAM_P_SW_OFSTS1_ADDR A:0xf9306800
y.create.l HWIO_USB30_BAM_P_SW_OFSTS2_ADDR A:0xf9307800
y.create.l HWIO_USB30_BAM_P_SW_OFSTS3_ADDR A:0xf9308800
y.create.l HWIO_USB30_BAM_P_SW_OFSTS4_ADDR A:0xf9309800
y.create.l HWIO_USB30_BAM_P_SW_OFSTS5_ADDR A:0xf930a800
y.create.l HWIO_USB30_BAM_P_SW_OFSTS6_ADDR A:0xf930b800
y.create.l HWIO_USB30_BAM_P_SW_OFSTS7_ADDR A:0xf930c800
y.create.l HWIO_USB30_BAM_P_DATA_FIFO_ADDR0_ADDR A:0xf9305824
y.create.l HWIO_USB30_BAM_P_DATA_FIFO_ADDR1_ADDR A:0xf9306824
y.create.l HWIO_USB30_BAM_P_DATA_FIFO_ADDR2_ADDR A:0xf9307824
y.create.l HWIO_USB30_BAM_P_DATA_FIFO_ADDR3_ADDR A:0xf9308824
y.create.l HWIO_USB30_BAM_P_DATA_FIFO_ADDR4_ADDR A:0xf9309824
y.create.l HWIO_USB30_BAM_P_DATA_FIFO_ADDR5_ADDR A:0xf930a824
y.create.l HWIO_USB30_BAM_P_DATA_FIFO_ADDR6_ADDR A:0xf930b824
y.create.l HWIO_USB30_BAM_P_DATA_FIFO_ADDR7_ADDR A:0xf930c824
y.create.l HWIO_USB30_BAM_P_DATA_FIFO_ADDR_LSB0_ADDR A:0xf9305920
y.create.l HWIO_USB30_BAM_P_DATA_FIFO_ADDR_LSB1_ADDR A:0xf9306920
y.create.l HWIO_USB30_BAM_P_DATA_FIFO_ADDR_LSB2_ADDR A:0xf9307920
y.create.l HWIO_USB30_BAM_P_DATA_FIFO_ADDR_LSB3_ADDR A:0xf9308920
y.create.l HWIO_USB30_BAM_P_DATA_FIFO_ADDR_LSB4_ADDR A:0xf9309920
y.create.l HWIO_USB30_BAM_P_DATA_FIFO_ADDR_LSB5_ADDR A:0xf930a920
y.create.l HWIO_USB30_BAM_P_DATA_FIFO_ADDR_LSB6_ADDR A:0xf930b920
y.create.l HWIO_USB30_BAM_P_DATA_FIFO_ADDR_LSB7_ADDR A:0xf930c920
y.create.l HWIO_USB30_BAM_P_DATA_FIFO_ADDR_MSB0_ADDR A:0xf9305924
y.create.l HWIO_USB30_BAM_P_DATA_FIFO_ADDR_MSB1_ADDR A:0xf9306924
y.create.l HWIO_USB30_BAM_P_DATA_FIFO_ADDR_MSB2_ADDR A:0xf9307924
y.create.l HWIO_USB30_BAM_P_DATA_FIFO_ADDR_MSB3_ADDR A:0xf9308924
y.create.l HWIO_USB30_BAM_P_DATA_FIFO_ADDR_MSB4_ADDR A:0xf9309924
y.create.l HWIO_USB30_BAM_P_DATA_FIFO_ADDR_MSB5_ADDR A:0xf930a924
y.create.l HWIO_USB30_BAM_P_DATA_FIFO_ADDR_MSB6_ADDR A:0xf930b924
y.create.l HWIO_USB30_BAM_P_DATA_FIFO_ADDR_MSB7_ADDR A:0xf930c924
y.create.l HWIO_USB30_BAM_P_DESC_FIFO_ADDR0_ADDR A:0xf930581c
y.create.l HWIO_USB30_BAM_P_DESC_FIFO_ADDR1_ADDR A:0xf930681c
y.create.l HWIO_USB30_BAM_P_DESC_FIFO_ADDR2_ADDR A:0xf930781c
y.create.l HWIO_USB30_BAM_P_DESC_FIFO_ADDR3_ADDR A:0xf930881c
y.create.l HWIO_USB30_BAM_P_DESC_FIFO_ADDR4_ADDR A:0xf930981c
y.create.l HWIO_USB30_BAM_P_DESC_FIFO_ADDR5_ADDR A:0xf930a81c
y.create.l HWIO_USB30_BAM_P_DESC_FIFO_ADDR6_ADDR A:0xf930b81c
y.create.l HWIO_USB30_BAM_P_DESC_FIFO_ADDR7_ADDR A:0xf930c81c
y.create.l HWIO_USB30_BAM_P_DESC_FIFO_ADDR_LSB0_ADDR A:0xf9305910
y.create.l HWIO_USB30_BAM_P_DESC_FIFO_ADDR_LSB1_ADDR A:0xf9306910
y.create.l HWIO_USB30_BAM_P_DESC_FIFO_ADDR_LSB2_ADDR A:0xf9307910
y.create.l HWIO_USB30_BAM_P_DESC_FIFO_ADDR_LSB3_ADDR A:0xf9308910
y.create.l HWIO_USB30_BAM_P_DESC_FIFO_ADDR_LSB4_ADDR A:0xf9309910
y.create.l HWIO_USB30_BAM_P_DESC_FIFO_ADDR_LSB5_ADDR A:0xf930a910
y.create.l HWIO_USB30_BAM_P_DESC_FIFO_ADDR_LSB6_ADDR A:0xf930b910
y.create.l HWIO_USB30_BAM_P_DESC_FIFO_ADDR_LSB7_ADDR A:0xf930c910
y.create.l HWIO_USB30_BAM_P_DESC_FIFO_ADDR_MSB0_ADDR A:0xf9305914
y.create.l HWIO_USB30_BAM_P_DESC_FIFO_ADDR_MSB1_ADDR A:0xf9306914
y.create.l HWIO_USB30_BAM_P_DESC_FIFO_ADDR_MSB2_ADDR A:0xf9307914
y.create.l HWIO_USB30_BAM_P_DESC_FIFO_ADDR_MSB3_ADDR A:0xf9308914
y.create.l HWIO_USB30_BAM_P_DESC_FIFO_ADDR_MSB4_ADDR A:0xf9309914
y.create.l HWIO_USB30_BAM_P_DESC_FIFO_ADDR_MSB5_ADDR A:0xf930a914
y.create.l HWIO_USB30_BAM_P_DESC_FIFO_ADDR_MSB6_ADDR A:0xf930b914
y.create.l HWIO_USB30_BAM_P_DESC_FIFO_ADDR_MSB7_ADDR A:0xf930c914
y.create.l HWIO_USB30_BAM_P_EVNT_GEN_TRSHLD0_ADDR A:0xf9305828
y.create.l HWIO_USB30_BAM_P_EVNT_GEN_TRSHLD1_ADDR A:0xf9306828
y.create.l HWIO_USB30_BAM_P_EVNT_GEN_TRSHLD2_ADDR A:0xf9307828
y.create.l HWIO_USB30_BAM_P_EVNT_GEN_TRSHLD3_ADDR A:0xf9308828
y.create.l HWIO_USB30_BAM_P_EVNT_GEN_TRSHLD4_ADDR A:0xf9309828
y.create.l HWIO_USB30_BAM_P_EVNT_GEN_TRSHLD5_ADDR A:0xf930a828
y.create.l HWIO_USB30_BAM_P_EVNT_GEN_TRSHLD6_ADDR A:0xf930b828
y.create.l HWIO_USB30_BAM_P_EVNT_GEN_TRSHLD7_ADDR A:0xf930c828
y.create.l HWIO_USB30_BAM_P_FIFO_SIZES0_ADDR A:0xf9305820
y.create.l HWIO_USB30_BAM_P_FIFO_SIZES1_ADDR A:0xf9306820
y.create.l HWIO_USB30_BAM_P_FIFO_SIZES2_ADDR A:0xf9307820
y.create.l HWIO_USB30_BAM_P_FIFO_SIZES3_ADDR A:0xf9308820
y.create.l HWIO_USB30_BAM_P_FIFO_SIZES4_ADDR A:0xf9309820
y.create.l HWIO_USB30_BAM_P_FIFO_SIZES5_ADDR A:0xf930a820
y.create.l HWIO_USB30_BAM_P_FIFO_SIZES6_ADDR A:0xf930b820
y.create.l HWIO_USB30_BAM_P_FIFO_SIZES7_ADDR A:0xf930c820
y.create.l HWIO_USB30_BAM_P_RETR_CNTXT_0_ADDR A:0xf9305834
y.create.l HWIO_USB30_BAM_P_RETR_CNTXT_1_ADDR A:0xf9306834
y.create.l HWIO_USB30_BAM_P_RETR_CNTXT_2_ADDR A:0xf9307834
y.create.l HWIO_USB30_BAM_P_RETR_CNTXT_3_ADDR A:0xf9308834
y.create.l HWIO_USB30_BAM_P_RETR_CNTXT_4_ADDR A:0xf9309834
y.create.l HWIO_USB30_BAM_P_RETR_CNTXT_5_ADDR A:0xf930a834
y.create.l HWIO_USB30_BAM_P_RETR_CNTXT_6_ADDR A:0xf930b834
y.create.l HWIO_USB30_BAM_P_RETR_CNTXT_7_ADDR A:0xf930c834
y.create.l HWIO_USB30_BAM_P_SI_CNTXT_0_ADDR A:0xf9305838
y.create.l HWIO_USB30_BAM_P_SI_CNTXT_1_ADDR A:0xf9306838
y.create.l HWIO_USB30_BAM_P_SI_CNTXT_2_ADDR A:0xf9307838
y.create.l HWIO_USB30_BAM_P_SI_CNTXT_3_ADDR A:0xf9308838
y.create.l HWIO_USB30_BAM_P_SI_CNTXT_4_ADDR A:0xf9309838
y.create.l HWIO_USB30_BAM_P_SI_CNTXT_5_ADDR A:0xf930a838
y.create.l HWIO_USB30_BAM_P_SI_CNTXT_6_ADDR A:0xf930b838
y.create.l HWIO_USB30_BAM_P_SI_CNTXT_7_ADDR A:0xf930c838
y.create.l HWIO_USB30_BAM_P_DF_CNTXT_0_ADDR A:0xf9305830
y.create.l HWIO_USB30_BAM_P_DF_CNTXT_1_ADDR A:0xf9306830
y.create.l HWIO_USB30_BAM_P_DF_CNTXT_2_ADDR A:0xf9307830
y.create.l HWIO_USB30_BAM_P_DF_CNTXT_3_ADDR A:0xf9308830
y.create.l HWIO_USB30_BAM_P_DF_CNTXT_4_ADDR A:0xf9309830
y.create.l HWIO_USB30_BAM_P_DF_CNTXT_5_ADDR A:0xf930a830
y.create.l HWIO_USB30_BAM_P_DF_CNTXT_6_ADDR A:0xf930b830
y.create.l HWIO_USB30_BAM_P_DF_CNTXT_7_ADDR A:0xf930c830
y.create.l HWIO_USB30_BAM_P_AU_PSM_CNTXT_1_0_ADDR A:0xf9305804
y.create.l HWIO_USB30_BAM_P_AU_PSM_CNTXT_1_1_ADDR A:0xf9306804
y.create.l HWIO_USB30_BAM_P_AU_PSM_CNTXT_1_2_ADDR A:0xf9307804
y.create.l HWIO_USB30_BAM_P_AU_PSM_CNTXT_1_3_ADDR A:0xf9308804
y.create.l HWIO_USB30_BAM_P_AU_PSM_CNTXT_1_4_ADDR A:0xf9309804
y.create.l HWIO_USB30_BAM_P_AU_PSM_CNTXT_1_5_ADDR A:0xf930a804
y.create.l HWIO_USB30_BAM_P_AU_PSM_CNTXT_1_6_ADDR A:0xf930b804
y.create.l HWIO_USB30_BAM_P_AU_PSM_CNTXT_1_7_ADDR A:0xf930c804
y.create.l HWIO_USB30_BAM_P_PSM_CNTXT_2_0_ADDR A:0xf9305808
y.create.l HWIO_USB30_BAM_P_PSM_CNTXT_2_1_ADDR A:0xf9306808
y.create.l HWIO_USB30_BAM_P_PSM_CNTXT_2_2_ADDR A:0xf9307808
y.create.l HWIO_USB30_BAM_P_PSM_CNTXT_2_3_ADDR A:0xf9308808
y.create.l HWIO_USB30_BAM_P_PSM_CNTXT_2_4_ADDR A:0xf9309808
y.create.l HWIO_USB30_BAM_P_PSM_CNTXT_2_5_ADDR A:0xf930a808
y.create.l HWIO_USB30_BAM_P_PSM_CNTXT_2_6_ADDR A:0xf930b808
y.create.l HWIO_USB30_BAM_P_PSM_CNTXT_2_7_ADDR A:0xf930c808
y.create.l HWIO_USB30_BAM_P_PSM_CNTXT_3_0_ADDR A:0xf930580c
y.create.l HWIO_USB30_BAM_P_PSM_CNTXT_3_1_ADDR A:0xf930680c
y.create.l HWIO_USB30_BAM_P_PSM_CNTXT_3_2_ADDR A:0xf930780c
y.create.l HWIO_USB30_BAM_P_PSM_CNTXT_3_3_ADDR A:0xf930880c
y.create.l HWIO_USB30_BAM_P_PSM_CNTXT_3_4_ADDR A:0xf930980c
y.create.l HWIO_USB30_BAM_P_PSM_CNTXT_3_5_ADDR A:0xf930a80c
y.create.l HWIO_USB30_BAM_P_PSM_CNTXT_3_6_ADDR A:0xf930b80c
y.create.l HWIO_USB30_BAM_P_PSM_CNTXT_3_7_ADDR A:0xf930c80c
y.create.l HWIO_USB30_BAM_P_PSM_CNTXT_3_LSB0_ADDR A:0xf9305900
y.create.l HWIO_USB30_BAM_P_PSM_CNTXT_3_LSB1_ADDR A:0xf9306900
y.create.l HWIO_USB30_BAM_P_PSM_CNTXT_3_LSB2_ADDR A:0xf9307900
y.create.l HWIO_USB30_BAM_P_PSM_CNTXT_3_LSB3_ADDR A:0xf9308900
y.create.l HWIO_USB30_BAM_P_PSM_CNTXT_3_LSB4_ADDR A:0xf9309900
y.create.l HWIO_USB30_BAM_P_PSM_CNTXT_3_LSB5_ADDR A:0xf930a900
y.create.l HWIO_USB30_BAM_P_PSM_CNTXT_3_LSB6_ADDR A:0xf930b900
y.create.l HWIO_USB30_BAM_P_PSM_CNTXT_3_LSB7_ADDR A:0xf930c900
y.create.l HWIO_USB30_BAM_P_PSM_CNTXT_3_MSB0_ADDR A:0xf9305904
y.create.l HWIO_USB30_BAM_P_PSM_CNTXT_3_MSB1_ADDR A:0xf9306904
y.create.l HWIO_USB30_BAM_P_PSM_CNTXT_3_MSB2_ADDR A:0xf9307904
y.create.l HWIO_USB30_BAM_P_PSM_CNTXT_3_MSB3_ADDR A:0xf9308904
y.create.l HWIO_USB30_BAM_P_PSM_CNTXT_3_MSB4_ADDR A:0xf9309904
y.create.l HWIO_USB30_BAM_P_PSM_CNTXT_3_MSB5_ADDR A:0xf930a904
y.create.l HWIO_USB30_BAM_P_PSM_CNTXT_3_MSB6_ADDR A:0xf930b904
y.create.l HWIO_USB30_BAM_P_PSM_CNTXT_3_MSB7_ADDR A:0xf930c904
y.create.l HWIO_USB30_BAM_P_PSM_CNTXT_4_0_ADDR A:0xf9305810
y.create.l HWIO_USB30_BAM_P_PSM_CNTXT_4_1_ADDR A:0xf9306810
y.create.l HWIO_USB30_BAM_P_PSM_CNTXT_4_2_ADDR A:0xf9307810
y.create.l HWIO_USB30_BAM_P_PSM_CNTXT_4_3_ADDR A:0xf9308810
y.create.l HWIO_USB30_BAM_P_PSM_CNTXT_4_4_ADDR A:0xf9309810
y.create.l HWIO_USB30_BAM_P_PSM_CNTXT_4_5_ADDR A:0xf930a810
y.create.l HWIO_USB30_BAM_P_PSM_CNTXT_4_6_ADDR A:0xf930b810
y.create.l HWIO_USB30_BAM_P_PSM_CNTXT_4_7_ADDR A:0xf930c810
y.create.l HWIO_USB30_BAM_P_PSM_CNTXT_5_0_ADDR A:0xf9305814
y.create.l HWIO_USB30_BAM_P_PSM_CNTXT_5_1_ADDR A:0xf9306814
y.create.l HWIO_USB30_BAM_P_PSM_CNTXT_5_2_ADDR A:0xf9307814
y.create.l HWIO_USB30_BAM_P_PSM_CNTXT_5_3_ADDR A:0xf9308814
y.create.l HWIO_USB30_BAM_P_PSM_CNTXT_5_4_ADDR A:0xf9309814
y.create.l HWIO_USB30_BAM_P_PSM_CNTXT_5_5_ADDR A:0xf930a814
y.create.l HWIO_USB30_BAM_P_PSM_CNTXT_5_6_ADDR A:0xf930b814
y.create.l HWIO_USB30_BAM_P_PSM_CNTXT_5_7_ADDR A:0xf930c814
y.create.l HWIO_XPU_CFG_DDR_PHY_CFG_XPU_SCR_ADDR A:0xfc501000
y.create.l HWIO_XPU_CFG_DDR_PHY_CFG_XPU_SWDR_ADDR A:0xfc501004
y.create.l HWIO_XPU_CFG_DDR_PHY_CFG_XPU_SEAR0_ADDR A:0xfc501040
y.create.l HWIO_XPU_CFG_DDR_PHY_CFG_XPU_SESR_ADDR A:0xfc501048
y.create.l HWIO_XPU_CFG_DDR_PHY_CFG_XPU_SESRRESTORE_ADDR A:0xfc50104c
y.create.l HWIO_XPU_CFG_DDR_PHY_CFG_XPU_SESYNR0_ADDR A:0xfc501050
y.create.l HWIO_XPU_CFG_DDR_PHY_CFG_XPU_SESYNR1_ADDR A:0xfc501054
y.create.l HWIO_XPU_CFG_DDR_PHY_CFG_XPU_SESYNR2_ADDR A:0xfc501058
y.create.l HWIO_XPU_CFG_DDR_PHY_CFG_XPU_MCR_ADDR A:0xfc501100
y.create.l HWIO_XPU_CFG_DDR_PHY_CFG_XPU_MEAR0_ADDR A:0xfc501140
y.create.l HWIO_XPU_CFG_DDR_PHY_CFG_XPU_MESR_ADDR A:0xfc501148
y.create.l HWIO_XPU_CFG_DDR_PHY_CFG_XPU_MESRRESTORE_ADDR A:0xfc50114c
y.create.l HWIO_XPU_CFG_DDR_PHY_CFG_XPU_MESYNR0_ADDR A:0xfc501150
y.create.l HWIO_XPU_CFG_DDR_PHY_CFG_XPU_MESYNR1_ADDR A:0xfc501154
y.create.l HWIO_XPU_CFG_DDR_PHY_CFG_XPU_MESYNR2_ADDR A:0xfc501158
y.create.l HWIO_XPU_CFG_DDR_PHY_CFG_XPU_CR_ADDR A:0xfc501080
y.create.l HWIO_XPU_CFG_DDR_PHY_CFG_XPU_RPU_ACR0_ADDR A:0xfc5010a0
y.create.l HWIO_XPU_CFG_DDR_PHY_CFG_XPU_EAR0_ADDR A:0xfc5010c0
y.create.l HWIO_XPU_CFG_DDR_PHY_CFG_XPU_ESR_ADDR A:0xfc5010c8
y.create.l HWIO_XPU_CFG_DDR_PHY_CFG_XPU_ESRRESTORE_ADDR A:0xfc5010cc
y.create.l HWIO_XPU_CFG_DDR_PHY_CFG_XPU_ESYNR0_ADDR A:0xfc5010d0
y.create.l HWIO_XPU_CFG_DDR_PHY_CFG_XPU_ESYNR1_ADDR A:0xfc5010d4
y.create.l HWIO_XPU_CFG_DDR_PHY_CFG_XPU_ESYNR2_ADDR A:0xfc5010d8
y.create.l HWIO_XPU_CFG_DDR_PHY_CFG_XPU_IDR0_ADDR A:0xfc501074
y.create.l HWIO_XPU_CFG_DDR_PHY_CFG_XPU_IDR1_ADDR A:0xfc501078
y.create.l HWIO_XPU_CFG_DDR_PHY_CFG_XPU_REV_ADDR A:0xfc50107c
y.create.l HWIO_XPU_CFG_DDR_PHY_CFG_XPU_RG0_RACR0_ADDR A:0xfc501200
y.create.l HWIO_XPU_CFG_DDR_PHY_CFG_XPU_RG0_WACR0_ADDR A:0xfc501220
y.create.l HWIO_XPU_CFG_DDR_PHY_CFG_XPU_RG0_SCR_ADDR A:0xfc501250
y.create.l HWIO_XPU_CFG_DDR_PHY_CFG_XPU_RG0_MCR_ADDR A:0xfc501254
y.create.l HWIO_XPU_CFG_QDSS_XPU_SCR_ADDR A:0xfc48d000
y.create.l HWIO_XPU_CFG_QDSS_XPU_SWDR_ADDR A:0xfc48d004
y.create.l HWIO_XPU_CFG_QDSS_XPU_SEAR0_ADDR A:0xfc48d040
y.create.l HWIO_XPU_CFG_QDSS_XPU_SESR_ADDR A:0xfc48d048
y.create.l HWIO_XPU_CFG_QDSS_XPU_SESRRESTORE_ADDR A:0xfc48d04c
y.create.l HWIO_XPU_CFG_QDSS_XPU_SESYNR0_ADDR A:0xfc48d050
y.create.l HWIO_XPU_CFG_QDSS_XPU_SESYNR1_ADDR A:0xfc48d054
y.create.l HWIO_XPU_CFG_QDSS_XPU_SESYNR2_ADDR A:0xfc48d058
y.create.l HWIO_XPU_CFG_QDSS_XPU_MCR_ADDR A:0xfc48d100
y.create.l HWIO_XPU_CFG_QDSS_XPU_MEAR0_ADDR A:0xfc48d140
y.create.l HWIO_XPU_CFG_QDSS_XPU_MESR_ADDR A:0xfc48d148
y.create.l HWIO_XPU_CFG_QDSS_XPU_MESRRESTORE_ADDR A:0xfc48d14c
y.create.l HWIO_XPU_CFG_QDSS_XPU_MESYNR0_ADDR A:0xfc48d150
y.create.l HWIO_XPU_CFG_QDSS_XPU_MESYNR1_ADDR A:0xfc48d154
y.create.l HWIO_XPU_CFG_QDSS_XPU_MESYNR2_ADDR A:0xfc48d158
y.create.l HWIO_XPU_CFG_QDSS_XPU_CR_ADDR A:0xfc48d080
y.create.l HWIO_XPU_CFG_QDSS_XPU_RPU_ACR0_ADDR A:0xfc48d0a0
y.create.l HWIO_XPU_CFG_QDSS_XPU_EAR0_ADDR A:0xfc48d0c0
y.create.l HWIO_XPU_CFG_QDSS_XPU_ESR_ADDR A:0xfc48d0c8
y.create.l HWIO_XPU_CFG_QDSS_XPU_ESRRESTORE_ADDR A:0xfc48d0cc
y.create.l HWIO_XPU_CFG_QDSS_XPU_ESYNR0_ADDR A:0xfc48d0d0
y.create.l HWIO_XPU_CFG_QDSS_XPU_ESYNR1_ADDR A:0xfc48d0d4
y.create.l HWIO_XPU_CFG_QDSS_XPU_ESYNR2_ADDR A:0xfc48d0d8
y.create.l HWIO_XPU_CFG_QDSS_XPU_IDR0_ADDR A:0xfc48d074
y.create.l HWIO_XPU_CFG_QDSS_XPU_IDR1_ADDR A:0xfc48d078
y.create.l HWIO_XPU_CFG_QDSS_XPU_REV_ADDR A:0xfc48d07c
y.create.l HWIO_XPU_CFG_QDSS_XPU_RG0_RACR0_ADDR A:0xfc48d200
y.create.l HWIO_XPU_CFG_QDSS_XPU_RG1_RACR0_ADDR A:0xfc48d280
y.create.l HWIO_XPU_CFG_QDSS_XPU_RG2_RACR0_ADDR A:0xfc48d300
y.create.l HWIO_XPU_CFG_QDSS_XPU_RG0_WACR0_ADDR A:0xfc48d220
y.create.l HWIO_XPU_CFG_QDSS_XPU_RG1_WACR0_ADDR A:0xfc48d2a0
y.create.l HWIO_XPU_CFG_QDSS_XPU_RG2_WACR0_ADDR A:0xfc48d320
y.create.l HWIO_XPU_CFG_QDSS_XPU_RG0_SCR_ADDR A:0xfc48d250
y.create.l HWIO_XPU_CFG_QDSS_XPU_RG1_SCR_ADDR A:0xfc48d2d0
y.create.l HWIO_XPU_CFG_QDSS_XPU_RG2_SCR_ADDR A:0xfc48d350
y.create.l HWIO_XPU_CFG_QDSS_XPU_RG0_MCR_ADDR A:0xfc48d254
y.create.l HWIO_XPU_CFG_QDSS_XPU_RG1_MCR_ADDR A:0xfc48d2d4
y.create.l HWIO_XPU_CFG_QDSS_XPU_RG2_MCR_ADDR A:0xfc48d354
y.create.l HWIO_XPU_CFG_SNOC_CFG_XPU_SCR_ADDR A:0xfc48c000
y.create.l HWIO_XPU_CFG_SNOC_CFG_XPU_SWDR_ADDR A:0xfc48c004
y.create.l HWIO_XPU_CFG_SNOC_CFG_XPU_PRTN_RACR_SSHADOW_ADDR A:0xfc48c008
y.create.l HWIO_XPU_CFG_SNOC_CFG_XPU_PRTN_WACR_SSHADOW_ADDR A:0xfc48c00c
y.create.l HWIO_XPU_CFG_SNOC_CFG_XPU_PRTN_START_SSHADOW0_ADDR A:0xfc48c010
y.create.l HWIO_XPU_CFG_SNOC_CFG_XPU_PRTN_END_SSHADOW0_ADDR A:0xfc48c018
y.create.l HWIO_XPU_CFG_SNOC_CFG_XPU_SEAR0_ADDR A:0xfc48c040
y.create.l HWIO_XPU_CFG_SNOC_CFG_XPU_SESR_ADDR A:0xfc48c048
y.create.l HWIO_XPU_CFG_SNOC_CFG_XPU_SESRRESTORE_ADDR A:0xfc48c04c
y.create.l HWIO_XPU_CFG_SNOC_CFG_XPU_SESYNR0_ADDR A:0xfc48c050
y.create.l HWIO_XPU_CFG_SNOC_CFG_XPU_SESYNR1_ADDR A:0xfc48c054
y.create.l HWIO_XPU_CFG_SNOC_CFG_XPU_SESYNR2_ADDR A:0xfc48c058
y.create.l HWIO_XPU_CFG_SNOC_CFG_XPU_MCR_ADDR A:0xfc48c100
y.create.l HWIO_XPU_CFG_SNOC_CFG_XPU_MEAR0_ADDR A:0xfc48c140
y.create.l HWIO_XPU_CFG_SNOC_CFG_XPU_MESR_ADDR A:0xfc48c148
y.create.l HWIO_XPU_CFG_SNOC_CFG_XPU_MESRRESTORE_ADDR A:0xfc48c14c
y.create.l HWIO_XPU_CFG_SNOC_CFG_XPU_MESYNR0_ADDR A:0xfc48c150
y.create.l HWIO_XPU_CFG_SNOC_CFG_XPU_MESYNR1_ADDR A:0xfc48c154
y.create.l HWIO_XPU_CFG_SNOC_CFG_XPU_MESYNR2_ADDR A:0xfc48c158
y.create.l HWIO_XPU_CFG_SNOC_CFG_XPU_CR_ADDR A:0xfc48c080
y.create.l HWIO_XPU_CFG_SNOC_CFG_XPU_PRTN_RACR_SHADOW_ADDR A:0xfc48c088
y.create.l HWIO_XPU_CFG_SNOC_CFG_XPU_PRTN_WACR_SHADOW_ADDR A:0xfc48c08c
y.create.l HWIO_XPU_CFG_SNOC_CFG_XPU_PRTN_START_SHADOW0_ADDR A:0xfc48c090
y.create.l HWIO_XPU_CFG_SNOC_CFG_XPU_PRTN_END_SHADOW0_ADDR A:0xfc48c098
y.create.l HWIO_XPU_CFG_SNOC_CFG_XPU_RPU_ACR0_ADDR A:0xfc48c0a0
y.create.l HWIO_XPU_CFG_SNOC_CFG_XPU_EAR0_ADDR A:0xfc48c0c0
y.create.l HWIO_XPU_CFG_SNOC_CFG_XPU_ESR_ADDR A:0xfc48c0c8
y.create.l HWIO_XPU_CFG_SNOC_CFG_XPU_ESRRESTORE_ADDR A:0xfc48c0cc
y.create.l HWIO_XPU_CFG_SNOC_CFG_XPU_ESYNR0_ADDR A:0xfc48c0d0
y.create.l HWIO_XPU_CFG_SNOC_CFG_XPU_ESYNR1_ADDR A:0xfc48c0d4
y.create.l HWIO_XPU_CFG_SNOC_CFG_XPU_ESYNR2_ADDR A:0xfc48c0d8
y.create.l HWIO_XPU_CFG_SNOC_CFG_XPU_UMR_RACR_ADDR A:0xfc48c0e0
y.create.l HWIO_XPU_CFG_SNOC_CFG_XPU_UMR_WACR_ADDR A:0xfc48c0e4
y.create.l HWIO_XPU_CFG_SNOC_CFG_XPU_IDR0_ADDR A:0xfc48c074
y.create.l HWIO_XPU_CFG_SNOC_CFG_XPU_IDR1_ADDR A:0xfc48c078
y.create.l HWIO_XPU_CFG_SNOC_CFG_XPU_REV_ADDR A:0xfc48c07c
y.create.l HWIO_XPU_CFG_SNOC_CFG_XPU_PRT0_RACR0_ADDR A:0xfc48c200
y.create.l HWIO_XPU_CFG_SNOC_CFG_XPU_PRT1_RACR0_ADDR A:0xfc48c280
y.create.l HWIO_XPU_CFG_SNOC_CFG_XPU_PRT2_RACR0_ADDR A:0xfc48c300
y.create.l HWIO_XPU_CFG_SNOC_CFG_XPU_PRT3_RACR0_ADDR A:0xfc48c380
y.create.l HWIO_XPU_CFG_SNOC_CFG_XPU_PRT4_RACR0_ADDR A:0xfc48c400
y.create.l HWIO_XPU_CFG_SNOC_CFG_XPU_PRT5_RACR0_ADDR A:0xfc48c480
y.create.l HWIO_XPU_CFG_SNOC_CFG_XPU_PRT6_RACR0_ADDR A:0xfc48c500
y.create.l HWIO_XPU_CFG_SNOC_CFG_XPU_PRT7_RACR0_ADDR A:0xfc48c580
y.create.l HWIO_XPU_CFG_SNOC_CFG_XPU_PRT8_RACR0_ADDR A:0xfc48c600
y.create.l HWIO_XPU_CFG_SNOC_CFG_XPU_PRT9_RACR0_ADDR A:0xfc48c680
y.create.l HWIO_XPU_CFG_SNOC_CFG_XPU_PRT0_WACR0_ADDR A:0xfc48c220
y.create.l HWIO_XPU_CFG_SNOC_CFG_XPU_PRT1_WACR0_ADDR A:0xfc48c2a0
y.create.l HWIO_XPU_CFG_SNOC_CFG_XPU_PRT2_WACR0_ADDR A:0xfc48c320
y.create.l HWIO_XPU_CFG_SNOC_CFG_XPU_PRT3_WACR0_ADDR A:0xfc48c3a0
y.create.l HWIO_XPU_CFG_SNOC_CFG_XPU_PRT4_WACR0_ADDR A:0xfc48c420
y.create.l HWIO_XPU_CFG_SNOC_CFG_XPU_PRT5_WACR0_ADDR A:0xfc48c4a0
y.create.l HWIO_XPU_CFG_SNOC_CFG_XPU_PRT6_WACR0_ADDR A:0xfc48c520
y.create.l HWIO_XPU_CFG_SNOC_CFG_XPU_PRT7_WACR0_ADDR A:0xfc48c5a0
y.create.l HWIO_XPU_CFG_SNOC_CFG_XPU_PRT8_WACR0_ADDR A:0xfc48c620
y.create.l HWIO_XPU_CFG_SNOC_CFG_XPU_PRT9_WACR0_ADDR A:0xfc48c6a0
y.create.l HWIO_XPU_CFG_SNOC_CFG_XPU_PRT0_START0_ADDR A:0xfc48c240
y.create.l HWIO_XPU_CFG_SNOC_CFG_XPU_PRT1_START0_ADDR A:0xfc48c2c0
y.create.l HWIO_XPU_CFG_SNOC_CFG_XPU_PRT2_START0_ADDR A:0xfc48c340
y.create.l HWIO_XPU_CFG_SNOC_CFG_XPU_PRT3_START0_ADDR A:0xfc48c3c0
y.create.l HWIO_XPU_CFG_SNOC_CFG_XPU_PRT4_START0_ADDR A:0xfc48c440
y.create.l HWIO_XPU_CFG_SNOC_CFG_XPU_PRT5_START0_ADDR A:0xfc48c4c0
y.create.l HWIO_XPU_CFG_SNOC_CFG_XPU_PRT6_START0_ADDR A:0xfc48c540
y.create.l HWIO_XPU_CFG_SNOC_CFG_XPU_PRT7_START0_ADDR A:0xfc48c5c0
y.create.l HWIO_XPU_CFG_SNOC_CFG_XPU_PRT8_START0_ADDR A:0xfc48c640
y.create.l HWIO_XPU_CFG_SNOC_CFG_XPU_PRT9_START0_ADDR A:0xfc48c6c0
y.create.l HWIO_XPU_CFG_SNOC_CFG_XPU_PRT0_END0_ADDR A:0xfc48c248
y.create.l HWIO_XPU_CFG_SNOC_CFG_XPU_PRT1_END0_ADDR A:0xfc48c2c8
y.create.l HWIO_XPU_CFG_SNOC_CFG_XPU_PRT2_END0_ADDR A:0xfc48c348
y.create.l HWIO_XPU_CFG_SNOC_CFG_XPU_PRT3_END0_ADDR A:0xfc48c3c8
y.create.l HWIO_XPU_CFG_SNOC_CFG_XPU_PRT4_END0_ADDR A:0xfc48c448
y.create.l HWIO_XPU_CFG_SNOC_CFG_XPU_PRT5_END0_ADDR A:0xfc48c4c8
y.create.l HWIO_XPU_CFG_SNOC_CFG_XPU_PRT6_END0_ADDR A:0xfc48c548
y.create.l HWIO_XPU_CFG_SNOC_CFG_XPU_PRT7_END0_ADDR A:0xfc48c5c8
y.create.l HWIO_XPU_CFG_SNOC_CFG_XPU_PRT8_END0_ADDR A:0xfc48c648
y.create.l HWIO_XPU_CFG_SNOC_CFG_XPU_PRT9_END0_ADDR A:0xfc48c6c8
y.create.l HWIO_XPU_CFG_SNOC_CFG_XPU_PRT0_SCR_ADDR A:0xfc48c250
y.create.l HWIO_XPU_CFG_SNOC_CFG_XPU_PRT1_SCR_ADDR A:0xfc48c2d0
y.create.l HWIO_XPU_CFG_SNOC_CFG_XPU_PRT2_SCR_ADDR A:0xfc48c350
y.create.l HWIO_XPU_CFG_SNOC_CFG_XPU_PRT3_SCR_ADDR A:0xfc48c3d0
y.create.l HWIO_XPU_CFG_SNOC_CFG_XPU_PRT4_SCR_ADDR A:0xfc48c450
y.create.l HWIO_XPU_CFG_SNOC_CFG_XPU_PRT5_SCR_ADDR A:0xfc48c4d0
y.create.l HWIO_XPU_CFG_SNOC_CFG_XPU_PRT6_SCR_ADDR A:0xfc48c550
y.create.l HWIO_XPU_CFG_SNOC_CFG_XPU_PRT7_SCR_ADDR A:0xfc48c5d0
y.create.l HWIO_XPU_CFG_SNOC_CFG_XPU_PRT8_SCR_ADDR A:0xfc48c650
y.create.l HWIO_XPU_CFG_SNOC_CFG_XPU_PRT9_SCR_ADDR A:0xfc48c6d0
y.create.l HWIO_XPU_CFG_SNOC_CFG_XPU_PRT0_MCR_ADDR A:0xfc48c254
y.create.l HWIO_XPU_CFG_SNOC_CFG_XPU_PRT1_MCR_ADDR A:0xfc48c2d4
y.create.l HWIO_XPU_CFG_SNOC_CFG_XPU_PRT2_MCR_ADDR A:0xfc48c354
y.create.l HWIO_XPU_CFG_SNOC_CFG_XPU_PRT3_MCR_ADDR A:0xfc48c3d4
y.create.l HWIO_XPU_CFG_SNOC_CFG_XPU_PRT4_MCR_ADDR A:0xfc48c454
y.create.l HWIO_XPU_CFG_SNOC_CFG_XPU_PRT5_MCR_ADDR A:0xfc48c4d4
y.create.l HWIO_XPU_CFG_SNOC_CFG_XPU_PRT6_MCR_ADDR A:0xfc48c554
y.create.l HWIO_XPU_CFG_SNOC_CFG_XPU_PRT7_MCR_ADDR A:0xfc48c5d4
y.create.l HWIO_XPU_CFG_SNOC_CFG_XPU_PRT8_MCR_ADDR A:0xfc48c654
y.create.l HWIO_XPU_CFG_SNOC_CFG_XPU_PRT9_MCR_ADDR A:0xfc48c6d4
y.create.l HWIO_XPU_CFG_SNOC_CFG_XPU_PRT0_CNTL0_ADDR A:0xfc48c258
y.create.l HWIO_XPU_CFG_SNOC_CFG_XPU_PRT1_CNTL0_ADDR A:0xfc48c2d8
y.create.l HWIO_XPU_CFG_SNOC_CFG_XPU_PRT2_CNTL0_ADDR A:0xfc48c358
y.create.l HWIO_XPU_CFG_SNOC_CFG_XPU_PRT3_CNTL0_ADDR A:0xfc48c3d8
y.create.l HWIO_XPU_CFG_SNOC_CFG_XPU_PRT4_CNTL0_ADDR A:0xfc48c458
y.create.l HWIO_XPU_CFG_SNOC_CFG_XPU_PRT5_CNTL0_ADDR A:0xfc48c4d8
y.create.l HWIO_XPU_CFG_SNOC_CFG_XPU_PRT6_CNTL0_ADDR A:0xfc48c558
y.create.l HWIO_XPU_CFG_SNOC_CFG_XPU_PRT7_CNTL0_ADDR A:0xfc48c5d8
y.create.l HWIO_XPU_CFG_SNOC_CFG_XPU_PRT8_CNTL0_ADDR A:0xfc48c658
y.create.l HWIO_XPU_CFG_SNOC_CFG_XPU_PRT9_CNTL0_ADDR A:0xfc48c6d8
y.create.l HWIO_XPU_CFG_SNOC_CFG_XPU_PRT0_CNTL1_ADDR A:0xfc48c25c
y.create.l HWIO_XPU_CFG_SNOC_CFG_XPU_PRT1_CNTL1_ADDR A:0xfc48c2dc
y.create.l HWIO_XPU_CFG_SNOC_CFG_XPU_PRT2_CNTL1_ADDR A:0xfc48c35c
y.create.l HWIO_XPU_CFG_SNOC_CFG_XPU_PRT3_CNTL1_ADDR A:0xfc48c3dc
y.create.l HWIO_XPU_CFG_SNOC_CFG_XPU_PRT4_CNTL1_ADDR A:0xfc48c45c
y.create.l HWIO_XPU_CFG_SNOC_CFG_XPU_PRT5_CNTL1_ADDR A:0xfc48c4dc
y.create.l HWIO_XPU_CFG_SNOC_CFG_XPU_PRT6_CNTL1_ADDR A:0xfc48c55c
y.create.l HWIO_XPU_CFG_SNOC_CFG_XPU_PRT7_CNTL1_ADDR A:0xfc48c5dc
y.create.l HWIO_XPU_CFG_SNOC_CFG_XPU_PRT8_CNTL1_ADDR A:0xfc48c65c
y.create.l HWIO_XPU_CFG_SNOC_CFG_XPU_PRT9_CNTL1_ADDR A:0xfc48c6dc
y.create.done
