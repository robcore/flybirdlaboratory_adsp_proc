; Generated by Flat2BAM on 7/31/2012 12:19 PM
; SpsListBAMs.cmm - Lists the BAMs for the given target

ENDDO Crypto0,Crypto1,LPASS_Slimbus,A2,MSS_Crypto,SDC1,SDC2,SDC3,SDC4,BLSP1,BLSP2,BAMDMA_BAM,BAMDMA,TSIF,USB1_HS,QDSS,USB30, ; , at the end is intentional
