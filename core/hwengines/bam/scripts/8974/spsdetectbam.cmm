; Generated by Flat2BAM on 7/31/2012 12:19 PM
; SpsDetectBAM.cmm - Detects the BAM to which the PhysAddr belongs

ENTRY &PhysAddr
   IF ((&PhysAddr>=&Crypto0_addr)&&(&PhysAddr<=&Crypto0_addr+0x8FFF))
   (
        ENDDO Crypto0 &Crypto0_addr
   )
   IF ((&PhysAddr>=&Crypto1_addr)&&(&PhysAddr<=&Crypto1_addr+0x8FFF))
   (
        ENDDO Crypto1 &Crypto1_addr
   )
   IF ((&PhysAddr>=&LPASS_Slimbus_addr)&&(&PhysAddr<=&LPASS_Slimbus_addr+0x1FFFF))
   (
        ENDDO LPASS_Slimbus &LPASS_Slimbus_addr
   )
   IF ((&PhysAddr>=&A2_addr)&&(&PhysAddr<=&A2_addr+0x6FFF))
   (
        ENDDO A2 &A2_addr
   )
   IF ((&PhysAddr>=&MSS_Crypto_addr)&&(&PhysAddr<=&MSS_Crypto_addr+0x2FFF))
   (
        ENDDO MSS_Crypto &MSS_Crypto_addr
   )
   IF ((&PhysAddr>=&SDC1_addr)&&(&PhysAddr<=&SDC1_addr+0x6FFF))
   (
        ENDDO SDC1 &SDC1_addr
   )
   IF ((&PhysAddr>=&SDC2_addr)&&(&PhysAddr<=&SDC2_addr+0x6FFF))
   (
        ENDDO SDC2 &SDC2_addr
   )
   IF ((&PhysAddr>=&SDC3_addr)&&(&PhysAddr<=&SDC3_addr+0x6FFF))
   (
        ENDDO SDC3 &SDC3_addr
   )
   IF ((&PhysAddr>=&SDC4_addr)&&(&PhysAddr<=&SDC4_addr+0x6FFF))
   (
        ENDDO SDC4 &SDC4_addr
   )
   IF ((&PhysAddr>=&BLSP1_addr)&&(&PhysAddr<=&BLSP1_addr+0x18FFF))
   (
        ENDDO BLSP1 &BLSP1_addr
   )
   IF ((&PhysAddr>=&BLSP2_addr)&&(&PhysAddr<=&BLSP2_addr+0x18FFF))
   (
        ENDDO BLSP2 &BLSP2_addr
   )
   IF ((&PhysAddr>=&BAMDMA_BAM_addr)&&(&PhysAddr<=&BAMDMA_BAM_addr+0x14FFF))
   (
        ENDDO BAMDMA_BAM &BAMDMA_BAM_addr
   )
   IF ((&PhysAddr>=&BAMDMA_addr)&&(&PhysAddr<=&BAMDMA_addr+0x1FFF))
   (
        ENDDO BAMDMA &BAMDMA_addr
   )
   IF ((&PhysAddr>=&TSIF_addr)&&(&PhysAddr<=&TSIF_addr+0x10FFF))
   (
        ENDDO TSIF &TSIF_addr
   )
   IF ((&PhysAddr>=&USB1_HS_addr)&&(&PhysAddr<=&USB1_HS_addr+0x10FFF))
   (
        ENDDO USB1_HS &USB1_HS_addr
   )
   IF ((&PhysAddr>=&QDSS_addr)&&(&PhysAddr<=&QDSS_addr+0x2FFF))
   (
        ENDDO QDSS &QDSS_addr
   )
   IF ((&PhysAddr>=&USB30_addr)&&(&PhysAddr<=&USB30_addr+0x4FFF))
   (
        ENDDO USB30 &USB30_addr
   )
ENDDO 0x0
