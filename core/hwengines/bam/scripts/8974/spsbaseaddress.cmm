; Generated by Flat2BAM on 7/31/2012 12:19 PM
; Spsbaseaddress.cmm - Initializes the global variables pertaining to sps

; Retrieves the Base addresses of the given BAM blocks
ENTRY &BAMBlockName
IF (STRING.LWR("&BAMBlockName")==STRING.LWR("Crypto0"))
(
   ENDDO 0xFD404000
)
IF (STRING.LWR("&BAMBlockName")==STRING.LWR("Crypto1"))
(
   ENDDO 0xFD444000
)
IF (STRING.LWR("&BAMBlockName")==STRING.LWR("LPASS_Slimbus"))
(
   ENDDO 0xFE104000
)
IF (STRING.LWR("&BAMBlockName")==STRING.LWR("A2"))
(
   ENDDO 0xFC834000
)
IF (STRING.LWR("&BAMBlockName")==STRING.LWR("MSS_Crypto"))
(
   ENDDO 0xFC9C4000
)
IF (STRING.LWR("&BAMBlockName")==STRING.LWR("SDC1"))
(
   ENDDO 0xF9804000
)
IF (STRING.LWR("&BAMBlockName")==STRING.LWR("SDC2"))
(
   ENDDO 0xF9844000
)
IF (STRING.LWR("&BAMBlockName")==STRING.LWR("SDC3"))
(
   ENDDO 0xF9884000
)
IF (STRING.LWR("&BAMBlockName")==STRING.LWR("SDC4"))
(
   ENDDO 0xF98C4000
)
IF (STRING.LWR("&BAMBlockName")==STRING.LWR("BLSP1"))
(
   ENDDO 0xF9904000
)
IF (STRING.LWR("&BAMBlockName")==STRING.LWR("BLSP2"))
(
   ENDDO 0xF9944000
)
IF (STRING.LWR("&BAMBlockName")==STRING.LWR("BAMDMA_BAM"))
(
   ENDDO 0xF9984000
)
IF (STRING.LWR("&BAMBlockName")==STRING.LWR("BAMDMA"))
(
   ENDDO 0xF9999000
)
IF (STRING.LWR("&BAMBlockName")==STRING.LWR("TSIF"))
(
   ENDDO 0xF99C4000
)
IF (STRING.LWR("&BAMBlockName")==STRING.LWR("USB1_HS"))
(
   ENDDO 0xF9A44000
)
IF (STRING.LWR("&BAMBlockName")==STRING.LWR("QDSS"))
(
   ENDDO 0xFC37C000
)
IF (STRING.LWR("&BAMBlockName")==STRING.LWR("USB30"))
(
   ENDDO 0xF9304000
)
ENDDO 0x0
