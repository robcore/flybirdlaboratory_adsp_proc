; Generated by Flat2BAM on 7/31/2012 12:19 PM
; Spsinit.cmm - Initializes the global variables pertaining to sps

; Base addresses of various BAM blocks
GLOBAL &Crypto0_addr
GLOBAL &Crypto1_addr
GLOBAL &LPASS_Slimbus_addr
GLOBAL &A2_addr
GLOBAL &MSS_Crypto_addr
GLOBAL &SDC1_addr
GLOBAL &SDC2_addr
GLOBAL &SDC3_addr
GLOBAL &SDC4_addr
GLOBAL &BLSP1_addr
GLOBAL &BLSP2_addr
GLOBAL &BAMDMA_BAM_addr
GLOBAL &BAMDMA_addr
GLOBAL &TSIF_addr
GLOBAL &USB1_HS_addr
GLOBAL &QDSS_addr
GLOBAL &USB30_addr
&Crypto0_addr=0xFD404000
&Crypto1_addr=0xFD444000
&LPASS_Slimbus_addr=0xFE104000
&A2_addr=0xFC834000
&MSS_Crypto_addr=0xFC9C4000
&SDC1_addr=0xF9804000
&SDC2_addr=0xF9844000
&SDC3_addr=0xF9884000
&SDC4_addr=0xF98C4000
&BLSP1_addr=0xF9904000
&BLSP2_addr=0xF9944000
&BAMDMA_BAM_addr=0xF9984000
&BAMDMA_addr=0xF9999000
&TSIF_addr=0xF99C4000
&USB1_HS_addr=0xF9A44000
&QDSS_addr=0xFC37C000
&USB30_addr=0xF9304000
ENDDO
