;****************************************************************
; filename: DSP_connect_loadDSP.cmm
; 	this script is utilized to connect to VPMSM8974, load SMD data structure and load DSP image
; please enter
;	1. Memory dump binary file	
;	2. Start address for memory dump
;       3. Start address for DSP image
;       4. Memory dump for SMD dump
;       5. Start address for SMD dump
; usage:
; 	DSP_connect_loadDSP <file 1> <address 1> <addresss 2> <file 2> <address 1>
; example:
; 	DSP_connect_loadDSP memdump.bin 0xdc00000 0xdc00000 smd.bin 0xfa00000
;****************************************************************

entry &dspfile &dumpaddr &dspaddr &smdfile &smdaddr
global &Qube_va
global &Qube_pa
print "You have entered &p_Port_ID as Port ID to connect VPM8974"

TOOLBAR ON
STATUSBAR ON
;WINPAGE.RESET

;******************************************************************
; Reset QDSP6 through intercomm command
;******************************************************************

;----------------------------------------------------------------------------
; Choose hex mode for input
;----------------------------------------------------------------------------
radix hex
area
area.select

;----------------------------------------------------------------------------
; Set the desired CPU
;----------------------------------------------------------------------------
sys.cpu HexagonV5
sys.up
;----------------------------------------------------------------------------
; Attach to the Virtio simulation
;----------------------------------------------------------------------------
;sys.mcdconfig arch=v5l port=&p_Port_ID simargs=""
;sys.mode.attach

if "&dumpaddr"==""
(
exit
)
else 
(
d.load.binary &dspfile a:&dumpaddr
)

if "&dspaddr"==""
(
&dspaddr=&dumpaddr
)

if "&smdaddr"==""
(
) 
else 
(
d.load.binary &smdfile a:&smdaddr
)

;----------------------------------------------------------------------------
; Setup look and feel
;----------------------------------------------------------------------------

;----------------------------------------------------------------------------
; Print banner
;----------------------------------------------------------------------------
print "VPMSM8974: LPASS"
title "VPMSM8974: LPASS_QDSP6"
;----------------------------------------------------------------------------
; Open the register set
;----------------------------------------------------------------------------
register /spotlight

;----------------------------------------------------------------------------
; Open the source listing
;----------------------------------------------------------------------------
data.list

;----------------------------------------------------------------------------
;Recall and Define History File
;----------------------------------------------------------------------------
autostore , history

sYmbol.SourcePath.reset

;----------------------------------------------------------------------------
; load DSP Image
;----------------------------------------------------------------------------
print "loading DSP Image ......."
d.load.elf .\build\ms\M8974AAAAAAAAQ1234.elf /NOCODE /NOREG
print "DSP Image loaded. Done"
&Qube_va=address.offset(start);
&Qube_pa=&dspaddr
print "DSP address vritual=0x" &Qube_va " physical=0x" &Qube_pa

;----------------------------------------------------------------------------
; set breakpoints
;----------------------------------------------------------------------------
;b.s main /onchip
;b.s QURTK_tlb_crash
;b.s QURTK_fatal_error
;b.s QURTK_nonfatal_error
;b.s QURTK_handle_error

;D.S D:&Qube_pa+0x30 %LE %LONG 1
;D.S D:&Qube_pa+0x34 %LE %LONG 1
;D.S D:&Qube_pa+0x38 %LE %LONG 1

;TERM.METHOD ANGEL QURTK_handle_trap0
;b.s QURTK_handle_trap0 /onchip
; This is where your printf messages will be displayed
;term.gate

print "DSP address vritual=0x" &Qube_va " physical=0x" &Qube_pa

mmu.create &Qube_va--(&Qube_va+0x1800000) &Qube_pa--(&Qube_pa+0x1800000)
mmu.format Blast QURTK_pagetables &Qube_va--(&Qube_va+0xffffff) &Qube_pa
mmu.on
mmu.autoscan on
mmu.tablewalk on

; LOAD RTOS AWARENESS MODULE
TASK.CONFIG .\core\kernel\qurt\install\MMv5\debugger\T32\qurt_model.t32
MENU.ReProgram .\core\kernel\qurt\install\MMv5\debugger\T32\qurt_model.men


; Enable RTOS debug messages
;ext.debug 1


y.spath.srd + .
MENU.REPROGRAM .\core\systemdrivers\hwio\scripts\msm8974\hwioreg.men
path . + .\core\systemdrivers\hwio\scripts\msm8974
do hwio.cmm

;r.s PC &Qube_va




