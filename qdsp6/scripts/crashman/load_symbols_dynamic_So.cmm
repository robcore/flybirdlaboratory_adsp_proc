LOCAL &dynamic_so_count
LOCAL &dynamic_so_string
LOCAL &Linkedlist_l_next
LOCAL &Linkedlist_l_addr1
LOCAL &printstring
LOCAL &Dynamic_obj_option
LOCAL &dynamicobjpath
LOCAL &Load_using_script
ENTRY &HeapVar &OpDir

&dynamic_so_count=0
&dynamic_so_string=""
&Linkedlist_l_next=0
&Linkedlist_l_addr1=0
&printstring=""
&Dynamic_obj_option=1.0
&Load_using_script=0

Area.Create DYN 200. 1000.       ;create an AREA window              
WINPOS 50% 0. 50% 103% 0. 0. DYN
Area.Select DYN                  ;select the AREA window as PRACTICE 
                                ;input/output window                
Area DYN                         ;display the AREA window   

if (!Y.EXIST("_rtld_debug"))
(
   print %ERROR "_rtld_debug variable is not found in the build. Exiting the script."
   enddo
)

&Linkedlist_l_next=V.VALUE((*((_rtld_debug).r_map)).l_next)

if (&Linkedlist_l_next==0)
(
  print " No Dynamic objects loaded using fastrpc"
  enddo
)

;pause;
print " DYNAMIC OBJECTS LOADED: ";
print " ";
while (&Linkedlist_l_next!=0)
(

	&dynamic_so_count=&dynamic_so_count+1
	&Linkedlist_l_addr=V.VALUE((*(((struct link_map *)&Linkedlist_l_next))).l_addr)
	&Linkedlist_l_name_full=V.STRING((*(((struct link_map *)&Linkedlist_l_next))).l_name)
	&Linkedlist_l_name=string.cut("&Linkedlist_l_name_full", 0xa)

	print " Start address: &Linkedlist_l_addr, Obj Name: &Linkedlist_l_name "  
	; print "Command to load symbols -  d.load.elf  <Unstripped symbol file of &Linkedlist_l_name > &Linkedlist_l_addr /nocode /noclear ";

	&Linkedlist_l_next=V.VALUE((*(((struct link_map *)&Linkedlist_l_next))).l_next)
)

&Linkedlist_l_next=V.VALUE((*((_rtld_debug).r_map)).l_next)
&Linkedlist_l_addr=V.VALUE((*(((struct link_map *)&Linkedlist_l_next))).l_addr)
&Linkedlist_l_name_full=V.STRING((*(((struct link_map *)&Linkedlist_l_next))).l_name)
&Linkedlist_l_name=string.cut("&Linkedlist_l_name_full", 0xa)

print " "
print " "
Print " TO LOAD SYMBOLS OF DYNAMIC OBJECT USE BELOW COMMAND - "
print " d.load.elf  <unstripped .so file> <start address> /nocode /noclear "
print " Example:"
print " d.load.elf  <unstripped .so file of &Linkedlist_l_name> &Linkedlist_l_addr /nocode /noclear "  
print " "


;------------------------------------------------------------------

print " "
print " "
print " YOU CAN EXIT AND MANUALLY LOAD DYNAMIC SYMBOL OBJECT USING ABOVE MENTIONED COMMANDS (OR)"
start:
print " DO YOU WISH TO CONTINUE LOADING DYNAMIC SYMBOL OBJECT USING CMM ?"
print " ENTER THE OPTION NUMBER:"
print " "
print " 1 - To continue"
print " 2 - Exit"
print " "
enter &Load_using_script 

if ("&Load_using_script"=="1")
(
	print " "
	print " "
	print " ENTER THE OPTION NUMBER FROM THE LIST OF DYNAMIC OBJECT SYMBOL FILES YOU WANT TO LOAD."
	print " "


	&Linkedlist_l_next=V.VALUE((*((_rtld_debug).r_map)).l_next)
	&dynamic_so_count=0
	print " Option no." 
	while (&Linkedlist_l_next!=0)
	(

		&dynamic_so_count=&dynamic_so_count+1
		&Linkedlist_l_addr=V.VALUE((*(((struct link_map *)&Linkedlist_l_next))).l_addr)
		&Linkedlist_l_name_full=V.STRING((*(((struct link_map *)&Linkedlist_l_next))).l_name)
		&Linkedlist_l_name=string.cut("&Linkedlist_l_name_full", 0xa)
        
		;&printstring=""
		;&printstring="&printstring"+format.DECIMAL(8.,&dynamic_so_count);
		;print "&printstring"+" .  &Linkedlist_l_name "
		print "     &dynamic_so_count .  &Linkedlist_l_name"  
		&Linkedlist_l_next=V.VALUE((*(((struct link_map *)&Linkedlist_l_next))).l_next)
	)
	print " "
	print " ENTER THE OPTION NUMBER (please note to enter in hex format):"
	print " "
	enter &Dynamic_obj_option 

	
	&Linkedlist_l_next=V.VALUE((*((_rtld_debug).r_map)).l_next)
	&dynamic_so_count=0
	&Linkedlist_l_addr1=0
	while (&Linkedlist_l_next!=0)
	(

		&dynamic_so_count=&dynamic_so_count+1
		&Linkedlist_l_addr=V.VALUE((*(((struct link_map *)&Linkedlist_l_next))).l_addr)
		&Linkedlist_l_name_full=V.STRING((*(((struct link_map *)&Linkedlist_l_next))).l_name)
		if &dynamic_so_count==&Dynamic_obj_option
		(
			&Linkedlist_l_addr1=&Linkedlist_l_addr
			&Linkedlist_l_name=string.cut("&Linkedlist_l_name_full", 0xa)
		)
		&Linkedlist_l_next=V.VALUE((*(((struct link_map *)&Linkedlist_l_next))).l_next)
	)
	if (&Linkedlist_l_addr1!=0)
	(
		print " PLEASE SELECT THE PATH OF UNSTRIPPED DYNAMIC OBJECT INCLUDING THE FILE NAME FOR &Linkedlist_l_name" 
		dialog.file *.so
		ENTRY &dynamicobjpath
		if ("&dynamicobjpath"!="")
		(
		  if (!os.file(&dynamicobjpath))
		  (
			   print %ERROR " Symbol file not properly chosen"
			   print " "
			   print " "
		  )
		  else
		  (
			print " "
			print " "
			print " Loading Symbol file of &Linkedlist_l_name" 
			print " d.load.elf &dynamicobjpath &Linkedlist_l_addr1 /nocode /noclear"
			d.load.elf &dynamicobjpath &Linkedlist_l_addr1 /nocode /noclear
			print %ERROR " SYMBOL FILE LOADED."
			print " "
			print " "
		  )
		)
		else
		(
		  print %ERROR " SYMBOL FILE NOT CHOSEN"
		  print " "
		  print " "
		)
	)
	else
	(
		Print %ERROR " WRONG OPTION GIVEN"
		print " "
		print " "
	)
)
else
(
	Print  " "
	Print  "Exited"
	enddo
)

goto start

enddo

