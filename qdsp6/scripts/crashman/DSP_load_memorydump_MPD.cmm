;****************************************************************
; filename: DSP_timestamp_check.cmm
;
;****************************************************************
LOCAL &ramdumppath &smddumppath &f3logpath &ulogpath &otherinfo &dumpSize
entry &choice 

TOOLBAR ON
STATUSBAR ON

ENTRY

;----------------------------------------------------------------------------
; Set the desired CPU
;----------------------------------------------------------------------------
;sys.cpu HexagonV5H
;sys.up

pwd
cd ../../../
pwd

print " "
print "PLEASE ENTERT ADSP image START ADDRESS: (eg: 0x00000000)" 
print " "
print " "
print " "
print " "
enter &adspbaseadd 

print "PLEASE ENTER THE PATH INCLUDING THE RAMDUMP FILE NAME" 
print " "
print " "
enter &ramdumppath

print " "
print "Enter the SMD starting address(eg: 0xfa00000) if you have SMD Ram dump"
print "PLEASE ENTER IF YOU DON'T HAVE "
print " "
print " "
print " "
enter &smdaddr

if "&smdaddr"==""
(
print "NO SMD RAMPDUMP FILE"
)
else
(

print "PLEASE ENTER THE PATH INCLUDING THE SMD RAMDUMP FILE NAME(optional)" 
print " "
print " "
enter &smd_dumpfile
)

print "PLEASE ENTER THE PATH INCLUDING THE CUSTOMER ELF FILE NAME(optional)" 
print " "
print " "
enter &smd_dumpfile

win.title "&ramdumppath"


Area.Select "output"
AREA.view "output"

print "RAM dump start path &ramdumppath"
print "RAM dump start address &ramdumpstartadd"
print "ADSP image start address &adspbaseadd"
print "Customer address &Customer_Elf_Path"
&dumpSize=OS.FILE.SIZE(&ramdumppath)
print "&ramdumppath size is &dumpSize"

if &dumpSize>31457280
(   // QPST RAM dump
    do qdsp6\scripts\crashman\DSP_connect_memdump_MPD.cmm &ramdumppath 0x00000000  &adspbaseadd  &smddumppath &smdaddr &Customer_Elf_Path
)
else  
(   // ADSP only RAM dump
    do qdsp6\scripts\crashman\DSP_connect_memdump_MPD.cmm &ramdumppath &adspbaseadd  &adspbaseadd  &smddumppath &smdaddr &Customer_Elf_Path
)
win.title "&ramdumppath"
area.select Crashman
print "Processing analy_qurt_error.cmm Script"
printer.file &OutputPath_temp\Crashman_Log.txt
printer.filetype ascii
printer.size 0xfa,0xfa
wp.area.view Crashman
do qdsp6\scripts\crashman\analy_qurt_error.cmm
WINclear TOP
area.select Crashman
print "Processing analy_qurt_error.cmm Script. Done"
printer.file &OutputPath_temp\Crashman_Log.txt
printer.filetype ascii
printer.size 0xfa,0xfa
wp.area.view Crashman


do qdsp6\scripts\crashman\DSP_load_pagetables.cmm &OutputPath_temp


Area.Select "output"
AREA.view "output"
&choice=0

print " "
print "Enter the choice number. Do you need F3 log?" 
print " "
print " "
print "1.  Yes"
print "2.  No"
print " "
print " "
enter &choice

if &choice==1
(
    print "PLEASE ENTER THE PATH YOU WANT TO STORE THE F3 LOG" 
    print " "
    print " "
    enter &f3logpath
    cd qdsp6\scripts
    do recover_f3.cmm &f3logpath
    cd ../..
)

Area.Select "output"
AREA.view "output"
&choice=0

print " "
print "Enter the choice number. Do you need U-log?" 
print " "
print " "
print "1.  Yes"
print "2.  No"
print " "
print " "
enter &choice

if &choice==1
(
    print "PLEASE ENTER THE PATH YOU WANT TO STORE THE U-LOG" 
    print " "
    print " "
    enter &ulogpath
    do core\power\ulog\scripts\ULogDump.cmm &ulogpath &ELF
)

Area.Select "output"
AREA.view "output"

&choice=0

print " "
print "Enter the choice number. Do you want more information?" 
print " "

print " "
print "1.  Yes"
print "2.  No"
print " "
print " "
enter &choice

if &choice==1
(
    print "PLEASE ENTER THE PATH YOU WANT TO STORE THE INFO" 
    print " "
    print " "
    enter &otherinfo

    do qdsp6\scripts\crashman\DSP_dump_info.cmm &otherinfo

    print " "
    print " "
    print "Information is saved in the location"
    print " "
    print " "
)

print " "
print " "
print "DONE"
print " "
print " "

