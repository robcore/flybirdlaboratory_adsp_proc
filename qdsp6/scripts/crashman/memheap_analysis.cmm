entry &loc &Target_Name &CurrentDirectory &ADSP_BUILDROOT
if OS.DIR(&loc\Def_Heap)
(
    print "Def_Heap diretory already exists"
)
else 
(
    mkdir &loc\Def_Heap
)


if OS.DIR(&loc\Def_Heap_forSensors_img)
(
    print " Def_Heap_forSensors_img diretory already exists"
)
else 
(
    mkdir &loc\Def_Heap_forSensors_img
)

if ("&slpi"=="True")
(
    printer.file &OutputPath_Qurt\Heap_Analysis_GuestOS.txt
    printer.filetype ascii
    printer.size 0xfa,0xfa
    ;cd qdsp6\scripts\msm8974
    do memheap2_heapWalker_Latest.cmm \\M8996AAAAAAAAQ1234\Global\amss_mem_heap &loc\Def_Heap
    wp.area ST
    WINclear TOP
    printer.file &OutputPath_Qurt\Heap_Analysis_Sensors.txt
    printer.filetype ascii
    printer.size 0xfa,0xfa
    ;cd qdsp6\scripts\msm8974
    do memheap2_heapWalker_Latest.cmm \\M8996AAAAAAAAQ1234_SENSOR\Global\amss_mem_heap &loc\Def_Heap_forSensors_img
    wp.area ST
    WINclear TOP
    printer.file &OutputPath_Qurt\Heap_Analysis_QURT.txt
    printer.filetype ascii
    printer.size 0xfa,0xfa
    do heapwalker.cmm qurtos_heap_struct &OutputPath_Qurt &CurrentDirectory
    wp.area ST
    WINclear TOP
    printer.file &OutputPath_Qurt\Heap_Analysis_QURTISLAND.txt
    printer.filetype ascii
    printer.size 0xfa,0xfa
    do heapwalker_island.cmm qurtos_island_heap_ptr &OutputPath_Qurt &CurrentDirectory 
    wp.area ST
    WINclear TOP
)
else if ("&Target_Name"=="8x10")
(
    printer.file &OutputPath_Qurt\Heap_Analysis_GuestOS.txt
    printer.filetype ascii
    printer.size 0xfa,0xfa
    do memheap2_heapWalker.cmm default_heap_state &loc\Def_Heap
    wp.area ST
    WINclear TOP
)
else if ("&Target_Name"=="8610")
(
    printer.file &OutputPath_Qurt\Heap_Analysis_GuestOS.txt
    printer.filetype ascii
    printer.size 0xfa,0xfa
    ;cd qdsp6\scripts\msm8974
    do memheap2_heapWalker.cmm default_heap_state &loc\Def_Heap
    wp.area ST
    WINclear TOP
)
else if ("&Target_Name"=="8x26")
(
    printer.file &OutputPath_Qurt\Heap_Analysis_GuestOS.txt
    printer.filetype ascii
    printer.size 0xfa,0xfa
    do memheap2_heapWalker.cmm \\M8x26AAAAAAAAQ1234\memory_wrappers\default_heap_state &loc\Def_Heap
    wp.area ST
    WINclear TOP
    printer.file &OutputPath_Qurt\Heap_Analysis_Sensors.txt
    printer.filetype ascii
    printer.size 0xfa,0xfa
    do memheap2_heapWalker.cmm \\M8x26AAAAAAAAQ1234_SENSOR\memory_wrappers\default_heap_state &loc\Def_Heap_forSensors_img
    wp.area ST
    WINclear TOP
)
else if ("&Target_Name"=="8084")
(
    printer.file &OutputPath_Qurt\Heap_Analysis_GuestOS.txt
    printer.filetype ascii
    printer.size 0xfa,0xfa
    do memheap2_heapWalker.cmm \\M8084AAAAAAAAQ1234\memory_wrappers\default_heap_state &loc\Def_Heap
    wp.area ST
    WINclear TOP
    printer.file &OutputPath_Qurt\Heap_Analysis_Sensors.txt
    printer.filetype ascii
    printer.size 0xfa,0xfa
    do memheap2_heapWalker.cmm \\M8084AAAAAAAAQ1234_SENSOR\memory_wrappers\default_heap_state &loc\Def_Heap_forSensors_img
    wp.area ST
    WINclear TOP
)
else if ("&Target_Name"=="8626")
(
    printer.file &OutputPath_Qurt\Heap_Analysis_GuestOS.txt
    printer.filetype ascii
    printer.size 0xfa,0xfa
    do memheap2_heapWalker.cmm \\M8x26AAAAAAAAQ1234\memory_wrappers\default_heap_state &loc\Def_Heap
    wp.area ST
    WINclear TOP
    printer.file &OutputPath_Qurt\Heap_Analysis_Sensors.txt
    printer.filetype ascii
    printer.size 0xfa,0xfa
    do memheap2_heapWalker.cmm \\M8x26AAAAAAAAQ1234_SENSOR\memory_wrappers\default_heap_state &loc\Def_Heap_forSensors_img
    wp.area ST
    WINclear TOP
)
else if ("&Target_Name"=="8974")
(
    printer.file &OutputPath_Qurt\Heap_Analysis_GuestOS.txt
    printer.filetype ascii
    printer.size 0xfa,0xfa
    do memheap2_heapWalker.cmm \\M8974AAAAAAAAQ1234\memory_wrappers\default_heap_state &loc\Def_Heap
    wp.area ST
    WINclear TOP
    printer.file &OutputPath_Qurt\Heap_Analysis_Sensors.txt
    printer.filetype ascii
    printer.size 0xfa,0xfa
    do memheap2_heapWalker.cmm \\M8974AAAAAAAAQ1234_SENSOR\memory_wrappers\default_heap_state &loc\Def_Heap_forSensors_img
    wp.area ST
    WINclear TOP
)
else if ("&Target_Name"=="8994")
(
    printer.file &OutputPath_Qurt\Heap_Analysis_GuestOS.txt
    printer.filetype ascii
    printer.size 0xfa,0xfa
    do memheap2_heapWalker_Latest.cmm \\M8994AAAAAAAAQ1234\Global\amss_mem_heap &loc\Def_Heap
    wp.area ST
    WINclear TOP
    printer.file &OutputPath_Qurt\Heap_Analysis_Sensors.txt
    printer.filetype ascii
    printer.size 0xfa,0xfa
    do memheap2_heapWalker_Latest.cmm \\M8994AAAAAAAAQ1234_SENSOR\Global\amss_mem_heap &loc\Def_Heap_forSensors_img
    wp.area ST
    WINclear TOP
    printer.file &OutputPath_Qurt\Heap_Analysis_QURT.txt
    printer.filetype ascii
    printer.size 0xfa,0xfa
    do heapwalker.cmm qurtos_heap_struct &OutputPath_Qurt &CurrentDirectory
    wp.area ST
    WINclear TOP
    printer.file &OutputPath_Qurt\Heap_Analysis_QURTISLAND.txt
    printer.filetype ascii
    printer.size 0xfa,0xfa
    do heapwalker_island.cmm qurtos_island_heap_ptr &OutputPath_Qurt &CurrentDirectory 
    wp.area ST
    WINclear TOP
)
else if ("&Target_Name"=="8992")
(
    printer.file &OutputPath_Qurt\Heap_Analysis_GuestOS.txt
    printer.filetype ascii
    printer.size 0xfa,0xfa
    do memheap2_heapWalker_Latest.cmm \\M8992AAAAAAAAQ1234\Global\amss_mem_heap &loc\Def_Heap
    wp.area ST
    WINclear TOP
    printer.file &OutputPath_Qurt\Heap_Analysis_Sensors.txt
    printer.filetype ascii
    printer.size 0xfa,0xfa
    do memheap2_heapWalker_Latest.cmm \\M8992AAAAAAAAQ1234_SENSOR\Global\amss_mem_heap &loc\Def_Heap_forSensors_img
    wp.area ST
    WINclear TOP
    printer.file &OutputPath_Qurt\Heap_Analysis_QURT.txt
    printer.filetype ascii
    printer.size 0xfa,0xfa
    do heapwalker.cmm qurtos_heap_struct &OutputPath_Qurt &CurrentDirectory
    wp.area ST
    WINclear TOP
    printer.file &OutputPath_Qurt\Heap_Analysis_QURTISLAND.txt
    printer.filetype ascii
    printer.size 0xfa,0xfa
    do heapwalker_island.cmm qurtos_island_heap_ptr &OutputPath_Qurt &CurrentDirectory 
    wp.area ST
    WINclear TOP
)
else if ("&Target_Name"=="8952")
(
    printer.file &OutputPath_Qurt\Heap_Analysis_GuestOS.txt
    printer.filetype ascii
    printer.size 0xfa,0xfa
    do memheap2_heapWalker_Latest.cmm \\M8952AAAAAAAAQ1234\Global\amss_mem_heap &loc\Def_Heap
    wp.area ST
    WINclear TOP
    ;printer.file &OutputPath_Qurt\Heap_Analysis_Sensors.txt
    ;printer.filetype ascii
    ;printer.size 0xfa,0xfa
    ;do memheap2_heapWalker_Latest.cmm \\M8952AAAAAAAAQ1234_SENSOR\Global\amss_mem_heap &loc\Def_Heap_forSensors_img
    ;wp.area ST
    ;WINclear TOP
    printer.file &OutputPath_Qurt\Heap_Analysis_QURT.txt
    printer.filetype ascii
    printer.size 0xfa,0xfa
    do heapwalker.cmm qurtos_heap_struct &OutputPath_Qurt &CurrentDirectory
    wp.area ST
    WINclear TOP
    printer.file &OutputPath_Qurt\Heap_Analysis_QURTISLAND.txt
    printer.filetype ascii
    printer.size 0xfa,0xfa
    do heapwalker_island.cmm qurtos_island_heap_ptr &OutputPath_Qurt &CurrentDirectory 
    wp.area ST
    WINclear TOP
)
else if ("&Target_Name"=="8976")
(
    printer.file &OutputPath_Qurt\Heap_Analysis_GuestOS.txt
    printer.filetype ascii
    printer.size 0xfa,0xfa
    do memheap2_heapWalker_Latest.cmm \\M8976AAAAAAAAQ1234\Global\amss_mem_heap &loc\Def_Heap
    wp.area ST
    WINclear TOP
    printer.file &OutputPath_Qurt\Heap_Analysis_Sensors.txt
    printer.filetype ascii
    printer.size 0xfa,0xfa
    do memheap2_heapWalker_Latest.cmm \\M8976AAAAAAAAQ1234_SENSOR\Global\amss_mem_heap &loc\Def_Heap_forSensors_img
    wp.area ST
    WINclear TOP
    printer.file &OutputPath_Qurt\Heap_Analysis_QURT.txt
    printer.filetype ascii
    printer.size 0xfa,0xfa
    do heapwalker.cmm qurtos_heap_struct &OutputPath_Qurt &CurrentDirectory
    wp.area ST
    WINclear TOP
    printer.file &OutputPath_Qurt\Heap_Analysis_QURTISLAND.txt
    printer.filetype ascii
    printer.size 0xfa,0xfa
    do heapwalker_island.cmm qurtos_island_heap_ptr &OutputPath_Qurt &CurrentDirectory 
    wp.area ST
    WINclear TOP
)
else if ("&Target_Name"=="9x25")
(
    printer.file &OutputPath_Qurt\Heap_Analysis_GuestOS.txt
    printer.filetype ascii
    printer.size 0xfa,0xfa
    do memheap2_heapWalker.cmm \\M9x25AAAAAAAAAQ1234\memory_wrappers\default_heap_state &OutputPath\Def_Heap
    wp.area ST
    WINclear TOP
)
else if ("&Target_Name"=="9625")
(
    printer.file &OutputPath_Qurt\Heap_Analysis_GuestOS.txt
    printer.filetype ascii
    printer.size 0xfa,0xfa
    do memheap2_heapWalker.cmm \\M9x25AAAAAAAAAQ1234\memory_wrappers\default_heap_state &OutputPath\Def_Heap
    wp.area ST
    WINclear TOP
)
else if ("&Target_Name"=="9x35")
(
    printer.file &OutputPath_Qurt\Heap_Analysis_GuestOS.txt
    printer.filetype ascii
    printer.size 0xfa,0xfa
    do memheap2_heapWalker.cmm \\M9x35AAAAAAAAQ1234\memory_wrappers\default_heap_state &OutputPath\Def_Heap
    wp.area ST
    WINclear TOP
)
else if ("&Target_Name"=="9635")
(
    printer.file &OutputPath_Qurt\Heap_Analysis_GuestOS.txt
    printer.filetype ascii
    printer.size 0xfa,0xfa
    do memheap2_heapWalker.cmm \\M9x35AAAAAAAAQ1234\memory_wrappers\default_heap_state &OutputPath\Def_Heap
    wp.area ST
    WINclear TOP
)
else if ("&Target_Name"=="8996")
(
    if OS.DIR(&OutputPath\Def_Heap_for_AUDIO_img)
    (
        print "Def_Heap_for_AUDIO_img diretory already exists"
    )
    else 
    (
        mkdir &OutputPath\Def_Heap_for_AUDIO_img
    )
    printer.file &OutputPath_Qurt\Heap_Analysis_GuestOS.txt
    printer.filetype ascii
    printer.size 0xfa,0xfa
    ;cd qdsp6\scripts\msm8974
    do memheap2_heapWalker_Latest.cmm \\M8996AAAAAAAAQ1234\Global\amss_mem_heap &loc\Def_Heap
    wp.area ST
    WINclear TOP
    printer.file &OutputPath_Qurt\Heap_Analysis_Audio.txt
    printer.filetype ascii
    printer.size 0xfa,0xfa
    ;cd qdsp6\scripts\msm8974
    do memheap2_heapWalker_Latest.cmm \\M8996AAAAAAAAQ1234_AUDIO\Global\amss_mem_heap &loc\Def_Heap_for_AUDIO_img
    wp.area ST
    WINclear TOP	
    printer.file &OutputPath_Qurt\Heap_Analysis_QURT.txt
    printer.filetype ascii
    printer.size 0xfa,0xfa
    do heapwalker.cmm qurtos_heap_struct &OutputPath_Qurt &CurrentDirectory
    wp.area ST
    WINclear TOP
    ;printer.file &OutputPath_Qurt\Heap_Analysis_QURTISLAND.txt
    ;printer.filetype ascii
    ;printer.size 0xfa,0xfa
    ;do heapwalker_island.cmm qurtos_island_heap_ptr &OutputPath_Qurt &CurrentDirectory 
    ;wp.area ST
    ;WINclear TOP
)
&cmd="python MemoryHeapAnalysis.py &OutputPath"
Os.Hidden &cmd

