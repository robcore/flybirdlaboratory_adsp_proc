;****************************************************************
;Filename : DSP_load_memorydump_crashman.cmm
;****************************************************************

ENTRY &Target_Name &ramdumpfile &OutputPath &ADSP_BUILDROOT &CurrentDirectory &Customer_Elf_Path &BinaryLength &adspstartadd &choice1 &DumpCheckFlag &slpi &Qube_pa_guestos_click

global &ramdumpstartadd
global &choice
global &CurrentDirectory
global &ADSP_BUILDROOT
global &Target_Name


global &OutputPath_Qurt
global &OutputPath_temp
global &OutputPath_ulog

area.close
winclear
reset
&OutputPath_temp="&OutputPath"
&OutputPath_Qurt="&OutputPath"
&OutputPath_ulog="&OutputPath"
area.create Crashman
area.open Crashman &OutputPath_temp\areainfo.txt
WINPOS 0% 0. 50% 103% 0. 0. Crashman
area.view Crashman 
area.select Crashman

sys.u

print "##########################################################################################################################"
print "############                Crashman Process logs                                                             ############"
print "##########################################################################################################################"
print 
print 

;OPEN #1 "&OutputPath_temp\version_check.txt" /READ
;READ #1 %line &Python_version
;READ #1 %line &Perl_version
;READ #1 %line &Crashman_version
;print "&Crashman_version"
;print "&Python_version "
;print "&Perl_version"
;print 

;version_start:
;read #1 %line &linelst 
;&Endstring=string.mid("&linelst", 0, 0xe)
;if "&Endstring"=="VersionFileEnd"
;(
;    goto version_done_reading
;)
;print %ERROR "&linelst"
;goto version_start
;version_done_reading:

;CLOSE #1 



print "Dump file Provided   :   &ramdumpfile "
print "ADSP build Provided  :   &ADSP_BUILDROOT "
print "Elf path provided    :   &Customer_Elf_Path"
print "Target Name Provided :   &Target_Name"
print "Output Folder        :   &OutputPath"
print 

;OPEN #1 "&OutputPath_temp\binarylength.txt" /READ
;READ #1 %line &BinaryLength
;CLOSE #1 

;OPEN #1 "&OutputPath_temp\adspstartaddr.txt" /READ
;READ #1 %line &adspstartadd 
;CLOSE #1

if (&BinaryLength>52428800)
(
    &ramdumpstartadd=0x00000000
)
else 
(
    &ramdumpstartadd=&adspstartadd
)

print "##########################"
print "ADSP Start Address: &adspstartadd"
if (&adspstartadd==0)
(
    print " Only LPASS dumps detected "
    print "PLEASE ENTERT ADSP image START ADDRESS: (eg: 0x00000000)" 
    print " "
    print " "
    print " "
    print " "
    enter &adspstartadd 
) 

&choice=&choice1

&cmd1 = "cd &CurrentDirectory"
OS.Hidden &cmd1
;;;do DSP_connect_memdump_MPD.cmm &ramdumpfile &UniqueNumber &ramdumpstartadd &adspstartadd &OutputPath &ADSP_BUILDROOT &Target_Name &CurrentDirectory &Customer_Elf_Path
;;entry &dspfile &UniqueNumber &dumpaddr &dspaddr &OutputPath &ADSP_BUILDROOT &Target_Name &CurrentDirectory &openDSPpath &smdfile &smdaddr 
;&dspfile=&ramdumpfile
&dumpaddr=&ramdumpstartadd
&dspaddr=&adspstartadd
;&openDSPpath=&Customer_Elf_Path
global &Qube_va_guestos
global &Qube_pa_guestos
global &ELF
global &SensorsELF
global &AudioELF

TOOLBAR ON
STATUSBAR ON

;----------------------------------------------------------------------------
; Set the desired CPU
;----------------------------------------------------------------------------
if ("&Target_Name"=="8994")
(
    print %ERROR "If HexagonV56 is not available, please update trace version to support HexagonV56 for 8994"
    print "To continue select the HexagonV5 cpu version available and type 'cont' for further crashman processing. "
    sys.cpu HexagonV56
)
else if ("&Target_Name"=="8992")
(
    print %ERROR "If HexagonV56 is not available, please update trace version to support HexagonV56 for 8992"
    print "To continue select the HexagonV5 cpu version available and type 'cont' for further crashman processing. "
    sys.cpu HexagonV56
)
else if ("&Target_Name"=="8952")
(
    print %ERROR "If HexagonV56 is not available, please update trace version to support HexagonV56 for 8952"
    print "To continue select the HexagonV5 cpu version available and type 'cont' for further crashman processing. "
    sys.cpu HexagonV56
)
else if ("&Target_Name"=="8976")
(
    print %ERROR "If HexagonV56 is not available, please update trace version to support HexagonV56 for 8976"
    print "To continue select the HexagonV5 cpu version available and type 'cont' for further crashman processing. "
    sys.cpu HexagonV56
)
else if ("&Target_Name"=="8996")
(
    print %ERROR "If HexagonV60 is not available, please update trace version to support HexagonV60 for 8996"
    print "To continue select the HexagonV5 cpu version available and type 'cont' for further crashman processing. "
    sys.cpu HexagonV60
)
else
(
    sys.cpu HexagonV5
)
sys.up
global &TCM_BASE

&TCM_BASE=0xfe400000
;----------------------------------------------------------------------------
; Attach to the Virtio simulation
;----------------------------------------------------------------------------
print "##########################"
print "Loading Binary : &ramdumpfile"
&command="python &CurrentDirectory\LPMPath.py &ramdumpfile &OutputPath"
OS.Hidden &command
if "&dumpaddr"==""
(
   exit
)
else 
(
    if &choice==1
    (
        if OS.FILE(.\build\ms\M8x10AAAAAAAAQ1234.elf)
        (
            ;--------If 8x10 load complete Ram dump . This is required due to SMMU-------
            d.load.binary &ramdumpfile a:&dumpaddr
        )
        else
        (
            if (&dumpaddr==0)
            (
                
                &dspaddr_temp=(&dspaddr)&0x7FFFFFFF
                if OS.FILE(.\build\ms\M8996AAAAAAAAQ1234.elf)
                (
                    d.load.binary &ramdumpfile a:&dspaddr++0x01800000 /SKIP (&dspaddr_temp)
                )
                else if ("&Target_Name"=="8996")
                (
                    d.load.binary &ramdumpfile a:&dspaddr++0x01800000 /SKIP (&dspaddr_temp)
                )
                else if ("&Target_Name"=="8976")
                (
                    d.load.binary &ramdumpfile a:&dspaddr++0x01800000 /SKIP (&dspaddr_temp)
                )
                else if ("&Target_Name"=="8952")
                (
                    d.load.binary &ramdumpfile a:&dspaddr++0x01800000 /SKIP (&dspaddr_temp)
                )
                else
                (
                    d.load.binary &ramdumpfile a:&dspaddr++0x01800000 /SKIP &dspaddr
                )
                ;----------------Only taking care of 8x26 and 8974 smem regions	
                ;----------------8x26, 8974 ,8084 - 0xfa00000	
                ;----------------8994 - cc0_0000
                ;----------------8x10 - 0xd900000
                ;----------------9x35- 1100000
            )
            else
            (
                d.load.binary &ramdumpfile a:&dumpaddr
            )
        )
    )
    else if &choice==2
    (
        d.load.elf &ramdumpfile 
    )
    else
    (
        print %ERROR "!!!!!!!!!!!Invalid Choice! Dump is not Loaded!!!!!!!!!!!!!"
        exit
    )
)
print "Loading DDRCS0.BIN Binary Done"
OPEN #1 "&OutputPath_temp\LPMPath.txt" /READ
READ #1 %line &LPMPath
CLOSE #1
cd &LPMPath
if OS.FILE(.\LPM.bin)
(
    d.load.binary LPM.bin a:0xfe090000 /noclear
)
d.save.binary &OutputPath\Adsp_Dump.bin a:&dspaddr++0x01e00000
print "Save Adsp_Dump.bin Done"
local &command
cd &ADSP_BUILDROOT
print "##########################"
if "&dspaddr"==""
(
    &dspaddr=&dumpaddr
)

;----------------------------------------------------------------------------
; Print banner
;----------------------------------------------------------------------------
&UniqueNumber="NotGiven"
&command="perl &CurrentDirectory\Compare.pl &OutputPath_temp &UniqueNumber"
Os.Hidden &command
OPEN #1 "&OutputPath_temp\Compare.txt" /READ
READ #1 %line &CompareFlag2
CLOSE #1
if (&CompareFlag2==1)
(
    print "&UniqueNumber &Target_Name Dumps: &ramdumpfile"
    title "&UniqueNumber &Target_Name Dumps: &ramdumpfile"
)
else
(
    print "&Target_Name Dumps: &ramdumpfile"
    title "&Target_Name Dumps: &ramdumpfile"
)
;----------------------------------------------------------------------------
;Recall and Define History File
;----------------------------------------------------------------------------
autostore , history

sYmbol.SourcePath.reset

;----------------------------------------------------------------------------
; load DSP Image
;----------------------------------------------------------------------------
cd &ADSP_BUILDROOT
print "##########################"
if OS.FILE(.\build\ms\M8974AAAAAAAAQ1234.elf)
(
    if OS.FILE(&Customer_Elf_Path\M8974AAAAAAAAQ1234.elf) 
    (
        print "8974 Loading ELF: &Customer_Elf_Path\M8974AAAAAAAAQ1234.elf"
        d.load.elf &Customer_Elf_Path\M8974AAAAAAAAQ1234.elf /NOCODE /NOREG /NOCLEAR /NOMAP /strippart "adsp_proc" /sourcepath "."
        &ELF="M8974AAAAAAAAQ1234"
        print "8974 Loading ELF Done"
        if OS.FILE(&Customer_Elf_Path\M8974AAAAAAAAQ1234_SENSOR.elf) 
        (
            print "8974 Loading ELF: &Customer_Elf_Path\M8974AAAAAAAAQ1234_SENSOR.elf"
            d.load.elf &Customer_Elf_Path\M8974AAAAAAAAQ1234_SENSOR.elf /NOCODE /NOREG /NOCLEAR /NOMAP /strippart "adsp_proc" /sourcepath "."
            &SensorsELF="M8974AAAAAAAAQ1234_SENSOR"
            print "8974 Loading ELF Done"
        )
    )
    else
    (
        print "8974 Loading ELF: .\build\ms\M8974AAAAAAAAQ1234.elf"
        d.load.elf .\build\ms\M8974AAAAAAAAQ1234.elf /NOCODE /NOREG /NOCLEAR /NOMAP /strippart "adsp_proc" /sourcepath "."
        &ELF="M8974AAAAAAAAQ1234"
        print "8974 Loading ELF Done"
        if OS.FILE(.\build\ms\M8974AAAAAAAAQ1234_SENSOR.elf) 
        (
            print "8974 Loading ELF: .\build\ms\M8974AAAAAAAAQ1234_SENSOR.elf"
            d.load.elf .\build\ms\M8974AAAAAAAAQ1234_SENSOR.elf /NOCODE /NOREG /NOCLEAR /NOMAP /strippart "adsp_proc" /sourcepath "."
            &SensorsELF="M8974AAAAAAAAQ1234_SENSOR"
            print "8974 Loading ELF Done"
        )
    )	
)
else if OS.FILE(.\build\ms\M8x26AAAAAAAAQ1234.elf)
(
	if OS.FILE(&Customer_Elf_Path\M8x26AAAAAAAAQ1234.elf) 
    (
        print "8x26 Loading ELF: &Customer_Elf_Path\M8x26AAAAAAAAQ1234.elf"
        d.load.elf &Customer_Elf_Path\M8x26AAAAAAAAQ1234.elf /NOCODE /NOREG /NOCLEAR /NOMAP /strippart "adsp_proc" /sourcepath "."
        &ELF="M8x26AAAAAAAAQ1234"
        print "8x26 Loading ELF Done"
        if OS.FILE(&Customer_Elf_Path\M8x26AAAAAAAAQ1234_SENSOR.elf) 
        (
            print "8x26 Loading ELF: &Customer_Elf_Path\M8x26AAAAAAAAQ1234_SENSOR.elf"
            d.load.elf &Customer_Elf_Path\M8x26AAAAAAAAQ1234_SENSOR.elf /NOCODE /NOREG /NOCLEAR /NOMAP /strippart "adsp_proc" /sourcepath "."
            &SensorsELF="M8x26AAAAAAAAQ1234_SENSOR"
            print "8x26 Loading ELF Done"
        )
    )
    else
    (
        print "8x26 Loading ELF: .\build\ms\M8x26AAAAAAAAQ1234.elf"
        d.load.elf .\build\ms\M8x26AAAAAAAAQ1234.elf /NOCODE /NOREG /NOCLEAR /NOMAP /strippart "adsp_proc" /sourcepath "."
        &ELF="M8x26AAAAAAAAQ1234"
        print "8x26 Loading ELF Done"
        if OS.FILE(&Customer_Elf_Path\M8x26AAAAAAAAQ1234_SENSOR.elf) 
        (
            print "8x26 Loading ELF: .\build\ms\M8x26AAAAAAAAQ1234_SENSOR.elf"
            d.load.elf .\build\ms\M8x26AAAAAAAAQ1234_SENSOR.elf /NOCODE /NOREG /NOCLEAR /NOMAP /strippart "adsp_proc" /sourcepath "."
            &SensorsELF="M8x26AAAAAAAAQ1234_SENSOR"
            print "8x26 Loading ELF Done"
        )
    )	
)
else if OS.FILE(.\build\ms\M8x10AAAAAAAAQ1234.elf)
(
	if OS.FILE(&Customer_Elf_Path\M8x10AAAAAAAAQ1234.elf) 
    (
        print "8x10 Loading ELF: &Customer_Elf_Path\M8x10AAAAAAAAQ1234.elf"
        d.load.elf &Customer_Elf_Path\M8x10AAAAAAAAQ1234.elf /NOCODE /NOREG /NOCLEAR /NOMAP /strippart "adsp_proc" /sourcepath "."
        &ELF="M8x10AAAAAAAAQ1234"
        print "8x10 Loading ELF Done"
    )
    else
    (
        print "8x10 Loading ELF: .\build\ms\M8x10AAAAAAAAQ1234.elf"
        d.load.elf .\build\ms\M8x10AAAAAAAAQ1234.elf /NOCODE /NOREG /NOCLEAR /NOMAP /strippart "adsp_proc" /sourcepath "."
        &ELF="M8x10AAAAAAAAQ1234"
        print "8x10 Loading ELF Done"
    )	
)
else if OS.FILE(.\build\ms\M8084AAAAAAAAQ1234.elf)
(
	if OS.FILE(&Customer_Elf_Path\M8084AAAAAAAAQ1234.elf) 
    (
        print "8084 Loading ELF: &Customer_Elf_Path\M8084AAAAAAAAQ1234.elf"
        d.load.elf &Customer_Elf_Path\M8084AAAAAAAAQ1234.elf /NOCODE /NOREG /NOCLEAR /NOMAP /strippart "adsp_proc" /sourcepath "."
        &ELF="M8084AAAAAAAAQ1234"
        print "8084 Loading ELF Done"
        if OS.FILE(&Customer_Elf_Path\M8084AAAAAAAAQ1234_SENSOR.elf) 
        (
            print "8084 Loading ELF: &Customer_Elf_Path\M8084AAAAAAAAQ1234_SENSOR.elf"
            d.load.elf &Customer_Elf_Path\M8084AAAAAAAAQ1234_SENSOR.elf /NOCODE /NOREG /NOCLEAR /NOMAP /strippart "adsp_proc" /sourcepath "."
            &SensorsELF="M8084AAAAAAAAQ1234_SENSOR"
            print "8084 Loading ELF Done"
        )
    )
    else
    (
        print "8084 Loading ELF: .\build\ms\M8084AAAAAAAAQ1234.elf"
        d.load.elf .\build\ms\M8084AAAAAAAAQ1234.elf /NOCODE /NOREG /NOCLEAR /NOMAP /strippart "adsp_proc" /sourcepath "."
        &ELF="M8084AAAAAAAAQ1234"
        print "8084 Loading ELF Done"
        if OS.FILE(.\build\ms\M8084AAAAAAAAQ1234_SENSOR.elf) 
        (
            print "8084 Loading ELF: .\build\ms\M8084AAAAAAAAQ1234_SENSOR.elf"
            d.load.elf .\build\ms\M8084AAAAAAAAQ1234_SENSOR.elf /NOCODE /NOREG /NOCLEAR /NOMAP /strippart "adsp_proc" /sourcepath "."
            &SensorsELF="M8084AAAAAAAAQ1234_SENSOR"
            print "8084 Loading ELF Done"
        )
    )	
)
else if OS.FILE(.\build\ms\M8994AAAAAAAAQ1234.elf)
(
	if OS.FILE(&Customer_Elf_Path\M8994AAAAAAAAQ1234.elf) 
    (
        print "8994 Loading ELF: &Customer_Elf_Path\M8994AAAAAAAAQ1234.elf"
        d.load.elf &Customer_Elf_Path\M8994AAAAAAAAQ1234.elf /NOCODE /NOREG /NOCLEAR /NOMAP /strippart "adsp_proc" /sourcepath "."
        &ELF="M8994AAAAAAAAQ1234"
        print "8994 Loading ELF Done"
        if OS.FILE(&Customer_Elf_Path\M8994AAAAAAAAQ1234_SENSOR.elf)
        (
            print "8994 Loading ELF: &Customer_Elf_Path\M8994AAAAAAAAQ1234_SENSOR.elf"
            d.load.elf &Customer_Elf_Path\M8994AAAAAAAAQ1234_SENSOR.elf /NOCODE /NOREG /NOCLEAR /NOMAP /strippart "adsp_proc" /sourcepath "."
            &SensorsELF="M8994AAAAAAAAQ1234_Sensor"
            print "8994 Loading ELF Done"
        )
        &AudioELF="M8994AAAAAAAAQ1234"
        if OS.FILE(&Customer_Elf_Path\M8994AAAAAAAAQ1234_AUDIO.elf)
        (
            print "8994 Loading ELF: &Customer_Elf_Path\M8994AAAAAAAAQ1234_AUDIO.elf"
            d.load.elf &Customer_Elf_Path\M8994AAAAAAAAQ1234_AUDIO.elf /NOCODE /NOREG /NOCLEAR /NOMAP /strippart "adsp_proc" /sourcepath "."
            &AudioELF="M8994AAAAAAAAQ1234_AUDIO"
            print "8994 Loading ELF Done"
        )
    )
    else
    (
        print "8994 Loading ELF: .\build\ms\M8994AAAAAAAAQ1234.elf"
        d.load.elf .\build\ms\M8994AAAAAAAAQ1234.elf /NOCODE /NOREG /NOCLEAR /NOMAP /strippart "adsp_proc" /sourcepath "."
        &ELF="M8994AAAAAAAAQ1234"
        print "8994 Loading ELF Done"
        if OS.FILE(.\build\ms\M8994AAAAAAAAQ1234_SENSOR.elf)
        (
            print "8994 Loading ELF: .\build\ms\M8994AAAAAAAAQ1234_SENSOR.elf"
            d.load.elf .\build\ms\M8994AAAAAAAAQ1234_SENSOR.elf /NOCODE /NOREG /NOCLEAR /NOMAP /strippart "adsp_proc" /sourcepath "."
            &SensorsELF="M8994AAAAAAAAQ1234_Sensor"
            print "8994 Loading ELF Done"
        )
        &AudioELF="M8994AAAAAAAAQ1234"
        if OS.FILE(.\build\ms\M8994AAAAAAAAQ1234_AUDIO.elf)
        (
            print "8994 Loading ELF: .\build\ms\M8994AAAAAAAAQ1234_AUDIO.elf"
            d.load.elf .\build\ms\M8994AAAAAAAAQ1234_AUDIO.elf /NOCODE /NOREG /NOCLEAR /NOMAP /strippart "adsp_proc" /sourcepath "."
            &AudioELF="M8994AAAAAAAAQ1234_AUDIO"
            print "8994 Loading ELF Done"
        )
    )	
)
else if OS.FILE(.\build\ms\M8992AAAAAAAAQ1234.elf)
(
	if OS.FILE(&Customer_Elf_Path\M8992AAAAAAAAQ1234.elf) 
    (
        print "8992 Loading ELF: &Customer_Elf_Path\M8992AAAAAAAAQ1234.elf"
        d.load.elf &Customer_Elf_Path\M8992AAAAAAAAQ1234.elf /NOCODE /NOREG /NOCLEAR /NOMAP /strippart "adsp_proc" /sourcepath "."
        &ELF="M8992AAAAAAAAQ1234"
        print "8992 Loading ELF Done"
        if OS.FILE(&Customer_Elf_Path\M8992AAAAAAAAQ1234_SENSOR.elf)
        (
            print "8992 Loading ELF: &Customer_Elf_Path\M8992AAAAAAAAQ1234_SENSOR.elf"
            d.load.elf &Customer_Elf_Path\M8992AAAAAAAAQ1234_SENSOR.elf /NOCODE /NOREG /NOCLEAR /NOMAP /strippart "adsp_proc" /sourcepath "."
            &SensorsELF="M8992AAAAAAAAQ1234_Sensor"
            print "8992 Loading ELF Done"
        )
        &AudioELF="M8992AAAAAAAAQ1234"
        if OS.FILE(&Customer_Elf_Path\M8992AAAAAAAAQ1234_AUDIO.elf)
        (
            print "8992 Loading ELF: &Customer_Elf_Path\M8992AAAAAAAAQ1234_AUDIO.elf"
            d.load.elf &Customer_Elf_Path\M8992AAAAAAAAQ1234_AUDIO.elf /NOCODE /NOREG /NOCLEAR /NOMAP /strippart "adsp_proc" /sourcepath "."
            &AudioELF="M8992AAAAAAAAQ1234_AUDIO"
            print "8992 Loading ELF Done"
        )
    )
    else
    (
        print "8992 Loading ELF: .\build\ms\M8992AAAAAAAAQ1234.elf"
        d.load.elf .\build\ms\M8992AAAAAAAAQ1234.elf /NOCODE /NOREG /NOCLEAR /NOMAP /strippart "adsp_proc" /sourcepath "."
        &ELF="M8992AAAAAAAAQ1234"
        print "8992 Loading ELF Done"
        if OS.FILE(.\build\ms\M8992AAAAAAAAQ1234_SENSOR.elf)
        (
            print "8992 Loading ELF: .\build\ms\M8992AAAAAAAAQ1234_SENSOR.elf"
            d.load.elf .\build\ms\M8992AAAAAAAAQ1234_SENSOR.elf /NOCODE /NOREG /NOCLEAR /NOMAP /strippart "adsp_proc" /sourcepath "."
            &SensorsELF="M8992AAAAAAAAQ1234_Sensor"
            print "8992 Loading ELF Done"
        )
        &AudioELF="M8992AAAAAAAAQ1234"
        if OS.FILE(.\build\ms\M8992AAAAAAAAQ1234_AUDIO.elf)
        (
            print "8992 Loading ELF: .\build\ms\M8992AAAAAAAAQ1234_AUDIO.elf"
            d.load.elf .\build\ms\M8992AAAAAAAAQ1234_AUDIO.elf /NOCODE /NOREG /NOCLEAR /NOMAP /strippart "adsp_proc" /sourcepath "."
            &AudioELF="M8992AAAAAAAAQ1234_AUDIO"
            print "8992 Loading ELF Done"
        )
    )	
)
else if OS.FILE(.\build\ms\M8952AAAAAAAAQ1234.elf)
(
	if OS.FILE(&Customer_Elf_Path\M8952AAAAAAAAQ1234.elf) 
    (
        print "8952 Loading ELF: &Customer_Elf_Path\M8952AAAAAAAAQ1234.elf"
        d.load.elf &Customer_Elf_Path\M8952AAAAAAAAQ1234.elf /NOCODE /NOREG /NOCLEAR /NOMAP /strippart "adsp_proc" /sourcepath "."
        &ELF="M8952AAAAAAAAQ1234"
        print "8952 Loading ELF Done"
        if OS.FILE(&Customer_Elf_Path\M8952AAAAAAAAQ1234_SENSOR.elf)
        (
            print "8952 Loading ELF: &Customer_Elf_Path\M8952AAAAAAAAQ1234_SENSOR.elf"
            d.load.elf &Customer_Elf_Path\M8952AAAAAAAAQ1234_SENSOR.elf /NOCODE /NOREG /NOCLEAR /NOMAP /strippart "adsp_proc" /sourcepath "."
            &SensorsELF="M8952AAAAAAAAQ1234_Sensor"
            print "8952 Loading ELF Done"
        )
        &AudioELF="M8952AAAAAAAAQ1234"
        if OS.FILE(&Customer_Elf_Path\M8952AAAAAAAAQ1234_AUDIO.elf)
        (
            print "8952 Loading ELF: &Customer_Elf_Path\M8952AAAAAAAAQ1234_AUDIO.elf"
            d.load.elf &Customer_Elf_Path\M8952AAAAAAAAQ1234_AUDIO.elf /NOCODE /NOREG /NOCLEAR /NOMAP /strippart "adsp_proc" /sourcepath "."
            &AudioELF="M8952AAAAAAAAQ1234_AUDIO"
            print "8952 Loading ELF Done"
        )
    )
    else
    (
        print "8952 Loading ELF: .\build\ms\M8952AAAAAAAAQ1234.elf"
        d.load.elf .\build\ms\M8952AAAAAAAAQ1234.elf /NOCODE /NOREG /NOCLEAR /NOMAP /strippart "adsp_proc" /sourcepath "."
        &ELF="M8952AAAAAAAAQ1234"
        print "8952 Loading ELF Done"
        if OS.FILE(.\build\ms\M8952AAAAAAAAQ1234_SENSOR.elf)
        (
            print "8952 Loading ELF: .\build\ms\M8952AAAAAAAAQ1234_SENSOR.elf"
            d.load.elf .\build\ms\M8952AAAAAAAAQ1234_SENSOR.elf /NOCODE /NOREG /NOCLEAR /NOMAP /strippart "adsp_proc" /sourcepath "."
            &SensorsELF="M8952AAAAAAAAQ1234_Sensor"
            print "8952 Loading ELF Done"
        )
        &AudioELF="M8952AAAAAAAAQ1234"
        if OS.FILE(.\build\ms\M8952AAAAAAAAQ1234_AUDIO.elf)
        (
            print "8952 Loading ELF: .\build\ms\M8952AAAAAAAAQ1234_AUDIO.elf"
            d.load.elf .\build\ms\M8952AAAAAAAAQ1234_AUDIO.elf /NOCODE /NOREG /NOCLEAR /NOMAP /strippart "adsp_proc" /sourcepath "."
            &AudioELF="M8952AAAAAAAAQ1234_AUDIO"
            print "8952 Loading ELF Done"
        )
    )	
)
else if OS.FILE(.\build\ms\M8976AAAAAAAAQ1234.elf)
(
	if OS.FILE(&Customer_Elf_Path\M8976AAAAAAAAQ1234.elf) 
    (
        print "8976 Loading ELF: &Customer_Elf_Path\M8976AAAAAAAAQ1234.elf"
        d.load.elf &Customer_Elf_Path\M8976AAAAAAAAQ1234.elf /NOCODE /NOREG /NOCLEAR /NOMAP /strippart "adsp_proc" /sourcepath "."
        &ELF="M8976AAAAAAAAQ1234"
        print "8976 Loading ELF Done"
        if OS.FILE(&Customer_Elf_Path\M8976AAAAAAAAQ1234_SENSOR.elf)
        (
            print "8976 Loading ELF: &Customer_Elf_Path\M8976AAAAAAAAQ1234_SENSOR.elf"
            d.load.elf &Customer_Elf_Path\M8976AAAAAAAAQ1234_SENSOR.elf /NOCODE /NOREG /NOCLEAR /NOMAP /strippart "adsp_proc" /sourcepath "."
            &SensorsELF="M8976AAAAAAAAQ1234_Sensor"
            print "8976 Loading ELF Done"
        )
        &AudioELF="M8976AAAAAAAAQ1234"
        if OS.FILE(&Customer_Elf_Path\M8976AAAAAAAAQ1234_AUDIO.elf)
        (
            print "8976 Loading ELF: &Customer_Elf_Path\M8976AAAAAAAAQ1234_AUDIO.elf"
            d.load.elf &Customer_Elf_Path\M8976AAAAAAAAQ1234_AUDIO.elf /NOCODE /NOREG /NOCLEAR /NOMAP /strippart "adsp_proc" /sourcepath "."
            &AudioELF="M8976AAAAAAAAQ1234_AUDIO"
            print "8976 Loading ELF Done"
        )
    )
    else
    (
        print "8976 Loading ELF: .\build\ms\M8976AAAAAAAAQ1234.elf"
        d.load.elf .\build\ms\M8976AAAAAAAAQ1234.elf /NOCODE /NOREG /NOCLEAR /NOMAP /strippart "adsp_proc" /sourcepath "."
        &ELF="M8976AAAAAAAAQ1234"
        print "8976 Loading ELF Done"
        if OS.FILE(.\build\ms\M8976AAAAAAAAQ1234_SENSOR.elf)
        (
            print "8976 Loading ELF: .\build\ms\M8976AAAAAAAAQ1234_SENSOR.elf"
            d.load.elf .\build\ms\M8976AAAAAAAAQ1234_SENSOR.elf /NOCODE /NOREG /NOCLEAR /NOMAP /strippart "adsp_proc" /sourcepath "."
            &SensorsELF="M8976AAAAAAAAQ1234_Sensor"
            print "8976 Loading ELF Done"
        )
        &AudioELF="M8976AAAAAAAAQ1234"
        if OS.FILE(.\build\ms\M8976AAAAAAAAQ1234_AUDIO.elf)
        (
            print "8976 Loading ELF: .\build\ms\M8976AAAAAAAAQ1234_AUDIO.elf"
            d.load.elf .\build\ms\M8976AAAAAAAAQ1234_AUDIO.elf /NOCODE /NOREG /NOCLEAR /NOMAP /strippart "adsp_proc" /sourcepath "."
            &AudioELF="M8976AAAAAAAAQ1234_AUDIO"
            print "8976 Loading ELF Done"
        )
    )	
)
else if OS.FILE(.\build\ms\M9x25AAAAAAAAAQ1234.elf)
(
	if OS.FILE(&Customer_Elf_Path\M9x25AAAAAAAAAQ1234.elf) 
    (
        print "9x25 Loading ELF: &Customer_Elf_Path\M9x25AAAAAAAAAQ1234.elf"
        d.load.elf &Customer_Elf_Path\M9x25AAAAAAAAAQ1234.elf /NOCODE /NOREG /NOCLEAR /NOMAP /strippart "adsp_proc" /sourcepath "."
        &ELF="M9x25AAAAAAAAAQ1234"
        print "9x25 Loading ELF Done"
    )
    else
    (
        print "9x25 Loading ELF: .\build\ms\M9x25AAAAAAAAAQ1234.elf"
        d.load.elf .\build\ms\M9x25AAAAAAAAAQ1234.elf /NOCODE /NOREG /NOCLEAR /NOMAP /strippart "adsp_proc" /sourcepath "."
        &ELF="M9x25AAAAAAAAAQ1234"
        print "9x25 Loading ELF Done"
    )	
)
else if OS.FILE(.\build\ms\M9x35AAAAAAAAQ1234.elf)
(
	if OS.FILE(&Customer_Elf_Path\M9x35AAAAAAAAQ1234.elf) 
    (
        print "9x35 Loading ELF: &Customer_Elf_Path\M9x35AAAAAAAAQ1234.elf"
        d.load.elf &Customer_Elf_Path\M9x35AAAAAAAAQ1234.elf /NOCODE /NOREG /NOCLEAR /NOMAP /strippart "adsp_proc" /sourcepath "."
        &ELF="M9x35AAAAAAAAQ1234"
        print "9x35 Loading ELF Done"
    )
    else
    (
        print "9x35 Loading ELF: .\build\ms\M9x35AAAAAAAAQ1234.elf"
        d.load.elf .\build\ms\M9x35AAAAAAAAQ1234.elf /NOCODE /NOREG /NOCLEAR /NOMAP /strippart "adsp_proc" /sourcepath "."
        &ELF="M9x35AAAAAAAAQ1234"
        print "9x35 Loading ELF Done"
    )	
)
else if OS.FILE(.\build\ms\M8996AAAAAAAAQ1234.elf)
(
	if OS.FILE(&Customer_Elf_Path\M8996AAAAAAAAQ1234.elf) 
    (
        print "8996 Loading ELF: &Customer_Elf_Path\M8996AAAAAAAAQ1234.elf"
        d.load.elf &Customer_Elf_Path\M8996AAAAAAAAQ1234.elf /NOCODE /NOREG /NOCLEAR /NOMAP /strippart "adsp_proc" /sourcepath "."        
        &ELF="M8996AAAAAAAAQ1234"
        print "8996 Loading ELF Done"
        &AudioELF="M8996AAAAAAAAQ1234"
        if OS.FILE(&Customer_Elf_Path\M8996AAAAAAAAQ1234_AUDIO.elf)
        (
            print "8996 Loading ELF: &Customer_Elf_Path\M8996AAAAAAAAQ1234_AUDIO.elf"
            d.load.elf &Customer_Elf_Path\M8996AAAAAAAAQ1234_AUDIO.elf /NOCODE /NOREG /NOCLEAR /NOMAP /strippart "adsp_proc" /sourcepath "."
            &AudioELF="M8996AAAAAAAAQ1234_AUDIO"
            print "8996 Loading ELF Done"
        )
    )
    else
    (
        print "8996 Loading ELF: .\build\ms\M8996AAAAAAAAQ1234.elf"
        d.load.elf .\build\ms\M8996AAAAAAAAQ1234.elf /NOCODE /NOREG /NOCLEAR /NOMAP /strippart "adsp_proc" /sourcepath "."        
        &ELF="M8996AAAAAAAAQ1234"
        print "8996 Loading ELF Done"
        &AudioELF="M8996AAAAAAAAQ1234"
        if OS.FILE(.\build\ms\M8996AAAAAAAAQ1234_AUDIO.elf)
        (
            print "8996 Loading ELF: .\build\ms\M8996AAAAAAAAQ1234_AUDIO.elf"
            d.load.elf .\build\ms\M8996AAAAAAAAQ1234_AUDIO.elf /NOCODE /NOREG /NOCLEAR /NOMAP /strippart "adsp_proc" /sourcepath "."
            &AudioELF="M8996AAAAAAAAQ1234_AUDIO"
            print "8996 Loading ELF Done"
        )
    )
)
&check_path="&CurrentDirectory"
if OS.FILE(&ADSP_BUILDROOT\core\kernel\qurt\build\core_libs\qdsp6\AAAAAAAA\install\ADSPv56MP\debugger\T32\qurt_model.t32)
(
    &check_path="&ADSP_BUILDROOT\core\kernel\qurt\build\core_libs\qdsp6\AAAAAAAA\install\ADSPv56MP\debugger\T32"
)
if OS.FILE(&ADSP_BUILDROOT\core\kernel\qurt\build\adsp_link\qdsp6\AAAAAAAA\install\ADSPv60MP\debugger\T32\qurt_model.t32)
(
    &check_path="&ADSP_BUILDROOT\core\kernel\qurt\build\adsp_link\qdsp6\AAAAAAAA\install\ADSPv60MP\debugger\T32"
)
else if OS.FILE(&ADSP_BUILDROOT\core\kernel\qurt\build\adsp_link\qdsp6\AAAAAAAA\install\ADSPv56MP\debugger\T32\qurt_model.t32)
(
    &check_path="&ADSP_BUILDROOT\core\kernel\qurt\build\adsp_link\qdsp6\AAAAAAAA\install\ADSPv56MP\debugger\T32"
)
else if OS.FILE(&ADSP_BUILDROOT\core\kernel\qurt\build\slpi_root\qdsp6\AAAAAAAA\install\sensorsv60_v1\debugger\T32\qurt_model.t32)
(
    &check_path="&ADSP_BUILDROOT\core\kernel\qurt\build\slpi_root\qdsp6\AAAAAAAA\install\sensorsv60_v1\debugger\T32"
)
else if OS.FILE(&ADSP_BUILDROOT\core\kernel\qurt\build\ssc_slpi_user\qdsp6\AAAAAAAA\install\sensorsv60_v1\debugger\T32\qurt_model.t32)
(
    &check_path="&ADSP_BUILDROOT\core\kernel\qurt\build\ssc_slpi_user\qdsp6\AAAAAAAA\install\sensorsv60_v1\debugger\T32"
)
print "##########################"
if ("&slpi"=="True")
(
    // initialize the variables first0x00c00078
    trans.off
    trans.reset
    mmu.reset
    &Qube_va_guestos=0xf0100000
    &Qube_pa_guestos=&dspaddr
    if (Y.EXIST(\\M8996AAAAAAAAQ1234\Global\start))
    (
       &Qube_va_guestos=address.offset(\\M8996AAAAAAAAQ1234\Global\start)
    )
    print "DSP SensorPD1 address virtual=&Qube_va_guestos  physical=0x" &Qube_pa_guestos

	
	print "mmu.create &Qube_va_guestos--(&Qube_va_guestos+0x1900000) &Qube_pa_guestos--(&Qube_pa_guestos+0x1900000)"
	mmu.create &Qube_va_guestos--(&Qube_va_guestos+0x1900000) &Qube_pa_guestos--(&Qube_pa_guestos+0x1900000)

    mmu.on
    ;mmu.autoscan on
    ;mmu.tablewalk on
    ; LOAD RTOS AWARENESS MODULE  
    
    TASK.CONFIG &check_path\qurt_model.t32
    MENU.ReProgram &check_path\qurt_model.men
    
    printer.file &OutputPath_temp\DSP_pgt.txt
    printer.filetype ASCII 
    printer.size 0xfa, 0xfa
    wp.task.pgt 
    
)
else if ("&Target_Name"=="8994")
(
    trans.off
    trans.reset
    &Qube_va_guestos=address.offset(start)
    &Qube_pa_guestos=&dspaddr
    &Qube_va_island=0xf0000000

    mmu.format QURT d.l(QURTK_pagetables) &Qube_va_guestos--(&Qube_va_guestos+0xffffff) &Qube_pa_guestos
    trans.tablewalk.on
    ;trans.autoenable
    trans.on
    &pagetable=d.l(QURTK_pagetables)
    print "Page table address = &pagetable"
    &cmd_4 = "d.dump \\M8994AAAAAAAAQ1234\Global\start "
    os.hidden &cmd_4
    &cmd_5 = "d.dump a:&dspaddr"
    os.hidden &cmd_5
    ;dialog.message "Loaded Page TABLES22"
    task.config &check_path\qurt_model.t32
    menu.rp &check_path\qurt_model.men
    &cmd_6 = "area//components/dev/dspcore.adsp/2.5/ypatnana.dspcore.adsp.2.5.Crashman8994Final96187/scripts/crashman/Start_Address.py"
    os.hidden &cmd_6
    mmu.create 0xF0000000--0xF0010000 0xFE400000
    // turn on mmu
    PER.Set REG:0x12 %Long 0x9
    DATA.COPY y.range(qurt_tcm_dump) a:&TCM_BASE
    mmu.create &Qube_va_island--(&Qube_va_island+0x80000) &TCM_BASE
    ;dialog.message "Loaded Page TABLES00"
    // write task.pgt out
    printer.file &OutputPath_temp\DSP_pgt.txt
    printer.filetype ASCII 
    printer.size 0xfa, 0xfa
    wp.task.pgt
    ;dialog.message "Loaded Page TABLES11"
    // remove forced mmu
    mmu.delete &Qube_va_island--(&Qube_va_island+0x80000)
    mmu.on
)
else if ("&Target_Name"=="8992")
(
    trans.off
    trans.reset
    &Qube_va_guestos=address.offset(start)
    &Qube_pa_guestos=&dspaddr
    &Qube_va_island=0xf0000000

    mmu.format QURT d.l(QURTK_pagetables) &Qube_va_guestos--(&Qube_va_guestos+0xffffff) &Qube_pa_guestos
    trans.tablewalk.on
    ;trans.autoenable
    trans.on
    &pagetable=d.l(QURTK_pagetables)
    print "Page table address = &pagetable"
    &cmd_4 = "d.dump \\M8992AAAAAAAAQ1234\Global\start "
    os.hidden &cmd_4
    &cmd_5 = "d.dump a:&dspaddr"
    os.hidden &cmd_5
    ;dialog.message "Loaded Page TABLES22"
    task.config &check_path\qurt_model.t32
    menu.rp &check_path\qurt_model.men
    &cmd_6 = "area//components/dev/dspcore.adsp/2.5/ypatnana.dspcore.adsp.2.5.Crashman8994Final96187/scripts/crashman/Start_Address.py"
    os.hidden &cmd_6
    mmu.create 0xF0000000--0xF0010000 0xFE400000
    // turn on mmu
    PER.Set REG:0x12 %Long 0x9
    DATA.COPY y.range(qurt_tcm_dump) a:&TCM_BASE
    mmu.create &Qube_va_island--(&Qube_va_island+0x80000) &TCM_BASE
    ;dialog.message "Loaded Page TABLES00"
    // write task.pgt out
    printer.file &OutputPath_temp\DSP_pgt.txt
    printer.filetype ASCII 
    printer.size 0xfa, 0xfa
    wp.task.pgt
    ;dialog.message "Loaded Page TABLES11"
    // remove forced mmu
    mmu.delete &Qube_va_island--(&Qube_va_island+0x80000)
    ;dialog.message "Loaded Page TABLES1"
    mmu.on
)
else if ("&Target_Name"=="8952")
(
    trans.off
    trans.reset
    &Qube_va_guestos=address.offset(start)
    &Qube_pa_guestos=&dspaddr
    &Qube_va_island=0xf0000000

    mmu.format QURT d.l(QURTK_pagetables) &Qube_va_guestos--(&Qube_va_guestos+0xffffff) &Qube_pa_guestos
    trans.tablewalk.on
    ;trans.autoenable
    trans.on
    &pagetable=d.l(QURTK_pagetables)
    print "Page table address = &pagetable"
    &cmd_4 = "d.dump \\M8952AAAAAAAAQ1234\Global\start "
    os.hidden &cmd_4
    &cmd_5 = "d.dump a:&dspaddr"
    os.hidden &cmd_5
    ;dialog.message "Loaded Page TABLES22"
    task.config &check_path\qurt_model.t32
    menu.rp &check_path\qurt_model.men
    &cmd_6 = "area//components/dev/dspcore.adsp/2.5/ypatnana.dspcore.adsp.2.5.Crashman8994Final96187/scripts/crashman/Start_Address.py"
    os.hidden &cmd_6
    mmu.create 0xF0000000--0xF0010000 0xFE400000
    // turn on mmu
    PER.Set REG:0x12 %Long 0x9
    DATA.COPY y.range(qurt_tcm_dump) a:&TCM_BASE
    mmu.create &Qube_va_island--(&Qube_va_island+0x80000) &TCM_BASE
    ;dialog.message "Loaded Page TABLES00"
    // write task.pgt out
    printer.file &OutputPath_temp\DSP_pgt.txt
    printer.filetype ASCII 
    printer.size 0xfa, 0xfa
    wp.task.pgt
    ;dialog.message "Loaded Page TABLES11"
    // remove forced mmu
    mmu.delete &Qube_va_island--(&Qube_va_island+0x80000)
    mmu.on
)
else if ("&Target_Name"=="8976")
(
    trans.off
    trans.reset
    &Qube_va_guestos=address.offset(start)
    &Qube_pa_guestos=&dspaddr
    &Qube_va_island=0xf0000000

    mmu.format QURT d.l(QURTK_pagetables) &Qube_va_guestos--(&Qube_va_guestos+0xffffff) &Qube_pa_guestos
    trans.tablewalk.on
    ;trans.autoenable
    trans.on
    &pagetable=d.l(QURTK_pagetables)
    print "Page table address = &pagetable"
    &cmd_4 = "d.dump \\M8976AAAAAAAAQ1234\Global\start "
    os.hidden &cmd_4
    &cmd_5 = "d.dump a:&dspaddr"
    os.hidden &cmd_5
    ;dialog.message "Loaded Page TABLES22"
    task.config &check_path\qurt_model.t32
    menu.rp &check_path\qurt_model.men
    &cmd_6 = "area//components/dev/dspcore.adsp/2.5/ypatnana.dspcore.adsp.2.5.Crashman8994Final96187/scripts/crashman/Start_Address.py"
    os.hidden &cmd_6
    mmu.create 0xF0000000--0xF0010000 0xFE400000
    // turn on mmu
    PER.Set REG:0x12 %Long 0x9
    DATA.COPY y.range(qurt_tcm_dump) a:&TCM_BASE
    mmu.create &Qube_va_island--(&Qube_va_island+0x80000) &TCM_BASE
    ;dialog.message "Loaded Page TABLES00"
    // write task.pgt out
    printer.file &OutputPath_temp\DSP_pgt.txt
    printer.filetype ASCII 
    printer.size 0xfa, 0xfa
    wp.task.pgt
    ;dialog.message "Loaded Page TABLES11"
    // remove forced mmu
    mmu.delete &Qube_va_island--(&Qube_va_island+0x80000)
    mmu.on
)
else if ("&Target_Name"=="8996")
(
    // initialize the variables first0x00c00078
    &Qube_pa_userpd1=0x07600000
    &matchAddr=0x07600000
    data.find A:0x07500000--0x077fffff %LONG %LE 0x7800c000
    if found()
    (    
        &matchAddr=(address.offset(track.address())-4)
        print "USER PD start address found 0x" &matchAddr
    )

    ;&Qube_va_guestos=address.offset(start);
    &Qube_pa_guestos=&dspaddr
    &Qube_va_userpd1=0xb0000000
    &Qube_pa_userpd1=0x8d400000
    print "DSP UserPD1 address vritual=0xf0000000  physical=0x" &Qube_pa_guestos

	
	
	mmu.create 0xf0000000--(0xf0000000+0x1900000) &Qube_pa_guestos--(&Qube_pa_guestos+0x1900000)

    mmu.format Blast QURTK_pagetables 0xf0000000--(0xf0000000+0xffffff) &Qube_pa_guestos
    ; mmu.create &Qube_va_userpd1--(&Qube_va_userpd1+0x500000) &Qube_pa_userpd1--(&Qube_pa_userpd1+0x500000)

    mmu.on
    mmu.autoscan on
    mmu.tablewalk on

    ; LOAD RTOS AWARENESS MODULE
    TASK.CONFIG &CurrentDirectory\qurt_model.t32
    MENU.ReProgram &CurrentDirectory\qurt_model.men
    printer.file &OutputPath_temp\DSP_pgt.txt
    printer.filetype ASCII 
    printer.size 0xfa, 0xfa
    wp.task.pgt
)
else
(
    // initialize the variables first0x00c00078
    &Qube_pa_userpd1=0x07600000
    &matchAddr=0x07600000
    data.find A:0x07500000--0x077fffff %LONG %LE 0x7800c000
    if found()
    (    
        &matchAddr=(address.offset(track.address())-4)
        print "USER PD start address found 0x" &matchAddr
    )

    &Qube_va_guestos=address.offset(start);
    &Qube_pa_guestos=&dspaddr
    print "DSP guest OS address vritual=0x" &Qube_va_guestos " physical=0x" &Qube_pa_guestos
    &Qube_va_userpd1=0x2da00000
    &Qube_pa_userpd1=&matchAddr
    print "DSP UserPD1 address vritual=0x" &Qube_va_userpd1 " physical=0x" &Qube_pa_userpd1

    mmu.create &Qube_va_guestos--(&Qube_va_guestos+0x1300000) &Qube_pa_guestos--(&Qube_pa_guestos+0x1300000)
    mmu.format Blast QURTK_pagetables &Qube_va_guestos--(&Qube_va_guestos+0xffffff) &Qube_pa_guestos
    if ("&ELF"!="M8x10AAAAAAAAQ1234")
    (
        mmu.create &Qube_va_userpd1--(&Qube_va_userpd1+0x500000) &Qube_pa_userpd1--(&Qube_pa_userpd1+0x500000)
    )
    mmu.on
    mmu.autoscan on
    mmu.tablewalk on

    ; LOAD RTOS AWARENESS MODULE
    TASK.CONFIG &CurrentDirectory\qurt_model.t32
    MENU.ReProgram &CurrentDirectory\qurt_model.men
    printer.file &OutputPath_temp\DSP_pgt.txt
    printer.filetype ASCII 
    printer.size 0xfa, 0xfa
    wp.task.pgt
)


mmu.create 0xf0000000--(0xf0000000+0xFFFFF) &Qube_pa_guestos_click--(&Qube_pa_guestos_click+0xFFFFF)

;;;Cache Flush Check
var.new \QURTK_flush_cache_status_var
var.set \QURTK_flush_cache_status_var=QURTK_flush_cache_status
&FlushFlag=v.value(\QURTK_flush_cache_status_var)
if (&FlushFlag==1)
(
)
else if (&FlushFlag==2)
(
    print "cache is flushed except the following information: L2VIC interrupt table and TCM dump are not flushed"
    ;dialog.message "cache is flushed except the following information: L2VIC interrupt table and TCM dump are not flushed"
)
else if (&FlushFlag==3)
(
    print "Receive External NMI (watchdog) while handling a FATAL exception"
    ;dialog.message "Receive External NMI (watchdog) while handling a FATAL exception"
)
else
(
    print %ERROR "Dumps provided are not Cache Flushed - Level2 of validating Dumps Failed with QURTK_flush_cache_status:&FlushFlag"
    dialog.message "Dumps provided are not Cache Flushed - Level2 of validating Dumps Failed"
)


;***************************
;;;Cache Flush Check End
;***************************

cd &CurrentDirectory
;******************************************************
;;;Loading page tables
;******************************************************
if ((&FlushFlag==1)||(&FlushFlag==2)||(&FlushFlag==3))
(
    if ("&slpi"=="True")
    (
        do DSP_load_pagetables_8994.cmm &OutputPath
    )
    else if ("&Target_Name"=="8994")
    (
        do DSP_load_pagetables_8994.cmm &OutputPath
    )    
    else if ("&Target_Name"=="8992")
    (
        do DSP_load_pagetables_8994.cmm &OutputPath
    )    
    else if ("&Target_Name"=="8952")
    (
        do DSP_load_pagetables_8994.cmm &OutputPath
    )    
    else
    (
        do DSP_load_pagetables.cmm &OutputPath
    )
    print "Loaded page tables"
    printer.file &OutputPath\Crashman_Log.txt
    printer.filetype ascii
    printer.size 0xfa,0xfa
    wp.area.view Crashman
)
else
(
    ;Loading Page tables only when dumps are cache flushed inorder not to be stopped in cmm 
)    
;***************************
;;;Loading page tables End
;***************************

;******************************************************
;;;Run analy_qurt_error
;******************************************************
if ((&FlushFlag==1)||(&FlushFlag==2)||(&FlushFlag==3))
(
    area.select Crashman
    print "Processing analy_qurt_error.cmm Script"
    printer.file &OutputPath\Crashman_Log.txt
    printer.filetype ascii
    printer.size 0xfa,0xfa
    wp.area.view Crashman
    do analy_qurt_error.cmm
    WINclear TOP
    area.select Crashman
    print "Processing analy_qurt_error.cmm Script Done"
    printer.file &OutputPath\Crashman_Log.txt
    printer.filetype ascii
    printer.size 0xfa,0xfa
    wp.area.view Crashman
    printer.file &OutputPath\Area_IO.txt
    printer.filetype ascii
    printer.size 0xfa,0xfa
    wp.Area IO
)
else
(
    ;Running analy qurt error script only when dumps are cache flushed inorder not to be stopped in cmm 
)    
;***************************
;;;Run analy_qurt_error End
;***************************

;******************************************************
;;;Update Callstack
;******************************************************
if ((&FlushFlag==1)||(&FlushFlag==2)||(&FlushFlag==3))
(
    do callstack_analysis.cmm &OutputPath
)
else
(
    ;Running analy qurt error script only when dumps are cache flushed inorder not to be stopped in cmm 
)    

;************************
;;;Update Callstack End
;************************
area.select Crashman
print "Loading Dumps. Done"
printer.file &OutputPath\Crashman_Log.txt
printer.filetype ascii
printer.size 0xfa,0xfa
wp.area.view Crashman
