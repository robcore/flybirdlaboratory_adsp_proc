;----------------------------------------------------------------------------
; Set the desired CPU
;----------------------------------------------------------------------------
sys.d
system.cpu CortexM3

;----------------------------------------------------------------------------
; Attach to the Virtio simulation
;----------------------------------------------------------------------------
system.multicore core "RPM_CortexM3"
system.mode.attach

;----------------------------------------------------------------------------
; Print banner
;----------------------------------------------------------------------------
print "VPMSM8994: RPMSS"
title "VPMSM8994: RPMSS_M3"

;----------------------------------------------------------------------------
; Init SMEM workaround
;----------------------------------------------------------------------------
d.load.binary smem.bin 0x06A00000 /noclear /nosymbol

;----------------------------------------------------------------------------
; Load RPM
;----------------------------------------------------------------------------
// Prompt the user for the RPM .ELF file.  
PRINT "Point to the RPM .elf file."
DIALOG.FILE *.elf
ENTRY &ELFILE

&RPM_ELFDIR=OS.FILE.PATH(&ELFILE)
&RPM_BUILDROOT="&RPM_ELFDIR\..\..\..\..\.."

D.LOAD.ELF &ELFILE /strippart "rpm_proc" /sourcepath "&RPM_BUILDROOT/rpm_proc"

;----------------------------------------------------------------------------
; Breakpoints
;----------------------------------------------------------------------------
b.s abort /o
b.s abort_isr /o
b.s main /o

b.l
d.l

;----------------------------------------------------------------------------
; Start Platform
;----------------------------------------------------------------------------
g
